ASAP2_VERSION 1 40
/begin PROJECT ProjectName "Project Comment Goes Here"
/begin HEADER "Header Comments go here" /end HEADER
/begin MODULE ModuleName "Module Comment Goes Here"
/begin MOD_COMMON "Mod Common Comment Here" BYTE_ORDER MSB_LAST ALIGNMENT_BYTE 1 ALIGNMENT_WORD 1 ALIGNMENT_LONG 1 ALIGNMENT_FLOAT32_IEEE 1 ALIGNMENT_FLOAT64_IEEE 1 /end MOD_COMMON
/begin COMPU_METHOD swc_BatBalnCtl_CM_boolean_dash_ "Q = V" RAT_FUNC "%1.0" "-" COEFFS 0 1 0 0 0 1 /end COMPU_METHOD
/begin COMPU_METHOD swc_BatBalnCtl_CM_single__ "Q = V" RAT_FUNC "%8.6" "癈" COEFFS 0 1 0 0 0 1 /end COMPU_METHOD
/begin COMPU_METHOD swc_BatBalnCtl_CM_single_A "Q = V" RAT_FUNC "%8.6" "A" COEFFS 0 1 0 0 0 1 /end COMPU_METHOD
/begin COMPU_METHOD swc_BatBalnCtl_CM_single_dash_ "Q = V" RAT_FUNC "%8.6" "-" COEFFS 0 1 0 0 0 1 /end COMPU_METHOD
/begin COMPU_METHOD swc_BatBalnCtl_CM_single_V "Q = V" RAT_FUNC "%8.6" "V" COEFFS 0 1 0 0 0 1 /end COMPU_METHOD
/begin COMPU_METHOD swc_BatBalnCtl_CM_uint16_dash_ "Q = V" RAT_FUNC "%5.0" "-" COEFFS 0 1 0 0 0 1 /end COMPU_METHOD
/begin COMPU_METHOD swc_BatBalnCtl_CM_uint16_s "Q = V" RAT_FUNC "%5.0" "s" COEFFS 0 1 0 0 0 1 /end COMPU_METHOD
/begin COMPU_METHOD swc_BatBalnCtl_CM_uint32_s "Q = V" RAT_FUNC "%10.0" "s" COEFFS 0 1 0 0 0 1 /end COMPU_METHOD
/begin COMPU_METHOD swc_BatBalnCtl_CM_uint8_dash_ "Q = V" RAT_FUNC "%3.0" "-" COEFFS 0 1 0 0 0 1 /end COMPU_METHOD
/begin COMPU_METHOD swc_BatCoreFct_CM_boolean_dash_ "Q = V" RAT_FUNC "%1.0" "-" COEFFS 0 1 0 0 0 1 /end COMPU_METHOD
/begin COMPU_METHOD swc_BatCoreFct_CM_single__ "Q = V" RAT_FUNC "%8.6" "癈" COEFFS 0 1 0 0 0 1 /end COMPU_METHOD
/begin COMPU_METHOD swc_BatCoreFct_CM_single_A "Q = V" RAT_FUNC "%8.6" "A" COEFFS 0 1 0 0 0 1 /end COMPU_METHOD
/begin COMPU_METHOD swc_BatCoreFct_CM_single_dash_ "Q = V" RAT_FUNC "%8.6" "-" COEFFS 0 1 0 0 0 1 /end COMPU_METHOD
/begin COMPU_METHOD swc_BatCoreFct_CM_single_Ohm "Q = V" RAT_FUNC "%8.6" "Ohm" COEFFS 0 1 0 0 0 1 /end COMPU_METHOD
/begin COMPU_METHOD swc_BatCoreFct_CM_single_s "Q = V" RAT_FUNC "%8.6" "s" COEFFS 0 1 0 0 0 1 /end COMPU_METHOD
/begin COMPU_METHOD swc_BatCoreFct_CM_single_V "Q = V" RAT_FUNC "%8.6" "V" COEFFS 0 1 0 0 0 1 /end COMPU_METHOD
/begin COMPU_METHOD swc_BatCoreFct_CM_uint32_s "Q = V" RAT_FUNC "%10.0" "s" COEFFS 0 1 0 0 0 1 /end COMPU_METHOD
/begin COMPU_METHOD swc_BatThermHndlgMngt_CM_int16_dash_ "Q = V" RAT_FUNC "%5.0" "-" COEFFS 0 1 0 0 0 1 /end COMPU_METHOD
/begin COMPU_METHOD swc_BatThermHndlgMngt_CM_single__ "Q = V" RAT_FUNC "%8.6" "癈" COEFFS 0 1 0 0 0 1 /end COMPU_METHOD
/begin COMPU_METHOD swc_BatThermHndlgMngt_CM_single_dash_ "Q = V" RAT_FUNC "%8.6" "-" COEFFS 0 1 0 0 0 1 /end COMPU_METHOD
/begin COMPU_METHOD swc_BatThermHndlgMngt_CM_uint32_dash_ "Q = V" RAT_FUNC "%10.0" "-" COEFFS 0 1 0 0 0 1 /end COMPU_METHOD
/begin COMPU_METHOD swc_BatThermHndlgMngt_CM_uint8_dash_ "Q = V" RAT_FUNC "%3.0" "-" COEFFS 0 1 0 0 0 1 /end COMPU_METHOD
/begin COMPU_METHOD swc_BatWntyLogtcData_CM_uint8_dash_ "Q = V" RAT_FUNC "%3.0" "-" COEFFS 0 1 0 0 0 1 /end COMPU_METHOD
/begin COMPU_METHOD swc_BcuStTranCtl_CM_single_A "Q = V" RAT_FUNC "%8.6" "A" COEFFS 0 1 0 0 0 1 /end COMPU_METHOD
/begin COMPU_METHOD swc_BcuStTranCtl_CM_single_min "Q = V" RAT_FUNC "%8.6" "min" COEFFS 0 1 0 0 0 1 /end COMPU_METHOD
/begin COMPU_METHOD swc_BcuStTranCtl_CM_single_s "Q = V" RAT_FUNC "%8.6" "s" COEFFS 0 1 0 0 0 1 /end COMPU_METHOD
/begin COMPU_METHOD swc_BcuStTranCtl_CM_uint32_dash_ "Q = V" RAT_FUNC "%10.0" "-" COEFFS 0 1 0 0 0 1 /end COMPU_METHOD
/begin COMPU_METHOD swc_BcuStTranCtl_CM_uint8_dash_ "Q = V" RAT_FUNC "%3.0" "-" COEFFS 0 1 0 0 0 1 /end COMPU_METHOD
/begin COMPU_METHOD swc_COL_CM_single___C "Q = V" RAT_FUNC "%8.6" "??C" COEFFS 0 1 0 0 0 1 /end COMPU_METHOD
/begin COMPU_METHOD swc_COL_CM_single_A "Q = V" RAT_FUNC "%8.6" "A" COEFFS 0 1 0 0 0 1 /end COMPU_METHOD
/begin COMPU_METHOD swc_COL_CM_single_dash_ "Q = V" RAT_FUNC "%8.6" "-" COEFFS 0 1 0 0 0 1 /end COMPU_METHOD
/begin COMPU_METHOD swc_COL_CM_single_kWh "Q = V" RAT_FUNC "%8.6" "kWh" COEFFS 0 1 0 0 0 1 /end COMPU_METHOD
/begin COMPU_METHOD swc_COL_CM_single_min "Q = V" RAT_FUNC "%8.6" "min" COEFFS 0 1 0 0 0 1 /end COMPU_METHOD
/begin COMPU_METHOD swc_COL_CM_single_percent_ "Q = V" RAT_FUNC "%8.6" "%" COEFFS 0 1 0 0 0 1 /end COMPU_METHOD
/begin COMPU_METHOD swc_COL_CM_single_V "Q = V" RAT_FUNC "%8.6" "V" COEFFS 0 1 0 0 0 1 /end COMPU_METHOD
/begin COMPU_METHOD swc_COL_CM_uint16_dash_ "Q = V" RAT_FUNC "%5.0" "-" COEFFS 0 1 0 0 0 1 /end COMPU_METHOD
/begin COMPU_METHOD swc_COL_CM_uint32_dash_ "Q = V" RAT_FUNC "%10.0" "-" COEFFS 0 1 0 0 0 1 /end COMPU_METHOD
/begin COMPU_METHOD swc_COL_CM_uint8___C "Q = V" RAT_FUNC "%3.0" "??C" COEFFS 0 1 0 0 0 1 /end COMPU_METHOD
/begin COMPU_METHOD swc_COL_CM_uint8_dash_ "Q = V" RAT_FUNC "%3.0" "-" COEFFS 0 1 0 0 0 1 /end COMPU_METHOD
/begin COMPU_METHOD swc_DiagcEveHndlg_CM_boolean_dash_ "Q = V" RAT_FUNC "%1.0" "-" COEFFS 0 1 0 0 0 1 /end COMPU_METHOD
/begin COMPU_METHOD swc_DiagcEveHndlg_CM_single_dash_ "Q = V" RAT_FUNC "%8.6" "-" COEFFS 0 1 0 0 0 1 /end COMPU_METHOD
/begin COMPU_METHOD swc_DiagcEveHndlg_CM_uint32_dash_ "Q = V" RAT_FUNC "%10.0" "-" COEFFS 0 1 0 0 0 1 /end COMPU_METHOD
/begin COMPU_METHOD swc_DiagcEveHndlg_CM_uint8_dash_ "Q = V" RAT_FUNC "%3.0" "-" COEFFS 0 1 0 0 0 1 /end COMPU_METHOD
/begin COMPU_METHOD swc_EltlLnkHzrdProtnNet_CM_single_s "Q = V" RAT_FUNC "%8.6" "s" COEFFS 0 1 0 0 0 1 /end COMPU_METHOD
/begin CHARACTERISTIC B2V_SingleChgEnergy_P "Single charge charge (when the charger is online)" VALUE 0x20019608 Scalar_FLOAT32_IEEE 0 swc_COL_CM_single_kWh 0 65535 /end CHARACTERISTIC
/begin CHARACTERISTIC BBC_AcvCellTestSrc_P "Source cell for manual balancing" VAL_BLK 0x20017CA8 Scalar_UWORD 0 swc_BatBalnCtl_CM_uint16_dash_ 0 65535 MATRIX_DIM 24 1 1 /end CHARACTERISTIC
/begin CHARACTERISTIC BBC_AcvCellTestTgt_P "Target cell for manual balancing" VAL_BLK 0x20017CD8 Scalar_UWORD 0 swc_BatBalnCtl_CM_uint16_dash_ 0 65535 MATRIX_DIM 24 1 1 /end CHARACTERISTIC
/begin CHARACTERISTIC BBC_CtrBalnTestMan_P "Balancing Count for manual balancing" VAL_BLK 0x20017D08 Scalar_UWORD 0 swc_BatBalnCtl_CM_uint16_dash_ 0 65535 MATRIX_DIM 24 1 1 /end CHARACTERISTIC
/begin CHARACTERISTIC BBC_EnaCellAcvBalnManSrc_P "To enable manual balancing on the bench for Source Cell Active Message" VALUE 0x20019C40 Scalar_UBYTE 0 swc_BatBalnCtl_CM_uint8_dash_ 0 255 /end CHARACTERISTIC
/begin CHARACTERISTIC BBC_EnaCellAcvBalnManTgt_P "To enable manual balancing on the bench for Target Cell Active Message" VALUE 0x20019C41 Scalar_UBYTE 0 swc_BatBalnCtl_CM_uint8_dash_ 0 255 /end CHARACTERISTIC
/begin CHARACTERISTIC BBC_EnaCellBalnMan_P "To enable manual balancing on the bench for Balancing Count Message" VALUE 0x20019C42 Scalar_UBYTE 0 swc_BatBalnCtl_CM_uint8_dash_ 0 255 /end CHARACTERISTIC
/begin CHARACTERISTIC BBC_EnaMdulNrBalnManSrc_P "To enable manual balancing on the bench for Source Module No Message" VALUE 0x20019C43 Scalar_UBYTE 0 swc_BatBalnCtl_CM_uint8_dash_ 0 255 /end CHARACTERISTIC
/begin CHARACTERISTIC BBC_EnaMdulNrBalnManTgt_P "To enable manual balancing on the bench for Target Module No Message" VALUE 0x20019C44 Scalar_UBYTE 0 swc_BatBalnCtl_CM_uint8_dash_ 0 255 /end CHARACTERISTIC
/begin CHARACTERISTIC BBC_ErrLvlMaxAllwd_P "Maximum balancing check parameter depending on Error Level (DEH_LvlErr) " VALUE 0x20019C46 Scalar_UBYTE 0 swc_BatBalnCtl_CM_uint8_dash_ 0 255 /end CHARACTERISTIC
/begin CHARACTERISTIC BBC_IPackBalnMax_P "Balancing will be disabled if the pack current flow is above this limit" VALUE 0x20017DCC Scalar_FLOAT32_IEEE 0 swc_BatBalnCtl_CM_single_A 0 2000 /end CHARACTERISTIC
/begin CHARACTERISTIC BBC_NrCellDchaInMdulAllwd_M "number of allowed cells per module for balancing" CURVE 0x200186D4 Lookup1D_FLOAT32_IEEE 0 swc_BatBalnCtl_CM_single_dash_ -10000 10000
 /begin AXIS_DESCR COM_AXIS NO_INPUT_QUANTITY swc_BatBalnCtl_CM_single_dash_ 9 -10000 10000 DEPOSIT ABSOLUTE AXIS_PTS_REF BBC_TMdulCtlr_A /end AXIS_DESCR
/end CHARACTERISTIC
/begin CHARACTERISTIC BBC_NrMdulTestSrc_P "Source module for manual balancing" VAL_BLK 0x20018890 Scalar_UBYTE 0 swc_BatBalnCtl_CM_uint8_dash_ 0 255 MATRIX_DIM 24 1 1 /end CHARACTERISTIC
/begin CHARACTERISTIC BBC_NrMdulTestTgt_P "Target module for manual balancing" VAL_BLK 0x200188A8 Scalar_UBYTE 0 swc_BatBalnCtl_CM_uint8_dash_ 0 255 MATRIX_DIM 24 1 1 /end CHARACTERISTIC
/begin CHARACTERISTIC BBC_SocCellLowrLim_P "cell lower SOC limit for balancing" VALUE 0x200186FC Scalar_FLOAT32_IEEE 0 swc_BatBalnCtl_CM_single_dash_ -10000 10000 /end CHARACTERISTIC
/begin CHARACTERISTIC BBC_SocCellUpprLim_P "cell upper SOC limit for balancing" VALUE 0x20018700 Scalar_FLOAT32_IEEE 0 swc_BatBalnCtl_CM_single_dash_ -10000 10000 /end CHARACTERISTIC
/begin CHARACTERISTIC BBC_SocCellVldTiDlyDelta_P "Time Delay Parameter for validity of deltaSOC signal before starting balancing" VALUE 0x20019BD6 Scalar_UWORD 0 swc_BatBalnCtl_CM_uint16_dash_ 0 65535 /end CHARACTERISTIC
/begin CHARACTERISTIC BBC_SofFac_P "Scaling factor for SOF charge/discharge limits to be used to allow balancing." VALUE 0x20018838 Scalar_FLOAT32_IEEE 0 swc_BatBalnCtl_CM_single_dash_ -10000 10000 /end CHARACTERISTIC
/begin CHARACTERISTIC BBC_TBalnRAvgHys_P "Hysteresis for resistor average temperature" VALUE 0x2001883C Scalar_FLOAT32_IEEE 0 swc_BatBalnCtl_CM_single__ -10000 10000 /end CHARACTERISTIC
/begin CHARACTERISTIC BBC_TBalnRAvgUpprLim_P "Upper limit for resistor average temperature" VALUE 0x20018840 Scalar_FLOAT32_IEEE 0 swc_BatBalnCtl_CM_single__ -10000 10000 /end CHARACTERISTIC
/begin CHARACTERISTIC BBC_TBalnRPasHys_P "Balancing resistor temperature limit hysteresis" VALUE 0x20018844 Scalar_FLOAT32_IEEE 0 swc_BatBalnCtl_CM_single__ -10000 10000 /end CHARACTERISTIC
/begin CHARACTERISTIC BBC_TBalnRPasUpprLim_P "Balancing resistor temperature limit" VALUE 0x20018848 Scalar_FLOAT32_IEEE 0 swc_BatBalnCtl_CM_single__ -10000 10000 /end CHARACTERISTIC
/begin CHARACTERISTIC BBC_TMdulBalnHiLim_P "Maximum module temperature to allow balancing." VALUE 0x2001884C Scalar_FLOAT32_IEEE 0 swc_BatBalnCtl_CM_single__ -273 1000 /end CHARACTERISTIC
/begin CHARACTERISTIC BBC_TMdulBalnLoLim_P "Minimum module temperature to allow balancing." VALUE 0x20018850 Scalar_FLOAT32_IEEE 0 swc_BatBalnCtl_CM_single__ -273 1000 /end CHARACTERISTIC
/begin CHARACTERISTIC BBC_TMdulCtlrLim_P "Module controller temperature limit" VALUE 0x20018854 Scalar_FLOAT32_IEEE 0 swc_BatBalnCtl_CM_single__ -10000 10000 /end CHARACTERISTIC
/begin AXIS_PTS BBC_TMdulCtlr_A "Temperature axis of number of allowed cells per module for balancing curve\n      " 0x20018858 NO_INPUT_QUANTITY Lookup1D_X_FLOAT32_IEEE 0 swc_BatBalnCtl_CM_single_dash_ 9 -10000 10000 DEPOSIT ABSOLUTE /end AXIS_PTS
/begin CHARACTERISTIC BBC_TiCellBalnAcvMax_P "Maximum discharge time" VALUE 0x2001887C Scalar_ULONG 0 swc_BatBalnCtl_CM_uint32_s 0 4294967295 /end CHARACTERISTIC
/begin CHARACTERISTIC BBC_TiCellBalnOffMin_P "Minimum resting time" VALUE 0x20018880 Scalar_ULONG 0 swc_BatBalnCtl_CM_uint32_s 0 4294967295 /end CHARACTERISTIC
/begin CHARACTERISTIC BBC_TiMdulBalnOff_P "Duty cycle of module to enable balancing" VAL_BLK 0x20017D38 Scalar_UWORD 0 swc_BatBalnCtl_CM_uint16_s 0 65535 MATRIX_DIM 24 1 1 /end CHARACTERISTIC
/begin CHARACTERISTIC BBC_TiMdulBalnPerd_P "PWM period of module to enable balancing" VALUE 0x20019BD8 Scalar_UWORD 0 swc_BatBalnCtl_CM_uint16_s 0 65535 /end CHARACTERISTIC
/begin CHARACTERISTIC BBC_UCellBalnHiLim_P "Maximum cell voltage to allow battery balancing." VALUE 0x20018888 Scalar_FLOAT32_IEEE 0 swc_BatBalnCtl_CM_single_V 0 100 /end CHARACTERISTIC
/begin CHARACTERISTIC BBC_UCellBalnLoLim_P "Minimum cell voltage to allow battery balancing." VALUE 0x2001888C Scalar_FLOAT32_IEEE 0 swc_BatBalnCtl_CM_single_V 0 100 /end CHARACTERISTIC
/begin CHARACTERISTIC BBC_bAcvSocRefForBalnSeln_P "Soc reference used for the balancing decision (0: minimum cell Soc; 1: average pack Soc)" VALUE 0x20019C48 Scalar_BOOLEAN 0 swc_BatBalnCtl_CM_boolean_dash_ 0 1 /end CHARACTERISTIC
/begin CHARACTERISTIC BCF_BvTc_M "Butler-Volmer Time Constant Curve" CURVE 0x1FFE7F08 Lookup1D_FLOAT32_IEEE 0 swc_BatCoreFct_CM_single_s -3.40282346639e+038 3.40282346639e+038
 /begin AXIS_DESCR COM_AXIS NO_INPUT_QUANTITY swc_BatCoreFct_CM_single__ 9 -3.40282346639e+038 3.40282346639e+038 DEPOSIT ABSOLUTE AXIS_PTS_REF BCF_TRngVld_A /end AXIS_DESCR
/end CHARACTERISTIC
/begin CHARACTERISTIC BCF_IDlcMeanHiLim_P "i_DLC mean higher limit" VALUE 0x1FFE8790 Scalar_FLOAT32_IEEE 0 swc_BatCoreFct_CM_single_A -3.40282346639e+038 3.40282346639e+038 /end CHARACTERISTIC
/begin CHARACTERISTIC BCF_IDlcMeanLoLim_P "i_DLC mean lower limit" VALUE 0x1FFE8794 Scalar_FLOAT32_IEEE 0 swc_BatCoreFct_CM_single_A -3.40282346639e+038 3.40282346639e+038 /end CHARACTERISTIC
/begin CHARACTERISTIC BCF_IRAc_A "AC Resistance map Z axis (Pack Current axis)" VAL_BLK 0x1FFE87A0 Scalar_FLOAT32_IEEE 0 swc_BatCoreFct_CM_single_A -3.40282346639e+038 3.40282346639e+038 MATRIX_DIM 11 1 1 /end CHARACTERISTIC
/begin CHARACTERISTIC BCF_IThdForMdlVld_P "Current limit to determine operating area" VAL_BLK 0x1FFE87CC Scalar_FLOAT32_IEEE 0 swc_BatCoreFct_CM_single_A 0 100000000 MATRIX_DIM 3 1 1 /end CHARACTERISTIC
/begin CHARACTERISTIC BCF_IWbz1MeanHiLim_P "i_WB1 mean higher limit" VALUE 0x1FFE87D8 Scalar_FLOAT32_IEEE 0 swc_BatCoreFct_CM_single_A -3.40282346639e+038 3.40282346639e+038 /end CHARACTERISTIC
/begin CHARACTERISTIC BCF_IWbz1MeanLoLim_P "i_WB1 mean lower limit" VALUE 0x1FFE87DC Scalar_FLOAT32_IEEE 0 swc_BatCoreFct_CM_single_A -3.40282346639e+038 3.40282346639e+038 /end CHARACTERISTIC
/begin CHARACTERISTIC BCF_IWbz2MeanHiLim_P "i_WB2 mean higher limit" VALUE 0x1FFE87E0 Scalar_FLOAT32_IEEE 0 swc_BatCoreFct_CM_single_A -3.40282346639e+038 3.40282346639e+038 /end CHARACTERISTIC
/begin CHARACTERISTIC BCF_IWbz2MeanLoLim_P "i_WB2 mean lower limit" VALUE 0x1FFE87E4 Scalar_FLOAT32_IEEE 0 swc_BatCoreFct_CM_single_A -3.40282346639e+038 3.40282346639e+038 /end CHARACTERISTIC
/begin CHARACTERISTIC BCF_ObsrgnAr1_P "Observer gain for low currents and mid-range SOC" VAL_BLK 0x1FFE87F8 Scalar_FLOAT32_IEEE 0 swc_BatCoreFct_CM_single_dash_ 0 100000000 MATRIX_DIM 4 1 1 /end CHARACTERISTIC
/begin CHARACTERISTIC BCF_ObsrgnAr2_P "Observer gain for high currents and very low or very high SOC" VAL_BLK 0x1FFE8808 Scalar_FLOAT32_IEEE 0 swc_BatCoreFct_CM_single_dash_ 0 100000000 MATRIX_DIM 4 1 1 /end CHARACTERISTIC
/begin CHARACTERISTIC BCF_ObsrgnLo_P "Observer gain for low temperature and balancing active scenarios" VAL_BLK 0x1FFE8818 Scalar_FLOAT32_IEEE 0 swc_BatCoreFct_CM_single_dash_ 0 100000000 MATRIX_DIM 4 1 1 /end CHARACTERISTIC
/begin CHARACTERISTIC BCF_RAc_M "AC Resistance Map" VAL_BLK 0x1FFE8A00 Scalar_FLOAT32_IEEE 0 swc_BatCoreFct_CM_single_Ohm -3.40282346639e+038 3.40282346639e+038 MATRIX_DIM 1188 1 1 /end CHARACTERISTIC
/begin CHARACTERISTIC BCF_RBv_M "Butler-Volmer Resistance Map" MAP 0x1FFE9C90 Lookup2D_FLOAT32_IEEE 0 swc_BatCoreFct_CM_single_Ohm -3.40282346639e+038 3.40282346639e+038
 /begin AXIS_DESCR COM_AXIS NO_INPUT_QUANTITY swc_BatCoreFct_CM_single_dash_ 12 -3.40282346639e+038 3.40282346639e+038 DEPOSIT ABSOLUTE AXIS_PTS_REF BCF_SocRBv_A /end AXIS_DESCR
 /begin AXIS_DESCR COM_AXIS NO_INPUT_QUANTITY swc_BatCoreFct_CM_single__ 9 -3.40282346639e+038 3.40282346639e+038 DEPOSIT ABSOLUTE AXIS_PTS_REF BCF_TRngVld_A /end AXIS_DESCR
/end CHARACTERISTIC
/begin CHARACTERISTIC BCF_RMdulAgiFacInvldErrMin_M "Error threshold when the signal is valid but outside the determined operating region" CURVE 0x1FFE9E4C Lookup1D_FLOAT32_IEEE 0 swc_BatCoreFct_CM_single_dash_ -3.40282346639e+038 3.40282346639e+038
 /begin AXIS_DESCR COM_AXIS NO_INPUT_QUANTITY swc_BatCoreFct_CM_uint32_s 5 0 4294967295 DEPOSIT ABSOLUTE AXIS_PTS_REF BCF_TiBatOffForAgiFac_A /end AXIS_DESCR
/end CHARACTERISTIC
/begin CHARACTERISTIC BCF_RMdulAgiFacInvldHeal_M "Heal threshold for RMdul Ageing Factor when the signal is valid but outside the determined operating region" CURVE 0x1FFE9E60 Lookup1D_FLOAT32_IEEE 0 swc_BatCoreFct_CM_single_dash_ -3.40282346639e+038 3.40282346639e+038
 /begin AXIS_DESCR COM_AXIS NO_INPUT_QUANTITY swc_BatCoreFct_CM_uint32_s 5 0 4294967295 DEPOSIT ABSOLUTE AXIS_PTS_REF BCF_TiBatOffForAgiFac_A /end AXIS_DESCR
/end CHARACTERISTIC
/begin CHARACTERISTIC BCF_RMdulAgiFacLowrLim_P "Module Resistance Ageing Factor saturation lower limit" VALUE 0x1FFE9E74 Scalar_FLOAT32_IEEE 0 swc_BatCoreFct_CM_single_dash_ -3.40282346639e+038 3.40282346639e+038 /end CHARACTERISTIC
/begin CHARACTERISTIC BCF_RMdulAgiFacSatn_M "Saturation Curve of the RMdulDelta Ageing Factor Update Step based on stand-still time" CURVE 0x1FFE9E78 Lookup1D_FLOAT32_IEEE 0 swc_BatCoreFct_CM_single_dash_ -3.40282346639e+038 3.40282346639e+038
 /begin AXIS_DESCR COM_AXIS NO_INPUT_QUANTITY swc_BatCoreFct_CM_uint32_s 5 0 4294967295 DEPOSIT ABSOLUTE AXIS_PTS_REF BCF_TiBatOffForAgiFac_A /end AXIS_DESCR
/end CHARACTERISTIC
/begin CHARACTERISTIC BCF_RMdulAgiFacUpd_P "Step size for RMdul updates" VALUE 0x1FFE9EEC Scalar_FLOAT32_IEEE 0 swc_BatCoreFct_CM_single_dash_ -3.40282346639e+038 3.40282346639e+038 /end CHARACTERISTIC
/begin CHARACTERISTIC BCF_RMdulAgiFacUpprLim_P "Module Resistance Ageing Factor saturation upper limit" VALUE 0x1FFE9EF0 Scalar_FLOAT32_IEEE 0 swc_BatCoreFct_CM_single_dash_ -3.40282346639e+038 3.40282346639e+038 /end CHARACTERISTIC
/begin CHARACTERISTIC BCF_RMdulAgiFacVldErrMin_M "Error threshold when the signal is valid and inside the determined operating region" CURVE 0x1FFE9EF4 Lookup1D_FLOAT32_IEEE 0 swc_BatCoreFct_CM_single_dash_ -3.40282346639e+038 3.40282346639e+038
 /begin AXIS_DESCR COM_AXIS NO_INPUT_QUANTITY swc_BatCoreFct_CM_uint32_s 5 0 4294967295 DEPOSIT ABSOLUTE AXIS_PTS_REF BCF_TiBatOffForAgiFac_A /end AXIS_DESCR
/end CHARACTERISTIC
/begin CHARACTERISTIC BCF_RMdulAgiFacVldHeal_M "Heal threshold for RMdul Ageing Factor when the signal is valid and inside the determined operating region" CURVE 0x1FFE9F08 Lookup1D_FLOAT32_IEEE 0 swc_BatCoreFct_CM_single_dash_ -3.40282346639e+038 3.40282346639e+038
 /begin AXIS_DESCR COM_AXIS NO_INPUT_QUANTITY swc_BatCoreFct_CM_uint32_s 5 0 4294967295 DEPOSIT ABSOLUTE AXIS_PTS_REF BCF_TiBatOffForAgiFac_A /end AXIS_DESCR
/end CHARACTERISTIC
/begin CHARACTERISTIC BCF_RMdulCnct_P "Cell-to-cell connection resistance within one module" VAL_BLK 0x20000F34 Scalar_FLOAT32_IEEE 0 swc_BatCoreFct_CM_single_Ohm -3.40282346639e+038 3.40282346639e+038 MATRIX_DIM 24 1 1 /end CHARACTERISTIC
/begin CHARACTERISTIC BCF_RMdulDeltaShoUpprLim_P "RMdulDelta Short Term Upper Limit" VALUE 0x1FFE9F48 Scalar_FLOAT32_IEEE 0 swc_BatCoreFct_CM_single_dash_ -3.40282346639e+038 3.40282346639e+038 /end CHARACTERISTIC
/begin CHARACTERISTIC BCF_RMdulDeltaUpprLimOfTrip_P "RMdulDelta Short Term Upper Limit" VALUE 0x1FFE9F4C Scalar_FLOAT32_IEEE 0 swc_BatCoreFct_CM_single_dash_ -3.40282346639e+038 3.40282346639e+038 /end CHARACTERISTIC
/begin CHARACTERISTIC BCF_RMdulTripLamWithBaln_P "Forgetting factor of MdulRObsr with Balancing" VALUE 0x1FFE9F58 Scalar_FLOAT32_IEEE 0 swc_BatCoreFct_CM_single_dash_ -3.40282346639e+038 3.40282346639e+038 /end CHARACTERISTIC
/begin CHARACTERISTIC BCF_RMdulTripLamWoutBaln_P "Forgetting factor of MdulRObsr without Balancing " VALUE 0x1FFE9F5C Scalar_FLOAT32_IEEE 0 swc_BatCoreFct_CM_single_dash_ -3.40282346639e+038 3.40282346639e+038 /end CHARACTERISTIC
/begin CHARACTERISTIC BCF_RSysMtrxCdngNrShoLimHi_P "Limit of the conditioning number of short term resistance observer system matrix" VALUE 0x1FFE9F68 Scalar_FLOAT32_IEEE 0 swc_BatCoreFct_CM_single_dash_ -3.40282346639e+038 3.40282346639e+038 /end CHARACTERISTIC
/begin CHARACTERISTIC BCF_RSysMtrxCdngNrTripLimHi_P "Limit of the conditioning number of trip resistance observer system matrix" VALUE 0x1FFE9F6C Scalar_FLOAT32_IEEE 0 swc_BatCoreFct_CM_single_dash_ -3.40282346639e+038 3.40282346639e+038 /end CHARACTERISTIC
/begin CHARACTERISTIC BCF_SocLowrLimForAgiFacUpd_P "SOC lower limit to update Aging Factor" VALUE 0x1FFEA234 Scalar_FLOAT32_IEEE 0 swc_BatCoreFct_CM_single_dash_ 0 100000000 /end CHARACTERISTIC
/begin CHARACTERISTIC BCF_SocLowrLimForObsrgn_P "SOC lower limit to determine operating area" VALUE 0x1FFEA238 Scalar_FLOAT32_IEEE 0 swc_BatCoreFct_CM_single_dash_ 0 100000000 /end CHARACTERISTIC
/begin CHARACTERISTIC BCF_SocMeanHiLim_P "SOC mean higher limit" VALUE 0x1FFEA274 Scalar_FLOAT32_IEEE 0 swc_BatCoreFct_CM_single_dash_ 0 1 /end CHARACTERISTIC
/begin CHARACTERISTIC BCF_SocMeanLoLim_P "SOC mean lower limit" VALUE 0x20000F9C Scalar_FLOAT32_IEEE 0 swc_BatCoreFct_CM_single_dash_ 0 1 /end CHARACTERISTIC
/begin CHARACTERISTIC BCF_SocRAc_A "AC Resistance map Y axis (SOC axis)" VAL_BLK 0x1FFEA2D8 Scalar_FLOAT32_IEEE 0 swc_BatCoreFct_CM_single_dash_ -3.40282346639e+038 3.40282346639e+038 MATRIX_DIM 12 1 1 /end CHARACTERISTIC
/begin AXIS_PTS BCF_SocRBv_A "Butler-Volmer Resistance Map Y axis (SOC axis)" 0x1FFEA308 NO_INPUT_QUANTITY Lookup2D_X_FLOAT32_IEEE 0 swc_BatCoreFct_CM_single_dash_ 12 -3.40282346639e+038 3.40282346639e+038 DEPOSIT ABSOLUTE /end AXIS_PTS
/begin CHARACTERISTIC BCF_SocUpprLimForAgiFacUpd_P "SOC upper limit to update Aging Factor" VALUE 0x1FFEA368 Scalar_FLOAT32_IEEE 0 swc_BatCoreFct_CM_single_dash_ 0 100000000 /end CHARACTERISTIC
/begin CHARACTERISTIC BCF_SocUpprLimForObsrgn_P "SOC upper limit to determine operating area" VALUE 0x1FFEA36C Scalar_FLOAT32_IEEE 0 swc_BatCoreFct_CM_single_dash_ 0 100000000 /end CHARACTERISTIC
/begin CHARACTERISTIC BCF_TLowrLimForAgiFacUpd_P "Lower temperature limit to determine operating area" VALUE 0x1FFEA57C Scalar_FLOAT32_IEEE 0 swc_BatCoreFct_CM_single__ 0 100000000 /end CHARACTERISTIC
/begin AXIS_PTS BCF_TRngVld_A "Valid Temperature range of of the model" 0x1FFEA590 NO_INPUT_QUANTITY Lookup2D_X_FLOAT32_IEEE 0 swc_BatCoreFct_CM_single__ 9 -3.40282346639e+038 3.40282346639e+038 DEPOSIT ABSOLUTE /end AXIS_PTS
/begin CHARACTERISTIC BCF_TdOffDig1003_P "Battery Core Function TimeDelay Off Digital _Parameter" VALUE 0x1FFEA5C0 Scalar_FLOAT32_IEEE 0 swc_BatCoreFct_CM_single_s -3.40282346639e+038 3.40282346639e+038 /end CHARACTERISTIC
/begin CHARACTERISTIC BCF_TdOffDig1005_P "Battery Core Function TimeDelay Off Digital _Parameter" VALUE 0x1FFEA5C8 Scalar_FLOAT32_IEEE 0 swc_BatCoreFct_CM_single_s -3.40282346639e+038 3.40282346639e+038 /end CHARACTERISTIC
/begin CHARACTERISTIC BCF_TdOnDig1003_P "Battery Core Function TimeDelay On Digital _Parameter" VALUE 0x1FFEA5D8 Scalar_FLOAT32_IEEE 0 swc_BatCoreFct_CM_single_s -3.40282346639e+038 3.40282346639e+038 /end CHARACTERISTIC
/begin CHARACTERISTIC BCF_TdOnDig1005_P "Battery Core Function TimeDelay On Digital _Parameter" VALUE 0x1FFEA5E0 Scalar_FLOAT32_IEEE 0 swc_BatCoreFct_CM_single_dash_ -3.40282346639e+038 3.40282346639e+038 /end CHARACTERISTIC
/begin AXIS_PTS BCF_TiBatOffForAgiFac_A "Time axis of the for Saturation Curve of the Ageing Factor Update Steps based on stand still time" 0x1FFEA5E8 NO_INPUT_QUANTITY Lookup1D_X_ULONG 0 swc_BatCoreFct_CM_uint32_s 5 0 4294967295 DEPOSIT ABSOLUTE /end AXIS_PTS
/begin CHARACTERISTIC BCF_UMdulDeErrLimForMdlInvld_P "Error limit for module voltage deviation between model and measurement error, when we consider the model to be invalid" VALUE 0x1FFEB0E0 Scalar_FLOAT32_IEEE 0 swc_BatCoreFct_CM_single_V -3.40282346639e+038 3.40282346639e+038 /end CHARACTERISTIC
/begin CHARACTERISTIC BCF_UMdulDeErrLimForMdlVld_P "Error limit for module voltage deviation between model and measurement error, when we consider the model to be valid" VALUE 0x1FFEB0E4 Scalar_FLOAT32_IEEE 0 swc_BatCoreFct_CM_single_V -3.40282346639e+038 3.40282346639e+038 /end CHARACTERISTIC
/begin CHARACTERISTIC BCF_WbzTcFac_P "Factor for the WB2 Filter Time constant" VALUE 0x1FFEB228 Scalar_FLOAT32_IEEE 0 swc_BatCoreFct_CM_single_dash_ -3.40282346639e+038 3.40282346639e+038 /end CHARACTERISTIC
/begin CHARACTERISTIC BCF_WbzTc_M "Time constant for Warburg Impedance curve" CURVE 0x1FFEB22C Lookup1D_FLOAT32_IEEE 0 swc_BatCoreFct_CM_single_s -3.40282346639e+038 3.40282346639e+038
 /begin AXIS_DESCR COM_AXIS NO_INPUT_QUANTITY swc_BatCoreFct_CM_single__ 9 -3.40282346639e+038 3.40282346639e+038 DEPOSIT ABSOLUTE AXIS_PTS_REF BCF_TRngVld_A /end AXIS_DESCR
/end CHARACTERISTIC
/begin CHARACTERISTIC BCF_bAcvObsr_P "SOC observer gain active flag, 1 = active, 0 = deactive (SOC estimation based on current integration)" VALUE 0x1FFEB530 Scalar_BOOLEAN 0 swc_BatCoreFct_CM_boolean_dash_ 0 1 /end CHARACTERISTIC
/begin CHARACTERISTIC BMS_BattMaxTemp1_P "The maximum temperature of the power battery (0xFF: Invalid)" VALUE 0x2001961C Scalar_FLOAT32_IEEE 0 swc_COL_CM_single___C 0 255 /end CHARACTERISTIC
/begin CHARACTERISTIC BMS_BattMaxWorkTemp_P "The power battery is allowed to operate at the maximum temperature (0xFF: Invalid)" VALUE 0x20019620 Scalar_FLOAT32_IEEE 0 swc_COL_CM_single___C 0 255 /end CHARACTERISTIC
/begin CHARACTERISTIC BMS_BattMinTemp1_P "The minimum temperature of the power battery (0xFF: Invalid)" VALUE 0x20019CCA Scalar_UBYTE 0 swc_COL_CM_uint8___C 0 255 /end CHARACTERISTIC
/begin CHARACTERISTIC BMS_BattMinWorkTemp_P "The power battery is allowed to operate at the lowest temperature (0xFF: Invalid)" VALUE 0x20019624 Scalar_FLOAT32_IEEE 0 swc_COL_CM_single___C 0 255 /end CHARACTERISTIC
/begin CHARACTERISTIC BMS_BattTotalChgEny_P "Cumulative energy charged by the power battery (entire life cycle)" VALUE 0x20019638 Scalar_FLOAT32_IEEE 0 swc_COL_CM_single_kWh 0 4294967296 /end CHARACTERISTIC
/begin CHARACTERISTIC BMS_BattTotalDischgEny_P "Accumulated energy discharged by the power battery (whole life cycle)" VALUE 0x2001963C Scalar_FLOAT32_IEEE 0 swc_COL_CM_single_kWh 0 4294967296 /end CHARACTERISTIC
/begin CHARACTERISTIC BMS_Cell_Avg_Temp_P "Cell temperature average (0xFE: Abnormal\n      0xFF: Signal Invalid)" VALUE 0x20019644 Scalar_FLOAT32_IEEE 0 swc_COL_CM_single___C 0 255 /end CHARACTERISTIC
/begin CHARACTERISTIC BMS_ChgCount_P "Number of charges" VALUE 0x20019C0E Scalar_UWORD 0 swc_COL_CM_uint16_dash_ 0 65535 /end CHARACTERISTIC
/begin CHARACTERISTIC BMS_ChgTimeRemain_P "Estimated time to fully charge" VALUE 0x20019648 Scalar_FLOAT32_IEEE 0 swc_COL_CM_single_min 0 65535 /end CHARACTERISTIC
/begin CHARACTERISTIC BMS_DCChgNegTemp_P "Fast charging port negative contact temperature" VALUE 0x2001964C Scalar_FLOAT32_IEEE 0 swc_COL_CM_single_dash_ 0 255 /end CHARACTERISTIC
/begin CHARACTERISTIC BMS_DCChgPosTemp_P "Calibration parameter foe Fast charging port positive contact temperature" VALUE 0x20019650 Scalar_FLOAT32_IEEE 0 swc_COL_CM_single_dash_ 0 255 /end CHARACTERISTIC
/begin CHARACTERISTIC BMS_IC_Temp_P "The gauge shows the battery temperature (0xFE: Abnormal\n      0XFF: Signal Invalid)" VALUE 0x20019654 Scalar_FLOAT32_IEEE 0 swc_COL_CM_single___C 0 255 /end CHARACTERISTIC
/begin CHARACTERISTIC BMS_MaxCellVolt_P "The maximum voltage of a single cell (0xFFFF: Invalid)" VALUE 0x20019658 Scalar_FLOAT32_IEEE 0 swc_COL_CM_single_V 0 65535 /end CHARACTERISTIC
/begin CHARACTERISTIC BMS_MaxPmtDischgCurr_P "The maximum allowable discharge current of the power battery (0xFFFF: Invalid)" VALUE 0x20019664 Scalar_FLOAT32_IEEE 0 swc_COL_CM_single_A 0 65535 /end CHARACTERISTIC
/begin CHARACTERISTIC BMS_MaxPmtEnyRecoCurr_P "The maximum allowable energy feedback current of the power battery (0xFFFF: Invalid)" VALUE 0x20019668 Scalar_FLOAT32_IEEE 0 swc_COL_CM_single_A 0 65535 /end CHARACTERISTIC
/begin CHARACTERISTIC BMS_MaxPmtEnyRecoVol_P "The maximum allowable energy feedback voltage of the power battery (0xFF: Invalid)" VALUE 0x2001966C Scalar_FLOAT32_IEEE 0 swc_COL_CM_single_percent_ 0 255 /end CHARACTERISTIC
/begin CHARACTERISTIC BMS_MaxTemp1PackNum_P "The address of the box where the highest temperature is located ()" VALUE 0x20019CEB Scalar_UBYTE 0 swc_COL_CM_uint8_dash_ 0 255 /end CHARACTERISTIC
/begin CHARACTERISTIC BMS_MaxTemp1SnsNum_P "The maximum temperature corresponds to the probe serial number" VALUE 0x20019CEC Scalar_UBYTE 0 swc_COL_CM_uint8_dash_ 0 255 /end CHARACTERISTIC
/begin CHARACTERISTIC BMS_MaxVoltCellNum_P "The cell number in the box/CSC where the highest voltage of the single cell is located" VALUE 0x20019C10 Scalar_UWORD 0 swc_COL_CM_uint16_dash_ 0 255 /end CHARACTERISTIC
/begin CHARACTERISTIC BMS_MaxVoltCellPackNum_P "The box/CSC address number where the highest voltage of the single battery is located" VALUE 0x20019CED Scalar_UBYTE 0 swc_COL_CM_uint8_dash_ 0 255 /end CHARACTERISTIC
/begin CHARACTERISTIC BMS_MinCellVolt_P "The minimum voltage of the single cell (0xFFFF: Invalid)" VALUE 0x20019670 Scalar_FLOAT32_IEEE 0 swc_COL_CM_single_V 0 65535 /end CHARACTERISTIC
/begin CHARACTERISTIC BMS_MinPmtSOC_P "The battery allows minimal SOC usage (0xFF: Invalid)" VALUE 0x20019674 Scalar_FLOAT32_IEEE 0 swc_COL_CM_single_percent_ 0 255 /end CHARACTERISTIC
/begin CHARACTERISTIC BMS_MinTemp1PackNum_P "The address of the enclosure where the lowest temperature is located" VALUE 0x20019CEE Scalar_UBYTE 0 swc_COL_CM_uint8_dash_ 0 255 /end CHARACTERISTIC
/begin CHARACTERISTIC BMS_MinTemp1SnsNum_P "The probe serial number corresponding to the lowest temperature ()" VALUE 0x20019CEF Scalar_UBYTE 0 swc_COL_CM_uint8_dash_ 0 255 /end CHARACTERISTIC
/begin CHARACTERISTIC BMS_MinVoltCellNum_P "The cell number in the box/CSC where the minimum voltage of the single battery is located" VALUE 0x20019C12 Scalar_UWORD 0 swc_COL_CM_uint16_dash_ 0 255 /end CHARACTERISTIC
/begin CHARACTERISTIC BMS_MinVoltCellPackNum_P "The box/CSC address number where the minimum voltage of the single battery 1 is located" VALUE 0x20019CF0 Scalar_UBYTE 0 swc_COL_CM_uint8_dash_ 0 255 /end CHARACTERISTIC
/begin CHARACTERISTIC BMS_SingleDisChgEny_P "Single discharge charge" VALUE 0x20019680 Scalar_FLOAT32_IEEE 0 swc_COL_CM_single_kWh 0 65535 /end CHARACTERISTIC
/begin CHARACTERISTIC BSTC_CswDiag_P "Configuration swtich for BSTC diagnosis" VALUE 0x20018C10 Scalar_ULONG 0 swc_BcuStTranCtl_CM_uint32_dash_ 0 4294967295 /end CHARACTERISTIC
/begin CHARACTERISTIC BSTC_IChScsMin_P "Minimum current for successful charging" VALUE 0x20018C14 Scalar_FLOAT32_IEEE 0 swc_BcuStTranCtl_CM_single_A -3.40282346639e+038 3.40282346639e+038 /end CHARACTERISTIC
/begin CHARACTERISTIC BSTC_ReqHvOnFromVcu_P "Request HV on from Vcu" VALUE 0x20019C50 Scalar_UBYTE 0 swc_BcuStTranCtl_CM_uint8_dash_ 0 255 /end CHARACTERISTIC
/begin AXIS_PTS BSTC_StBcu_A "Axis for BCU state" 0x20019ADC NO_INPUT_QUANTITY Lookup1D_X_UBYTE 0 swc_DiagcEveHndlg_CM_uint8_dash_ 8 0 255 DEPOSIT ABSOLUTE /end AXIS_PTS
/begin CHARACTERISTIC BSTC_StBcu_M "Map for diagnosis global trigger" CURVE 0x20019AE4 Lookup1D_UBYTE 0 swc_DiagcEveHndlg_CM_uint8_dash_ 0 255
 /begin AXIS_DESCR COM_AXIS NO_INPUT_QUANTITY swc_DiagcEveHndlg_CM_uint8_dash_ 8 0 255 DEPOSIT ABSOLUTE AXIS_PTS_REF BSTC_StBcu_A /end AXIS_DESCR
/end CHARACTERISTIC
/begin CHARACTERISTIC BSTC_StLoopHvNorm_P "HV loop state is normal" VALUE 0x20019C52 Scalar_UBYTE 0 swc_BcuStTranCtl_CM_uint8_dash_ 0 255 /end CHARACTERISTIC
/begin CHARACTERISTIC BSTC_StLoopHvPrechFnshd_P "HV loop state is precharging finished" VALUE 0x20019C53 Scalar_UBYTE 0 swc_BcuStTranCtl_CM_uint8_dash_ 0 255 /end CHARACTERISTIC
/begin CHARACTERISTIC BSTC_ThdILowrLim_P "The lower limit of the threshold current" VALUE 0x20018C18 Scalar_FLOAT32_IEEE 0 swc_BcuStTranCtl_CM_single_A -3.40282346639e+038 3.40282346639e+038 /end CHARACTERISTIC
/begin CHARACTERISTIC BSTC_ThdIUpprLim_P "The upper limit of the threshold current" VALUE 0x20018C1C Scalar_FLOAT32_IEEE 0 swc_BcuStTranCtl_CM_single_A -3.40282346639e+038 3.40282346639e+038 /end CHARACTERISTIC
/begin CHARACTERISTIC BSTC_TiBalMaxForCh_P "Maximum equalisation time after charging" VALUE 0x20018C20 Scalar_FLOAT32_IEEE 0 swc_BcuStTranCtl_CM_single_s -3.40282346639e+038 3.40282346639e+038 /end CHARACTERISTIC
/begin CHARACTERISTIC BSTC_TiBswStore_P "Wait time for Bsw stored data" VALUE 0x20018C24 Scalar_FLOAT32_IEEE 0 swc_BcuStTranCtl_CM_single_s -3.40282346639e+038 3.40282346639e+038 /end CHARACTERISTIC
/begin CHARACTERISTIC BSTC_TiChkDeb_P "Maximum debounce time for self-check" VALUE 0x20018C28 Scalar_FLOAT32_IEEE 0 swc_BcuStTranCtl_CM_single_s -3.40282346639e+038 3.40282346639e+038 /end CHARACTERISTIC
/begin CHARACTERISTIC BSTC_TiCutoffLvReqFromVcu_P "Wait time for receiving Lv cutoff request from Vcu" VALUE 0x20018C2C Scalar_FLOAT32_IEEE 0 swc_BcuStTranCtl_CM_single_s -3.40282346639e+038 3.40282346639e+038 /end CHARACTERISTIC
/begin CHARACTERISTIC BSTC_TiOffDigForPwrOff_P "Turn off delay for diagnose the failure of the BMS to power off" VALUE 0x20018C30 Scalar_FLOAT32_IEEE 0 swc_BcuStTranCtl_CM_single_s -3.40282346639e+038 3.40282346639e+038 /end CHARACTERISTIC
/begin CHARACTERISTIC BSTC_TiOnDigForPwrOff_P "Turn on delay for diagnose the failure of the BMS to power off" VALUE 0x20018C34 Scalar_FLOAT32_IEEE 0 swc_BcuStTranCtl_CM_single_s -3.40282346639e+038 3.40282346639e+038 /end CHARACTERISTIC
/begin CHARACTERISTIC BSTC_TiRtcWUpNxt_P "Time of next RTC wake-up call" VALUE 0x20018C3C Scalar_FLOAT32_IEEE 0 swc_BcuStTranCtl_CM_single_min -3.40282346639e+038 3.40282346639e+038 /end CHARACTERISTIC
/begin CHARACTERISTIC BSTC_TiVcuShtdn_P "Wait time for Vcu shutdown" VALUE 0x20018C54 Scalar_FLOAT32_IEEE 0 swc_BcuStTranCtl_CM_single_s -3.40282346639e+038 3.40282346639e+038 /end CHARACTERISTIC
/begin CHARACTERISTIC BSTC_TiWaitChk_P "Waiting time for self-check after initialisation" VALUE 0x20018C58 Scalar_FLOAT32_IEEE 0 swc_BcuStTranCtl_CM_single_s -3.40282346639e+038 3.40282346639e+038 /end CHARACTERISTIC
/begin CHARACTERISTIC BTHM_CswGlb_P "parameter for test" VALUE 0x20018C60 Scalar_ULONG 0 swc_BatThermHndlgMngt_CM_uint32_dash_ 0 4294967295 /end CHARACTERISTIC
/begin CHARACTERISTIC BTHM_CswReplDig_P "parameter for replace switch diagnosis" VALUE 0x20018C64 Scalar_ULONG 0 swc_BatThermHndlgMngt_CM_uint32_dash_ 0 4294967295 /end CHARACTERISTIC
/begin CHARACTERISTIC BTHM_IThermAllToRlyCls1_P "parameter for current to closing heating relay" VALUE 0x20018CA4 Scalar_FLOAT32_IEEE 0 swc_BatThermHndlgMngt_CM_single_dash_ -3.40282346639e+038 3.40282346639e+038 /end CHARACTERISTIC
/begin CHARACTERISTIC BTHM_IThermAllToRlyCls2_P "parameter for current to closing heating relay" VALUE 0x20018CA8 Scalar_FLOAT32_IEEE 0 swc_BatThermHndlgMngt_CM_single_dash_ -3.40282346639e+038 3.40282346639e+038 /end CHARACTERISTIC
/begin CHARACTERISTIC BTHM_IThermAllToRlyOpen_P "parameter for current to open negative relay" VALUE 0x20018CAC Scalar_FLOAT32_IEEE 0 swc_BatThermHndlgMngt_CM_single_dash_ -3.40282346639e+038 3.40282346639e+038 /end CHARACTERISTIC
/begin CHARACTERISTIC BTHM_ModeSelnOfPackTDif_P "Parameter used for switching pack temperature spread diagnosis mode. 0 - Corrected values are used; 1 - Raw values are used." VALUE 0x20019C5A Scalar_UBYTE 0 swc_BatThermHndlgMngt_CM_uint8_dash_ 0 255 /end CHARACTERISTIC
/begin CHARACTERISTIC BTHM_PctgRlyUClsNegMax_P "maximum percentage for close negative relay" VALUE 0x20019C5C Scalar_UBYTE 0 swc_BatThermHndlgMngt_CM_uint8_dash_ 0 255 /end CHARACTERISTIC
/begin CHARACTERISTIC BTHM_PctgRlyUClsNegMin_P "minimum percentage for close negative relay" VALUE 0x20019C5D Scalar_UBYTE 0 swc_BatThermHndlgMngt_CM_uint8_dash_ 0 255 /end CHARACTERISTIC
/begin CHARACTERISTIC BTHM_SocExitTherm_P "parameter for soc to exit thermal management" VALUE 0x20018CB0 Scalar_FLOAT32_IEEE 0 swc_BatThermHndlgMngt_CM_single_dash_ -3.40282346639e+038 3.40282346639e+038 /end CHARACTERISTIC
/begin CHARACTERISTIC BTHM_SocSelnToTherm_P "parameter for soc to alloweding thermal management" VALUE 0x20018CB4 Scalar_FLOAT32_IEEE 0 swc_BatThermHndlgMngt_CM_single_dash_ -3.40282346639e+038 3.40282346639e+038 /end CHARACTERISTIC
/begin CHARACTERISTIC BTHM_SocThermAllwd1_P "parameter for soc to alloweding thermal management" VALUE 0x20018CB8 Scalar_FLOAT32_IEEE 0 swc_BatThermHndlgMngt_CM_single_dash_ -3.40282346639e+038 3.40282346639e+038 /end CHARACTERISTIC
/begin CHARACTERISTIC BTHM_SocThermAllwd2_P "parameter for soc to alloweding thermal management" VALUE 0x20018CBC Scalar_FLOAT32_IEEE 0 swc_BatThermHndlgMngt_CM_single_dash_ -3.40282346639e+038 3.40282346639e+038 /end CHARACTERISTIC
/begin CHARACTERISTIC BTHM_SocThermToSeln_P "parameter for soc to exit thermal management" VALUE 0x20018CC0 Scalar_FLOAT32_IEEE 0 swc_BatThermHndlgMngt_CM_single_dash_ -3.40282346639e+038 3.40282346639e+038 /end CHARACTERISTIC
/begin CHARACTERISTIC BTHM_TAFERstDig_P "AFE temperature for reset daignosis" VALUE 0x20018CC4 Scalar_FLOAT32_IEEE 0 swc_BatThermHndlgMngt_CM_single_dash_ -3.40282346639e+038 3.40282346639e+038 /end CHARACTERISTIC
/begin CHARACTERISTIC BTHM_TAFESetDig_P "AFE temperature for set daignosis" VALUE 0x20018CC8 Scalar_FLOAT32_IEEE 0 swc_BatThermHndlgMngt_CM_single_dash_ -3.40282346639e+038 3.40282346639e+038 /end CHARACTERISTIC
/begin CHARACTERISTIC BTHM_TChCoolgModeMax_P "parameter for maximum temperature to cooling mode request" VALUE 0x20018CD4 Scalar_FLOAT32_IEEE 0 swc_BatThermHndlgMngt_CM_single_dash_ -3.40282346639e+038 3.40282346639e+038 /end CHARACTERISTIC
/begin CHARACTERISTIC BTHM_TChCoolgModeMin_P "parameter for minimum temperature to cooling mode request" VALUE 0x20018CD8 Scalar_FLOAT32_IEEE 0 swc_BatThermHndlgMngt_CM_single_dash_ -3.40282346639e+038 3.40282346639e+038 /end CHARACTERISTIC
/begin CHARACTERISTIC BTHM_TChLqdToChThermMin_P "parameter for minimum temperature to charge thermal" VALUE 0x20018CDC Scalar_FLOAT32_IEEE 0 swc_BatThermHndlgMngt_CM_single_dash_ -3.40282346639e+038 3.40282346639e+038 /end CHARACTERISTIC
/begin CHARACTERISTIC BTHM_TChThermToChMax_P "parameter for maximum temperature to charge only" VALUE 0x20018CE0 Scalar_FLOAT32_IEEE 0 swc_BatThermHndlgMngt_CM_single_dash_ -3.40282346639e+038 3.40282346639e+038 /end CHARACTERISTIC
/begin CHARACTERISTIC BTHM_TChThermToChMin_P "parameter for minimum temperature to charge only" VALUE 0x20018CE4 Scalar_FLOAT32_IEEE 0 swc_BatThermHndlgMngt_CM_single_dash_ -3.40282346639e+038 3.40282346639e+038 /end CHARACTERISTIC
/begin CHARACTERISTIC BTHM_TChThermToThermOnly_P "parameter for temperature to thermal only" VALUE 0x20018CE8 Scalar_FLOAT32_IEEE 0 swc_BatThermHndlgMngt_CM_single_dash_ -3.40282346639e+038 3.40282346639e+038 /end CHARACTERISTIC
/begin CHARACTERISTIC BTHM_TChToChTherm_P "parameter for temperature to charge and thermal" VALUE 0x20018CEC Scalar_FLOAT32_IEEE 0 swc_BatThermHndlgMngt_CM_single_dash_ -3.40282346639e+038 3.40282346639e+038 /end CHARACTERISTIC
/begin CHARACTERISTIC BTHM_TChToCoolgMax_P "parameter for maximum temperature to cooling mode request" VALUE 0x20018CF0 Scalar_FLOAT32_IEEE 0 swc_BatThermHndlgMngt_CM_single_dash_ -3.40282346639e+038 3.40282346639e+038 /end CHARACTERISTIC
/begin CHARACTERISTIC BTHM_TCoolgMax_P "parameter for maximum temperature to cooling mode request" VALUE 0x20018CF4 Scalar_FLOAT32_IEEE 0 swc_BatThermHndlgMngt_CM_single_dash_ -3.40282346639e+038 3.40282346639e+038 /end CHARACTERISTIC
/begin CHARACTERISTIC BTHM_TCoolgToChMax_P "parameter for maximum temperature to charge cooling mode request" VALUE 0x20018CF8 Scalar_FLOAT32_IEEE 0 swc_BatThermHndlgMngt_CM_single_dash_ -3.40282346639e+038 3.40282346639e+038 /end CHARACTERISTIC
/begin CHARACTERISTIC BTHM_TCoolgToSelnMax_P "parameter for maximum temperature to init" VALUE 0x20018CFC Scalar_FLOAT32_IEEE 0 swc_BatThermHndlgMngt_CM_single_dash_ -3.40282346639e+038 3.40282346639e+038 /end CHARACTERISTIC
/begin CHARACTERISTIC BTHM_TDig232_P "Temperature for daignosis 232" VALUE 0x20019BDA Scalar_SWORD 0 swc_BatThermHndlgMngt_CM_int16_dash_ -32768 32767 /end CHARACTERISTIC
/begin CHARACTERISTIC BTHM_TDig233_P "Temperature for daignosis 233" VALUE 0x20019BDC Scalar_SWORD 0 swc_BatThermHndlgMngt_CM_int16_dash_ -32768 32767 /end CHARACTERISTIC
/begin CHARACTERISTIC BTHM_TExitThermMax_P "parameter for maximum temperature to exit thermal management" VALUE 0x20018D0C Scalar_FLOAT32_IEEE 0 swc_BatThermHndlgMngt_CM_single_dash_ -3.40282346639e+038 3.40282346639e+038 /end CHARACTERISTIC
/begin CHARACTERISTIC BTHM_TExitThermMin_P "parameter for minimum temperature to exit thermal management" VALUE 0x20018D10 Scalar_FLOAT32_IEEE 0 swc_BatThermHndlgMngt_CM_single_dash_ -3.40282346639e+038 3.40282346639e+038 /end CHARACTERISTIC
/begin CHARACTERISTIC BTHM_TExitTherm_P "temperature to exit thermal" VALUE 0x20018D14 Scalar_FLOAT32_IEEE 0 swc_BatThermHndlgMngt_CM_single_dash_ 0 3.40282346639e+038 /end CHARACTERISTIC
/begin CHARACTERISTIC BTHM_TLoopSelfMax_P "parameter for pack temperature to self loop mode request" VALUE 0x20018D18 Scalar_FLOAT32_IEEE 0 swc_BatThermHndlgMngt_CM_single_dash_ -3.40282346639e+038 3.40282346639e+038 /end CHARACTERISTIC
/begin CHARACTERISTIC BTHM_TLqdChThermToChMax_P "parameter for maximum temperature to charge only" VALUE 0x20018D1C Scalar_FLOAT32_IEEE 0 swc_BatThermHndlgMngt_CM_single_dash_ -3.40282346639e+038 3.40282346639e+038 /end CHARACTERISTIC
/begin CHARACTERISTIC BTHM_TLqdChThermToChMin_P "parameter for minimum temperature to charge only" VALUE 0x20018D20 Scalar_FLOAT32_IEEE 0 swc_BatThermHndlgMngt_CM_single_dash_ -3.40282346639e+038 3.40282346639e+038 /end CHARACTERISTIC
/begin CHARACTERISTIC BTHM_TMdulCtlrSnsrMax_P "Maximum measured module controller temperature of battery pack." VALUE 0x20018D28 Scalar_FLOAT32_IEEE 0 swc_BatThermHndlgMngt_CM_single__ -60 140 /end CHARACTERISTIC
/begin CHARACTERISTIC BTHM_TMdulCtlrSnsrMin_P "Minimum measured module controller temperature of battery pack." VALUE 0x20018D2C Scalar_FLOAT32_IEEE 0 swc_BatThermHndlgMngt_CM_single__ -60 140 /end CHARACTERISTIC
/begin CHARACTERISTIC BTHM_TMdulSnsrMaxRaw_P "Minimum measured cell temperature of battery pack." VALUE 0x20018D74 Scalar_FLOAT32_IEEE 0 swc_BatThermHndlgMngt_CM_single__ -60 140 /end CHARACTERISTIC
/begin CHARACTERISTIC BTHM_TMdulSnsrMax_P "Maximum measured cell temperature of battery pack." VALUE 0x20018D78 Scalar_FLOAT32_IEEE 0 swc_BatThermHndlgMngt_CM_single__ -60 140 /end CHARACTERISTIC
/begin CHARACTERISTIC BTHM_TMdulSnsrMinRaw_P "Minimum measured cell temperature of battery pack." VALUE 0x20018D7C Scalar_FLOAT32_IEEE 0 swc_BatThermHndlgMngt_CM_single__ -60 140 /end CHARACTERISTIC
/begin CHARACTERISTIC BTHM_TMdulSnsrMin_P "Minimum measured cell temperature of battery pack." VALUE 0x20018D80 Scalar_FLOAT32_IEEE 0 swc_BatThermHndlgMngt_CM_single__ -60 140 /end CHARACTERISTIC
/begin CHARACTERISTIC BTHM_TMdulThermAllwd1_P "parameter for temperature to alloweding thermal management" VALUE 0x20018D84 Scalar_FLOAT32_IEEE 0 swc_BatThermHndlgMngt_CM_single_dash_ -3.40282346639e+038 3.40282346639e+038 /end CHARACTERISTIC
/begin CHARACTERISTIC BTHM_TMdulThermAllwd2_P "parameter for temperature to alloweding thermal management" VALUE 0x20018D88 Scalar_FLOAT32_IEEE 0 swc_BatThermHndlgMngt_CM_single_dash_ -3.40282346639e+038 3.40282346639e+038 /end CHARACTERISTIC
/begin CHARACTERISTIC BTHM_TPackChCoolgMode_P "parameter for pack temperature to cooling mode request" VALUE 0x20018D90 Scalar_FLOAT32_IEEE 0 swc_BatThermHndlgMngt_CM_single_dash_ -3.40282346639e+038 3.40282346639e+038 /end CHARACTERISTIC
/begin CHARACTERISTIC BTHM_TPackChThermLqdToCh_P "parameter for pack temperature to charge only" VALUE 0x20018D94 Scalar_FLOAT32_IEEE 0 swc_BatThermHndlgMngt_CM_single_dash_ -3.40282346639e+038 3.40282346639e+038 /end CHARACTERISTIC
/begin CHARACTERISTIC BTHM_TPackChToCoolg_P "parameter for pack temperature to cooling mode request" VALUE 0x20018D98 Scalar_FLOAT32_IEEE 0 swc_BatThermHndlgMngt_CM_single_dash_ -3.40282346639e+038 3.40282346639e+038 /end CHARACTERISTIC
/begin CHARACTERISTIC BTHM_TPackCoolgToCh_P "parameter for pack temperature to cooling mode request" VALUE 0x20018D9C Scalar_FLOAT32_IEEE 0 swc_BatThermHndlgMngt_CM_single_dash_ -3.40282346639e+038 3.40282346639e+038 /end CHARACTERISTIC
/begin CHARACTERISTIC BTHM_TPackCoolgToSeln_P "parameter for pack temperature to exit thermal management" VALUE 0x20018DA0 Scalar_FLOAT32_IEEE 0 swc_BatThermHndlgMngt_CM_single_dash_ -3.40282346639e+038 3.40282346639e+038 /end CHARACTERISTIC
/begin CHARACTERISTIC BTHM_TPackCoolg_P "parameter for pack temperature to cooling mode request" VALUE 0x20018DA4 Scalar_FLOAT32_IEEE 0 swc_BatThermHndlgMngt_CM_single_dash_ -3.40282346639e+038 3.40282346639e+038 /end CHARACTERISTIC
/begin CHARACTERISTIC BTHM_TPackLoopSelf_P "parameter for pack temperature to self loop mode request" VALUE 0x20018DA8 Scalar_FLOAT32_IEEE 0 swc_BatThermHndlgMngt_CM_single_dash_ -3.40282346639e+038 3.40282346639e+038 /end CHARACTERISTIC
/begin CHARACTERISTIC BTHM_TPackSelnLqdToCh_P "parameter for pack temperature to charge only" VALUE 0x20018DAC Scalar_FLOAT32_IEEE 0 swc_BatThermHndlgMngt_CM_single_dash_ -3.40282346639e+038 3.40282346639e+038 /end CHARACTERISTIC
/begin CHARACTERISTIC BTHM_TPackSelnToCoolg_P "parameter for pack temperature to cooling mode request" VALUE 0x20018DB0 Scalar_FLOAT32_IEEE 0 swc_BatThermHndlgMngt_CM_single_dash_ -3.40282346639e+038 3.40282346639e+038 /end CHARACTERISTIC
/begin CHARACTERISTIC BTHM_TPack_P "Mean Temperature of Pack" VALUE 0x20018DB4 Scalar_FLOAT32_IEEE 0 swc_BatThermHndlgMngt_CM_single__ -60 140 /end CHARACTERISTIC
/begin CHARACTERISTIC BTHM_TRstDig177_P "Temperature for reset daignosis 177" VALUE 0x20018DB8 Scalar_FLOAT32_IEEE 0 swc_BatThermHndlgMngt_CM_single_dash_ -3.40282346639e+038 3.40282346639e+038 /end CHARACTERISTIC
/begin CHARACTERISTIC BTHM_TSelnLqdToChMax_P "parameter for maximum temperature to charge only" VALUE 0x20018DC0 Scalar_FLOAT32_IEEE 0 swc_BatThermHndlgMngt_CM_single_dash_ -3.40282346639e+038 3.40282346639e+038 /end CHARACTERISTIC
/begin CHARACTERISTIC BTHM_TSelnLqdToChMin_P "parameter for minimum temperature to charge only" VALUE 0x20018DC4 Scalar_FLOAT32_IEEE 0 swc_BatThermHndlgMngt_CM_single_dash_ -3.40282346639e+038 3.40282346639e+038 /end CHARACTERISTIC
/begin CHARACTERISTIC BTHM_TSelnLqdToChThermMin_P "parameter for minimum temperature to charge and thermal" VALUE 0x20018DC8 Scalar_FLOAT32_IEEE 0 swc_BatThermHndlgMngt_CM_single_dash_ -3.40282346639e+038 3.40282346639e+038 /end CHARACTERISTIC
/begin CHARACTERISTIC BTHM_TSelnLqdToThermOnlyMin_P "parameter for minimum temperature to thermal only" VALUE 0x20018DCC Scalar_FLOAT32_IEEE 0 swc_BatThermHndlgMngt_CM_single_dash_ -3.40282346639e+038 3.40282346639e+038 /end CHARACTERISTIC
/begin CHARACTERISTIC BTHM_TSelnToChMax_P "parameter for maximum temperature to charge" VALUE 0x20018DD0 Scalar_FLOAT32_IEEE 0 swc_BatThermHndlgMngt_CM_single_dash_ -3.40282346639e+038 3.40282346639e+038 /end CHARACTERISTIC
/begin CHARACTERISTIC BTHM_TSelnToChMin_P "parameter for minimum temperature to charge" VALUE 0x20018DD4 Scalar_FLOAT32_IEEE 0 swc_BatThermHndlgMngt_CM_single_dash_ -3.40282346639e+038 3.40282346639e+038 /end CHARACTERISTIC
/begin CHARACTERISTIC BTHM_TSelnToChThermMin_P "parameter for minimum temperature to charge and thermal" VALUE 0x20018DD8 Scalar_FLOAT32_IEEE 0 swc_BatThermHndlgMngt_CM_single_dash_ -3.40282346639e+038 3.40282346639e+038 /end CHARACTERISTIC
/begin CHARACTERISTIC BTHM_TSelnToCoolgMax_P "parameter for maximum temperature to charge and thermal" VALUE 0x20018DDC Scalar_FLOAT32_IEEE 0 swc_BatThermHndlgMngt_CM_single_dash_ -3.40282346639e+038 3.40282346639e+038 /end CHARACTERISTIC
/begin CHARACTERISTIC BTHM_TSelnToThermOnlyMax_P "parameter for maximum temperature to thermal only" VALUE 0x20018DE0 Scalar_FLOAT32_IEEE 0 swc_BatThermHndlgMngt_CM_single_dash_ -3.40282346639e+038 3.40282346639e+038 /end CHARACTERISTIC
/begin CHARACTERISTIC BTHM_TSelnToThermOnlyMin_P "parameter for minimum temperature to thermal only" VALUE 0x20018DE4 Scalar_FLOAT32_IEEE 0 swc_BatThermHndlgMngt_CM_single_dash_ -3.40282346639e+038 3.40282346639e+038 /end CHARACTERISTIC
/begin CHARACTERISTIC BTHM_TSelnToTherm_P "parameter for temperature allowed thermal management" VALUE 0x20018DE8 Scalar_FLOAT32_IEEE 0 swc_BatThermHndlgMngt_CM_single_dash_ -3.40282346639e+038 3.40282346639e+038 /end CHARACTERISTIC
/begin CHARACTERISTIC BTHM_TSetDig177_P "Temperature for set daignosis 177" VALUE 0x20018DEC Scalar_FLOAT32_IEEE 0 swc_BatThermHndlgMngt_CM_single_dash_ -3.40282346639e+038 3.40282346639e+038 /end CHARACTERISTIC
/begin CHARACTERISTIC BTHM_TSetDig64Max_P "Max temperature for reset daignosis 64" VALUE 0x20018DF0 Scalar_FLOAT32_IEEE 0 swc_BatThermHndlgMngt_CM_single_dash_ -3.40282346639e+038 3.40282346639e+038 /end CHARACTERISTIC
/begin CHARACTERISTIC BTHM_TSetDig64_P "Temperature for reset daignosis 64" VALUE 0x20018DF4 Scalar_FLOAT32_IEEE 0 swc_BatThermHndlgMngt_CM_single_dash_ -3.40282346639e+038 3.40282346639e+038 /end CHARACTERISTIC
/begin CHARACTERISTIC BTHM_TSetOverLo_P "Temperature for set daignosis low limit" VALUE 0x20018DFC Scalar_FLOAT32_IEEE 0 swc_BatThermHndlgMngt_CM_single_dash_ -3.40282346639e+038 3.40282346639e+038 /end CHARACTERISTIC
/begin CHARACTERISTIC BTHM_TSetOverUp_P "Temperature for set daignosis  up limit" VALUE 0x20018E00 Scalar_FLOAT32_IEEE 0 swc_BatThermHndlgMngt_CM_single_dash_ -3.40282346639e+038 3.40282346639e+038 /end CHARACTERISTIC
/begin CHARACTERISTIC BTHM_TShnt1RstDig_P "Temperature for reset daignosis shunt first error" VALUE 0x20019BDE Scalar_SWORD 0 swc_BatThermHndlgMngt_CM_int16_dash_ -32768 32767 /end CHARACTERISTIC
/begin CHARACTERISTIC BTHM_TShnt1SetDig_P "Temperature for set daignosis shunt first error" VALUE 0x20019BE0 Scalar_SWORD 0 swc_BatThermHndlgMngt_CM_int16_dash_ -32768 32767 /end CHARACTERISTIC
/begin CHARACTERISTIC BTHM_TShnt2RstDig_P "Temperature for reset daignosis shunt second error" VALUE 0x20019BE2 Scalar_SWORD 0 swc_BatThermHndlgMngt_CM_int16_dash_ -32768 32767 /end CHARACTERISTIC
/begin CHARACTERISTIC BTHM_TShnt2SetDig_P "Temperature for set daignosis shunt second error" VALUE 0x20019BE4 Scalar_SWORD 0 swc_BatThermHndlgMngt_CM_int16_dash_ -32768 32767 /end CHARACTERISTIC
/begin CHARACTERISTIC BTHM_TThermLqdToChThermMin_P "parameter for minimum temperature to charge and thermal" VALUE 0x20018E04 Scalar_FLOAT32_IEEE 0 swc_BatThermHndlgMngt_CM_single_dash_ -3.40282346639e+038 3.40282346639e+038 /end CHARACTERISTIC
/begin CHARACTERISTIC BTHM_TThermOnlyToChThermMin_P "parameter for minimum temperature to charge and thermal" VALUE 0x20018E08 Scalar_FLOAT32_IEEE 0 swc_BatThermHndlgMngt_CM_single_dash_ -3.40282346639e+038 3.40282346639e+038 /end CHARACTERISTIC
/begin CHARACTERISTIC BTHM_TThermToSelnMax_P "parameter for maximum to exit thermal management" VALUE 0x20018E0C Scalar_FLOAT32_IEEE 0 swc_BatThermHndlgMngt_CM_single_dash_ -3.40282346639e+038 3.40282346639e+038 /end CHARACTERISTIC
/begin CHARACTERISTIC BTHM_TThermToSelnMin_P "parameter for minimum to exit thermal management" VALUE 0x20018E10 Scalar_FLOAT32_IEEE 0 swc_BatThermHndlgMngt_CM_single_dash_ -3.40282346639e+038 3.40282346639e+038 /end CHARACTERISTIC
/begin CHARACTERISTIC BTHM_TiAFEOffDig_P "Timer delay off for daignosis AFE" VALUE 0x20018E14 Scalar_FLOAT32_IEEE 0 swc_BatThermHndlgMngt_CM_single_dash_ -3.40282346639e+038 3.40282346639e+038 /end CHARACTERISTIC
/begin CHARACTERISTIC BTHM_TiAFEOnDig_P "Timer delay on for daignosis AFE" VALUE 0x20018E18 Scalar_FLOAT32_IEEE 0 swc_BatThermHndlgMngt_CM_single_dash_ -3.40282346639e+038 3.40282346639e+038 /end CHARACTERISTIC
/begin CHARACTERISTIC BTHM_TiDlyDchaTherm_P "Timer for discharge thermal management" VALUE 0x20018E1C Scalar_FLOAT32_IEEE 0 swc_BatThermHndlgMngt_CM_single_dash_ 0 3.40282346639e+038 /end CHARACTERISTIC
/begin CHARACTERISTIC BTHM_TiDlyForCellVolLo_P "time delay for cell voltage too low" VALUE 0x20018E20 Scalar_FLOAT32_IEEE 0 swc_BatThermHndlgMngt_CM_single_dash_ 0 3.40282346639e+038 /end CHARACTERISTIC
/begin CHARACTERISTIC BTHM_TiDlyForIDetn_P "time delay for current detection" VALUE 0x20018E24 Scalar_FLOAT32_IEEE 0 swc_BatThermHndlgMngt_CM_single_dash_ 0 3.40282346639e+038 /end CHARACTERISTIC
/begin CHARACTERISTIC BTHM_TiDlyForUDetn_P "time delay for voltage detection" VALUE 0x20018E28 Scalar_FLOAT32_IEEE 0 swc_BatThermHndlgMngt_CM_single_dash_ 0 3.40282346639e+038 /end CHARACTERISTIC
/begin CHARACTERISTIC BTHM_TiDlyToTClcd_P "time delay for calculated temperature" VALUE 0x20018E2C Scalar_FLOAT32_IEEE 0 swc_BatThermHndlgMngt_CM_single_dash_ 0 3.40282346639e+038 /end CHARACTERISTIC
/begin CHARACTERISTIC BTHM_TiOffDig1091_P "Timer delay off for daignosis 1091" VALUE 0x20018E30 Scalar_FLOAT32_IEEE 0 swc_BatThermHndlgMngt_CM_single_dash_ -3.40282346639e+038 3.40282346639e+038 /end CHARACTERISTIC
/begin CHARACTERISTIC BTHM_TiOffDig1092_P "Timer delay off for daignosis 1092" VALUE 0x20018E34 Scalar_FLOAT32_IEEE 0 swc_BatThermHndlgMngt_CM_single_dash_ -3.40282346639e+038 3.40282346639e+038 /end CHARACTERISTIC
/begin CHARACTERISTIC BTHM_TiOffDig1093_P "Timer delay off for daignosis 1093" VALUE 0x20018E38 Scalar_FLOAT32_IEEE 0 swc_BatThermHndlgMngt_CM_single_dash_ -3.40282346639e+038 3.40282346639e+038 /end CHARACTERISTIC
/begin CHARACTERISTIC BTHM_TiOffDig1094_P "Timer delay off for daignosis 1094" VALUE 0x20018E3C Scalar_FLOAT32_IEEE 0 swc_BatThermHndlgMngt_CM_single_dash_ -3.40282346639e+038 3.40282346639e+038 /end CHARACTERISTIC
/begin CHARACTERISTIC BTHM_TiOffDig177_P "Timer delay off for daignosis 177" VALUE 0x20018E40 Scalar_FLOAT32_IEEE 0 swc_BatThermHndlgMngt_CM_single_dash_ -3.40282346639e+038 3.40282346639e+038 /end CHARACTERISTIC
/begin CHARACTERISTIC BTHM_TiOffDig198_P "Timer delay off for daignosis 198" VALUE 0x20018E44 Scalar_FLOAT32_IEEE 0 swc_BatThermHndlgMngt_CM_single_dash_ -3.40282346639e+038 3.40282346639e+038 /end CHARACTERISTIC
/begin CHARACTERISTIC BTHM_TiOffDig232_P "Timer delay off for daignosis 232" VALUE 0x20018E48 Scalar_FLOAT32_IEEE 0 swc_BatThermHndlgMngt_CM_single_dash_ -3.40282346639e+038 3.40282346639e+038 /end CHARACTERISTIC
/begin CHARACTERISTIC BTHM_TiOffDig233_P "Timer delay off for daignosis 233" VALUE 0x20018E4C Scalar_FLOAT32_IEEE 0 swc_BatThermHndlgMngt_CM_single_dash_ -3.40282346639e+038 3.40282346639e+038 /end CHARACTERISTIC
/begin CHARACTERISTIC BTHM_TiOffDig234_P "Timer delay off for daignosis 234" VALUE 0x20018E50 Scalar_FLOAT32_IEEE 0 swc_BatThermHndlgMngt_CM_single_dash_ -3.40282346639e+038 3.40282346639e+038 /end CHARACTERISTIC
/begin CHARACTERISTIC BTHM_TiOffDig236_P "Timer delay off for daignosis 236" VALUE 0x20018E54 Scalar_FLOAT32_IEEE 0 swc_BatThermHndlgMngt_CM_single_dash_ -3.40282346639e+038 3.40282346639e+038 /end CHARACTERISTIC
/begin CHARACTERISTIC BTHM_TiOffDig64_P "Timer delay off for daignosis 64" VALUE 0x20018E5C Scalar_FLOAT32_IEEE 0 swc_BatThermHndlgMngt_CM_single_dash_ -3.40282346639e+038 3.40282346639e+038 /end CHARACTERISTIC
/begin CHARACTERISTIC BTHM_TiOffOverLoDig_P "Timer delay off for daignosis temperature low limit" VALUE 0x20018E64 Scalar_FLOAT32_IEEE 0 swc_BatThermHndlgMngt_CM_single_dash_ -3.40282346639e+038 3.40282346639e+038 /end CHARACTERISTIC
/begin CHARACTERISTIC BTHM_TiOffOverUpDig_P "Timer delay off for daignosis temperature up limit" VALUE 0x20018E68 Scalar_FLOAT32_IEEE 0 swc_BatThermHndlgMngt_CM_single_dash_ -3.40282346639e+038 3.40282346639e+038 /end CHARACTERISTIC
/begin CHARACTERISTIC BTHM_TiOnDig1091_P "Timer delay on for daignosis 1091" VALUE 0x20018E6C Scalar_FLOAT32_IEEE 0 swc_BatThermHndlgMngt_CM_single_dash_ -3.40282346639e+038 3.40282346639e+038 /end CHARACTERISTIC
/begin CHARACTERISTIC BTHM_TiOnDig1092_P "Timer delay on for daignosis 1092" VALUE 0x20018E70 Scalar_FLOAT32_IEEE 0 swc_BatThermHndlgMngt_CM_single_dash_ -3.40282346639e+038 3.40282346639e+038 /end CHARACTERISTIC
/begin CHARACTERISTIC BTHM_TiOnDig1093_P "Timer delay on for daignosis 1093" VALUE 0x20018E74 Scalar_FLOAT32_IEEE 0 swc_BatThermHndlgMngt_CM_single_dash_ -3.40282346639e+038 3.40282346639e+038 /end CHARACTERISTIC
/begin CHARACTERISTIC BTHM_TiOnDig1094_P "Timer delay on for daignosis 1094" VALUE 0x20018E78 Scalar_FLOAT32_IEEE 0 swc_BatThermHndlgMngt_CM_single_dash_ -3.40282346639e+038 3.40282346639e+038 /end CHARACTERISTIC
/begin CHARACTERISTIC BTHM_TiOnDig177_P "Timer delay on for daignosis 177" VALUE 0x20018E7C Scalar_FLOAT32_IEEE 0 swc_BatThermHndlgMngt_CM_single_dash_ -3.40282346639e+038 3.40282346639e+038 /end CHARACTERISTIC
/begin CHARACTERISTIC BTHM_TiOnDig198_P "Timer delay on for daignosis 198" VALUE 0x20018E80 Scalar_FLOAT32_IEEE 0 swc_BatThermHndlgMngt_CM_single_dash_ -3.40282346639e+038 3.40282346639e+038 /end CHARACTERISTIC
/begin CHARACTERISTIC BTHM_TiOnDig232_P "Timer delay on for daignosis 232" VALUE 0x20018E84 Scalar_FLOAT32_IEEE 0 swc_BatThermHndlgMngt_CM_single_dash_ -3.40282346639e+038 3.40282346639e+038 /end CHARACTERISTIC
/begin CHARACTERISTIC BTHM_TiOnDig233_P "Timer delay on for daignosis 233" VALUE 0x20018E88 Scalar_FLOAT32_IEEE 0 swc_BatThermHndlgMngt_CM_single_dash_ -3.40282346639e+038 3.40282346639e+038 /end CHARACTERISTIC
/begin CHARACTERISTIC BTHM_TiOnDig234_P "Timer delay on for daignosis 234" VALUE 0x20018E8C Scalar_FLOAT32_IEEE 0 swc_BatThermHndlgMngt_CM_single_dash_ -3.40282346639e+038 3.40282346639e+038 /end CHARACTERISTIC
/begin CHARACTERISTIC BTHM_TiOnDig236_P "Timer delay on for daignosis 236" VALUE 0x20018E90 Scalar_FLOAT32_IEEE 0 swc_BatThermHndlgMngt_CM_single_dash_ -3.40282346639e+038 3.40282346639e+038 /end CHARACTERISTIC
/begin CHARACTERISTIC BTHM_TiOnDig64_P "Timer delay on for daignosis 64" VALUE 0x20018E98 Scalar_FLOAT32_IEEE 0 swc_BatThermHndlgMngt_CM_single_dash_ -3.40282346639e+038 3.40282346639e+038 /end CHARACTERISTIC
/begin CHARACTERISTIC BTHM_TiOnOverLoDig_P "Timer delay on for daignosis temperature low limit" VALUE 0x20018EA0 Scalar_FLOAT32_IEEE 0 swc_BatThermHndlgMngt_CM_single_dash_ -3.40282346639e+038 3.40282346639e+038 /end CHARACTERISTIC
/begin CHARACTERISTIC BTHM_TiOnOverUpDig_P "Timer delay on for daignosis temperature up limit" VALUE 0x20018EA4 Scalar_FLOAT32_IEEE 0 swc_BatThermHndlgMngt_CM_single_dash_ -3.40282346639e+038 3.40282346639e+038 /end CHARACTERISTIC
/begin CHARACTERISTIC BTHM_TiRlyDlyNegOpen_P "time delay for open negative relay" VALUE 0x20018EA8 Scalar_FLOAT32_IEEE 0 swc_BatThermHndlgMngt_CM_single_dash_ 0 3.40282346639e+038 /end CHARACTERISTIC
/begin CHARACTERISTIC BTHM_TiShnt1OffDig_P "Timer delay off for daignosis shunt first error" VALUE 0x20018EAC Scalar_FLOAT32_IEEE 0 swc_BatThermHndlgMngt_CM_single_dash_ -3.40282346639e+038 3.40282346639e+038 /end CHARACTERISTIC
/begin CHARACTERISTIC BTHM_TiShnt1OnDig_P "Timer delay on for daignosis shunt first error" VALUE 0x20018EB0 Scalar_FLOAT32_IEEE 0 swc_BatThermHndlgMngt_CM_single_dash_ -3.40282346639e+038 3.40282346639e+038 /end CHARACTERISTIC
/begin CHARACTERISTIC BTHM_TiShnt2OffDig_P "Timer delay off for daignosis shunt second error" VALUE 0x20018EB4 Scalar_FLOAT32_IEEE 0 swc_BatThermHndlgMngt_CM_single_dash_ -3.40282346639e+038 3.40282346639e+038 /end CHARACTERISTIC
/begin CHARACTERISTIC BTHM_TiShnt2OnDig_P "Timer delay on for daignosis shunt second error" VALUE 0x20018EB8 Scalar_FLOAT32_IEEE 0 swc_BatThermHndlgMngt_CM_single_dash_ -3.40282346639e+038 3.40282346639e+038 /end CHARACTERISTIC
/begin CHARACTERISTIC BTHM_USelnToTherm_P "parameter for voltage allowed thermal management" VALUE 0x20018EC0 Scalar_FLOAT32_IEEE 0 swc_BatThermHndlgMngt_CM_single_dash_ -3.40282346639e+038 3.40282346639e+038 /end CHARACTERISTIC
/begin CHARACTERISTIC BTHM_UThermToSeln_P "parameter for voltage exit thermal management" VALUE 0x20018EC4 Scalar_FLOAT32_IEEE 0 swc_BatThermHndlgMngt_CM_single_dash_ -3.40282346639e+038 3.40282346639e+038 /end CHARACTERISTIC
/begin CHARACTERISTIC BTHM_ValOnDig234_P "value for on daignosis 234" VALUE 0x20018EC8 Scalar_FLOAT32_IEEE 0 swc_BatThermHndlgMngt_CM_single_dash_ -3.40282346639e+038 3.40282346639e+038 /end CHARACTERISTIC
/begin CHARACTERISTIC BTHM_ValOnDig236_P "value for on daignosis 236" VALUE 0x20018ECC Scalar_FLOAT32_IEEE 0 swc_BatThermHndlgMngt_CM_single_dash_ -3.40282346639e+038 3.40282346639e+038 /end CHARACTERISTIC
/begin CHARACTERISTIC BTHM_ValReplDig_P "parameter for replace value diagnosis" VALUE 0x20018ED0 Scalar_ULONG 0 swc_BatThermHndlgMngt_CM_uint32_dash_ 0 4294967295 /end CHARACTERISTIC
/begin CHARACTERISTIC BWLD_LvlAcs_P "Global access level for service command requests. Is determined from current access key." VALUE 0x20019C60 Scalar_UBYTE 0 swc_BatWntyLogtcData_CM_uint8_dash_ 0 255 /end CHARACTERISTIC
/begin CHARACTERISTIC COL_Csw6_P "Code word 1 for activation of replacement values" VALUE 0x200196C0 Scalar_ULONG 0 swc_COL_CM_uint32_dash_ 0 4294967295 /end CHARACTERISTIC
/begin CHARACTERISTIC DEH_Csw1_P "bypass switch 1" VALUE 0x20019AB0 Scalar_ULONG 0 swc_DiagcEveHndlg_CM_uint32_dash_ 0 4294967295 /end CHARACTERISTIC
/begin CHARACTERISTIC DEH_EnaDiagGlbMan_P "switch for global diagnosis enable flag" VALUE 0x20019D6A Scalar_BOOLEAN 0 swc_DiagcEveHndlg_CM_boolean_dash_ 0 1 /end CHARACTERISTIC
/begin CHARACTERISTIC DEH_LvlErrMan_P "Manual Error Level Value (for test purposes only)" VALUE 0x20019D67 Scalar_UBYTE 0 swc_DiagcEveHndlg_CM_uint8_dash_ 0 255 /end CHARACTERISTIC
/begin CHARACTERISTIC DEH_LvlErrSbMan_P "Sub Error Level calculated by DEH\n      0x00 = No error \n      0x01 = level1\n      0x02 = level2\n      0x03 = level3" VALUE 0x20019D68 Scalar_UBYTE 0 swc_DiagcEveHndlg_CM_uint8_dash_ 0 255 /end CHARACTERISTIC
/begin CHARACTERISTIC DEH_StFltLampIndcnMan_P "manual set fault lamp state" VALUE 0x20019D69 Scalar_UBYTE 0 swc_DiagcEveHndlg_CM_uint8_dash_ 0 255 /end CHARACTERISTIC
/begin CHARACTERISTIC DEH_UTrmlLowrThd_P "KL30 voltage lower threshold" VALUE 0x20019AD4 Scalar_FLOAT32_IEEE 0 swc_DiagcEveHndlg_CM_single_dash_ -3.40282346639e+038 3.40282346639e+038 /end CHARACTERISTIC
/begin CHARACTERISTIC DEH_UTrmlUpprThd_P "KL30 voltage upper threshold" VALUE 0x20019AD8 Scalar_FLOAT32_IEEE 0 swc_DiagcEveHndlg_CM_single_dash_ -3.40282346639e+038 3.40282346639e+038 /end CHARACTERISTIC
/begin CHARACTERISTIC DEH_bAcvAcChInh_P "Battery AC charge inhibition flag" VALUE 0x20019D6B Scalar_BOOLEAN 0 swc_DiagcEveHndlg_CM_boolean_dash_ 0 1 /end CHARACTERISTIC
/begin CHARACTERISTIC DEH_bAcvChInh_P "Battery charge inhibition flag" VALUE 0x20019D6C Scalar_BOOLEAN 0 swc_DiagcEveHndlg_CM_boolean_dash_ 0 1 /end CHARACTERISTIC
/begin CHARACTERISTIC DEH_bAcvDcChInh_P "Battery DC charge inhibition flag" VALUE 0x20019D6D Scalar_BOOLEAN 0 swc_DiagcEveHndlg_CM_boolean_dash_ 0 1 /end CHARACTERISTIC
/begin CHARACTERISTIC DEH_bAcvDchaInh_P "Battery discharge inhibition flag" VALUE 0x20019D6E Scalar_BOOLEAN 0 swc_DiagcEveHndlg_CM_boolean_dash_ 0 1 /end CHARACTERISTIC
/begin CHARACTERISTIC DEH_bAcvEmcyHvOff1_P "Emergency Hv Off flag 1" VALUE 0x20019D6F Scalar_BOOLEAN 0 swc_DiagcEveHndlg_CM_boolean_dash_ 0 1 /end CHARACTERISTIC
/begin CHARACTERISTIC DEH_bAcvEmcyHvOff2_P "Emergency Hv Off flag 2" VALUE 0x20019D70 Scalar_BOOLEAN 0 swc_DiagcEveHndlg_CM_boolean_dash_ 0 1 /end CHARACTERISTIC
/begin CHARACTERISTIC DEH_bAcvHeatInh_P "Battery heat inhibition flag" VALUE 0x20019D71 Scalar_BOOLEAN 0 swc_DiagcEveHndlg_CM_boolean_dash_ 0 1 /end CHARACTERISTIC
/begin CHARACTERISTIC DEH_bAcvLvlErr1_P "Battery error level 1" VALUE 0x20019D72 Scalar_BOOLEAN 0 swc_DiagcEveHndlg_CM_boolean_dash_ 0 1 /end CHARACTERISTIC
/begin CHARACTERISTIC DEH_bAcvLvlErr2_P "Battery error level 2" VALUE 0x20019D73 Scalar_BOOLEAN 0 swc_DiagcEveHndlg_CM_boolean_dash_ 0 1 /end CHARACTERISTIC
/begin CHARACTERISTIC DEH_bAcvLvlErr3_P "Battery error level 3" VALUE 0x20019D74 Scalar_BOOLEAN 0 swc_DiagcEveHndlg_CM_boolean_dash_ 0 1 /end CHARACTERISTIC
/begin CHARACTERISTIC DEH_bAcvLvlErrSb1_P "Battery sub error level 1" VALUE 0x20019D75 Scalar_BOOLEAN 0 swc_DiagcEveHndlg_CM_boolean_dash_ 0 1 /end CHARACTERISTIC
/begin CHARACTERISTIC DEH_bAcvLvlErrSb2_P "Battery sub error level 2" VALUE 0x20019D76 Scalar_BOOLEAN 0 swc_DiagcEveHndlg_CM_boolean_dash_ 0 1 /end CHARACTERISTIC
/begin CHARACTERISTIC DEH_bAcvLvlErrSb3_P "Battery sub error level 3" VALUE 0x20019D77 Scalar_BOOLEAN 0 swc_DiagcEveHndlg_CM_boolean_dash_ 0 1 /end CHARACTERISTIC
/begin CHARACTERISTIC DEH_bAcvPowupInh_P "Powerup inhibition flag" VALUE 0x20019D78 Scalar_BOOLEAN 0 swc_DiagcEveHndlg_CM_boolean_dash_ 0 1 /end CHARACTERISTIC
/begin CHARACTERISTIC DEH_bAcvPwrChLim1_P "Limit battery charge power to 50 percent" VALUE 0x20019D79 Scalar_BOOLEAN 0 swc_DiagcEveHndlg_CM_boolean_dash_ 0 1 /end CHARACTERISTIC
/begin CHARACTERISTIC DEH_bAcvPwrChLim2_P "Limit battery charge power to 75 percent" VALUE 0x20019D7A Scalar_BOOLEAN 0 swc_DiagcEveHndlg_CM_boolean_dash_ 0 1 /end CHARACTERISTIC
/begin CHARACTERISTIC DEH_bAcvPwrDchaLim1_P "Limit battery discharge power to 50 percent" VALUE 0x20019D7B Scalar_BOOLEAN 0 swc_DiagcEveHndlg_CM_boolean_dash_ 0 1 /end CHARACTERISTIC
/begin CHARACTERISTIC DEH_bAcvPwrDchaLim2_P "Limit battery discharge power to 75 percent" VALUE 0x20019D7C Scalar_BOOLEAN 0 swc_DiagcEveHndlg_CM_boolean_dash_ 0 1 /end CHARACTERISTIC
/begin CHARACTERISTIC DEH_bAcvPwrRecupLim1_P "Limit battery recuperation power to 50 percent" VALUE 0x20019D7D Scalar_BOOLEAN 0 swc_DiagcEveHndlg_CM_boolean_dash_ 0 1 /end CHARACTERISTIC
/begin CHARACTERISTIC DEH_bAcvPwrRecupLim2_P "Limit battery recuperation power to 75 percent" VALUE 0x20019D7E Scalar_BOOLEAN 0 swc_DiagcEveHndlg_CM_boolean_dash_ 0 1 /end CHARACTERISTIC
/begin CHARACTERISTIC DEH_bAcvPwrdNorm_P "BMS normal powerdown trigger" VALUE 0x20019D7F Scalar_BOOLEAN 0 swc_DiagcEveHndlg_CM_boolean_dash_ 0 1 /end CHARACTERISTIC
/begin CHARACTERISTIC DEH_bAcvRecupInh_P "Recuperation inhibition flag" VALUE 0x20019D80 Scalar_BOOLEAN 0 swc_DiagcEveHndlg_CM_boolean_dash_ 0 1 /end CHARACTERISTIC
/begin CHARACTERISTIC DEH_bAcvSleepNorm_P "BMS normal sleep trigger" VALUE 0x20019D81 Scalar_BOOLEAN 0 swc_DiagcEveHndlg_CM_boolean_dash_ 0 1 /end CHARACTERISTIC
/begin CHARACTERISTIC ELHPN_TiCrashDebIniOff_P "Time delay off for debounce of crash state while initializing." VALUE 0x20019B2C Scalar_FLOAT32_IEEE 0 swc_EltlLnkHzrdProtnNet_CM_single_s -3.40282346639e+038 3.40282346639e+038 /end CHARACTERISTIC
/begin CHARACTERISTIC ELHPN_TiCrashDebIniOn_P "Time delay on for debounce of crash state while initializing." VALUE 0x20019B30 Scalar_FLOAT32_IEEE 0 swc_EltlLnkHzrdProtnNet_CM_single_s -3.40282346639e+038 3.40282346639e+038 /end CHARACTERISTIC
/begin GROUP S339_BCF_RMdulDeltaUpprLimOfTrip_P "swc_BatCoreFct/BCF_100ms_sys/BatCoreFct/PackObs/PackObsLoop/MdulObs/MdulRObs/RMdulDeltaTripSatn/BCF_RMdulDeltaUpprLimOfTrip_P" /begin REF_CHARACTERISTIC BCF_RMdulDeltaUpprLimOfTrip_P /end REF_CHARACTERISTIC /end GROUP
/begin GROUP S340_BCF_RMdulDeltaShoUpprLim_P "swc_BatCoreFct/BCF_100ms_sys/BatCoreFct/PackObs/PackObsLoop/MdulObs/MdulRObs/Sensitivity of Estimation/BCF_RMdulDeltaShoUpprLim_P" /begin REF_CHARACTERISTIC BCF_RMdulDeltaShoUpprLim_P /end REF_CHARACTERISTIC /end GROUP
/begin GROUP S340_BCF_RMdulTripLamWithBaln_P "swc_BatCoreFct/BCF_100ms_sys/BatCoreFct/PackObs/PackObsLoop/MdulObs/MdulRObs/Sensitivity of Estimation/BCF_RMdulTripLamWithBaln_P" /begin REF_CHARACTERISTIC BCF_RMdulTripLamWithBaln_P /end REF_CHARACTERISTIC /end GROUP
/begin GROUP S340_BCF_RMdulTripLamWoutBaln_P "swc_BatCoreFct/BCF_100ms_sys/BatCoreFct/PackObs/PackObsLoop/MdulObs/MdulRObs/Sensitivity of Estimation/BCF_RMdulTripLamWoutBaln_P" /begin REF_CHARACTERISTIC BCF_RMdulTripLamWoutBaln_P /end REF_CHARACTERISTIC /end GROUP
/begin GROUP S340_BCF_RSysMtrxCdngNrShoLimHi_P "swc_BatCoreFct/BCF_100ms_sys/BatCoreFct/PackObs/PackObsLoop/MdulObs/MdulRObs/Sensitivity of Estimation/BCF_RSysMtrxCdngNrShoLimHi_P" /begin REF_CHARACTERISTIC BCF_RSysMtrxCdngNrShoLimHi_P /end REF_CHARACTERISTIC /end GROUP
/begin GROUP S340_BCF_RSysMtrxCdngNrTripLimHi_P "swc_BatCoreFct/BCF_100ms_sys/BatCoreFct/PackObs/PackObsLoop/MdulObs/MdulRObs/Sensitivity of Estimation/BCF_RSysMtrxCdngNrTripLimHi_P" /begin REF_CHARACTERISTIC BCF_RSysMtrxCdngNrTripLimHi_P /end REF_CHARACTERISTIC /end GROUP
/begin GROUP S341_Diagnostic_of_UMdulOffSho "swc_BatCoreFct/BCF_100ms_sys/BatCoreFct/PackObs/PackObsLoop/MdulObs/MdulRObs/UMdulOffSho Diagnosis/Diagnostic of UMdulOffSho"
 /begin SUB_GROUP S368_BCF_Td_P S368_BCF_TdOffDig1005_P S368_BCF_TdOnDig1005_P S368_BCF_UMdulDeErrLimForMdlInvld_P S368_BCF_UMdulDeErrLimForMdlVld_P S368_BitSelect3 /end SUB_GROUP
/end GROUP
/begin GROUP S342_Calculate_update_of_aging_factor "swc_BatCoreFct/BCF_100ms_sys/BatCoreFct/PackObs/PackObsLoop/MdulObs/MdulRObs/Update RMdulAgiFac/Calculate update of aging factor" /begin SUB_GROUP S383_BCF_RMdulAgiFacSatn_M S383_BCF_RMdulAgiFacUpd_P /end SUB_GROUP /end GROUP
/begin GROUP S342_Diagnostic_of_module_degradation "swc_BatCoreFct/BCF_100ms_sys/BatCoreFct/PackObs/PackObsLoop/MdulObs/MdulRObs/Update RMdulAgiFac/Diagnostic of module degradation"
 /begin SUB_GROUP S385_BCF_RMdulAgiFacInvldErrMin_M S385_BCF_RMdulAgiFacInvldHeal_M S385_BCF_RMdulAgiFacVldErrMin_M S385_BCF_RMdulAgiFacVldHeal_M S385_BCF_Td_P S385_BCF_TdOffDig1003_P S385_BCF_TdOnDig1003_P S385_BitSelect3 /end SUB_GROUP
/end GROUP
/begin GROUP S342_Update_new_aging_factor "swc_BatCoreFct/BCF_100ms_sys/BatCoreFct/PackObs/PackObsLoop/MdulObs/MdulRObs/Update RMdulAgiFac/Update new aging factor"
 /begin SUB_GROUP S386_BCF_RMdulAgiFacLowrLim_P S386_BCF_RMdulAgiFacUpprLim_P /end SUB_GROUP
/end GROUP
/begin GROUP S35_ELHPN_TiCrashDebIniOff_P "swc_EltlLnkHzrdProtnNet/ELHPN_10ms_sys/ELHPN_10ms_sys/CrashErr/InitialCheck/ELHPN_TiCrashDebIniOff_P" /begin REF_CHARACTERISTIC ELHPN_TiCrashDebIniOff_P /end REF_CHARACTERISTIC /end GROUP
/begin GROUP S35_ELHPN_TiCrashDebIniOn_P "swc_EltlLnkHzrdProtnNet/ELHPN_10ms_sys/ELHPN_10ms_sys/CrashErr/InitialCheck/ELHPN_TiCrashDebIniOn_P" /begin REF_CHARACTERISTIC ELHPN_TiCrashDebIniOn_P /end REF_CHARACTERISTIC /end GROUP
/begin GROUP S367_BTHM_PctgRlyUClsNegMax_P "swc_BatThermHndlgMngt/BTHM_100ms_sys/100ms/ThermManage/HeatThermalCondition/BTHM_PctgRlyUClsNegMax_P" /begin REF_CHARACTERISTIC BTHM_PctgRlyUClsNegMax_P /end REF_CHARACTERISTIC /end GROUP
/begin GROUP S367_BTHM_PctgRlyUClsNegMin_P "swc_BatThermHndlgMngt/BTHM_100ms_sys/100ms/ThermManage/HeatThermalCondition/BTHM_PctgRlyUClsNegMin_P" /begin REF_CHARACTERISTIC BTHM_PctgRlyUClsNegMin_P /end REF_CHARACTERISTIC /end GROUP
/begin GROUP S367_CompareToCalibrationPara "swc_BatThermHndlgMngt/BTHM_100ms_sys/100ms/ThermManage/HeatThermalCondition/CompareToCalibrationPara" /begin REF_CHARACTERISTIC BTHM_SocThermAllwd1_P /end REF_CHARACTERISTIC /end GROUP
/begin GROUP S367_CompareToCalibrationPara1 "swc_BatThermHndlgMngt/BTHM_100ms_sys/100ms/ThermManage/HeatThermalCondition/CompareToCalibrationPara1" /begin REF_CHARACTERISTIC BTHM_TMdulThermAllwd1_P /end REF_CHARACTERISTIC /end GROUP
/begin GROUP S367_CompareToCalibrationPara10 "swc_BatThermHndlgMngt/BTHM_100ms_sys/100ms/ThermManage/HeatThermalCondition/CompareToCalibrationPara10" /begin REF_CHARACTERISTIC BTHM_SocExitTherm_P /end REF_CHARACTERISTIC /end GROUP
/begin GROUP S367_CompareToCalibrationPara11 "swc_BatThermHndlgMngt/BTHM_100ms_sys/100ms/ThermManage/HeatThermalCondition/CompareToCalibrationPara11" /begin REF_CHARACTERISTIC BTHM_TExitThermMin_P /end REF_CHARACTERISTIC /end GROUP
/begin GROUP S367_CompareToCalibrationPara12 "swc_BatThermHndlgMngt/BTHM_100ms_sys/100ms/ThermManage/HeatThermalCondition/CompareToCalibrationPara12" /begin REF_CHARACTERISTIC BTHM_TExitThermMax_P /end REF_CHARACTERISTIC /end GROUP
/begin GROUP S367_CompareToCalibrationPara13 "swc_BatThermHndlgMngt/BTHM_100ms_sys/100ms/ThermManage/HeatThermalCondition/CompareToCalibrationPara13" /begin REF_CHARACTERISTIC BTHM_TSelnToThermOnlyMax_P /end REF_CHARACTERISTIC /end GROUP
/begin GROUP S367_CompareToCalibrationPara14 "swc_BatThermHndlgMngt/BTHM_100ms_sys/100ms/ThermManage/HeatThermalCondition/CompareToCalibrationPara14" /begin REF_CHARACTERISTIC BTHM_TSelnToThermOnlyMin_P /end REF_CHARACTERISTIC /end GROUP
/begin GROUP S367_CompareToCalibrationPara15 "swc_BatThermHndlgMngt/BTHM_100ms_sys/100ms/ThermManage/HeatThermalCondition/CompareToCalibrationPara15" /begin REF_CHARACTERISTIC BTHM_IThermAllToRlyCls1_P /end REF_CHARACTERISTIC /end GROUP
/begin GROUP S367_CompareToCalibrationPara16 "swc_BatThermHndlgMngt/BTHM_100ms_sys/100ms/ThermManage/HeatThermalCondition/CompareToCalibrationPara16" /begin REF_CHARACTERISTIC BTHM_IThermAllToRlyCls2_P /end REF_CHARACTERISTIC /end GROUP
/begin GROUP S367_CompareToCalibrationPara2 "swc_BatThermHndlgMngt/BTHM_100ms_sys/100ms/ThermManage/HeatThermalCondition/CompareToCalibrationPara2" /begin REF_CHARACTERISTIC BTHM_SocThermAllwd2_P /end REF_CHARACTERISTIC /end GROUP
/begin GROUP S367_CompareToCalibrationPara29 "swc_BatThermHndlgMngt/BTHM_100ms_sys/100ms/ThermManage/HeatThermalCondition/CompareToCalibrationPara29" /begin REF_CHARACTERISTIC BTHM_TSelnToChMax_P /end REF_CHARACTERISTIC /end GROUP
/begin GROUP S367_CompareToCalibrationPara3 "swc_BatThermHndlgMngt/BTHM_100ms_sys/100ms/ThermManage/HeatThermalCondition/CompareToCalibrationPara3" /begin REF_CHARACTERISTIC BTHM_TMdulThermAllwd2_P /end REF_CHARACTERISTIC /end GROUP
/begin GROUP S367_CompareToCalibrationPara30 "swc_BatThermHndlgMngt/BTHM_100ms_sys/100ms/ThermManage/HeatThermalCondition/CompareToCalibrationPara30" /begin REF_CHARACTERISTIC BTHM_TSelnToChMin_P /end REF_CHARACTERISTIC /end GROUP
/begin GROUP S367_CompareToCalibrationPara31 "swc_BatThermHndlgMngt/BTHM_100ms_sys/100ms/ThermManage/HeatThermalCondition/CompareToCalibrationPara31" /begin REF_CHARACTERISTIC BTHM_TSelnToChMin_P /end REF_CHARACTERISTIC /end GROUP
/begin GROUP S367_CompareToCalibrationPara32 "swc_BatThermHndlgMngt/BTHM_100ms_sys/100ms/ThermManage/HeatThermalCondition/CompareToCalibrationPara32" /begin REF_CHARACTERISTIC BTHM_TSelnToChThermMin_P /end REF_CHARACTERISTIC /end GROUP
/begin GROUP S367_CompareToCalibrationPara33 "swc_BatThermHndlgMngt/BTHM_100ms_sys/100ms/ThermManage/HeatThermalCondition/CompareToCalibrationPara33" /begin REF_CHARACTERISTIC BTHM_TSelnToChMax_P /end REF_CHARACTERISTIC /end GROUP
/begin GROUP S367_CompareToCalibrationPara4 "swc_BatThermHndlgMngt/BTHM_100ms_sys/100ms/ThermManage/HeatThermalCondition/CompareToCalibrationPara4" /begin REF_CHARACTERISTIC BTHM_SocThermAllwd1_P /end REF_CHARACTERISTIC /end GROUP
/begin GROUP S367_CompareToCalibrationPara5 "swc_BatThermHndlgMngt/BTHM_100ms_sys/100ms/ThermManage/HeatThermalCondition/CompareToCalibrationPara5" /begin REF_CHARACTERISTIC BTHM_TChThermToChMin_P /end REF_CHARACTERISTIC /end GROUP
/begin GROUP S367_CompareToCalibrationPara6 "swc_BatThermHndlgMngt/BTHM_100ms_sys/100ms/ThermManage/HeatThermalCondition/CompareToCalibrationPara6" /begin REF_CHARACTERISTIC BTHM_TChThermToChMax_P /end REF_CHARACTERISTIC /end GROUP
/begin GROUP S367_CompareToCalibrationPara7 "swc_BatThermHndlgMngt/BTHM_100ms_sys/100ms/ThermManage/HeatThermalCondition/CompareToCalibrationPara7" /begin REF_CHARACTERISTIC BTHM_TChToChTherm_P /end REF_CHARACTERISTIC /end GROUP
/begin GROUP S367_CompareToCalibrationPara8 "swc_BatThermHndlgMngt/BTHM_100ms_sys/100ms/ThermManage/HeatThermalCondition/CompareToCalibrationPara8" /begin REF_CHARACTERISTIC BTHM_TChThermToThermOnly_P /end REF_CHARACTERISTIC /end GROUP
/begin GROUP S367_CompareToCalibrationPara9 "swc_BatThermHndlgMngt/BTHM_100ms_sys/100ms/ThermManage/HeatThermalCondition/CompareToCalibrationPara9" /begin REF_CHARACTERISTIC BTHM_TThermOnlyToChThermMin_P /end REF_CHARACTERISTIC /end GROUP
/begin GROUP S368_BCF_TdOffDig1005_P "swc_BatCoreFct/BCF_100ms_sys/BatCoreFct/PackObs/PackObsLoop/MdulObs/MdulRObs/UMdulOffSho Diagnosis/Diagnostic of UMdulOffSho/BCF_TdOffDig1005_P" /begin REF_CHARACTERISTIC BCF_TdOffDig1005_P /end REF_CHARACTERISTIC /end GROUP
/begin GROUP S368_BCF_TdOnDig1005_P "swc_BatCoreFct/BCF_100ms_sys/BatCoreFct/PackObs/PackObsLoop/MdulObs/MdulRObs/UMdulOffSho Diagnosis/Diagnostic of UMdulOffSho/BCF_TdOnDig1005_P" /begin REF_CHARACTERISTIC BCF_TdOnDig1005_P /end REF_CHARACTERISTIC /end GROUP
/begin GROUP S368_BCF_UMdulDeErrLimForMdlInvld_P "swc_BatCoreFct/BCF_100ms_sys/BatCoreFct/PackObs/PackObsLoop/MdulObs/MdulRObs/UMdulOffSho Diagnosis/Diagnostic of UMdulOffSho/BCF_UMdulDeErrLimForMdlInvld_P" /begin REF_CHARACTERISTIC BCF_UMdulDeErrLimForMdlInvld_P /end REF_CHARACTERISTIC /end GROUP
/begin GROUP S368_BCF_UMdulDeErrLimForMdlVld_P "swc_BatCoreFct/BCF_100ms_sys/BatCoreFct/PackObs/PackObsLoop/MdulObs/MdulRObs/UMdulOffSho Diagnosis/Diagnostic of UMdulOffSho/BCF_UMdulDeErrLimForMdlVld_P" /begin REF_CHARACTERISTIC BCF_UMdulDeErrLimForMdlVld_P /end REF_CHARACTERISTIC /end GROUP
/begin GROUP S369_BTHM_PctgRlyUClsNegMax_P "swc_BatThermHndlgMngt/BTHM_100ms_sys/100ms/ThermManage/LiquidThermalCondition/BTHM_PctgRlyUClsNegMax_P" /begin REF_CHARACTERISTIC BTHM_PctgRlyUClsNegMax_P /end REF_CHARACTERISTIC /end GROUP
/begin GROUP S369_BTHM_PctgRlyUClsNegMin_P "swc_BatThermHndlgMngt/BTHM_100ms_sys/100ms/ThermManage/LiquidThermalCondition/BTHM_PctgRlyUClsNegMin_P" /begin REF_CHARACTERISTIC BTHM_PctgRlyUClsNegMin_P /end REF_CHARACTERISTIC /end GROUP
/begin GROUP S369_BTHM_TiDlyForCellVolLo_P "swc_BatThermHndlgMngt/BTHM_100ms_sys/100ms/ThermManage/LiquidThermalCondition/BTHM_TiDlyForCellVolLo_P" /begin REF_CHARACTERISTIC BTHM_TiDlyForCellVolLo_P /end REF_CHARACTERISTIC /end GROUP
/begin GROUP S369_CompareToCalibrationPara1 "swc_BatThermHndlgMngt/BTHM_100ms_sys/100ms/ThermManage/LiquidThermalCondition/CompareToCalibrationPara1" /begin REF_CHARACTERISTIC BTHM_USelnToTherm_P /end REF_CHARACTERISTIC /end GROUP
/begin GROUP S369_CompareToCalibrationPara10 "swc_BatThermHndlgMngt/BTHM_100ms_sys/100ms/ThermManage/LiquidThermalCondition/CompareToCalibrationPara10" /begin REF_CHARACTERISTIC BTHM_IThermAllToRlyOpen_P /end REF_CHARACTERISTIC /end GROUP
/begin GROUP S369_CompareToCalibrationPara11 "swc_BatThermHndlgMngt/BTHM_100ms_sys/100ms/ThermManage/LiquidThermalCondition/CompareToCalibrationPara11" /begin REF_CHARACTERISTIC BTHM_TSelnLqdToThermOnlyMin_P /end REF_CHARACTERISTIC /end GROUP
/begin GROUP S369_CompareToCalibrationPara12 "swc_BatThermHndlgMngt/BTHM_100ms_sys/100ms/ThermManage/LiquidThermalCondition/CompareToCalibrationPara12" /begin REF_CHARACTERISTIC BTHM_TThermLqdToChThermMin_P /end REF_CHARACTERISTIC /end GROUP
/begin GROUP S369_CompareToCalibrationPara13 "swc_BatThermHndlgMngt/BTHM_100ms_sys/100ms/ThermManage/LiquidThermalCondition/CompareToCalibrationPara13" /begin REF_CHARACTERISTIC BTHM_TPackSelnToCoolg_P /end REF_CHARACTERISTIC /end GROUP
/begin GROUP S369_CompareToCalibrationPara14 "swc_BatThermHndlgMngt/BTHM_100ms_sys/100ms/ThermManage/LiquidThermalCondition/CompareToCalibrationPara14" /begin REF_CHARACTERISTIC BTHM_TSelnToCoolgMax_P /end REF_CHARACTERISTIC /end GROUP
/begin GROUP S369_CompareToCalibrationPara15 "swc_BatThermHndlgMngt/BTHM_100ms_sys/100ms/ThermManage/LiquidThermalCondition/CompareToCalibrationPara15" /begin REF_CHARACTERISTIC BTHM_TPackLoopSelf_P /end REF_CHARACTERISTIC /end GROUP
/begin GROUP S369_CompareToCalibrationPara16 "swc_BatThermHndlgMngt/BTHM_100ms_sys/100ms/ThermManage/LiquidThermalCondition/CompareToCalibrationPara16" /begin REF_CHARACTERISTIC BTHM_TLoopSelfMax_P /end REF_CHARACTERISTIC /end GROUP
/begin GROUP S369_CompareToCalibrationPara17 "swc_BatThermHndlgMngt/BTHM_100ms_sys/100ms/ThermManage/LiquidThermalCondition/CompareToCalibrationPara17" /begin REF_CHARACTERISTIC BTHM_TPackCoolg_P /end REF_CHARACTERISTIC /end GROUP
/begin GROUP S369_CompareToCalibrationPara18 "swc_BatThermHndlgMngt/BTHM_100ms_sys/100ms/ThermManage/LiquidThermalCondition/CompareToCalibrationPara18" /begin REF_CHARACTERISTIC BTHM_TCoolgMax_P /end REF_CHARACTERISTIC /end GROUP
/begin GROUP S369_CompareToCalibrationPara19 "swc_BatThermHndlgMngt/BTHM_100ms_sys/100ms/ThermManage/LiquidThermalCondition/CompareToCalibrationPara19" /begin REF_CHARACTERISTIC BTHM_TChCoolgModeMin_P /end REF_CHARACTERISTIC /end GROUP
/begin GROUP S369_CompareToCalibrationPara2 "swc_BatThermHndlgMngt/BTHM_100ms_sys/100ms/ThermManage/LiquidThermalCondition/CompareToCalibrationPara2" /begin REF_CHARACTERISTIC BTHM_UThermToSeln_P /end REF_CHARACTERISTIC /end GROUP
/begin GROUP S369_CompareToCalibrationPara20 "swc_BatThermHndlgMngt/BTHM_100ms_sys/100ms/ThermManage/LiquidThermalCondition/CompareToCalibrationPara20" /begin REF_CHARACTERISTIC BTHM_TChCoolgModeMax_P /end REF_CHARACTERISTIC /end GROUP
/begin GROUP S369_CompareToCalibrationPara21 "swc_BatThermHndlgMngt/BTHM_100ms_sys/100ms/ThermManage/LiquidThermalCondition/CompareToCalibrationPara21" /begin REF_CHARACTERISTIC BTHM_TPackChCoolgMode_P /end REF_CHARACTERISTIC /end GROUP
/begin GROUP S369_CompareToCalibrationPara22 "swc_BatThermHndlgMngt/BTHM_100ms_sys/100ms/ThermManage/LiquidThermalCondition/CompareToCalibrationPara22" /begin REF_CHARACTERISTIC BTHM_TChToCoolgMax_P /end REF_CHARACTERISTIC /end GROUP
/begin GROUP S369_CompareToCalibrationPara23 "swc_BatThermHndlgMngt/BTHM_100ms_sys/100ms/ThermManage/LiquidThermalCondition/CompareToCalibrationPara23" /begin REF_CHARACTERISTIC BTHM_TPackChToCoolg_P /end REF_CHARACTERISTIC /end GROUP
/begin GROUP S369_CompareToCalibrationPara24 "swc_BatThermHndlgMngt/BTHM_100ms_sys/100ms/ThermManage/LiquidThermalCondition/CompareToCalibrationPara24" /begin REF_CHARACTERISTIC BTHM_TCoolgToChMax_P /end REF_CHARACTERISTIC /end GROUP
/begin GROUP S369_CompareToCalibrationPara25 "swc_BatThermHndlgMngt/BTHM_100ms_sys/100ms/ThermManage/LiquidThermalCondition/CompareToCalibrationPara25" /begin REF_CHARACTERISTIC BTHM_TPackCoolgToCh_P /end REF_CHARACTERISTIC /end GROUP
/begin GROUP S369_CompareToCalibrationPara26 "swc_BatThermHndlgMngt/BTHM_100ms_sys/100ms/ThermManage/LiquidThermalCondition/CompareToCalibrationPara26" /begin REF_CHARACTERISTIC BTHM_TSelnLqdToChMin_P /end REF_CHARACTERISTIC /end GROUP
/begin GROUP S369_CompareToCalibrationPara27 "swc_BatThermHndlgMngt/BTHM_100ms_sys/100ms/ThermManage/LiquidThermalCondition/CompareToCalibrationPara27" /begin REF_CHARACTERISTIC BTHM_TSelnLqdToChMax_P /end REF_CHARACTERISTIC /end GROUP
/begin GROUP S369_CompareToCalibrationPara28 "swc_BatThermHndlgMngt/BTHM_100ms_sys/100ms/ThermManage/LiquidThermalCondition/CompareToCalibrationPara28" /begin REF_CHARACTERISTIC BTHM_TPackSelnLqdToCh_P /end REF_CHARACTERISTIC /end GROUP
/begin GROUP S369_CompareToCalibrationPara29 "swc_BatThermHndlgMngt/BTHM_100ms_sys/100ms/ThermManage/LiquidThermalCondition/CompareToCalibrationPara29" /begin REF_CHARACTERISTIC BTHM_TChLqdToChThermMin_P /end REF_CHARACTERISTIC /end GROUP
/begin GROUP S369_CompareToCalibrationPara3 "swc_BatThermHndlgMngt/BTHM_100ms_sys/100ms/ThermManage/LiquidThermalCondition/CompareToCalibrationPara3" /begin REF_CHARACTERISTIC BTHM_TPackCoolgToSeln_P /end REF_CHARACTERISTIC /end GROUP
/begin GROUP S369_CompareToCalibrationPara30 "swc_BatThermHndlgMngt/BTHM_100ms_sys/100ms/ThermManage/LiquidThermalCondition/CompareToCalibrationPara30" /begin REF_CHARACTERISTIC BTHM_TLqdChThermToChMin_P /end REF_CHARACTERISTIC /end GROUP
/begin GROUP S369_CompareToCalibrationPara31 "swc_BatThermHndlgMngt/BTHM_100ms_sys/100ms/ThermManage/LiquidThermalCondition/CompareToCalibrationPara31" /begin REF_CHARACTERISTIC BTHM_TLqdChThermToChMax_P /end REF_CHARACTERISTIC /end GROUP
/begin GROUP S369_CompareToCalibrationPara32 "swc_BatThermHndlgMngt/BTHM_100ms_sys/100ms/ThermManage/LiquidThermalCondition/CompareToCalibrationPara32" /begin REF_CHARACTERISTIC BTHM_TPackChThermLqdToCh_P /end REF_CHARACTERISTIC /end GROUP
/begin GROUP S369_CompareToCalibrationPara33 "swc_BatThermHndlgMngt/BTHM_100ms_sys/100ms/ThermManage/LiquidThermalCondition/CompareToCalibrationPara33" /begin REF_CHARACTERISTIC BTHM_TChToCoolgMax_P /end REF_CHARACTERISTIC /end GROUP
/begin GROUP S369_CompareToCalibrationPara34 "swc_BatThermHndlgMngt/BTHM_100ms_sys/100ms/ThermManage/LiquidThermalCondition/CompareToCalibrationPara34" /begin REF_CHARACTERISTIC BTHM_TSelnLqdToChThermMin_P /end REF_CHARACTERISTIC /end GROUP
/begin GROUP S369_CompareToCalibrationPara35 "swc_BatThermHndlgMngt/BTHM_100ms_sys/100ms/ThermManage/LiquidThermalCondition/CompareToCalibrationPara35" /begin REF_CHARACTERISTIC BTHM_TPackChToCoolg_P /end REF_CHARACTERISTIC /end GROUP
/begin GROUP S369_CompareToCalibrationPara36 "swc_BatThermHndlgMngt/BTHM_100ms_sys/100ms/ThermManage/LiquidThermalCondition/CompareToCalibrationPara36" /begin REF_CHARACTERISTIC BTHM_TPackLoopSelf_P /end REF_CHARACTERISTIC /end GROUP
/begin GROUP S369_CompareToCalibrationPara37 "swc_BatThermHndlgMngt/BTHM_100ms_sys/100ms/ThermManage/LiquidThermalCondition/CompareToCalibrationPara37" /begin REF_CHARACTERISTIC BTHM_TLoopSelfMax_P /end REF_CHARACTERISTIC /end GROUP
/begin GROUP S369_CompareToCalibrationPara38 "swc_BatThermHndlgMngt/BTHM_100ms_sys/100ms/ThermManage/LiquidThermalCondition/CompareToCalibrationPara38" /begin REF_CHARACTERISTIC BTHM_TPackLoopSelf_P /end REF_CHARACTERISTIC /end GROUP
/begin GROUP S369_CompareToCalibrationPara39 "swc_BatThermHndlgMngt/BTHM_100ms_sys/100ms/ThermManage/LiquidThermalCondition/CompareToCalibrationPara39" /begin REF_CHARACTERISTIC BTHM_TLoopSelfMax_P /end REF_CHARACTERISTIC /end GROUP
/begin GROUP S369_CompareToCalibrationPara4 "swc_BatThermHndlgMngt/BTHM_100ms_sys/100ms/ThermManage/LiquidThermalCondition/CompareToCalibrationPara4" /begin REF_CHARACTERISTIC BTHM_TCoolgToSelnMax_P /end REF_CHARACTERISTIC /end GROUP
/begin GROUP S369_CompareToCalibrationPara40 "swc_BatThermHndlgMngt/BTHM_100ms_sys/100ms/ThermManage/LiquidThermalCondition/CompareToCalibrationPara40" /begin REF_CHARACTERISTIC BTHM_TChToCoolgMax_P /end REF_CHARACTERISTIC /end GROUP
/begin GROUP S369_CompareToCalibrationPara41 "swc_BatThermHndlgMngt/BTHM_100ms_sys/100ms/ThermManage/LiquidThermalCondition/CompareToCalibrationPara41" /begin REF_CHARACTERISTIC BTHM_TPackChToCoolg_P /end REF_CHARACTERISTIC /end GROUP
/begin GROUP S369_CompareToCalibrationPara5 "swc_BatThermHndlgMngt/BTHM_100ms_sys/100ms/ThermManage/LiquidThermalCondition/CompareToCalibrationPara5" /begin REF_CHARACTERISTIC BTHM_TSelnToTherm_P /end REF_CHARACTERISTIC /end GROUP
/begin GROUP S369_CompareToCalibrationPara6 "swc_BatThermHndlgMngt/BTHM_100ms_sys/100ms/ThermManage/LiquidThermalCondition/CompareToCalibrationPara6" /begin REF_CHARACTERISTIC BTHM_SocSelnToTherm_P /end REF_CHARACTERISTIC /end GROUP
/begin GROUP S369_CompareToCalibrationPara7 "swc_BatThermHndlgMngt/BTHM_100ms_sys/100ms/ThermManage/LiquidThermalCondition/CompareToCalibrationPara7" /begin REF_CHARACTERISTIC BTHM_SocThermToSeln_P /end REF_CHARACTERISTIC /end GROUP
/begin GROUP S369_CompareToCalibrationPara8 "swc_BatThermHndlgMngt/BTHM_100ms_sys/100ms/ThermManage/LiquidThermalCondition/CompareToCalibrationPara8" /begin REF_CHARACTERISTIC BTHM_TThermToSelnMax_P /end REF_CHARACTERISTIC /end GROUP
/begin GROUP S369_CompareToCalibrationPara9 "swc_BatThermHndlgMngt/BTHM_100ms_sys/100ms/ThermManage/LiquidThermalCondition/CompareToCalibrationPara9" /begin REF_CHARACTERISTIC BTHM_TThermToSelnMin_P /end REF_CHARACTERISTIC /end GROUP
/begin GROUP S36_BitSelect "swc_DiagcEveHndlg/DEH_10ms_sys/DEH_10ms_sys/FIM/BitSelect" /begin REF_CHARACTERISTIC DEH_Csw1_P /end REF_CHARACTERISTIC /end GROUP
/begin GROUP S36_BitSelect1 "swc_DiagcEveHndlg/DEH_10ms_sys/DEH_10ms_sys/FIM/BitSelect1" /begin REF_CHARACTERISTIC DEH_Csw1_P /end REF_CHARACTERISTIC /end GROUP
/begin GROUP S36_BitSelect10 "swc_DiagcEveHndlg/DEH_10ms_sys/DEH_10ms_sys/FIM/BitSelect10" /begin REF_CHARACTERISTIC DEH_Csw1_P /end REF_CHARACTERISTIC /end GROUP
/begin GROUP S36_BitSelect11 "swc_DiagcEveHndlg/DEH_10ms_sys/DEH_10ms_sys/FIM/BitSelect11" /begin REF_CHARACTERISTIC DEH_Csw1_P /end REF_CHARACTERISTIC /end GROUP
/begin GROUP S36_BitSelect12 "swc_DiagcEveHndlg/DEH_10ms_sys/DEH_10ms_sys/FIM/BitSelect12" /begin REF_CHARACTERISTIC DEH_Csw1_P /end REF_CHARACTERISTIC /end GROUP
/begin GROUP S36_BitSelect13 "swc_DiagcEveHndlg/DEH_10ms_sys/DEH_10ms_sys/FIM/BitSelect13" /begin REF_CHARACTERISTIC DEH_Csw1_P /end REF_CHARACTERISTIC /end GROUP
/begin GROUP S36_BitSelect14 "swc_DiagcEveHndlg/DEH_10ms_sys/DEH_10ms_sys/FIM/BitSelect14" /begin REF_CHARACTERISTIC DEH_Csw1_P /end REF_CHARACTERISTIC /end GROUP
/begin GROUP S36_BitSelect15 "swc_DiagcEveHndlg/DEH_10ms_sys/DEH_10ms_sys/FIM/BitSelect15" /begin REF_CHARACTERISTIC DEH_Csw1_P /end REF_CHARACTERISTIC /end GROUP
/begin GROUP S36_BitSelect16 "swc_DiagcEveHndlg/DEH_10ms_sys/DEH_10ms_sys/FIM/BitSelect16" /begin REF_CHARACTERISTIC DEH_Csw1_P /end REF_CHARACTERISTIC /end GROUP
/begin GROUP S36_BitSelect17 "swc_DiagcEveHndlg/DEH_10ms_sys/DEH_10ms_sys/FIM/BitSelect17" /begin REF_CHARACTERISTIC DEH_Csw1_P /end REF_CHARACTERISTIC /end GROUP
/begin GROUP S36_BitSelect18 "swc_DiagcEveHndlg/DEH_10ms_sys/DEH_10ms_sys/FIM/BitSelect18" /begin REF_CHARACTERISTIC DEH_Csw1_P /end REF_CHARACTERISTIC /end GROUP
/begin GROUP S36_BitSelect19 "swc_DiagcEveHndlg/DEH_10ms_sys/DEH_10ms_sys/FIM/BitSelect19" /begin REF_CHARACTERISTIC DEH_Csw1_P /end REF_CHARACTERISTIC /end GROUP
/begin GROUP S36_BitSelect2 "swc_DiagcEveHndlg/DEH_10ms_sys/DEH_10ms_sys/FIM/BitSelect2" /begin REF_CHARACTERISTIC DEH_Csw1_P /end REF_CHARACTERISTIC /end GROUP
/begin GROUP S36_BitSelect20 "swc_DiagcEveHndlg/DEH_10ms_sys/DEH_10ms_sys/FIM/BitSelect20" /begin REF_CHARACTERISTIC DEH_Csw1_P /end REF_CHARACTERISTIC /end GROUP
/begin GROUP S36_BitSelect21 "swc_DiagcEveHndlg/DEH_10ms_sys/DEH_10ms_sys/FIM/BitSelect21" /begin REF_CHARACTERISTIC DEH_Csw1_P /end REF_CHARACTERISTIC /end GROUP
/begin GROUP S36_BitSelect22 "swc_DiagcEveHndlg/DEH_10ms_sys/DEH_10ms_sys/FIM/BitSelect22" /begin REF_CHARACTERISTIC DEH_Csw1_P /end REF_CHARACTERISTIC /end GROUP
/begin GROUP S36_BitSelect3 "swc_DiagcEveHndlg/DEH_10ms_sys/DEH_10ms_sys/FIM/BitSelect3" /begin REF_CHARACTERISTIC DEH_Csw1_P /end REF_CHARACTERISTIC /end GROUP
/begin GROUP S36_BitSelect4 "swc_DiagcEveHndlg/DEH_10ms_sys/DEH_10ms_sys/FIM/BitSelect4" /begin REF_CHARACTERISTIC DEH_Csw1_P /end REF_CHARACTERISTIC /end GROUP
/begin GROUP S36_BitSelect5 "swc_DiagcEveHndlg/DEH_10ms_sys/DEH_10ms_sys/FIM/BitSelect5" /begin REF_CHARACTERISTIC DEH_Csw1_P /end REF_CHARACTERISTIC /end GROUP
/begin GROUP S36_BitSelect6 "swc_DiagcEveHndlg/DEH_10ms_sys/DEH_10ms_sys/FIM/BitSelect6" /begin REF_CHARACTERISTIC DEH_Csw1_P /end REF_CHARACTERISTIC /end GROUP
/begin GROUP S36_BitSelect7 "swc_DiagcEveHndlg/DEH_10ms_sys/DEH_10ms_sys/FIM/BitSelect7" /begin REF_CHARACTERISTIC DEH_Csw1_P /end REF_CHARACTERISTIC /end GROUP
/begin GROUP S36_BitSelect8 "swc_DiagcEveHndlg/DEH_10ms_sys/DEH_10ms_sys/FIM/BitSelect8" /begin REF_CHARACTERISTIC DEH_Csw1_P /end REF_CHARACTERISTIC /end GROUP
/begin GROUP S36_BitSelect9 "swc_DiagcEveHndlg/DEH_10ms_sys/DEH_10ms_sys/FIM/BitSelect9" /begin REF_CHARACTERISTIC DEH_Csw1_P /end REF_CHARACTERISTIC /end GROUP
/begin GROUP S36_DataChk "swc_BatThermHndlgMngt/BTHM_100ms_sys/100ms/DataPrep/DataChk" /begin SUB_GROUP S38_TBcuSnsrChk S38_TMdulCtlrSnsrChk /end SUB_GROUP /end GROUP
/begin GROUP S36_DataClcn "swc_BatThermHndlgMngt/BTHM_100ms_sys/100ms/DataPrep/DataClcn"
 /begin SUB_GROUP S39_BitSelect S39_BitSelect1 S39_BitSelect2 S39_BitSelect3 S39_BitSelect4 S39_BitSelect5 S39_BitSelect6 S39_BTHM_TMdulCtlrSnsrMax_P S39_BTHM_TMdulCtlrSnsrMin_P S39_BTHM_TMdulSnsrMax_P S39_BTHM_TMdulSnsrMaxRaw_P S39_BTHM_TMdulSnsrMin_P S39_BTHM_TMdulSnsrMinRaw_P S39_BTHM_TPack_P S39_TPackDif /end SUB_GROUP
/end GROUP
/begin GROUP S36_DataCnvnMdulCtrl "swc_BatThermHndlgMngt/BTHM_100ms_sys/100ms/DataPrep/DataCnvnMdulCtrl" /begin SUB_GROUP S41_MeasCorrn /end SUB_GROUP /end GROUP
/begin GROUP S36_DEH_bAcvAcChInh_P "swc_DiagcEveHndlg/DEH_10ms_sys/DEH_10ms_sys/FIM/DEH_bAcvAcChInh_P" /begin REF_CHARACTERISTIC DEH_bAcvAcChInh_P /end REF_CHARACTERISTIC /end GROUP
/begin GROUP S36_DEH_bAcvChInh_P "swc_DiagcEveHndlg/DEH_10ms_sys/DEH_10ms_sys/FIM/DEH_bAcvChInh_P" /begin REF_CHARACTERISTIC DEH_bAcvChInh_P /end REF_CHARACTERISTIC /end GROUP
/begin GROUP S36_DEH_bAcvDcChInh_P "swc_DiagcEveHndlg/DEH_10ms_sys/DEH_10ms_sys/FIM/DEH_bAcvDcChInh_P" /begin REF_CHARACTERISTIC DEH_bAcvDcChInh_P /end REF_CHARACTERISTIC /end GROUP
/begin GROUP S36_DEH_bAcvDchaInh_P "swc_DiagcEveHndlg/DEH_10ms_sys/DEH_10ms_sys/FIM/DEH_bAcvDchaInh_P" /begin REF_CHARACTERISTIC DEH_bAcvDchaInh_P /end REF_CHARACTERISTIC /end GROUP
/begin GROUP S36_DEH_bAcvEmcyHvOff1_P "swc_DiagcEveHndlg/DEH_10ms_sys/DEH_10ms_sys/FIM/DEH_bAcvEmcyHvOff1_P" /begin REF_CHARACTERISTIC DEH_bAcvEmcyHvOff1_P /end REF_CHARACTERISTIC /end GROUP
/begin GROUP S36_DEH_bAcvEmcyHvOff2_P "swc_DiagcEveHndlg/DEH_10ms_sys/DEH_10ms_sys/FIM/DEH_bAcvEmcyHvOff2_P" /begin REF_CHARACTERISTIC DEH_bAcvEmcyHvOff2_P /end REF_CHARACTERISTIC /end GROUP
/begin GROUP S36_DEH_bAcvHeatInh_P "swc_DiagcEveHndlg/DEH_10ms_sys/DEH_10ms_sys/FIM/DEH_bAcvHeatInh_P" /begin REF_CHARACTERISTIC DEH_bAcvHeatInh_P /end REF_CHARACTERISTIC /end GROUP
/begin GROUP S36_DEH_bAcvLvlErr1_P "swc_DiagcEveHndlg/DEH_10ms_sys/DEH_10ms_sys/FIM/DEH_bAcvLvlErr1_P" /begin REF_CHARACTERISTIC DEH_bAcvLvlErr1_P /end REF_CHARACTERISTIC /end GROUP
/begin GROUP S36_DEH_bAcvLvlErr2_P "swc_DiagcEveHndlg/DEH_10ms_sys/DEH_10ms_sys/FIM/DEH_bAcvLvlErr2_P" /begin REF_CHARACTERISTIC DEH_bAcvLvlErr2_P /end REF_CHARACTERISTIC /end GROUP
/begin GROUP S36_DEH_bAcvLvlErr3_P "swc_DiagcEveHndlg/DEH_10ms_sys/DEH_10ms_sys/FIM/DEH_bAcvLvlErr3_P" /begin REF_CHARACTERISTIC DEH_bAcvLvlErr3_P /end REF_CHARACTERISTIC /end GROUP
/begin GROUP S36_DEH_bAcvLvlErrSb1_P "swc_DiagcEveHndlg/DEH_10ms_sys/DEH_10ms_sys/FIM/DEH_bAcvLvlErrSb1_P" /begin REF_CHARACTERISTIC DEH_bAcvLvlErrSb1_P /end REF_CHARACTERISTIC /end GROUP
/begin GROUP S36_DEH_bAcvLvlErrSb2_P "swc_DiagcEveHndlg/DEH_10ms_sys/DEH_10ms_sys/FIM/DEH_bAcvLvlErrSb2_P" /begin REF_CHARACTERISTIC DEH_bAcvLvlErrSb2_P /end REF_CHARACTERISTIC /end GROUP
/begin GROUP S36_DEH_bAcvLvlErrSb3_P "swc_DiagcEveHndlg/DEH_10ms_sys/DEH_10ms_sys/FIM/DEH_bAcvLvlErrSb3_P" /begin REF_CHARACTERISTIC DEH_bAcvLvlErrSb3_P /end REF_CHARACTERISTIC /end GROUP
/begin GROUP S36_DEH_bAcvPowupInh_P "swc_DiagcEveHndlg/DEH_10ms_sys/DEH_10ms_sys/FIM/DEH_bAcvPowupInh_P" /begin REF_CHARACTERISTIC DEH_bAcvPowupInh_P /end REF_CHARACTERISTIC /end GROUP
/begin GROUP S36_DEH_bAcvPwrChLim1_P "swc_DiagcEveHndlg/DEH_10ms_sys/DEH_10ms_sys/FIM/DEH_bAcvPwrChLim1_P" /begin REF_CHARACTERISTIC DEH_bAcvPwrChLim1_P /end REF_CHARACTERISTIC /end GROUP
/begin GROUP S36_DEH_bAcvPwrChLim2_P "swc_DiagcEveHndlg/DEH_10ms_sys/DEH_10ms_sys/FIM/DEH_bAcvPwrChLim2_P" /begin REF_CHARACTERISTIC DEH_bAcvPwrChLim2_P /end REF_CHARACTERISTIC /end GROUP
/begin GROUP S36_DEH_bAcvPwrDchaLim1_P "swc_DiagcEveHndlg/DEH_10ms_sys/DEH_10ms_sys/FIM/DEH_bAcvPwrDchaLim1_P" /begin REF_CHARACTERISTIC DEH_bAcvPwrDchaLim1_P /end REF_CHARACTERISTIC /end GROUP
/begin GROUP S36_DEH_bAcvPwrDchaLim2_P "swc_DiagcEveHndlg/DEH_10ms_sys/DEH_10ms_sys/FIM/DEH_bAcvPwrDchaLim2_P" /begin REF_CHARACTERISTIC DEH_bAcvPwrDchaLim2_P /end REF_CHARACTERISTIC /end GROUP
/begin GROUP S36_DEH_bAcvPwrdNorm_P "swc_DiagcEveHndlg/DEH_10ms_sys/DEH_10ms_sys/FIM/DEH_bAcvPwrdNorm_P" /begin REF_CHARACTERISTIC DEH_bAcvPwrdNorm_P /end REF_CHARACTERISTIC /end GROUP
/begin GROUP S36_DEH_bAcvPwrRecupLim1_P "swc_DiagcEveHndlg/DEH_10ms_sys/DEH_10ms_sys/FIM/DEH_bAcvPwrRecupLim1_P" /begin REF_CHARACTERISTIC DEH_bAcvPwrRecupLim1_P /end REF_CHARACTERISTIC /end GROUP
/begin GROUP S36_DEH_bAcvPwrRecupLim2_P "swc_DiagcEveHndlg/DEH_10ms_sys/DEH_10ms_sys/FIM/DEH_bAcvPwrRecupLim2_P" /begin REF_CHARACTERISTIC DEH_bAcvPwrRecupLim2_P /end REF_CHARACTERISTIC /end GROUP
/begin GROUP S36_DEH_bAcvRecupInh_P "swc_DiagcEveHndlg/DEH_10ms_sys/DEH_10ms_sys/FIM/DEH_bAcvRecupInh_P" /begin REF_CHARACTERISTIC DEH_bAcvRecupInh_P /end REF_CHARACTERISTIC /end GROUP
/begin GROUP S36_DEH_bAcvSleepNorm_P "swc_DiagcEveHndlg/DEH_10ms_sys/DEH_10ms_sys/FIM/DEH_bAcvSleepNorm_P" /begin REF_CHARACTERISTIC DEH_bAcvSleepNorm_P /end REF_CHARACTERISTIC /end GROUP
/begin GROUP S36_Diagnosis "swc_BatThermHndlgMngt/BTHM_100ms_sys/100ms/DataPrep/Diagnosis"
 /begin SUB_GROUP S42_BitSelect S42_BitSelect1 S42_BitSelect10 S42_BitSelect11 S42_BitSelect12 S42_BitSelect13 S42_BitSelect14 S42_BitSelect15 S42_BitSelect16 S42_BitSelect17 S42_BitSelect18 S42_BitSelect19 S42_BitSelect2 S42_BitSelect20 S42_BitSelect21 S42_BitSelect22 S42_BitSelect23 S42_BitSelect24 S42_BitSelect25 S42_BitSelect26 S42_BitSelect27 S42_BitSelect28 S42_BitSelect29 S42_BitSelect3 S42_BitSelect30 S42_BitSelect31 S42_BitSelect32 S42_BitSelect33 S42_BitSelect34 S42_BitSelect35 S42_BitSelect36 S42_BitSelect37 S42_BitSelect38 S42_BitSelect39 S42_BitSelect4 S42_BitSelect40 S42_BitSelect41 S42_BitSelect42 S42_BitSelect43 S42_BitSelect44 S42_BitSelect45 S42_BitSelect46 S42_BitSelect47 S42_BitSelect5 S42_BitSelect6 S42_BitSelect7 S42_BitSelect8 S42_BitSelect9 S42_BTHM_ModeSelnOfPackTDif_P S42_BTHM_ModeSelnOfPackTDif_P1 S42_BTHM_TiAFEOffDig_P S42_BTHM_TiAFEOnDig_P S42_BTHM_TiOffDig1091_P S42_BTHM_TiOffDig1092_P S42_BTHM_TiOffDig1093_P S42_BTHM_TiOffDig1094_P S42_BTHM_TiOffDig177_P S42_BTHM_TiOffDig198_P S42_BTHM_TiOffDig232_P S42_BTHM_TiOffDig233_P S42_BTHM_TiOffDig234_P S42_BTHM_TiOffDig236_P S42_BTHM_TiOffDig64_P S42_BTHM_TiOffOverLoDig_P S42_BTHM_TiOffOverUpDig_P S42_BTHM_TiOnDig1091_P S42_BTHM_TiOnDig1092_P S42_BTHM_TiOnDig1093_P S42_BTHM_TiOnDig1094_P S42_BTHM_TiOnDig177_P S42_BTHM_TiOnDig198_P S42_BTHM_TiOnDig232_P S42_BTHM_TiOnDig233_P S42_BTHM_TiOnDig234_P S42_BTHM_TiOnDig236_P S42_BTHM_TiOnDig64_P S42_BTHM_TiOnOverLoDig_P S42_BTHM_TiOnOverUpDig_P S42_BTHM_TiShnt1OffDig_P S42_BTHM_TiShnt1OnDig_P S42_BTHM_TiShnt2OffDig_P S42_BTHM_TiShnt2OnDig_P S42_BTHM_TiTask100Ms_P S42_BTHM_TiTask100Ms_P1 S42_BTHM_TiTask100Ms_P10 S42_BTHM_TiTask100Ms_P11 S42_BTHM_TiTask100Ms_P12 S42_BTHM_TiTask100Ms_P13 S42_BTHM_TiTask100Ms_P14 S42_BTHM_TiTask100Ms_P15 S42_BTHM_TiTask100Ms_P2 S42_BTHM_TiTask100Ms_P3 S42_BTHM_TiTask100Ms_P4 S42_BTHM_TiTask100Ms_P5 S42_BTHM_TiTask100Ms_P6 S42_BTHM_TiTask100Ms_P7 S42_BTHM_TiTask100Ms_P8 S42_BTHM_TiTask100Ms_P9 S42_BTHM_ValOnDig234_P S42_BTHM_ValOnDig236_P S42_CompareToCalibrationPara S42_CompareToCalibrationPara1 S42_CompareToCalibrationPara10 S42_CompareToCalibrationPara11 S42_CompareToCalibrationPara12 S42_CompareToCalibrationPara13 S42_CompareToCalibrationPara14 S42_CompareToCalibrationPara15 S42_CompareToCalibrationPara2 S42_CompareToCalibrationPara3 S42_CompareToCalibrationPara4 S42_CompareToCalibrationPara5 S42_CompareToCalibrationPara6 S42_CompareToCalibrationPara7 S42_CompareToCalibrationPara8 S42_CompareToCalibrationPara9 S42_IntialCheck /end SUB_GROUP
/end GROUP
/begin GROUP S37_BBC_bAcvSocRefForBalnSeln_P "swc_BatBalnCtl/BBC_100ms_sys/BBC_100ms_sys/BatBalnCtl/Battery Balancing Decision/BatBalnCtl/BBC_bAcvSocRefForBalnSeln_P" /begin REF_CHARACTERISTIC BBC_bAcvSocRefForBalnSeln_P /end REF_CHARACTERISTIC /end GROUP
/begin GROUP S37_BBC_ErrLvlMaxAllwd_P "swc_BatBalnCtl/BBC_100ms_sys/BBC_100ms_sys/BatBalnCtl/Battery Balancing Decision/BatBalnCtl/BBC_ErrLvlMaxAllwd_P" /begin REF_CHARACTERISTIC BBC_ErrLvlMaxAllwd_P /end REF_CHARACTERISTIC /end GROUP
/begin GROUP S37_BBC_IPackBalnMax_P "swc_BatBalnCtl/BBC_100ms_sys/BBC_100ms_sys/BatBalnCtl/Battery Balancing Decision/BatBalnCtl/BBC_IPackBalnMax_P" /begin REF_CHARACTERISTIC BBC_IPackBalnMax_P /end REF_CHARACTERISTIC /end GROUP
/begin GROUP S37_BBC_NrCellDchaInMdulAllwd_M "swc_BatBalnCtl/BBC_100ms_sys/BBC_100ms_sys/BatBalnCtl/Battery Balancing Decision/BatBalnCtl/BBC_NrCellDchaInMdulAllwd_M" /begin REF_CHARACTERISTIC BBC_NrCellDchaInMdulAllwd_M /end REF_CHARACTERISTIC /end GROUP
/begin GROUP S37_BBC_SocCellLowrLim_P "swc_BatBalnCtl/BBC_100ms_sys/BBC_100ms_sys/BatBalnCtl/Battery Balancing Decision/BatBalnCtl/BBC_SocCellLowrLim_P" /begin REF_CHARACTERISTIC BBC_SocCellLowrLim_P /end REF_CHARACTERISTIC /end GROUP
/begin GROUP S37_BBC_SocCellUpprLim_P "swc_BatBalnCtl/BBC_100ms_sys/BBC_100ms_sys/BatBalnCtl/Battery Balancing Decision/BatBalnCtl/BBC_SocCellUpprLim_P" /begin REF_CHARACTERISTIC BBC_SocCellUpprLim_P /end REF_CHARACTERISTIC /end GROUP
/begin GROUP S37_BBC_SocCellVldTiDlyDelta_P "swc_BatBalnCtl/BBC_100ms_sys/BBC_100ms_sys/BatBalnCtl/Battery Balancing Decision/BatBalnCtl/BBC_SocCellVldTiDlyDelta_P" /begin REF_CHARACTERISTIC BBC_SocCellVldTiDlyDelta_P /end REF_CHARACTERISTIC /end GROUP
/begin GROUP S37_BBC_SofFac_P "swc_BatBalnCtl/BBC_100ms_sys/BBC_100ms_sys/BatBalnCtl/Battery Balancing Decision/BatBalnCtl/BBC_SofFac_P" /begin REF_CHARACTERISTIC BBC_SofFac_P /end REF_CHARACTERISTIC /end GROUP
/begin GROUP S37_BBC_TBalnRAvgHys_P "swc_BatBalnCtl/BBC_100ms_sys/BBC_100ms_sys/BatBalnCtl/Battery Balancing Decision/BatBalnCtl/BBC_TBalnRAvgHys_P" /begin REF_CHARACTERISTIC BBC_TBalnRAvgHys_P /end REF_CHARACTERISTIC /end GROUP
/begin GROUP S37_BBC_TBalnRAvgUpprLim_P "swc_BatBalnCtl/BBC_100ms_sys/BBC_100ms_sys/BatBalnCtl/Battery Balancing Decision/BatBalnCtl/BBC_TBalnRAvgUpprLim_P" /begin REF_CHARACTERISTIC BBC_TBalnRAvgUpprLim_P /end REF_CHARACTERISTIC /end GROUP
/begin GROUP S37_BBC_TBalnRPasHys_P "swc_BatBalnCtl/BBC_100ms_sys/BBC_100ms_sys/BatBalnCtl/Battery Balancing Decision/BatBalnCtl/BBC_TBalnRPasHys_P" /begin REF_CHARACTERISTIC BBC_TBalnRPasHys_P /end REF_CHARACTERISTIC /end GROUP
/begin GROUP S37_BBC_TBalnRPasUpprLim_P "swc_BatBalnCtl/BBC_100ms_sys/BBC_100ms_sys/BatBalnCtl/Battery Balancing Decision/BatBalnCtl/BBC_TBalnRPasUpprLim_P" /begin REF_CHARACTERISTIC BBC_TBalnRPasUpprLim_P /end REF_CHARACTERISTIC /end GROUP
/begin GROUP S37_BBC_TiCellBalnAcvMax_P "swc_BatBalnCtl/BBC_100ms_sys/BBC_100ms_sys/BatBalnCtl/Battery Balancing Decision/BatBalnCtl/BBC_TiCellBalnAcvMax_P" /begin REF_CHARACTERISTIC BBC_TiCellBalnAcvMax_P /end REF_CHARACTERISTIC /end GROUP
/begin GROUP S37_BBC_TiCellBalnOffMin_P "swc_BatBalnCtl/BBC_100ms_sys/BBC_100ms_sys/BatBalnCtl/Battery Balancing Decision/BatBalnCtl/BBC_TiCellBalnOffMin_P" /begin REF_CHARACTERISTIC BBC_TiCellBalnOffMin_P /end REF_CHARACTERISTIC /end GROUP
/begin GROUP S37_BBC_TiMdulBalnOff_P "swc_BatBalnCtl/BBC_100ms_sys/BBC_100ms_sys/BatBalnCtl/Battery Balancing Decision/BatBalnCtl/BBC_TiMdulBalnOff_P" /begin REF_CHARACTERISTIC BBC_TiMdulBalnOff_P /end REF_CHARACTERISTIC /end GROUP
/begin GROUP S37_BBC_TiMdulBalnPerd_P "swc_BatBalnCtl/BBC_100ms_sys/BBC_100ms_sys/BatBalnCtl/Battery Balancing Decision/BatBalnCtl/BBC_TiMdulBalnPerd_P" /begin REF_CHARACTERISTIC BBC_TiMdulBalnPerd_P /end REF_CHARACTERISTIC /end GROUP
/begin GROUP S37_BBC_TMdulBalnHiLim_P "swc_BatBalnCtl/BBC_100ms_sys/BBC_100ms_sys/BatBalnCtl/Battery Balancing Decision/BatBalnCtl/BBC_TMdulBalnHiLim_P" /begin REF_CHARACTERISTIC BBC_TMdulBalnHiLim_P /end REF_CHARACTERISTIC /end GROUP
/begin GROUP S37_BBC_TMdulBalnLoLim_P "swc_BatBalnCtl/BBC_100ms_sys/BBC_100ms_sys/BatBalnCtl/Battery Balancing Decision/BatBalnCtl/BBC_TMdulBalnLoLim_P" /begin REF_CHARACTERISTIC BBC_TMdulBalnLoLim_P /end REF_CHARACTERISTIC /end GROUP
/begin GROUP S37_BBC_TMdulCtlrLim_P "swc_BatBalnCtl/BBC_100ms_sys/BBC_100ms_sys/BatBalnCtl/Battery Balancing Decision/BatBalnCtl/BBC_TMdulCtlrLim_P" /begin REF_CHARACTERISTIC BBC_TMdulCtlrLim_P /end REF_CHARACTERISTIC /end GROUP
/begin GROUP S37_BBC_UCellBalnHiLim_P "swc_BatBalnCtl/BBC_100ms_sys/BBC_100ms_sys/BatBalnCtl/Battery Balancing Decision/BatBalnCtl/BBC_UCellBalnHiLim_P" /begin REF_CHARACTERISTIC BBC_UCellBalnHiLim_P /end REF_CHARACTERISTIC /end GROUP
/begin GROUP S37_BBC_UCellBalnLoLim_P "swc_BatBalnCtl/BBC_100ms_sys/BBC_100ms_sys/BatBalnCtl/Battery Balancing Decision/BatBalnCtl/BBC_UCellBalnLoLim_P" /begin REF_CHARACTERISTIC BBC_UCellBalnLoLim_P /end REF_CHARACTERISTIC /end GROUP
/begin GROUP S37_BitSelect "swc_DiagcEveHndlg/DEH_10ms_sys/DEH_10ms_sys/General Diagnosis Signals/BitSelect" /begin REF_CHARACTERISTIC DEH_Csw1_P /end REF_CHARACTERISTIC /end GROUP
/begin GROUP S37_BitSelect1 "swc_DiagcEveHndlg/DEH_10ms_sys/DEH_10ms_sys/General Diagnosis Signals/BitSelect1" /begin REF_CHARACTERISTIC DEH_Csw1_P /end REF_CHARACTERISTIC /end GROUP
/begin GROUP S37_BSTC_IChScsMin_P "swc_BcuStTranCtl/BcuStTranCtl_sys/BcuStTranCtl/ConditionConfirm/BSTC_IChScsMin_P" /begin REF_CHARACTERISTIC BSTC_IChScsMin_P /end REF_CHARACTERISTIC /end GROUP
/begin GROUP S37_BSTC_ReqHvOnFromVcu_P "swc_BcuStTranCtl/BcuStTranCtl_sys/BcuStTranCtl/ConditionConfirm/BSTC_ReqHvOnFromVcu_P" /begin REF_CHARACTERISTIC BSTC_ReqHvOnFromVcu_P /end REF_CHARACTERISTIC /end GROUP
/begin GROUP S37_BSTC_StBcu_M "swc_DiagcEveHndlg/DEH_10ms_sys/DEH_10ms_sys/General Diagnosis Signals/BSTC_StBcu_M" /begin REF_CHARACTERISTIC BSTC_StBcu_M /end REF_CHARACTERISTIC /end GROUP
/begin GROUP S37_BSTC_StLoopHvNorm_P "swc_BcuStTranCtl/BcuStTranCtl_sys/BcuStTranCtl/ConditionConfirm/BSTC_StLoopHvNorm_P" /begin REF_CHARACTERISTIC BSTC_StLoopHvNorm_P /end REF_CHARACTERISTIC /end GROUP
/begin GROUP S37_BSTC_StLoopHvPrechFnshd_P "swc_BcuStTranCtl/BcuStTranCtl_sys/BcuStTranCtl/ConditionConfirm/BSTC_StLoopHvPrechFnshd_P" /begin REF_CHARACTERISTIC BSTC_StLoopHvPrechFnshd_P /end REF_CHARACTERISTIC /end GROUP
/begin GROUP S37_BSTC_ThdILowrLim_P "swc_BcuStTranCtl/BcuStTranCtl_sys/BcuStTranCtl/ConditionConfirm/BSTC_ThdILowrLim_P" /begin REF_CHARACTERISTIC BSTC_ThdILowrLim_P /end REF_CHARACTERISTIC /end GROUP
/begin GROUP S37_BSTC_ThdIUpprLim_P "swc_BcuStTranCtl/BcuStTranCtl_sys/BcuStTranCtl/ConditionConfirm/BSTC_ThdIUpprLim_P" /begin REF_CHARACTERISTIC BSTC_ThdIUpprLim_P /end REF_CHARACTERISTIC /end GROUP
/begin GROUP S37_BSTC_TiBalMaxForCh_P "swc_BcuStTranCtl/BcuStTranCtl_sys/BcuStTranCtl/ConditionConfirm/BSTC_TiBalMaxForCh_P" /begin REF_CHARACTERISTIC BSTC_TiBalMaxForCh_P /end REF_CHARACTERISTIC /end GROUP
/begin GROUP S37_BSTC_TiCutoffLvReqFromVcu_P "swc_BcuStTranCtl/BcuStTranCtl_sys/BcuStTranCtl/ConditionConfirm/BSTC_TiCutoffLvReqFromVcu_P" /begin REF_CHARACTERISTIC BSTC_TiCutoffLvReqFromVcu_P /end REF_CHARACTERISTIC /end GROUP
/begin GROUP S37_BTHM_TExitTherm_P "swc_BatThermHndlgMngt/BTHM_100ms_sys/100ms/ThermManage/BTHM_TExitTherm_P" /begin REF_CHARACTERISTIC BTHM_TExitTherm_P /end REF_CHARACTERISTIC /end GROUP
/begin GROUP S37_BTHM_TiDlyDchaTherm_P "swc_BatThermHndlgMngt/BTHM_100ms_sys/100ms/ThermManage/BTHM_TiDlyDchaTherm_P" /begin REF_CHARACTERISTIC BTHM_TiDlyDchaTherm_P /end REF_CHARACTERISTIC /end GROUP
/begin GROUP S37_BTHM_TiDlyForIDetn_P "swc_BatThermHndlgMngt/BTHM_100ms_sys/100ms/ThermManage/BTHM_TiDlyForIDetn_P" /begin REF_CHARACTERISTIC BTHM_TiDlyForIDetn_P /end REF_CHARACTERISTIC /end GROUP
/begin GROUP S37_BTHM_TiDlyForIDetn_P1 "swc_BatThermHndlgMngt/BTHM_100ms_sys/100ms/ThermManage/BTHM_TiDlyForIDetn_P1" /begin REF_CHARACTERISTIC BTHM_TiDlyForIDetn_P /end REF_CHARACTERISTIC /end GROUP
/begin GROUP S37_BTHM_TiDlyForUDetn_P "swc_BatThermHndlgMngt/BTHM_100ms_sys/100ms/ThermManage/BTHM_TiDlyForUDetn_P" /begin REF_CHARACTERISTIC BTHM_TiDlyForUDetn_P /end REF_CHARACTERISTIC /end GROUP
/begin GROUP S37_BTHM_TiDlyForUDetn_P1 "swc_BatThermHndlgMngt/BTHM_100ms_sys/100ms/ThermManage/BTHM_TiDlyForUDetn_P1" /begin REF_CHARACTERISTIC BTHM_TiDlyForUDetn_P /end REF_CHARACTERISTIC /end GROUP
/begin GROUP S37_BTHM_TiDlyToTClcd_P1 "swc_BatThermHndlgMngt/BTHM_100ms_sys/100ms/ThermManage/BTHM_TiDlyToTClcd_P1" /begin REF_CHARACTERISTIC BTHM_TiDlyToTClcd_P /end REF_CHARACTERISTIC /end GROUP
/begin GROUP S37_BTHM_TiRlyDlyNegOpen_P "swc_BatThermHndlgMngt/BTHM_100ms_sys/100ms/ThermManage/BTHM_TiRlyDlyNegOpen_P" /begin REF_CHARACTERISTIC BTHM_TiRlyDlyNegOpen_P /end REF_CHARACTERISTIC /end GROUP
/begin GROUP S37_BWLD_LvlAcs_P "swc_BatWntyLogtcData/10ms/10ms/BWLD_LvlAcs_P" /begin REF_CHARACTERISTIC BWLD_LvlAcs_P /end REF_CHARACTERISTIC /end GROUP
/begin GROUP S37_DEH_EnaDiagGlbMan_P "swc_DiagcEveHndlg/DEH_10ms_sys/DEH_10ms_sys/General Diagnosis Signals/DEH_EnaDiagGlbMan_P" /begin REF_CHARACTERISTIC DEH_EnaDiagGlbMan_P /end REF_CHARACTERISTIC /end GROUP
/begin GROUP S37_DEH_LvlErrMan_P1 "swc_DiagcEveHndlg/DEH_10ms_sys/DEH_10ms_sys/General Diagnosis Signals/DEH_LvlErrMan_P1" /begin REF_CHARACTERISTIC DEH_LvlErrMan_P /end REF_CHARACTERISTIC /end GROUP
/begin GROUP S37_DEH_LvlErrSbMan_P "swc_DiagcEveHndlg/DEH_10ms_sys/DEH_10ms_sys/General Diagnosis Signals/DEH_LvlErrSbMan_P" /begin REF_CHARACTERISTIC DEH_LvlErrSbMan_P /end REF_CHARACTERISTIC /end GROUP
/begin GROUP S37_DEH_StFltLampIndcnMan_P "swc_DiagcEveHndlg/DEH_10ms_sys/DEH_10ms_sys/General Diagnosis Signals/DEH_StFltLampIndcnMan_P" /begin REF_CHARACTERISTIC DEH_StFltLampIndcnMan_P /end REF_CHARACTERISTIC /end GROUP
/begin GROUP S37_DEH_UTrmlLowrThd_P "swc_DiagcEveHndlg/DEH_10ms_sys/DEH_10ms_sys/General Diagnosis Signals/DEH_UTrmlLowrThd_P" /begin REF_CHARACTERISTIC DEH_UTrmlLowrThd_P /end REF_CHARACTERISTIC /end GROUP
/begin GROUP S37_DEH_UTrmlUpprThd_P "swc_DiagcEveHndlg/DEH_10ms_sys/DEH_10ms_sys/General Diagnosis Signals/DEH_UTrmlUpprThd_P" /begin REF_CHARACTERISTIC DEH_UTrmlUpprThd_P /end REF_CHARACTERISTIC /end GROUP
/begin GROUP S37_Determine_Balancing_Thresholds "swc_BatBalnCtl/BBC_100ms_sys/BBC_100ms_sys/BatBalnCtl/Battery Balancing Decision/BatBalnCtl/Determine Balancing Thresholds"
 /begin SUB_GROUP S66_Battery_is_AC_Charging S66_Battery_is_DC_Charging S66_Battery_is_Offline____Relais_open S66_Battery_is_Online /end SUB_GROUP
/end GROUP
/begin GROUP S37_EBat "swc_BatWntyLogtcData/10ms/10ms/EBat"
 /begin SUB_GROUP S73_BWLD_DirIChg_P S73_BWLD_DirIChg_P1 S73_BWLD_IChCtLim_P S73_BWLD_IDchaCtLim_P S73_SetTotalCharge S73_SetTotalDischarge /end SUB_GROUP
/end GROUP
/begin GROUP S37_HeatThermalCondition "swc_BatThermHndlgMngt/BTHM_100ms_sys/100ms/ThermManage/HeatThermalCondition"
 /begin SUB_GROUP S367_BTHM_PctgRlyUClsNegMax_P S367_BTHM_PctgRlyUClsNegMin_P S367_CompareToCalibrationPara S367_CompareToCalibrationPara1 S367_CompareToCalibrationPara10 S367_CompareToCalibrationPara11 S367_CompareToCalibrationPara12 S367_CompareToCalibrationPara13 S367_CompareToCalibrationPara14 S367_CompareToCalibrationPara15 S367_CompareToCalibrationPara16 S367_CompareToCalibrationPara2 S367_CompareToCalibrationPara29 S367_CompareToCalibrationPara3 S367_CompareToCalibrationPara30 S367_CompareToCalibrationPara31 S367_CompareToCalibrationPara32 S367_CompareToCalibrationPara33 S367_CompareToCalibrationPara4 S367_CompareToCalibrationPara5 S367_CompareToCalibrationPara6 S367_CompareToCalibrationPara7 S367_CompareToCalibrationPara8 S367_CompareToCalibrationPara9 /end SUB_GROUP
/end GROUP
/begin GROUP S37_IBat "swc_BatWntyLogtcData/10ms/10ms/IBat" /begin SUB_GROUP S74_BWLD_DirIChg_P S74_BWLD_IBatRst_P /end SUB_GROUP /end GROUP
/begin GROUP S37_LiquidThermalCondition "swc_BatThermHndlgMngt/BTHM_100ms_sys/100ms/ThermManage/LiquidThermalCondition"
 /begin SUB_GROUP S369_BTHM_PctgRlyUClsNegMax_P S369_BTHM_PctgRlyUClsNegMin_P S369_BTHM_TiDlyForCellVolLo_P S369_BTHM_TiTask100Ms_P S369_CompareToCalibrationPara1 S369_CompareToCalibrationPara10 S369_CompareToCalibrationPara11 S369_CompareToCalibrationPara12 S369_CompareToCalibrationPara13 S369_CompareToCalibrationPara14 S369_CompareToCalibrationPara15 S369_CompareToCalibrationPara16 S369_CompareToCalibrationPara17 S369_CompareToCalibrationPara18 S369_CompareToCalibrationPara19 S369_CompareToCalibrationPara2 S369_CompareToCalibrationPara20 S369_CompareToCalibrationPara21 S369_CompareToCalibrationPara22 S369_CompareToCalibrationPara23 S369_CompareToCalibrationPara24 S369_CompareToCalibrationPara25 S369_CompareToCalibrationPara26 S369_CompareToCalibrationPara27 S369_CompareToCalibrationPara28 S369_CompareToCalibrationPara29 S369_CompareToCalibrationPara3 S369_CompareToCalibrationPara30 S369_CompareToCalibrationPara31 S369_CompareToCalibrationPara32 S369_CompareToCalibrationPara33 S369_CompareToCalibrationPara34 S369_CompareToCalibrationPara35 S369_CompareToCalibrationPara36 S369_CompareToCalibrationPara37 S369_CompareToCalibrationPara38 S369_CompareToCalibrationPara39 S369_CompareToCalibrationPara4 S369_CompareToCalibrationPara40 S369_CompareToCalibrationPara41 S369_CompareToCalibrationPara5 S369_CompareToCalibrationPara6 S369_CompareToCalibrationPara7 S369_CompareToCalibrationPara8 S369_CompareToCalibrationPara9 /end SUB_GROUP
/end GROUP
/begin GROUP S37_PBat "swc_BatWntyLogtcData/10ms/10ms/PBat" /begin SUB_GROUP S75_BWLD_DirIChg_P S75_BWLD_PBatRst_P /end SUB_GROUP /end GROUP
/begin GROUP S37_ShutdownDetection "swc_BcuStTranCtl/BcuStTranCtl_sys/BcuStTranCtl/ConditionConfirm/ShutdownDetection"
 /begin SUB_GROUP S92_BSTC_ReqEmcyHvOffFromVcu_P S92_BSTC_ReqNormHvOffFromVcu_P S92_BSTC_TiProc_P S92_BSTC_TiProc_P1 S92_BSTC_TiProc_P2 S92_BSTC_TiRxHvOffReqAftEmcy_P S92_BSTC_TiRxHvOffReqForAcCh_P S92_BSTC_TiRxHvOffReqForDcCh_P S92_BSTC_TiRxHvOffReqForDcha_P S92_Subsystem /end SUB_GROUP
/end GROUP
/begin GROUP S37_UBat "swc_BatWntyLogtcData/10ms/10ms/UBat" /begin SUB_GROUP S76_BWLD_UBatRst_P /end SUB_GROUP /end GROUP
/begin GROUP S383_BCF_RMdulAgiFacSatn_M "swc_BatCoreFct/BCF_100ms_sys/BatCoreFct/PackObs/PackObsLoop/MdulObs/MdulRObs/Update RMdulAgiFac/Calculate update of aging factor/BCF_RMdulAgiFacSatn_M" /begin REF_CHARACTERISTIC BCF_RMdulAgiFacSatn_M /end REF_CHARACTERISTIC /end GROUP
/begin GROUP S383_BCF_RMdulAgiFacUpd_P "swc_BatCoreFct/BCF_100ms_sys/BatCoreFct/PackObs/PackObsLoop/MdulObs/MdulRObs/Update RMdulAgiFac/Calculate update of aging factor/BCF_RMdulAgiFacUpd_P" /begin REF_CHARACTERISTIC BCF_RMdulAgiFacUpd_P /end REF_CHARACTERISTIC /end GROUP
/begin GROUP S385_BCF_RMdulAgiFacInvldErrMin_M "swc_BatCoreFct/BCF_100ms_sys/BatCoreFct/PackObs/PackObsLoop/MdulObs/MdulRObs/Update RMdulAgiFac/Diagnostic of module degradation/BCF_RMdulAgiFacInvldErrMin_M" /begin REF_CHARACTERISTIC BCF_RMdulAgiFacInvldErrMin_M /end REF_CHARACTERISTIC /end GROUP
/begin GROUP S385_BCF_RMdulAgiFacInvldHeal_M "swc_BatCoreFct/BCF_100ms_sys/BatCoreFct/PackObs/PackObsLoop/MdulObs/MdulRObs/Update RMdulAgiFac/Diagnostic of module degradation/BCF_RMdulAgiFacInvldHeal_M" /begin REF_CHARACTERISTIC BCF_RMdulAgiFacInvldHeal_M /end REF_CHARACTERISTIC /end GROUP
/begin GROUP S385_BCF_RMdulAgiFacVldErrMin_M "swc_BatCoreFct/BCF_100ms_sys/BatCoreFct/PackObs/PackObsLoop/MdulObs/MdulRObs/Update RMdulAgiFac/Diagnostic of module degradation/BCF_RMdulAgiFacVldErrMin_M" /begin REF_CHARACTERISTIC BCF_RMdulAgiFacVldErrMin_M /end REF_CHARACTERISTIC /end GROUP
/begin GROUP S385_BCF_RMdulAgiFacVldHeal_M "swc_BatCoreFct/BCF_100ms_sys/BatCoreFct/PackObs/PackObsLoop/MdulObs/MdulRObs/Update RMdulAgiFac/Diagnostic of module degradation/BCF_RMdulAgiFacVldHeal_M" /begin REF_CHARACTERISTIC BCF_RMdulAgiFacVldHeal_M /end REF_CHARACTERISTIC /end GROUP
/begin GROUP S385_BCF_TdOffDig1003_P "swc_BatCoreFct/BCF_100ms_sys/BatCoreFct/PackObs/PackObsLoop/MdulObs/MdulRObs/Update RMdulAgiFac/Diagnostic of module degradation/BCF_TdOffDig1003_P" /begin REF_CHARACTERISTIC BCF_TdOffDig1003_P /end REF_CHARACTERISTIC /end GROUP
/begin GROUP S385_BCF_TdOnDig1003_P "swc_BatCoreFct/BCF_100ms_sys/BatCoreFct/PackObs/PackObsLoop/MdulObs/MdulRObs/Update RMdulAgiFac/Diagnostic of module degradation/BCF_TdOnDig1003_P" /begin REF_CHARACTERISTIC BCF_TdOnDig1003_P /end REF_CHARACTERISTIC /end GROUP
/begin GROUP S386_BCF_RMdulAgiFacLowrLim_P "swc_BatCoreFct/BCF_100ms_sys/BatCoreFct/PackObs/PackObsLoop/MdulObs/MdulRObs/Update RMdulAgiFac/Update new aging factor/BCF_RMdulAgiFacLowrLim_P" /begin REF_CHARACTERISTIC BCF_RMdulAgiFacLowrLim_P /end REF_CHARACTERISTIC /end GROUP
/begin GROUP S386_BCF_RMdulAgiFacUpprLim_P "swc_BatCoreFct/BCF_100ms_sys/BatCoreFct/PackObs/PackObsLoop/MdulObs/MdulRObs/Update RMdulAgiFac/Update new aging factor/BCF_RMdulAgiFacUpprLim_P" /begin REF_CHARACTERISTIC BCF_RMdulAgiFacUpprLim_P /end REF_CHARACTERISTIC /end GROUP
/begin GROUP S38_BitSelect "swc_BcuStTranCtl/BcuStTranCtl_sys/BcuStTranCtl/DTC/BitSelect" /begin REF_CHARACTERISTIC BSTC_CswDiag_P /end REF_CHARACTERISTIC /end GROUP
/begin GROUP S38_BitSelect1 "swc_BcuStTranCtl/BcuStTranCtl_sys/BcuStTranCtl/DTC/BitSelect1" /begin REF_CHARACTERISTIC BSTC_CswDiag_P /end REF_CHARACTERISTIC /end GROUP
/begin GROUP S38_BitSelect2 "swc_BcuStTranCtl/BcuStTranCtl_sys/BcuStTranCtl/DTC/BitSelect2" /begin REF_CHARACTERISTIC BSTC_CswDiag_P /end REF_CHARACTERISTIC /end GROUP
/begin GROUP S38_BitSelect3 "swc_BcuStTranCtl/BcuStTranCtl_sys/BcuStTranCtl/DTC/BitSelect3" /begin REF_CHARACTERISTIC BSTC_CswDiag_P /end REF_CHARACTERISTIC /end GROUP
/begin GROUP S38_BitSelect4 "swc_BcuStTranCtl/BcuStTranCtl_sys/BcuStTranCtl/DTC/BitSelect4" /begin REF_CHARACTERISTIC BSTC_CswDiag_P /end REF_CHARACTERISTIC /end GROUP
/begin GROUP S38_BSTC_TiOffDigForPwrOff_P "swc_BcuStTranCtl/BcuStTranCtl_sys/BcuStTranCtl/DTC/BSTC_TiOffDigForPwrOff_P" /begin REF_CHARACTERISTIC BSTC_TiOffDigForPwrOff_P /end REF_CHARACTERISTIC /end GROUP
/begin GROUP S38_BSTC_TiOnDigForPwrOff_P "swc_BcuStTranCtl/BcuStTranCtl_sys/BcuStTranCtl/DTC/BSTC_TiOnDigForPwrOff_P" /begin REF_CHARACTERISTIC BSTC_TiOnDigForPwrOff_P /end REF_CHARACTERISTIC /end GROUP
/begin GROUP S38_TBcuSnsrChk "swc_BatThermHndlgMngt/BTHM_100ms_sys/100ms/DataPrep/DataChk/TBcuSnsrChk"
 /begin SUB_GROUP S45_BTHM_DincrtDataErr_P1 S45_BTHM_DmaxDataErr_P1 S45_BTHM_DminDataErr_P1 S45_BTHM_TBcuSnsrUMax_P1 S45_BTHM_TBcuSnsrUMin_P1 /end SUB_GROUP
/end GROUP
/begin GROUP S38_TMdulCtlrSnsrChk "swc_BatThermHndlgMngt/BTHM_100ms_sys/100ms/DataPrep/DataChk/TMdulCtlrSnsrChk"
 /begin SUB_GROUP S46_BTHM_DincrtMdulSnsrErr_P S46_BTHM_DmaxMdulSnsrErr_P S46_BTHM_DminMdulSnsrErr_P S46_BTHM_TMdulCtlrSnsrUMax_P S46_BTHM_TMdulCtlrSnsrUMin_P /end SUB_GROUP
/end GROUP
/begin GROUP S39_BitSelect "swc_BatThermHndlgMngt/BTHM_100ms_sys/100ms/DataPrep/DataClcn/BitSelect" /begin REF_CHARACTERISTIC BTHM_CswGlb_P /end REF_CHARACTERISTIC /end GROUP
/begin GROUP S39_BitSelect1 "swc_BatThermHndlgMngt/BTHM_100ms_sys/100ms/DataPrep/DataClcn/BitSelect1" /begin REF_CHARACTERISTIC BTHM_CswGlb_P /end REF_CHARACTERISTIC /end GROUP
/begin GROUP S39_BitSelect2 "swc_BatThermHndlgMngt/BTHM_100ms_sys/100ms/DataPrep/DataClcn/BitSelect2" /begin REF_CHARACTERISTIC BTHM_CswGlb_P /end REF_CHARACTERISTIC /end GROUP
/begin GROUP S39_BitSelect3 "swc_BatThermHndlgMngt/BTHM_100ms_sys/100ms/DataPrep/DataClcn/BitSelect3" /begin REF_CHARACTERISTIC BTHM_CswGlb_P /end REF_CHARACTERISTIC /end GROUP
/begin GROUP S39_BitSelect4 "swc_BatThermHndlgMngt/BTHM_100ms_sys/100ms/DataPrep/DataClcn/BitSelect4" /begin REF_CHARACTERISTIC BTHM_CswGlb_P /end REF_CHARACTERISTIC /end GROUP
/begin GROUP S39_BitSelect5 "swc_BatThermHndlgMngt/BTHM_100ms_sys/100ms/DataPrep/DataClcn/BitSelect5" /begin REF_CHARACTERISTIC BTHM_CswGlb_P /end REF_CHARACTERISTIC /end GROUP
/begin GROUP S39_BitSelect6 "swc_BatThermHndlgMngt/BTHM_100ms_sys/100ms/DataPrep/DataClcn/BitSelect6" /begin REF_CHARACTERISTIC BTHM_CswGlb_P /end REF_CHARACTERISTIC /end GROUP
/begin GROUP S39_BTHM_TMdulCtlrSnsrMax_P "swc_BatThermHndlgMngt/BTHM_100ms_sys/100ms/DataPrep/DataClcn/BTHM_TMdulCtlrSnsrMax_P" /begin REF_CHARACTERISTIC BTHM_TMdulCtlrSnsrMax_P /end REF_CHARACTERISTIC /end GROUP
/begin GROUP S39_BTHM_TMdulCtlrSnsrMin_P "swc_BatThermHndlgMngt/BTHM_100ms_sys/100ms/DataPrep/DataClcn/BTHM_TMdulCtlrSnsrMin_P" /begin REF_CHARACTERISTIC BTHM_TMdulCtlrSnsrMin_P /end REF_CHARACTERISTIC /end GROUP
/begin GROUP S39_BTHM_TMdulSnsrMax_P "swc_BatThermHndlgMngt/BTHM_100ms_sys/100ms/DataPrep/DataClcn/BTHM_TMdulSnsrMax_P" /begin REF_CHARACTERISTIC BTHM_TMdulSnsrMax_P /end REF_CHARACTERISTIC /end GROUP
/begin GROUP S39_BTHM_TMdulSnsrMaxRaw_P "swc_BatThermHndlgMngt/BTHM_100ms_sys/100ms/DataPrep/DataClcn/BTHM_TMdulSnsrMaxRaw_P" /begin REF_CHARACTERISTIC BTHM_TMdulSnsrMaxRaw_P /end REF_CHARACTERISTIC /end GROUP
/begin GROUP S39_BTHM_TMdulSnsrMin_P "swc_BatThermHndlgMngt/BTHM_100ms_sys/100ms/DataPrep/DataClcn/BTHM_TMdulSnsrMin_P" /begin REF_CHARACTERISTIC BTHM_TMdulSnsrMin_P /end REF_CHARACTERISTIC /end GROUP
/begin GROUP S39_BTHM_TMdulSnsrMinRaw_P "swc_BatThermHndlgMngt/BTHM_100ms_sys/100ms/DataPrep/DataClcn/BTHM_TMdulSnsrMinRaw_P" /begin REF_CHARACTERISTIC BTHM_TMdulSnsrMinRaw_P /end REF_CHARACTERISTIC /end GROUP
/begin GROUP S39_BTHM_TPack_P "swc_BatThermHndlgMngt/BTHM_100ms_sys/100ms/DataPrep/DataClcn/BTHM_TPack_P" /begin REF_CHARACTERISTIC BTHM_TPack_P /end REF_CHARACTERISTIC /end GROUP
/begin GROUP S39_TPackDif "swc_BatThermHndlgMngt/BTHM_100ms_sys/100ms/DataPrep/DataClcn/TPackDif"
 /begin SUB_GROUP S74_BitSelect S74_BitSelect22 S74_BitSelect23 S74_BTHM_ModeSelnOfPackTDif_P S74_BTHM_TiOffDig93_P S74_BTHM_TiOnDig93_P S74_BTHM_TiTask100Ms_P S74_CompareToCalibrationPara S74_CompareToCalibrationPara1 /end SUB_GROUP
/end GROUP
/begin GROUP S3_10ms "swc_BatWntyLogtcData/10ms/10ms" /begin SUB_GROUP S37_BWLD_LvlAcs_P S37_EBat S37_IBat S37_PBat S37_UBat /end SUB_GROUP /end GROUP
/begin GROUP S3_CellTemperatureDiagnosis "swc_BatProtnPack/PackSocAndSohDiag/1000ms/CellTemperatureDiagnosis"
 /begin SUB_GROUP S17_BitSelect1 S17_BitSelect2 S17_BPP_TCellWarnMax2_P S17_BPP_TCellWarnMax3_P S17_BPP_TCellWarnMax_P S17_BPP_TCellWarnMaxOff2_P S17_BPP_TCellWarnMaxOff3_P S17_BPP_TCellWarnMaxOff_P S17_BPP_TiOffDig176_P S17_BPP_TiOffDig6_P S17_BPP_TiOffDig91_P S17_BPP_TiOnDig176_P S17_BPP_TiOnDig6_P S17_BPP_TiOnDig91_P S17_BPP_TiSample2_P S17_BPP_TiSample2_P1 S17_BPP_TiSample2_P2 S17_BPP_TMdulSnsrSeln_P1 S18_BitSelect S18_BPP_TCellWarnMin_P1 S18_BPP_TCellWarnMinOff_P S18_BPP_TiOffDig176_P S18_BPP_TiOnDig176_P S18_BPP_TiSample2_P S18_BPP_TMdulSnsrSeln_P /end SUB_GROUP
/end GROUP
/begin GROUP S3_CellVoltageDiagnosis "swc_BatProtnIU/CellUDiag/100ms/CellVoltageDiagnosis"
 /begin SUB_GROUP S16_CellVoltageLimitCore S16_CellVoltageOutOfRange S16_ModulelVoltageOutOfRange S16_UCellCollectionDiagnosis S16_UCellDiffDiag S16_UCellMaxDiagnosis S16_UCellRateDiagnosis /end SUB_GROUP
/end GROUP
/begin GROUP S3_COL_10ms_sys "swc_COL/COL_10ms_sys/COL_10ms_sys"
 /begin SUB_GROUP S631_BMS_CoolNegRelayCtrl_P S631_BMS_CoolPosRelayCtrl_P S631_BMS_HeatNegRelayCtrl_Reserved_P S631_BMS_HeatPosRelayCtrl_Reserved_P S631_BMS_InsideFltCode_P S631_BMS_TestFrame_P S631_BMS_TestInfo1_BMS_MainNegRelay1Ctrl_P S631_BMS_TestInfo1_BMS_MainNegRelay2Ctrl_P S631_BmsSuspCause_ActiveSuspend_P S631_BmsSuspCause_SingleVoltage_P S631_BmsSuspCause_SOC_P S631_BmsSuspCause_TotalVoltage_P S631_BmsSuspError_AbnormalVoltage_P S631_BmsSuspError_ExcessiveCurrent_P S631_BmsSuspFault_BatteryTemp_P S631_BmsSuspFault_BmsTemp_P S631_BmsSuspFault_ChargeConn_P S631_BmsSuspFault_Insulation_P S631_BmsSuspFault_OtherFaults_P S631_BmsSuspFault_OutputConnTemp_P S631_BmsSuspFault_VoltageDetection_P S631_BmsSuspFault_VoltageRelay_P S631_BmuControl_BalanceControl_P S631_BSWIOSP_Mode_Request_shutdown_P S631_BSWIOSP_Request_BCL_P S631_BSWIOSP_Request_BCP_P S631_BSWIOSP_Request_BCPP_P S631_BSWIOSP_Request_BCS_P S631_BSWIOSP_Request_BCSP_P S631_BSWIOSP_Request_BDC_P S631_BSWIOSP_Request_BEM_P S631_BSWIOSP_Request_BHM_P S631_BSWIOSP_Request_BMS_FastChgStopInfo_P S631_BSWIOSP_Request_BMT_P S631_BSWIOSP_Request_BMV_P S631_BSWIOSP_Request_BRM_P S631_BSWIOSP_Request_BRO_P S631_BSWIOSP_Request_BSD_P S631_BSWIOSP_Request_BSM_P S631_BSWIOSP_Request_BSP_P S631_BSWIOSP_Request_BST_P S631_ChargingMode_P S631_CurrentDemand_P S631_DTRC_Csw_P_100 S631_DTRC_Csw_P_101 S631_DTRC_Csw_P_109 S631_DTRC_Csw_P_119 S631_DTRC_Csw_P_120 S631_DTRC_Csw_P_121 S631_DTRC_Csw_P_122 S631_DTRC_Csw_P_123 S631_DTRC_Csw_P_124 S631_DTRC_Csw_P_125 S631_DTRC_Csw_P_126 S631_DTRC_Csw_P_127 S631_DTRC_Csw_P_128 S631_DTRC_Csw_P_129 S631_DTRC_Csw_P_130 S631_DTRC_Csw_P_131 S631_DTRC_Csw_P_132 S631_DTRC_Csw_P_133 S631_DTRC_Csw_P_134 S631_DTRC_Csw_P_135 S631_DTRC_Csw_P_164 S631_DTRC_Csw_P_40 S631_DTRC_Csw_P_43 S631_DTRC_Csw_P_54 S631_DTRC_Csw_P_8 S631_DTRC_Csw_P_89 S631_DTRC_Csw_P_9 S631_DTRC_Csw_P_90 S631_DTRC_Csw_P_92 S631_DTRC_Csw_P_96 S631_HvSysSample_DisableIso_P S631_VoltageDemand_P /end SUB_GROUP
/end GROUP
/begin GROUP S3_ElecVehChegnStHdlr_Sys "swc_BatChCtl/DC_10ms_sys/ElecVehChegnStHdlr_Sys" /begin SUB_GROUP S305_ElecVehChegnStHdlr /end SUB_GROUP /end GROUP
/begin GROUP S3_HighVoltageDiagnosis "swc_BatProtnIU/CellUDiag/100ms/HighVoltageDiagnosis"
 /begin SUB_GROUP S17_BitSelect S17_BPIU_TiOffDig81_P S17_BPIU_TiOnDig81_P S17_BPIU_TiSample2_P1 S17_BPIU_UAcqnDeMax_P S17_BPIU_UCellMinLim_P /end SUB_GROUP
/end GROUP
/begin GROUP S3_PackSocDiagnosisAndLimit "swc_BatProtnPack/PackSocAndSohDiag/1000ms/PackSocDiagnosisAndLimit"
 /begin SUB_GROUP S63_BitSelect4 S63_BPP_SocCellDifMax_P S63_BPP_SocCellDifMin_P S63_BPP_TiOffDig196_P S63_BPP_TiOnDig196_P S63_BPP_TiSample2_P S64_BitSelect1 S64_BitSelect2 S64_BitSelect3 S64_BitSelect4 S64_BPIU_SocPackMinLim1_P S64_BPIU_SocPackMinLim2_P S64_BPIU_SocPackMinOff1_P S64_BPIU_SocPackMinOff2_P S64_BPP_SocPackJmpLim_P S64_BPP_TiOffDig182_P S64_BPP_TiOffDig184_P S64_BPP_TiOffDig185_P S64_BPP_TiOffDig97_P S64_BPP_TiOnDig182_P S64_BPP_TiOnDig184_P S64_BPP_TiOnDig185_P S64_BPP_TiOnDig97_P S64_BPP_TiSample2_P S64_BPP_TiSample2_P1 S64_BPP_TiSample2_P2 S64_BPP_TiSample2_P3 /end SUB_GROUP
/end GROUP
/begin GROUP S3_PackSohDiagnosis "swc_BatProtnPack/PackSocAndSohDiag/1000ms/PackSohDiagnosis" /end GROUP
/begin GROUP S3_TotalVoltageFault "swc_BatProtnIU/CellUDiag/100ms/TotalVoltageFault"
 /begin SUB_GROUP S19_BitSelect S19_BPIU_TiOffDig112_P S19_BPIU_TiOnDig112_P S19_BPIU_TiSample2_P1 S19_BPIU_UPackLimOff_P S19_BPIU_UPackLimOn_P /end SUB_GROUP
/end GROUP
/begin GROUP S3_UPackCollectionDiagnosis "swc_BatProtnIU/CellUDiag/100ms/UPackCollectionDiagnosis"
 /begin SUB_GROUP S20_BitSelect S20_BPIU_TiOffDig133_P S20_BPIU_TiOnDig133_P S20_BPIU_TiSample2_P1 S20_BPIU_UCellMaxLim_P /end SUB_GROUP
/end GROUP
/begin GROUP S40_BBC_AcvCellTestSrc_P "swc_BatBalnCtl/BBC_100ms_sys/BBC_100ms_sys/BatBalnCtl/Battery Balancing Decision/ManualSwitch/BBC_AcvCellTestSrc_P" /begin REF_CHARACTERISTIC BBC_AcvCellTestSrc_P /end REF_CHARACTERISTIC /end GROUP
/begin GROUP S40_BBC_AcvCellTestTgt_P "swc_BatBalnCtl/BBC_100ms_sys/BBC_100ms_sys/BatBalnCtl/Battery Balancing Decision/ManualSwitch/BBC_AcvCellTestTgt_P" /begin REF_CHARACTERISTIC BBC_AcvCellTestTgt_P /end REF_CHARACTERISTIC /end GROUP
/begin GROUP S40_BBC_CtrBalnTestMan_P "swc_BatBalnCtl/BBC_100ms_sys/BBC_100ms_sys/BatBalnCtl/Battery Balancing Decision/ManualSwitch/BBC_CtrBalnTestMan_P" /begin REF_CHARACTERISTIC BBC_CtrBalnTestMan_P /end REF_CHARACTERISTIC /end GROUP
/begin GROUP S40_BBC_EnaCellAcvBalnManSrc_P "swc_BatBalnCtl/BBC_100ms_sys/BBC_100ms_sys/BatBalnCtl/Battery Balancing Decision/ManualSwitch/BBC_EnaCellAcvBalnManSrc_P" /begin REF_CHARACTERISTIC BBC_EnaCellAcvBalnManSrc_P /end REF_CHARACTERISTIC /end GROUP
/begin GROUP S40_BBC_EnaCellAcvBalnManTgt_P "swc_BatBalnCtl/BBC_100ms_sys/BBC_100ms_sys/BatBalnCtl/Battery Balancing Decision/ManualSwitch/BBC_EnaCellAcvBalnManTgt_P" /begin REF_CHARACTERISTIC BBC_EnaCellAcvBalnManTgt_P /end REF_CHARACTERISTIC /end GROUP
/begin GROUP S40_BBC_EnaCellBalnMan_P "swc_BatBalnCtl/BBC_100ms_sys/BBC_100ms_sys/BatBalnCtl/Battery Balancing Decision/ManualSwitch/BBC_EnaCellBalnMan_P" /begin REF_CHARACTERISTIC BBC_EnaCellBalnMan_P /end REF_CHARACTERISTIC /end GROUP
/begin GROUP S40_BBC_EnaMdulNrBalnManSrc_P "swc_BatBalnCtl/BBC_100ms_sys/BBC_100ms_sys/BatBalnCtl/Battery Balancing Decision/ManualSwitch/BBC_EnaMdulNrBalnManSrc_P" /begin REF_CHARACTERISTIC BBC_EnaMdulNrBalnManSrc_P /end REF_CHARACTERISTIC /end GROUP
/begin GROUP S40_BBC_EnaMdulNrBalnManTgt_P "swc_BatBalnCtl/BBC_100ms_sys/BBC_100ms_sys/BatBalnCtl/Battery Balancing Decision/ManualSwitch/BBC_EnaMdulNrBalnManTgt_P" /begin REF_CHARACTERISTIC BBC_EnaMdulNrBalnManTgt_P /end REF_CHARACTERISTIC /end GROUP
/begin GROUP S40_BBC_NrMdulTestSrc_P "swc_BatBalnCtl/BBC_100ms_sys/BBC_100ms_sys/BatBalnCtl/Battery Balancing Decision/ManualSwitch/BBC_NrMdulTestSrc_P" /begin REF_CHARACTERISTIC BBC_NrMdulTestSrc_P /end REF_CHARACTERISTIC /end GROUP
/begin GROUP S40_BBC_NrMdulTestTgt_P "swc_BatBalnCtl/BBC_100ms_sys/BBC_100ms_sys/BatBalnCtl/Battery Balancing Decision/ManualSwitch/BBC_NrMdulTestTgt_P" /begin REF_CHARACTERISTIC BBC_NrMdulTestTgt_P /end REF_CHARACTERISTIC /end GROUP
/begin GROUP S415_BCF_SocLowrLimForAgiFacUpd_P "swc_BatCoreFct/BCF_100ms_sys/BatCoreFct/PackObs/PackObsLoop/MdulObs/MdulSocObsr/Evaluate Estimate/BCF_SocLowrLimForAgiFacUpd_P" /begin REF_CHARACTERISTIC BCF_SocLowrLimForAgiFacUpd_P /end REF_CHARACTERISTIC /end GROUP
/begin GROUP S415_BCF_SocUpprLimForAgiFacUpd_P "swc_BatCoreFct/BCF_100ms_sys/BatCoreFct/PackObs/PackObsLoop/MdulObs/MdulSocObsr/Evaluate Estimate/BCF_SocUpprLimForAgiFacUpd_P" /begin REF_CHARACTERISTIC BCF_SocUpprLimForAgiFacUpd_P /end REF_CHARACTERISTIC /end GROUP
/begin GROUP S415_BCF_TLowrLimForAgiFacUpd_P "swc_BatCoreFct/BCF_100ms_sys/BatCoreFct/PackObs/PackObsLoop/MdulObs/MdulSocObsr/Evaluate Estimate/BCF_TLowrLimForAgiFacUpd_P" /begin REF_CHARACTERISTIC BCF_TLowrLimForAgiFacUpd_P /end REF_CHARACTERISTIC /end GROUP
/begin GROUP S417_Correction_of_State_Estimation "swc_BatCoreFct/BCF_100ms_sys/BatCoreFct/PackObs/PackObsLoop/MdulObs/MdulSocObsr/MdulStateObs/Correction of State Estimation"
 /begin SUB_GROUP S428_BCF_bAcvObsr_P S428_BCF_IDlcMeanHiLim_P S428_BCF_IDlcMeanLoLim_P S428_BCF_IWbz1MeanHiLim_P S428_BCF_IWbz1MeanLoLim_P S428_BCF_IWbz2MeanHiLim_P S428_BCF_IWbz2MeanLoLim_P S428_BCF_SocMeanHiLim_P S428_BCF_SocMeanLoLim_P /end SUB_GROUP
/end GROUP
/begin GROUP S417_Determine_Observer_Gain "swc_BatCoreFct/BCF_100ms_sys/BatCoreFct/PackObs/PackObsLoop/MdulObs/MdulSocObsr/MdulStateObs/Determine Observer Gain"
 /begin SUB_GROUP S429_BCF_IThdForMdlVld_P S429_BCF_ObsrgnAr1_P S429_BCF_ObsrgnAr2_P S429_BCF_ObsrgnLo_P S429_BCF_SocLowrLimForObsrgn_P S429_BCF_SocUpprLimForObsrgn_P S429_BCF_TLowrLimForAgiFacUpd_P /end SUB_GROUP
/end GROUP
/begin GROUP S417_MdulModel "swc_BatCoreFct/BCF_100ms_sys/BatCoreFct/PackObs/PackObsLoop/MdulObs/MdulSocObsr/MdulStateObs/MdulModel"
 /begin SUB_GROUP S430__Process_Equation__ffun S430_Measurement_Equation_hfun /end SUB_GROUP
/end GROUP
/begin GROUP S418_Evaluation_of_Estimation "swc_BatCoreFct/BCF_100ms_sys/BatCoreFct/PackObs/PackObsLoop/MdulObs/MdulSocObsr/MdulTObs/Evaluation of Estimation"
 /begin SUB_GROUP S472_BCF_TCooltHiLim_P S472_BCF_TCooltLoLim_P S472_BCF_TMdulHiLim_P S472_BCF_TMdulLoLim_P /end SUB_GROUP
/end GROUP
/begin GROUP S418_T_Estimation "swc_BatCoreFct/BCF_100ms_sys/BatCoreFct/PackObs/PackObsLoop/MdulObs/MdulSocObsr/MdulTObs/T Estimation" /begin SUB_GROUP S473_TCoolt_Estimation S473_TMdul_Estimation /end SUB_GROUP /end GROUP
/begin GROUP S41_B2V_SingleChgEnergy_P "swc_COL/COL_1000ms_sys/COL_1000ms_sys/B2V_SingleChgEnergy_P" /begin REF_CHARACTERISTIC B2V_SingleChgEnergy_P /end REF_CHARACTERISTIC /end GROUP
/begin GROUP S41_BMS_BattMaxTemp1_P "swc_COL/COL_1000ms_sys/COL_1000ms_sys/BMS_BattMaxTemp1_P" /begin REF_CHARACTERISTIC BMS_BattMaxTemp1_P /end REF_CHARACTERISTIC /end GROUP
/begin GROUP S41_BMS_BattMaxWorkTemp_P "swc_COL/COL_1000ms_sys/COL_1000ms_sys/BMS_BattMaxWorkTemp_P" /begin REF_CHARACTERISTIC BMS_BattMaxWorkTemp_P /end REF_CHARACTERISTIC /end GROUP
/begin GROUP S41_BMS_BattMinTemp1_P "swc_COL/COL_1000ms_sys/COL_1000ms_sys/BMS_BattMinTemp1_P" /begin REF_CHARACTERISTIC BMS_BattMinTemp1_P /end REF_CHARACTERISTIC /end GROUP
/begin GROUP S41_BMS_BattMinWorkTemp_P "swc_COL/COL_1000ms_sys/COL_1000ms_sys/BMS_BattMinWorkTemp_P" /begin REF_CHARACTERISTIC BMS_BattMinWorkTemp_P /end REF_CHARACTERISTIC /end GROUP
/begin GROUP S41_BMS_BattTotalChgEny_P "swc_COL/COL_1000ms_sys/COL_1000ms_sys/BMS_BattTotalChgEny_P" /begin REF_CHARACTERISTIC BMS_BattTotalChgEny_P /end REF_CHARACTERISTIC /end GROUP
/begin GROUP S41_BMS_BattTotalDischgEny_P "swc_COL/COL_1000ms_sys/COL_1000ms_sys/BMS_BattTotalDischgEny_P" /begin REF_CHARACTERISTIC BMS_BattTotalDischgEny_P /end REF_CHARACTERISTIC /end GROUP
/begin GROUP S41_BMS_Cell_Avg_Temp_P "swc_COL/COL_1000ms_sys/COL_1000ms_sys/BMS_Cell_Avg_Temp_P" /begin REF_CHARACTERISTIC BMS_Cell_Avg_Temp_P /end REF_CHARACTERISTIC /end GROUP
/begin GROUP S41_BMS_ChgCount_P "swc_COL/COL_1000ms_sys/COL_1000ms_sys/BMS_ChgCount_P" /begin REF_CHARACTERISTIC BMS_ChgCount_P /end REF_CHARACTERISTIC /end GROUP
/begin GROUP S41_BMS_ChgTimeRemain_P "swc_COL/COL_1000ms_sys/COL_1000ms_sys/BMS_ChgTimeRemain_P" /begin REF_CHARACTERISTIC BMS_ChgTimeRemain_P /end REF_CHARACTERISTIC /end GROUP
/begin GROUP S41_BMS_DCChgNegTemp_P "swc_COL/COL_1000ms_sys/COL_1000ms_sys/BMS_DCChgNegTemp_P" /begin REF_CHARACTERISTIC BMS_DCChgNegTemp_P /end REF_CHARACTERISTIC /end GROUP
/begin GROUP S41_BMS_DCChgPosTemp_P "swc_COL/COL_1000ms_sys/COL_1000ms_sys/BMS_DCChgPosTemp_P" /begin REF_CHARACTERISTIC BMS_DCChgPosTemp_P /end REF_CHARACTERISTIC /end GROUP
/begin GROUP S41_BMS_IC_Temp_P "swc_COL/COL_1000ms_sys/COL_1000ms_sys/BMS_IC_Temp_P" /begin REF_CHARACTERISTIC BMS_IC_Temp_P /end REF_CHARACTERISTIC /end GROUP
/begin GROUP S41_BMS_MaxCellVolt_P "swc_COL/COL_1000ms_sys/COL_1000ms_sys/BMS_MaxCellVolt_P" /begin REF_CHARACTERISTIC BMS_MaxCellVolt_P /end REF_CHARACTERISTIC /end GROUP
/begin GROUP S41_BMS_MaxPmtDischgCurr_P "swc_COL/COL_1000ms_sys/COL_1000ms_sys/BMS_MaxPmtDischgCurr_P" /begin REF_CHARACTERISTIC BMS_MaxPmtDischgCurr_P /end REF_CHARACTERISTIC /end GROUP
/begin GROUP S41_BMS_MaxPmtEnyRecoCurr_P "swc_COL/COL_1000ms_sys/COL_1000ms_sys/BMS_MaxPmtEnyRecoCurr_P" /begin REF_CHARACTERISTIC BMS_MaxPmtEnyRecoCurr_P /end REF_CHARACTERISTIC /end GROUP
/begin GROUP S41_BMS_MaxPmtEnyRecoVol_P "swc_COL/COL_1000ms_sys/COL_1000ms_sys/BMS_MaxPmtEnyRecoVol_P" /begin REF_CHARACTERISTIC BMS_MaxPmtEnyRecoVol_P /end REF_CHARACTERISTIC /end GROUP
/begin GROUP S41_BMS_MaxTemp1PackNum_P "swc_COL/COL_1000ms_sys/COL_1000ms_sys/BMS_MaxTemp1PackNum_P" /begin REF_CHARACTERISTIC BMS_MaxTemp1PackNum_P /end REF_CHARACTERISTIC /end GROUP
/begin GROUP S41_BMS_MaxTemp1SnsNum_P "swc_COL/COL_1000ms_sys/COL_1000ms_sys/BMS_MaxTemp1SnsNum_P" /begin REF_CHARACTERISTIC BMS_MaxTemp1SnsNum_P /end REF_CHARACTERISTIC /end GROUP
/begin GROUP S41_BMS_MaxVoltCellNum_P "swc_COL/COL_1000ms_sys/COL_1000ms_sys/BMS_MaxVoltCellNum_P" /begin REF_CHARACTERISTIC BMS_MaxVoltCellNum_P /end REF_CHARACTERISTIC /end GROUP
/begin GROUP S41_BMS_MaxVoltCellPackNum_P "swc_COL/COL_1000ms_sys/COL_1000ms_sys/BMS_MaxVoltCellPackNum_P" /begin REF_CHARACTERISTIC BMS_MaxVoltCellPackNum_P /end REF_CHARACTERISTIC /end GROUP
/begin GROUP S41_BMS_MinCellVolt_P "swc_COL/COL_1000ms_sys/COL_1000ms_sys/BMS_MinCellVolt_P" /begin REF_CHARACTERISTIC BMS_MinCellVolt_P /end REF_CHARACTERISTIC /end GROUP
/begin GROUP S41_BMS_MinPmtSOC_P "swc_COL/COL_1000ms_sys/COL_1000ms_sys/BMS_MinPmtSOC_P" /begin REF_CHARACTERISTIC BMS_MinPmtSOC_P /end REF_CHARACTERISTIC /end GROUP
/begin GROUP S41_BMS_MinTemp1PackNum_P "swc_COL/COL_1000ms_sys/COL_1000ms_sys/BMS_MinTemp1PackNum_P" /begin REF_CHARACTERISTIC BMS_MinTemp1PackNum_P /end REF_CHARACTERISTIC /end GROUP
/begin GROUP S41_BMS_MinTemp1SnsNum_P "swc_COL/COL_1000ms_sys/COL_1000ms_sys/BMS_MinTemp1SnsNum_P" /begin REF_CHARACTERISTIC BMS_MinTemp1SnsNum_P /end REF_CHARACTERISTIC /end GROUP
/begin GROUP S41_BMS_MinVoltCellNum_P "swc_COL/COL_1000ms_sys/COL_1000ms_sys/BMS_MinVoltCellNum_P" /begin REF_CHARACTERISTIC BMS_MinVoltCellNum_P /end REF_CHARACTERISTIC /end GROUP
/begin GROUP S41_BMS_MinVoltCellPackNum_P "swc_COL/COL_1000ms_sys/COL_1000ms_sys/BMS_MinVoltCellPackNum_P" /begin REF_CHARACTERISTIC BMS_MinVoltCellPackNum_P /end REF_CHARACTERISTIC /end GROUP
/begin GROUP S41_BMS_SingleDisChgEny_P "swc_COL/COL_1000ms_sys/COL_1000ms_sys/BMS_SingleDisChgEny_P" /begin REF_CHARACTERISTIC BMS_SingleDisChgEny_P /end REF_CHARACTERISTIC /end GROUP
/begin GROUP S41_BSTC_TiRtcWUpNxt_P "swc_BcuStTranCtl/BcuStTranCtl_sys/BcuStTranCtl/SetWakeUpTime/BSTC_TiRtcWUpNxt_P" /begin REF_CHARACTERISTIC BSTC_TiRtcWUpNxt_P /end REF_CHARACTERISTIC /end GROUP
/begin GROUP S41_DTRC_Csw_P_1 "swc_COL/COL_1000ms_sys/COL_1000ms_sys/DTRC_Csw_P.1" /begin REF_CHARACTERISTIC COL_Csw6_P /end REF_CHARACTERISTIC /end GROUP
/begin GROUP S41_DTRC_Csw_P_103 "swc_COL/COL_1000ms_sys/COL_1000ms_sys/DTRC_Csw_P.103" /begin REF_CHARACTERISTIC COL_Csw6_P /end REF_CHARACTERISTIC /end GROUP
/begin GROUP S41_DTRC_Csw_P_110 "swc_COL/COL_1000ms_sys/COL_1000ms_sys/DTRC_Csw_P.110" /begin REF_CHARACTERISTIC COL_Csw6_P /end REF_CHARACTERISTIC /end GROUP
/begin GROUP S41_DTRC_Csw_P_14 "swc_COL/COL_1000ms_sys/COL_1000ms_sys/DTRC_Csw_P.14" /begin REF_CHARACTERISTIC COL_Csw6_P /end REF_CHARACTERISTIC /end GROUP
/begin GROUP S41_DTRC_Csw_P_15 "swc_COL/COL_1000ms_sys/COL_1000ms_sys/DTRC_Csw_P.15" /begin REF_CHARACTERISTIC COL_Csw6_P /end REF_CHARACTERISTIC /end GROUP
/begin GROUP S41_DTRC_Csw_P_16 "swc_COL/COL_1000ms_sys/COL_1000ms_sys/DTRC_Csw_P.16" /begin REF_CHARACTERISTIC COL_Csw6_P /end REF_CHARACTERISTIC /end GROUP
/begin GROUP S41_DTRC_Csw_P_17 "swc_COL/COL_1000ms_sys/COL_1000ms_sys/DTRC_Csw_P.17" /begin REF_CHARACTERISTIC COL_Csw6_P /end REF_CHARACTERISTIC /end GROUP
/begin GROUP S41_DTRC_Csw_P_18 "swc_COL/COL_1000ms_sys/COL_1000ms_sys/DTRC_Csw_P.18" /begin REF_CHARACTERISTIC COL_Csw6_P /end REF_CHARACTERISTIC /end GROUP
/begin GROUP S41_DTRC_Csw_P_19 "swc_COL/COL_1000ms_sys/COL_1000ms_sys/DTRC_Csw_P.19" /begin REF_CHARACTERISTIC COL_Csw6_P /end REF_CHARACTERISTIC /end GROUP
/begin GROUP S41_DTRC_Csw_P_2 "swc_COL/COL_1000ms_sys/COL_1000ms_sys/DTRC_Csw_P.2" /begin REF_CHARACTERISTIC COL_Csw6_P /end REF_CHARACTERISTIC /end GROUP
/begin GROUP S41_DTRC_Csw_P_20 "swc_COL/COL_1000ms_sys/COL_1000ms_sys/DTRC_Csw_P.20" /begin REF_CHARACTERISTIC COL_Csw6_P /end REF_CHARACTERISTIC /end GROUP
/begin GROUP S41_DTRC_Csw_P_21 "swc_COL/COL_1000ms_sys/COL_1000ms_sys/DTRC_Csw_P.21" /begin REF_CHARACTERISTIC COL_Csw6_P /end REF_CHARACTERISTIC /end GROUP
/begin GROUP S41_DTRC_Csw_P_22 "swc_COL/COL_1000ms_sys/COL_1000ms_sys/DTRC_Csw_P.22" /begin REF_CHARACTERISTIC COL_Csw6_P /end REF_CHARACTERISTIC /end GROUP
/begin GROUP S41_DTRC_Csw_P_24 "swc_COL/COL_1000ms_sys/COL_1000ms_sys/DTRC_Csw_P.24" /begin REF_CHARACTERISTIC COL_Csw6_P /end REF_CHARACTERISTIC /end GROUP
/begin GROUP S41_DTRC_Csw_P_25 "swc_COL/COL_1000ms_sys/COL_1000ms_sys/DTRC_Csw_P.25" /begin REF_CHARACTERISTIC COL_Csw6_P /end REF_CHARACTERISTIC /end GROUP
/begin GROUP S41_DTRC_Csw_P_26 "swc_COL/COL_1000ms_sys/COL_1000ms_sys/DTRC_Csw_P.26" /begin REF_CHARACTERISTIC COL_Csw6_P /end REF_CHARACTERISTIC /end GROUP
/begin GROUP S41_DTRC_Csw_P_27 "swc_COL/COL_1000ms_sys/COL_1000ms_sys/DTRC_Csw_P.27" /begin REF_CHARACTERISTIC COL_Csw6_P /end REF_CHARACTERISTIC /end GROUP
/begin GROUP S41_DTRC_Csw_P_29 "swc_COL/COL_1000ms_sys/COL_1000ms_sys/DTRC_Csw_P.29" /begin REF_CHARACTERISTIC COL_Csw6_P /end REF_CHARACTERISTIC /end GROUP
/begin GROUP S41_DTRC_Csw_P_30 "swc_COL/COL_1000ms_sys/COL_1000ms_sys/DTRC_Csw_P.30" /begin REF_CHARACTERISTIC COL_Csw6_P /end REF_CHARACTERISTIC /end GROUP
/begin GROUP S41_DTRC_Csw_P_31 "swc_COL/COL_1000ms_sys/COL_1000ms_sys/DTRC_Csw_P.31" /begin REF_CHARACTERISTIC COL_Csw6_P /end REF_CHARACTERISTIC /end GROUP
/begin GROUP S41_DTRC_Csw_P_34 "swc_COL/COL_1000ms_sys/COL_1000ms_sys/DTRC_Csw_P.34" /begin REF_CHARACTERISTIC COL_Csw6_P /end REF_CHARACTERISTIC /end GROUP
/begin GROUP S41_DTRC_Csw_P_46 "swc_COL/COL_1000ms_sys/COL_1000ms_sys/DTRC_Csw_P.46" /begin REF_CHARACTERISTIC COL_Csw6_P /end REF_CHARACTERISTIC /end GROUP
/begin GROUP S41_DTRC_Csw_P_47 "swc_COL/COL_1000ms_sys/COL_1000ms_sys/DTRC_Csw_P.47" /begin REF_CHARACTERISTIC COL_Csw6_P /end REF_CHARACTERISTIC /end GROUP
/begin GROUP S41_DTRC_Csw_P_48 "swc_COL/COL_1000ms_sys/COL_1000ms_sys/DTRC_Csw_P.48" /begin REF_CHARACTERISTIC COL_Csw6_P /end REF_CHARACTERISTIC /end GROUP
/begin GROUP S41_DTRC_Csw_P_57 "swc_COL/COL_1000ms_sys/COL_1000ms_sys/DTRC_Csw_P.57" /begin REF_CHARACTERISTIC COL_Csw6_P /end REF_CHARACTERISTIC /end GROUP
/begin GROUP S41_DTRC_Csw_P_58 "swc_COL/COL_1000ms_sys/COL_1000ms_sys/DTRC_Csw_P.58" /begin REF_CHARACTERISTIC COL_Csw6_P /end REF_CHARACTERISTIC /end GROUP
/begin GROUP S41_DTRC_Csw_P_77 "swc_COL/COL_1000ms_sys/COL_1000ms_sys/DTRC_Csw_P.77" /begin REF_CHARACTERISTIC COL_Csw6_P /end REF_CHARACTERISTIC /end GROUP
/begin GROUP S41_DTRC_Csw_P_98 "swc_COL/COL_1000ms_sys/COL_1000ms_sys/DTRC_Csw_P.98" /begin REF_CHARACTERISTIC COL_Csw6_P /end REF_CHARACTERISTIC /end GROUP
/begin GROUP S41_MeasCorrn "swc_BatThermHndlgMngt/BTHM_100ms_sys/100ms/DataPrep/DataCnvnMdulCtrl/MeasCorrn"
 /begin SUB_GROUP S103_BTHM_bEnaMdulSnsrCorrnT_P S103_Filter S103_MeasCorrnSnsrSeln /end SUB_GROUP
/end GROUP
/begin GROUP S428_BCF_bAcvObsr_P "swc_BatCoreFct/BCF_100ms_sys/BatCoreFct/PackObs/PackObsLoop/MdulObs/MdulSocObsr/MdulStateObs/Correction of State Estimation/BCF_bAcvObsr_P" /begin REF_CHARACTERISTIC BCF_bAcvObsr_P /end REF_CHARACTERISTIC /end GROUP
/begin GROUP S428_BCF_IDlcMeanHiLim_P "swc_BatCoreFct/BCF_100ms_sys/BatCoreFct/PackObs/PackObsLoop/MdulObs/MdulSocObsr/MdulStateObs/Correction of State Estimation/BCF_IDlcMeanHiLim_P" /begin REF_CHARACTERISTIC BCF_IDlcMeanHiLim_P /end REF_CHARACTERISTIC /end GROUP
/begin GROUP S428_BCF_IDlcMeanLoLim_P "swc_BatCoreFct/BCF_100ms_sys/BatCoreFct/PackObs/PackObsLoop/MdulObs/MdulSocObsr/MdulStateObs/Correction of State Estimation/BCF_IDlcMeanLoLim_P" /begin REF_CHARACTERISTIC BCF_IDlcMeanLoLim_P /end REF_CHARACTERISTIC /end GROUP
/begin GROUP S428_BCF_IWbz1MeanHiLim_P "swc_BatCoreFct/BCF_100ms_sys/BatCoreFct/PackObs/PackObsLoop/MdulObs/MdulSocObsr/MdulStateObs/Correction of State Estimation/BCF_IWbz1MeanHiLim_P" /begin REF_CHARACTERISTIC BCF_IWbz1MeanHiLim_P /end REF_CHARACTERISTIC /end GROUP
/begin GROUP S428_BCF_IWbz1MeanLoLim_P "swc_BatCoreFct/BCF_100ms_sys/BatCoreFct/PackObs/PackObsLoop/MdulObs/MdulSocObsr/MdulStateObs/Correction of State Estimation/BCF_IWbz1MeanLoLim_P" /begin REF_CHARACTERISTIC BCF_IWbz1MeanLoLim_P /end REF_CHARACTERISTIC /end GROUP
/begin GROUP S428_BCF_IWbz2MeanHiLim_P "swc_BatCoreFct/BCF_100ms_sys/BatCoreFct/PackObs/PackObsLoop/MdulObs/MdulSocObsr/MdulStateObs/Correction of State Estimation/BCF_IWbz2MeanHiLim_P" /begin REF_CHARACTERISTIC BCF_IWbz2MeanHiLim_P /end REF_CHARACTERISTIC /end GROUP
/begin GROUP S428_BCF_IWbz2MeanLoLim_P "swc_BatCoreFct/BCF_100ms_sys/BatCoreFct/PackObs/PackObsLoop/MdulObs/MdulSocObsr/MdulStateObs/Correction of State Estimation/BCF_IWbz2MeanLoLim_P" /begin REF_CHARACTERISTIC BCF_IWbz2MeanLoLim_P /end REF_CHARACTERISTIC /end GROUP
/begin GROUP S428_BCF_SocMeanHiLim_P "swc_BatCoreFct/BCF_100ms_sys/BatCoreFct/PackObs/PackObsLoop/MdulObs/MdulSocObsr/MdulStateObs/Correction of State Estimation/BCF_SocMeanHiLim_P" /begin REF_CHARACTERISTIC BCF_SocMeanHiLim_P /end REF_CHARACTERISTIC /end GROUP
/begin GROUP S428_BCF_SocMeanLoLim_P "swc_BatCoreFct/BCF_100ms_sys/BatCoreFct/PackObs/PackObsLoop/MdulObs/MdulSocObsr/MdulStateObs/Correction of State Estimation/BCF_SocMeanLoLim_P" /begin REF_CHARACTERISTIC BCF_SocMeanLoLim_P /end REF_CHARACTERISTIC /end GROUP
/begin GROUP S429_BCF_IThdForMdlVld_P "swc_BatCoreFct/BCF_100ms_sys/BatCoreFct/PackObs/PackObsLoop/MdulObs/MdulSocObsr/MdulStateObs/Determine Observer Gain/BCF_IThdForMdlVld_P" /begin REF_CHARACTERISTIC BCF_IThdForMdlVld_P /end REF_CHARACTERISTIC /end GROUP
/begin GROUP S429_BCF_ObsrgnAr1_P "swc_BatCoreFct/BCF_100ms_sys/BatCoreFct/PackObs/PackObsLoop/MdulObs/MdulSocObsr/MdulStateObs/Determine Observer Gain/BCF_ObsrgnAr1_P" /begin REF_CHARACTERISTIC BCF_ObsrgnAr1_P /end REF_CHARACTERISTIC /end GROUP
/begin GROUP S429_BCF_ObsrgnAr2_P "swc_BatCoreFct/BCF_100ms_sys/BatCoreFct/PackObs/PackObsLoop/MdulObs/MdulSocObsr/MdulStateObs/Determine Observer Gain/BCF_ObsrgnAr2_P" /begin REF_CHARACTERISTIC BCF_ObsrgnAr2_P /end REF_CHARACTERISTIC /end GROUP
/begin GROUP S429_BCF_ObsrgnLo_P "swc_BatCoreFct/BCF_100ms_sys/BatCoreFct/PackObs/PackObsLoop/MdulObs/MdulSocObsr/MdulStateObs/Determine Observer Gain/BCF_ObsrgnLo_P" /begin REF_CHARACTERISTIC BCF_ObsrgnLo_P /end REF_CHARACTERISTIC /end GROUP
/begin GROUP S429_BCF_SocLowrLimForObsrgn_P "swc_BatCoreFct/BCF_100ms_sys/BatCoreFct/PackObs/PackObsLoop/MdulObs/MdulSocObsr/MdulStateObs/Determine Observer Gain/BCF_SocLowrLimForObsrgn_P" /begin REF_CHARACTERISTIC BCF_SocLowrLimForObsrgn_P /end REF_CHARACTERISTIC /end GROUP
/begin GROUP S429_BCF_SocUpprLimForObsrgn_P "swc_BatCoreFct/BCF_100ms_sys/BatCoreFct/PackObs/PackObsLoop/MdulObs/MdulSocObsr/MdulStateObs/Determine Observer Gain/BCF_SocUpprLimForObsrgn_P" /begin REF_CHARACTERISTIC BCF_SocUpprLimForObsrgn_P /end REF_CHARACTERISTIC /end GROUP
/begin GROUP S429_BCF_TLowrLimForAgiFacUpd_P "swc_BatCoreFct/BCF_100ms_sys/BatCoreFct/PackObs/PackObsLoop/MdulObs/MdulSocObsr/MdulStateObs/Determine Observer Gain/BCF_TLowrLimForAgiFacUpd_P" /begin REF_CHARACTERISTIC BCF_TLowrLimForAgiFacUpd_P /end REF_CHARACTERISTIC /end GROUP
/begin GROUP S42_BitSelect16 "swc_BatThermHndlgMngt/BTHM_100ms_sys/100ms/DataPrep/Diagnosis/BitSelect16" /begin REF_CHARACTERISTIC BTHM_CswReplDig_P /end REF_CHARACTERISTIC /end GROUP
/begin GROUP S42_BitSelect17 "swc_BatThermHndlgMngt/BTHM_100ms_sys/100ms/DataPrep/Diagnosis/BitSelect17" /begin REF_CHARACTERISTIC BTHM_ValReplDig_P /end REF_CHARACTERISTIC /end GROUP
/begin GROUP S42_BitSelect18 "swc_BatThermHndlgMngt/BTHM_100ms_sys/100ms/DataPrep/Diagnosis/BitSelect18" /begin REF_CHARACTERISTIC BTHM_CswReplDig_P /end REF_CHARACTERISTIC /end GROUP
/begin GROUP S42_BitSelect19 "swc_BatThermHndlgMngt/BTHM_100ms_sys/100ms/DataPrep/Diagnosis/BitSelect19" /begin REF_CHARACTERISTIC BTHM_ValReplDig_P /end REF_CHARACTERISTIC /end GROUP
/begin GROUP S42_BitSelect20 "swc_BatThermHndlgMngt/BTHM_100ms_sys/100ms/DataPrep/Diagnosis/BitSelect20" /begin REF_CHARACTERISTIC BTHM_CswReplDig_P /end REF_CHARACTERISTIC /end GROUP
/begin GROUP S42_BitSelect21 "swc_BatThermHndlgMngt/BTHM_100ms_sys/100ms/DataPrep/Diagnosis/BitSelect21" /begin REF_CHARACTERISTIC BTHM_ValReplDig_P /end REF_CHARACTERISTIC /end GROUP
/begin GROUP S42_BitSelect22 "swc_BatThermHndlgMngt/BTHM_100ms_sys/100ms/DataPrep/Diagnosis/BitSelect22" /begin REF_CHARACTERISTIC BTHM_CswReplDig_P /end REF_CHARACTERISTIC /end GROUP
/begin GROUP S42_BitSelect23 "swc_BatThermHndlgMngt/BTHM_100ms_sys/100ms/DataPrep/Diagnosis/BitSelect23" /begin REF_CHARACTERISTIC BTHM_ValReplDig_P /end REF_CHARACTERISTIC /end GROUP
/begin GROUP S42_BitSelect24 "swc_BatThermHndlgMngt/BTHM_100ms_sys/100ms/DataPrep/Diagnosis/BitSelect24" /begin REF_CHARACTERISTIC BTHM_CswReplDig_P /end REF_CHARACTERISTIC /end GROUP
/begin GROUP S42_BitSelect25 "swc_BatThermHndlgMngt/BTHM_100ms_sys/100ms/DataPrep/Diagnosis/BitSelect25" /begin REF_CHARACTERISTIC BTHM_ValReplDig_P /end REF_CHARACTERISTIC /end GROUP
/begin GROUP S42_BitSelect26 "swc_BatThermHndlgMngt/BTHM_100ms_sys/100ms/DataPrep/Diagnosis/BitSelect26" /begin REF_CHARACTERISTIC BTHM_CswReplDig_P /end REF_CHARACTERISTIC /end GROUP
/begin GROUP S42_BitSelect27 "swc_BatThermHndlgMngt/BTHM_100ms_sys/100ms/DataPrep/Diagnosis/BitSelect27" /begin REF_CHARACTERISTIC BTHM_ValReplDig_P /end REF_CHARACTERISTIC /end GROUP
/begin GROUP S42_BitSelect28 "swc_BatThermHndlgMngt/BTHM_100ms_sys/100ms/DataPrep/Diagnosis/BitSelect28" /begin REF_CHARACTERISTIC BTHM_CswReplDig_P /end REF_CHARACTERISTIC /end GROUP
/begin GROUP S42_BitSelect29 "swc_BatThermHndlgMngt/BTHM_100ms_sys/100ms/DataPrep/Diagnosis/BitSelect29" /begin REF_CHARACTERISTIC BTHM_ValReplDig_P /end REF_CHARACTERISTIC /end GROUP
/begin GROUP S42_BitSelect30 "swc_BatThermHndlgMngt/BTHM_100ms_sys/100ms/DataPrep/Diagnosis/BitSelect30" /begin REF_CHARACTERISTIC BTHM_CswReplDig_P /end REF_CHARACTERISTIC /end GROUP
/begin GROUP S42_BitSelect31 "swc_BatThermHndlgMngt/BTHM_100ms_sys/100ms/DataPrep/Diagnosis/BitSelect31" /begin REF_CHARACTERISTIC BTHM_ValReplDig_P /end REF_CHARACTERISTIC /end GROUP
/begin GROUP S42_BitSelect32 "swc_BatThermHndlgMngt/BTHM_100ms_sys/100ms/DataPrep/Diagnosis/BitSelect32" /begin REF_CHARACTERISTIC BTHM_CswReplDig_P /end REF_CHARACTERISTIC /end GROUP
/begin GROUP S42_BitSelect33 "swc_BatThermHndlgMngt/BTHM_100ms_sys/100ms/DataPrep/Diagnosis/BitSelect33" /begin REF_CHARACTERISTIC BTHM_ValReplDig_P /end REF_CHARACTERISTIC /end GROUP
/begin GROUP S42_BitSelect34 "swc_BatThermHndlgMngt/BTHM_100ms_sys/100ms/DataPrep/Diagnosis/BitSelect34" /begin REF_CHARACTERISTIC BTHM_CswReplDig_P /end REF_CHARACTERISTIC /end GROUP
/begin GROUP S42_BitSelect35 "swc_BatThermHndlgMngt/BTHM_100ms_sys/100ms/DataPrep/Diagnosis/BitSelect35" /begin REF_CHARACTERISTIC BTHM_ValReplDig_P /end REF_CHARACTERISTIC /end GROUP
/begin GROUP S42_BitSelect36 "swc_BatThermHndlgMngt/BTHM_100ms_sys/100ms/DataPrep/Diagnosis/BitSelect36" /begin REF_CHARACTERISTIC BTHM_CswReplDig_P /end REF_CHARACTERISTIC /end GROUP
/begin GROUP S42_BitSelect37 "swc_BatThermHndlgMngt/BTHM_100ms_sys/100ms/DataPrep/Diagnosis/BitSelect37" /begin REF_CHARACTERISTIC BTHM_ValReplDig_P /end REF_CHARACTERISTIC /end GROUP
/begin GROUP S42_BitSelect38 "swc_BatThermHndlgMngt/BTHM_100ms_sys/100ms/DataPrep/Diagnosis/BitSelect38" /begin REF_CHARACTERISTIC BTHM_CswReplDig_P /end REF_CHARACTERISTIC /end GROUP
/begin GROUP S42_BitSelect39 "swc_BatThermHndlgMngt/BTHM_100ms_sys/100ms/DataPrep/Diagnosis/BitSelect39" /begin REF_CHARACTERISTIC BTHM_ValReplDig_P /end REF_CHARACTERISTIC /end GROUP
/begin GROUP S42_BitSelect40 "swc_BatThermHndlgMngt/BTHM_100ms_sys/100ms/DataPrep/Diagnosis/BitSelect40" /begin REF_CHARACTERISTIC BTHM_CswReplDig_P /end REF_CHARACTERISTIC /end GROUP
/begin GROUP S42_BitSelect41 "swc_BatThermHndlgMngt/BTHM_100ms_sys/100ms/DataPrep/Diagnosis/BitSelect41" /begin REF_CHARACTERISTIC BTHM_ValReplDig_P /end REF_CHARACTERISTIC /end GROUP
/begin GROUP S42_BitSelect42 "swc_BatThermHndlgMngt/BTHM_100ms_sys/100ms/DataPrep/Diagnosis/BitSelect42" /begin REF_CHARACTERISTIC BTHM_CswReplDig_P /end REF_CHARACTERISTIC /end GROUP
/begin GROUP S42_BitSelect43 "swc_BatThermHndlgMngt/BTHM_100ms_sys/100ms/DataPrep/Diagnosis/BitSelect43" /begin REF_CHARACTERISTIC BTHM_ValReplDig_P /end REF_CHARACTERISTIC /end GROUP
/begin GROUP S42_BitSelect44 "swc_BatThermHndlgMngt/BTHM_100ms_sys/100ms/DataPrep/Diagnosis/BitSelect44" /begin REF_CHARACTERISTIC BTHM_CswReplDig_P /end REF_CHARACTERISTIC /end GROUP
/begin GROUP S42_BitSelect45 "swc_BatThermHndlgMngt/BTHM_100ms_sys/100ms/DataPrep/Diagnosis/BitSelect45" /begin REF_CHARACTERISTIC BTHM_ValReplDig_P /end REF_CHARACTERISTIC /end GROUP
/begin GROUP S42_BitSelect46 "swc_BatThermHndlgMngt/BTHM_100ms_sys/100ms/DataPrep/Diagnosis/BitSelect46" /begin REF_CHARACTERISTIC BTHM_CswReplDig_P /end REF_CHARACTERISTIC /end GROUP
/begin GROUP S42_BitSelect47 "swc_BatThermHndlgMngt/BTHM_100ms_sys/100ms/DataPrep/Diagnosis/BitSelect47" /begin REF_CHARACTERISTIC BTHM_ValReplDig_P /end REF_CHARACTERISTIC /end GROUP
/begin GROUP S42_BSTC_TiBswStore_P "swc_BcuStTranCtl/BcuStTranCtl_sys/BcuStTranCtl/Time/BSTC_TiBswStore_P" /begin REF_CHARACTERISTIC BSTC_TiBswStore_P /end REF_CHARACTERISTIC /end GROUP
/begin GROUP S42_BSTC_TiChkDeb_P "swc_BcuStTranCtl/BcuStTranCtl_sys/BcuStTranCtl/Time/BSTC_TiChkDeb_P" /begin REF_CHARACTERISTIC BSTC_TiChkDeb_P /end REF_CHARACTERISTIC /end GROUP
/begin GROUP S42_BSTC_TiVcuShtdn_P "swc_BcuStTranCtl/BcuStTranCtl_sys/BcuStTranCtl/Time/BSTC_TiVcuShtdn_P" /begin REF_CHARACTERISTIC BSTC_TiVcuShtdn_P /end REF_CHARACTERISTIC /end GROUP
/begin GROUP S42_BSTC_TiWaitChk_P "swc_BcuStTranCtl/BcuStTranCtl_sys/BcuStTranCtl/Time/BSTC_TiWaitChk_P" /begin REF_CHARACTERISTIC BSTC_TiWaitChk_P /end REF_CHARACTERISTIC /end GROUP
/begin GROUP S42_BTHM_ModeSelnOfPackTDif_P "swc_BatThermHndlgMngt/BTHM_100ms_sys/100ms/DataPrep/Diagnosis/BTHM_ModeSelnOfPackTDif_P" /begin REF_CHARACTERISTIC BTHM_ModeSelnOfPackTDif_P /end REF_CHARACTERISTIC /end GROUP
/begin GROUP S42_BTHM_ModeSelnOfPackTDif_P1 "swc_BatThermHndlgMngt/BTHM_100ms_sys/100ms/DataPrep/Diagnosis/BTHM_ModeSelnOfPackTDif_P1" /begin REF_CHARACTERISTIC BTHM_ModeSelnOfPackTDif_P /end REF_CHARACTERISTIC /end GROUP
/begin GROUP S42_BTHM_TiAFEOffDig_P "swc_BatThermHndlgMngt/BTHM_100ms_sys/100ms/DataPrep/Diagnosis/BTHM_TiAFEOffDig_P" /begin REF_CHARACTERISTIC BTHM_TiAFEOffDig_P /end REF_CHARACTERISTIC /end GROUP
/begin GROUP S42_BTHM_TiAFEOnDig_P "swc_BatThermHndlgMngt/BTHM_100ms_sys/100ms/DataPrep/Diagnosis/BTHM_TiAFEOnDig_P" /begin REF_CHARACTERISTIC BTHM_TiAFEOnDig_P /end REF_CHARACTERISTIC /end GROUP
/begin GROUP S42_BTHM_TiOffDig1091_P "swc_BatThermHndlgMngt/BTHM_100ms_sys/100ms/DataPrep/Diagnosis/BTHM_TiOffDig1091_P" /begin REF_CHARACTERISTIC BTHM_TiOffDig1091_P /end REF_CHARACTERISTIC /end GROUP
/begin GROUP S42_BTHM_TiOffDig1092_P "swc_BatThermHndlgMngt/BTHM_100ms_sys/100ms/DataPrep/Diagnosis/BTHM_TiOffDig1092_P" /begin REF_CHARACTERISTIC BTHM_TiOffDig1092_P /end REF_CHARACTERISTIC /end GROUP
/begin GROUP S42_BTHM_TiOffDig1093_P "swc_BatThermHndlgMngt/BTHM_100ms_sys/100ms/DataPrep/Diagnosis/BTHM_TiOffDig1093_P" /begin REF_CHARACTERISTIC BTHM_TiOffDig1093_P /end REF_CHARACTERISTIC /end GROUP
/begin GROUP S42_BTHM_TiOffDig1094_P "swc_BatThermHndlgMngt/BTHM_100ms_sys/100ms/DataPrep/Diagnosis/BTHM_TiOffDig1094_P" /begin REF_CHARACTERISTIC BTHM_TiOffDig1094_P /end REF_CHARACTERISTIC /end GROUP
/begin GROUP S42_BTHM_TiOffDig177_P "swc_BatThermHndlgMngt/BTHM_100ms_sys/100ms/DataPrep/Diagnosis/BTHM_TiOffDig177_P" /begin REF_CHARACTERISTIC BTHM_TiOffDig177_P /end REF_CHARACTERISTIC /end GROUP
/begin GROUP S42_BTHM_TiOffDig198_P "swc_BatThermHndlgMngt/BTHM_100ms_sys/100ms/DataPrep/Diagnosis/BTHM_TiOffDig198_P" /begin REF_CHARACTERISTIC BTHM_TiOffDig198_P /end REF_CHARACTERISTIC /end GROUP
/begin GROUP S42_BTHM_TiOffDig232_P "swc_BatThermHndlgMngt/BTHM_100ms_sys/100ms/DataPrep/Diagnosis/BTHM_TiOffDig232_P" /begin REF_CHARACTERISTIC BTHM_TiOffDig232_P /end REF_CHARACTERISTIC /end GROUP
/begin GROUP S42_BTHM_TiOffDig233_P "swc_BatThermHndlgMngt/BTHM_100ms_sys/100ms/DataPrep/Diagnosis/BTHM_TiOffDig233_P" /begin REF_CHARACTERISTIC BTHM_TiOffDig233_P /end REF_CHARACTERISTIC /end GROUP
/begin GROUP S42_BTHM_TiOffDig234_P "swc_BatThermHndlgMngt/BTHM_100ms_sys/100ms/DataPrep/Diagnosis/BTHM_TiOffDig234_P" /begin REF_CHARACTERISTIC BTHM_TiOffDig234_P /end REF_CHARACTERISTIC /end GROUP
/begin GROUP S42_BTHM_TiOffDig236_P "swc_BatThermHndlgMngt/BTHM_100ms_sys/100ms/DataPrep/Diagnosis/BTHM_TiOffDig236_P" /begin REF_CHARACTERISTIC BTHM_TiOffDig236_P /end REF_CHARACTERISTIC /end GROUP
/begin GROUP S42_BTHM_TiOffDig64_P "swc_BatThermHndlgMngt/BTHM_100ms_sys/100ms/DataPrep/Diagnosis/BTHM_TiOffDig64_P" /begin REF_CHARACTERISTIC BTHM_TiOffDig64_P /end REF_CHARACTERISTIC /end GROUP
/begin GROUP S42_BTHM_TiOffOverLoDig_P "swc_BatThermHndlgMngt/BTHM_100ms_sys/100ms/DataPrep/Diagnosis/BTHM_TiOffOverLoDig_P" /begin REF_CHARACTERISTIC BTHM_TiOffOverLoDig_P /end REF_CHARACTERISTIC /end GROUP
/begin GROUP S42_BTHM_TiOffOverUpDig_P "swc_BatThermHndlgMngt/BTHM_100ms_sys/100ms/DataPrep/Diagnosis/BTHM_TiOffOverUpDig_P" /begin REF_CHARACTERISTIC BTHM_TiOffOverUpDig_P /end REF_CHARACTERISTIC /end GROUP
/begin GROUP S42_BTHM_TiOnDig1091_P "swc_BatThermHndlgMngt/BTHM_100ms_sys/100ms/DataPrep/Diagnosis/BTHM_TiOnDig1091_P" /begin REF_CHARACTERISTIC BTHM_TiOnDig1091_P /end REF_CHARACTERISTIC /end GROUP
/begin GROUP S42_BTHM_TiOnDig1092_P "swc_BatThermHndlgMngt/BTHM_100ms_sys/100ms/DataPrep/Diagnosis/BTHM_TiOnDig1092_P" /begin REF_CHARACTERISTIC BTHM_TiOnDig1092_P /end REF_CHARACTERISTIC /end GROUP
/begin GROUP S42_BTHM_TiOnDig1093_P "swc_BatThermHndlgMngt/BTHM_100ms_sys/100ms/DataPrep/Diagnosis/BTHM_TiOnDig1093_P" /begin REF_CHARACTERISTIC BTHM_TiOnDig1093_P /end REF_CHARACTERISTIC /end GROUP
/begin GROUP S42_BTHM_TiOnDig1094_P "swc_BatThermHndlgMngt/BTHM_100ms_sys/100ms/DataPrep/Diagnosis/BTHM_TiOnDig1094_P" /begin REF_CHARACTERISTIC BTHM_TiOnDig1094_P /end REF_CHARACTERISTIC /end GROUP
/begin GROUP S42_BTHM_TiOnDig177_P "swc_BatThermHndlgMngt/BTHM_100ms_sys/100ms/DataPrep/Diagnosis/BTHM_TiOnDig177_P" /begin REF_CHARACTERISTIC BTHM_TiOnDig177_P /end REF_CHARACTERISTIC /end GROUP
/begin GROUP S42_BTHM_TiOnDig198_P "swc_BatThermHndlgMngt/BTHM_100ms_sys/100ms/DataPrep/Diagnosis/BTHM_TiOnDig198_P" /begin REF_CHARACTERISTIC BTHM_TiOnDig198_P /end REF_CHARACTERISTIC /end GROUP
/begin GROUP S42_BTHM_TiOnDig232_P "swc_BatThermHndlgMngt/BTHM_100ms_sys/100ms/DataPrep/Diagnosis/BTHM_TiOnDig232_P" /begin REF_CHARACTERISTIC BTHM_TiOnDig232_P /end REF_CHARACTERISTIC /end GROUP
/begin GROUP S42_BTHM_TiOnDig233_P "swc_BatThermHndlgMngt/BTHM_100ms_sys/100ms/DataPrep/Diagnosis/BTHM_TiOnDig233_P" /begin REF_CHARACTERISTIC BTHM_TiOnDig233_P /end REF_CHARACTERISTIC /end GROUP
/begin GROUP S42_BTHM_TiOnDig234_P "swc_BatThermHndlgMngt/BTHM_100ms_sys/100ms/DataPrep/Diagnosis/BTHM_TiOnDig234_P" /begin REF_CHARACTERISTIC BTHM_TiOnDig234_P /end REF_CHARACTERISTIC /end GROUP
/begin GROUP S42_BTHM_TiOnDig236_P "swc_BatThermHndlgMngt/BTHM_100ms_sys/100ms/DataPrep/Diagnosis/BTHM_TiOnDig236_P" /begin REF_CHARACTERISTIC BTHM_TiOnDig236_P /end REF_CHARACTERISTIC /end GROUP
/begin GROUP S42_BTHM_TiOnDig64_P "swc_BatThermHndlgMngt/BTHM_100ms_sys/100ms/DataPrep/Diagnosis/BTHM_TiOnDig64_P" /begin REF_CHARACTERISTIC BTHM_TiOnDig64_P /end REF_CHARACTERISTIC /end GROUP
/begin GROUP S42_BTHM_TiOnOverLoDig_P "swc_BatThermHndlgMngt/BTHM_100ms_sys/100ms/DataPrep/Diagnosis/BTHM_TiOnOverLoDig_P" /begin REF_CHARACTERISTIC BTHM_TiOnOverLoDig_P /end REF_CHARACTERISTIC /end GROUP
/begin GROUP S42_BTHM_TiOnOverUpDig_P "swc_BatThermHndlgMngt/BTHM_100ms_sys/100ms/DataPrep/Diagnosis/BTHM_TiOnOverUpDig_P" /begin REF_CHARACTERISTIC BTHM_TiOnOverUpDig_P /end REF_CHARACTERISTIC /end GROUP
/begin GROUP S42_BTHM_TiShnt1OffDig_P "swc_BatThermHndlgMngt/BTHM_100ms_sys/100ms/DataPrep/Diagnosis/BTHM_TiShnt1OffDig_P" /begin REF_CHARACTERISTIC BTHM_TiShnt1OffDig_P /end REF_CHARACTERISTIC /end GROUP
/begin GROUP S42_BTHM_TiShnt1OnDig_P "swc_BatThermHndlgMngt/BTHM_100ms_sys/100ms/DataPrep/Diagnosis/BTHM_TiShnt1OnDig_P" /begin REF_CHARACTERISTIC BTHM_TiShnt1OnDig_P /end REF_CHARACTERISTIC /end GROUP
/begin GROUP S42_BTHM_TiShnt2OffDig_P "swc_BatThermHndlgMngt/BTHM_100ms_sys/100ms/DataPrep/Diagnosis/BTHM_TiShnt2OffDig_P" /begin REF_CHARACTERISTIC BTHM_TiShnt2OffDig_P /end REF_CHARACTERISTIC /end GROUP
/begin GROUP S42_BTHM_TiShnt2OnDig_P "swc_BatThermHndlgMngt/BTHM_100ms_sys/100ms/DataPrep/Diagnosis/BTHM_TiShnt2OnDig_P" /begin REF_CHARACTERISTIC BTHM_TiShnt2OnDig_P /end REF_CHARACTERISTIC /end GROUP
/begin GROUP S42_BTHM_ValOnDig234_P "swc_BatThermHndlgMngt/BTHM_100ms_sys/100ms/DataPrep/Diagnosis/BTHM_ValOnDig234_P" /begin REF_CHARACTERISTIC BTHM_ValOnDig234_P /end REF_CHARACTERISTIC /end GROUP
/begin GROUP S42_BTHM_ValOnDig236_P "swc_BatThermHndlgMngt/BTHM_100ms_sys/100ms/DataPrep/Diagnosis/BTHM_ValOnDig236_P" /begin REF_CHARACTERISTIC BTHM_ValOnDig236_P /end REF_CHARACTERISTIC /end GROUP
/begin GROUP S42_CompareToCalibrationPara "swc_BatThermHndlgMngt/BTHM_100ms_sys/100ms/DataPrep/Diagnosis/CompareToCalibrationPara" /begin REF_CHARACTERISTIC BTHM_TDig232_P /end REF_CHARACTERISTIC /end GROUP
/begin GROUP S42_CompareToCalibrationPara1 "swc_BatThermHndlgMngt/BTHM_100ms_sys/100ms/DataPrep/Diagnosis/CompareToCalibrationPara1" /begin REF_CHARACTERISTIC BTHM_TDig233_P /end REF_CHARACTERISTIC /end GROUP
/begin GROUP S42_CompareToCalibrationPara10 "swc_BatThermHndlgMngt/BTHM_100ms_sys/100ms/DataPrep/Diagnosis/CompareToCalibrationPara10" /begin REF_CHARACTERISTIC BTHM_TShnt2SetDig_P /end REF_CHARACTERISTIC /end GROUP
/begin GROUP S42_CompareToCalibrationPara11 "swc_BatThermHndlgMngt/BTHM_100ms_sys/100ms/DataPrep/Diagnosis/CompareToCalibrationPara11" /begin REF_CHARACTERISTIC BTHM_TShnt2RstDig_P /end REF_CHARACTERISTIC /end GROUP
/begin GROUP S42_CompareToCalibrationPara12 "swc_BatThermHndlgMngt/BTHM_100ms_sys/100ms/DataPrep/Diagnosis/CompareToCalibrationPara12" /begin REF_CHARACTERISTIC BTHM_TSetOverLo_P /end REF_CHARACTERISTIC /end GROUP
/begin GROUP S42_CompareToCalibrationPara13 "swc_BatThermHndlgMngt/BTHM_100ms_sys/100ms/DataPrep/Diagnosis/CompareToCalibrationPara13" /begin REF_CHARACTERISTIC BTHM_TSetOverUp_P /end REF_CHARACTERISTIC /end GROUP
/begin GROUP S42_CompareToCalibrationPara14 "swc_BatThermHndlgMngt/BTHM_100ms_sys/100ms/DataPrep/Diagnosis/CompareToCalibrationPara14" /begin REF_CHARACTERISTIC BTHM_TSetOverUp_P /end REF_CHARACTERISTIC /end GROUP
/begin GROUP S42_CompareToCalibrationPara15 "swc_BatThermHndlgMngt/BTHM_100ms_sys/100ms/DataPrep/Diagnosis/CompareToCalibrationPara15" /begin REF_CHARACTERISTIC BTHM_TSetOverLo_P /end REF_CHARACTERISTIC /end GROUP
/begin GROUP S42_CompareToCalibrationPara2 "swc_BatThermHndlgMngt/BTHM_100ms_sys/100ms/DataPrep/Diagnosis/CompareToCalibrationPara2" /begin REF_CHARACTERISTIC BTHM_TSetDig177_P /end REF_CHARACTERISTIC /end GROUP
/begin GROUP S42_CompareToCalibrationPara3 "swc_BatThermHndlgMngt/BTHM_100ms_sys/100ms/DataPrep/Diagnosis/CompareToCalibrationPara3" /begin REF_CHARACTERISTIC BTHM_TRstDig177_P /end REF_CHARACTERISTIC /end GROUP
/begin GROUP S42_CompareToCalibrationPara4 "swc_BatThermHndlgMngt/BTHM_100ms_sys/100ms/DataPrep/Diagnosis/CompareToCalibrationPara4" /begin REF_CHARACTERISTIC BTHM_TSetDig64Max_P /end REF_CHARACTERISTIC /end GROUP
/begin GROUP S42_CompareToCalibrationPara5 "swc_BatThermHndlgMngt/BTHM_100ms_sys/100ms/DataPrep/Diagnosis/CompareToCalibrationPara5" /begin REF_CHARACTERISTIC BTHM_TSetDig64_P /end REF_CHARACTERISTIC /end GROUP
/begin GROUP S42_CompareToCalibrationPara6 "swc_BatThermHndlgMngt/BTHM_100ms_sys/100ms/DataPrep/Diagnosis/CompareToCalibrationPara6" /begin REF_CHARACTERISTIC BTHM_TAFESetDig_P /end REF_CHARACTERISTIC /end GROUP
/begin GROUP S42_CompareToCalibrationPara7 "swc_BatThermHndlgMngt/BTHM_100ms_sys/100ms/DataPrep/Diagnosis/CompareToCalibrationPara7" /begin REF_CHARACTERISTIC BTHM_TAFERstDig_P /end REF_CHARACTERISTIC /end GROUP
/begin GROUP S42_CompareToCalibrationPara8 "swc_BatThermHndlgMngt/BTHM_100ms_sys/100ms/DataPrep/Diagnosis/CompareToCalibrationPara8" /begin REF_CHARACTERISTIC BTHM_TShnt1SetDig_P /end REF_CHARACTERISTIC /end GROUP
/begin GROUP S42_CompareToCalibrationPara9 "swc_BatThermHndlgMngt/BTHM_100ms_sys/100ms/DataPrep/Diagnosis/CompareToCalibrationPara9" /begin REF_CHARACTERISTIC BTHM_TShnt1RstDig_P /end REF_CHARACTERISTIC /end GROUP
/begin GROUP S42_IntialCheck "swc_BatThermHndlgMngt/BTHM_100ms_sys/100ms/DataPrep/Diagnosis/IntialCheck"
 /begin SUB_GROUP S255_BitSelect5 S255_BTHM_TiOffDig641_P S255_BTHM_TiOnDig641_P S255_BTHM_TiTask100Ms_P5 /end SUB_GROUP
/end GROUP
/begin GROUP S430__Process_Equation__ffun "swc_BatCoreFct/BCF_100ms_sys/BatCoreFct/PackObs/PackObsLoop/MdulObs/MdulSocObsr/MdulStateObs/MdulModel/ Process Equation, ffun"
 /begin SUB_GROUP S448_BCF_BvTc_M S448_BCF_CCellNom_M S448_BCF_Td_P S448_BCF_WbzTc_M S448_BCF_WbzTcFac_P S448_SimpleFilterState1 S448_SimpleFilterState2 S448_SimpleFilterState3 /end SUB_GROUP
/end GROUP
/begin GROUP S430_Measurement_Equation_hfun "swc_BatCoreFct/BCF_100ms_sys/BatCoreFct/PackObs/PackObsLoop/MdulObs/MdulSocObsr/MdulStateObs/MdulModel/Measurement Equation hfun"
 /begin SUB_GROUP S449_BCF_RBv_M S449_BCF_RMdulCnct_P S449_BCF_UChOc_M S449_BCF_UDchaOc_M S449_BCF_Wbz_M S449_BCF_WbzFac_P /end SUB_GROUP
 /begin REF_CHARACTERISTIC BCF_IRAc_A BCF_RAc_M BCF_SocRAc_A /end REF_CHARACTERISTIC
/end GROUP
/begin GROUP S448_BCF_BvTc_M "swc_BatCoreFct/BCF_100ms_sys/BatCoreFct/PackObs/PackObsLoop/MdulObs/MdulSocObsr/MdulStateObs/MdulModel/ Process Equation, ffun/BCF_BvTc_M" /begin REF_CHARACTERISTIC BCF_BvTc_M /end REF_CHARACTERISTIC /end GROUP
/begin GROUP S448_BCF_WbzTc_M "swc_BatCoreFct/BCF_100ms_sys/BatCoreFct/PackObs/PackObsLoop/MdulObs/MdulSocObsr/MdulStateObs/MdulModel/ Process Equation, ffun/BCF_WbzTc_M" /begin REF_CHARACTERISTIC BCF_WbzTc_M /end REF_CHARACTERISTIC /end GROUP
/begin GROUP S448_BCF_WbzTcFac_P "swc_BatCoreFct/BCF_100ms_sys/BatCoreFct/PackObs/PackObsLoop/MdulObs/MdulSocObsr/MdulStateObs/MdulModel/ Process Equation, ffun/BCF_WbzTcFac_P" /begin REF_CHARACTERISTIC BCF_WbzTcFac_P /end REF_CHARACTERISTIC /end GROUP
/begin GROUP S448_SimpleFilterState1 "swc_BatCoreFct/BCF_100ms_sys/BatCoreFct/PackObs/PackObsLoop/MdulObs/MdulSocObsr/MdulStateObs/MdulModel/ Process Equation, ffun/SimpleFilterState1" /begin SUB_GROUP S456_BCF_Td_P /end SUB_GROUP /end GROUP
/begin GROUP S448_SimpleFilterState2 "swc_BatCoreFct/BCF_100ms_sys/BatCoreFct/PackObs/PackObsLoop/MdulObs/MdulSocObsr/MdulStateObs/MdulModel/ Process Equation, ffun/SimpleFilterState2" /begin SUB_GROUP S457_BCF_Td_P /end SUB_GROUP /end GROUP
/begin GROUP S448_SimpleFilterState3 "swc_BatCoreFct/BCF_100ms_sys/BatCoreFct/PackObs/PackObsLoop/MdulObs/MdulSocObsr/MdulStateObs/MdulModel/ Process Equation, ffun/SimpleFilterState3" /begin SUB_GROUP S458_BCF_Td_P /end SUB_GROUP /end GROUP
/begin GROUP S449_BCF_RBv_M "swc_BatCoreFct/BCF_100ms_sys/BatCoreFct/PackObs/PackObsLoop/MdulObs/MdulSocObsr/MdulStateObs/MdulModel/Measurement Equation hfun/BCF_RBv_M" /begin REF_CHARACTERISTIC BCF_RBv_M /end REF_CHARACTERISTIC /end GROUP
/begin GROUP S449_BCF_RMdulCnct_P "swc_BatCoreFct/BCF_100ms_sys/BatCoreFct/PackObs/PackObsLoop/MdulObs/MdulSocObsr/MdulStateObs/MdulModel/Measurement Equation hfun/BCF_RMdulCnct_P" /begin REF_CHARACTERISTIC BCF_RMdulCnct_P /end REF_CHARACTERISTIC /end GROUP
/begin GROUP S526_RPack_Calculation "swc_BatCoreFct/BCF_100ms_sys/BatCoreFct/PackStateClcn/PackSofClcn/RPack Calculation" /begin REF_CHARACTERISTIC BCF_IRAc_A BCF_RAc_M BCF_SocRAc_A /end REF_CHARACTERISTIC /end GROUP
/begin GROUP S542_BCF_RBv_M "swc_BatCoreFct/BCF_100ms_sys/BatCoreFct/PackStateClcn/PackSofClcn/RPack Calculation/BCF_RBv_M" /begin REF_CHARACTERISTIC BCF_RBv_M /end REF_CHARACTERISTIC /end GROUP
/begin GROUP S542_BCF_RMdulCnct_P "swc_BatCoreFct/BCF_100ms_sys/BatCoreFct/PackStateClcn/PackSofClcn/RPack Calculation/BCF_RMdulCnct_P" /begin REF_CHARACTERISTIC BCF_RMdulCnct_P /end REF_CHARACTERISTIC /end GROUP
/begin GROUP S612_Measurement_Equation_hfun "swc_BatCoreFct/BCF_100ms_sys/BatCoreFct/PackStateClcn/PackSofClcn/Pack Min Max Current Calculation (PwrLoss & U)/Pred Worst Cell Voltages and Power Losses/Predict average cell voltages/Predict Average Cell Voltages/Measurement Equation hfun" /begin REF_CHARACTERISTIC BCF_IRAc_A BCF_RAc_M BCF_SocRAc_A /end REF_CHARACTERISTIC /end GROUP
/begin GROUP S621_BCF_WbzTc_M "swc_BatCoreFct/BCF_100ms_sys/BatCoreFct/PackStateClcn/PackSofClcn/Pack Min Max Current Calculation (PwrLoss & U)/Pred Worst Cell Voltages and Power Losses/Predict average cell voltages/Predict Average Cell Voltages/ Process Equation, ffun/BCF_WbzTc_M" /begin REF_CHARACTERISTIC BCF_WbzTc_M /end REF_CHARACTERISTIC /end GROUP
/begin GROUP S622_BCF_RBv_M "swc_BatCoreFct/BCF_100ms_sys/BatCoreFct/PackStateClcn/PackSofClcn/Pack Min Max Current Calculation (PwrLoss & U)/Pred Worst Cell Voltages and Power Losses/Predict average cell voltages/Predict Average Cell Voltages/Measurement Equation hfun/BCF_RBv_M" /begin REF_CHARACTERISTIC BCF_RBv_M /end REF_CHARACTERISTIC /end GROUP
/begin GROUP S622_BCF_RMdulCnct_P "swc_BatCoreFct/BCF_100ms_sys/BatCoreFct/PackStateClcn/PackSofClcn/Pack Min Max Current Calculation (PwrLoss & U)/Pred Worst Cell Voltages and Power Losses/Predict average cell voltages/Predict Average Cell Voltages/Measurement Equation hfun/BCF_RMdulCnct_" /begin REF_CHARACTERISTIC BCF_RMdulCnct_P /end REF_CHARACTERISTIC /end GROUP
/begin GROUP S692_Measurement_Equation_hfun "swc_BatCoreFct/BCF_100ms_sys/BatCoreFct/PackStateClcn/PackSofClcn/Pack Min Max Voltage Prediction/Module Min Max Voltage Prediction/SOF Actual/Measurement Equation hfun" /begin REF_CHARACTERISTIC BCF_IRAc_A BCF_RAc_M BCF_SocRAc_A /end REF_CHARACTERISTIC /end GROUP
/begin GROUP S693_Measurement_Equation_hfun "swc_BatCoreFct/BCF_100ms_sys/BatCoreFct/PackStateClcn/PackSofClcn/Pack Min Max Voltage Prediction/Module Min Max Voltage Prediction/SOF Pred/Measurement Equation hfun" /begin REF_CHARACTERISTIC BCF_IRAc_A BCF_RAc_M BCF_SocRAc_A /end REF_CHARACTERISTIC /end GROUP
/begin GROUP S700_BCF_WbzTc_M "swc_BatCoreFct/BCF_100ms_sys/BatCoreFct/PackStateClcn/PackSofClcn/Pack Min Max Voltage Prediction/Module Min Max Voltage Prediction/SOF Actual/ Process Equation, ffun/BCF_WbzTc_M" /begin REF_CHARACTERISTIC BCF_WbzTc_M /end REF_CHARACTERISTIC /end GROUP
/begin GROUP S701_BCF_RBv_M "swc_BatCoreFct/BCF_100ms_sys/BatCoreFct/PackStateClcn/PackSofClcn/Pack Min Max Voltage Prediction/Module Min Max Voltage Prediction/SOF Actual/Measurement Equation hfun/BCF_RBv_M" /begin REF_CHARACTERISTIC BCF_RBv_M /end REF_CHARACTERISTIC /end GROUP
/begin GROUP S701_BCF_RMdulCnct_P "swc_BatCoreFct/BCF_100ms_sys/BatCoreFct/PackStateClcn/PackSofClcn/Pack Min Max Voltage Prediction/Module Min Max Voltage Prediction/SOF Actual/Measurement Equation hfun/BCF_RMdulCnct_P" /begin REF_CHARACTERISTIC BCF_RMdulCnct_P /end REF_CHARACTERISTIC /end GROUP
/begin GROUP S717_BCF_WbzTc_M "swc_BatCoreFct/BCF_100ms_sys/BatCoreFct/PackStateClcn/PackSofClcn/Pack Min Max Voltage Prediction/Module Min Max Voltage Prediction/SOF Pred/ Process Equation, ffun/BCF_WbzTc_M" /begin REF_CHARACTERISTIC BCF_WbzTc_M /end REF_CHARACTERISTIC /end GROUP
/begin GROUP S718_BCF_RBv_M "swc_BatCoreFct/BCF_100ms_sys/BatCoreFct/PackStateClcn/PackSofClcn/Pack Min Max Voltage Prediction/Module Min Max Voltage Prediction/SOF Pred/Measurement Equation hfun/BCF_RBv_M" /begin REF_CHARACTERISTIC BCF_RBv_M /end REF_CHARACTERISTIC /end GROUP
/begin GROUP S718_BCF_RMdulCnct_P "swc_BatCoreFct/BCF_100ms_sys/BatCoreFct/PackStateClcn/PackSofClcn/Pack Min Max Voltage Prediction/Module Min Max Voltage Prediction/SOF Pred/Measurement Equation hfun/BCF_RMdulCnct_P" /begin REF_CHARACTERISTIC BCF_RMdulCnct_P /end REF_CHARACTERISTIC /end GROUP
/begin GROUP S74_BitSelect22 "swc_BatThermHndlgMngt/BTHM_100ms_sys/100ms/DataPrep/DataClcn/TPackDif/BitSelect22" /begin REF_CHARACTERISTIC BTHM_CswReplDig_P /end REF_CHARACTERISTIC /end GROUP
/begin GROUP S74_BitSelect23 "swc_BatThermHndlgMngt/BTHM_100ms_sys/100ms/DataPrep/DataClcn/TPackDif/BitSelect23" /begin REF_CHARACTERISTIC BTHM_ValReplDig_P /end REF_CHARACTERISTIC /end GROUP
/begin GROUP S74_BTHM_ModeSelnOfPackTDif_P "swc_BatThermHndlgMngt/BTHM_100ms_sys/100ms/DataPrep/DataClcn/TPackDif/BTHM_ModeSelnOfPackTDif_P" /begin REF_CHARACTERISTIC BTHM_ModeSelnOfPackTDif_P /end REF_CHARACTERISTIC /end GROUP
/begin RECORD_LAYOUT Lookup1D_FLOAT32_IEEE FNC_VALUES 1 FLOAT32_IEEE COLUMN_DIR DIRECT /end RECORD_LAYOUT
/begin RECORD_LAYOUT Lookup1D_UBYTE FNC_VALUES 1 UBYTE COLUMN_DIR DIRECT /end RECORD_LAYOUT
/begin RECORD_LAYOUT Lookup1D_X_FLOAT32_IEEE AXIS_PTS_X 1 FLOAT32_IEEE INDEX_INCR DIRECT /end RECORD_LAYOUT
/begin RECORD_LAYOUT Lookup1D_X_UBYTE AXIS_PTS_X 1 UBYTE INDEX_INCR DIRECT /end RECORD_LAYOUT
/begin RECORD_LAYOUT Lookup1D_X_ULONG AXIS_PTS_X 1 ULONG INDEX_INCR DIRECT /end RECORD_LAYOUT
/begin RECORD_LAYOUT Lookup2D_FLOAT32_IEEE FNC_VALUES 1 FLOAT32_IEEE COLUMN_DIR DIRECT /end RECORD_LAYOUT
/begin RECORD_LAYOUT Lookup2D_X_FLOAT32_IEEE AXIS_PTS_X 1 FLOAT32_IEEE INDEX_INCR DIRECT /end RECORD_LAYOUT
/begin RECORD_LAYOUT Lookup2D_X_UWORD AXIS_PTS_X 1 UWORD INDEX_INCR DIRECT /end RECORD_LAYOUT
/begin RECORD_LAYOUT Lookup2D_X_WORD AXIS_PTS_X 1 SWORD INDEX_INCR DIRECT /end RECORD_LAYOUT
/begin RECORD_LAYOUT Scalar_BOOLEAN FNC_VALUES 1 UBYTE COLUMN_DIR DIRECT /end RECORD_LAYOUT
/begin RECORD_LAYOUT Scalar_FLOAT32_IEEE FNC_VALUES 1 FLOAT32_IEEE COLUMN_DIR DIRECT /end RECORD_LAYOUT
/begin RECORD_LAYOUT Scalar_FLOAT64_IEEE FNC_VALUES 1 FLOAT64_IEEE COLUMN_DIR DIRECT /end RECORD_LAYOUT
/begin RECORD_LAYOUT Scalar_SWORD FNC_VALUES 1 SWORD COLUMN_DIR DIRECT /end RECORD_LAYOUT
/begin RECORD_LAYOUT Scalar_UBYTE FNC_VALUES 1 UBYTE COLUMN_DIR DIRECT /end RECORD_LAYOUT
/begin RECORD_LAYOUT Scalar_ULONG FNC_VALUES 1 ULONG COLUMN_DIR DIRECT /end RECORD_LAYOUT
/begin RECORD_LAYOUT Scalar_UWORD FNC_VALUES 1 UWORD COLUMN_DIR DIRECT /end RECORD_LAYOUT
/begin RECORD_LAYOUT __UBYTE_Z FNC_VALUES 1 UBYTE ROW_DIR DIRECT /end RECORD_LAYOUT
/begin RECORD_LAYOUT __UWORD_Z FNC_VALUES 1 UWORD ROW_DIR DIRECT /end RECORD_LAYOUT
/begin RECORD_LAYOUT __ULONG_Z FNC_VALUES 1 ULONG ROW_DIR DIRECT /end RECORD_LAYOUT
/begin RECORD_LAYOUT __SBYTE_Z FNC_VALUES 1 SBYTE ROW_DIR DIRECT /end RECORD_LAYOUT
/begin RECORD_LAYOUT __SWORD_Z FNC_VALUES 1 SWORD ROW_DIR DIRECT /end RECORD_LAYOUT
/begin RECORD_LAYOUT __SLONG_Z FNC_VALUES 1 SLONG ROW_DIR DIRECT /end RECORD_LAYOUT
/end MODULE
/end PROJECT
