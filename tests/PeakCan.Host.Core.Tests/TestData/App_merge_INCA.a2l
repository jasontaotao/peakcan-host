ASAP2_VERSION 1 40
/begin PROJECT ProjectName "Project Comment Goes Here"
/begin HEADER "Header Comments go here" /end HEADER
/begin MODULE ModuleName "Module Comment Goes Here"
/begin MOD_COMMON "Mod Common Comment Here" BYTE_ORDER MSB_LAST ALIGNMENT_BYTE 1 ALIGNMENT_WORD 1 ALIGNMENT_LONG 1 ALIGNMENT_FLOAT32_IEEE 1 ALIGNMENT_FLOAT64_IEEE 1 /end MOD_COMMON
/begin COMPU_METHOD swc_BatBalnCtl_CM_single_dash_ "Q = V" RAT_FUNC "%8.6" "-" COEFFS 0 1 0 0 0 1 /end COMPU_METHOD
/begin COMPU_METHOD swc_BatChCtl_CM_boolean_s "Q = V" RAT_FUNC "%1.0" "s" COEFFS 0 1 0 0 0 1 /end COMPU_METHOD
/begin COMPU_METHOD swc_BatChCtl_CM_single__ "Q = V" RAT_FUNC "%8.6" "癈" COEFFS 0 1 0 0 0 1 /end COMPU_METHOD
/begin COMPU_METHOD swc_BatChCtl_CM_single_dash_ "Q = V" RAT_FUNC "%8.6" "-" COEFFS 0 1 0 0 0 1 /end COMPU_METHOD
/begin COMPU_METHOD swc_BatChCtl_CM_single_s "Q = V" RAT_FUNC "%8.6" "s" COEFFS 0 1 0 0 0 1 /end COMPU_METHOD
/begin COMPU_METHOD swc_BatChCtl_CM_uint8_dash_ "Q = V" RAT_FUNC "%3.0" "-" COEFFS 0 1 0 0 0 1 /end COMPU_METHOD
/begin COMPU_METHOD swc_BatCoreFct_CM_single_dash_ "Q = V" RAT_FUNC "%8.6" "-" COEFFS 0 1 0 0 0 1 /end COMPU_METHOD
/begin COMPU_METHOD swc_BatCoreFct_CM_single_s "Q = V" RAT_FUNC "%8.6" "s" COEFFS 0 1 0 0 0 1 /end COMPU_METHOD
/begin COMPU_METHOD swc_BatCoreFct_CM_single_V "Q = V" RAT_FUNC "%8.6" "V" COEFFS 0 1 0 0 0 1 /end COMPU_METHOD
/begin COMPU_METHOD swc_BatCoreFct_CM_uint16_dash_ "Q = V" RAT_FUNC "%5.0" "-" COEFFS 0 1 0 0 0 1 /end COMPU_METHOD
/begin COMPU_METHOD swc_BatCoreFct_CM_uint32_s "Q = V" RAT_FUNC "%10.0" "s" COEFFS 0 1 0 0 0 1 /end COMPU_METHOD
/begin COMPU_METHOD swc_BatProtnIU_CM_single_s "Q = V" RAT_FUNC "%8.6" "s" COEFFS 0 1 0 0 0 1 /end COMPU_METHOD
/begin COMPU_METHOD swc_BatProtnIU_CM_single_V "Q = V" RAT_FUNC "%8.6" "V" COEFFS 0 1 0 0 0 1 /end COMPU_METHOD
/begin COMPU_METHOD swc_BatThermHndlgMngt_CM_single__ "Q = V" RAT_FUNC "%8.6" "癈" COEFFS 0 1 0 0 0 1 /end COMPU_METHOD
/begin COMPU_METHOD swc_BatThermHndlgMngt_CM_single_dash_ "Q = V" RAT_FUNC "%8.6" "-" COEFFS 0 1 0 0 0 1 /end COMPU_METHOD
/begin COMPU_METHOD swc_BatThermHndlgMngt_CM_uint32_dash_ "Q = V" RAT_FUNC "%10.0" "-" COEFFS 0 1 0 0 0 1 /end COMPU_METHOD
/begin COMPU_METHOD swc_BatThermHndlgMngt_CM_uint8_dash_ "Q = V" RAT_FUNC "%3.0" "-" COEFFS 0 1 0 0 0 1 /end COMPU_METHOD
/begin COMPU_METHOD swc_BatWntyLogtcData_CM_boolean_dash_ "Q = V" RAT_FUNC "%1.0" "-" COEFFS 0 1 0 0 0 1 /end COMPU_METHOD
/begin COMPU_METHOD swc_CIL_CM_boolean_dash_ "Q = V" RAT_FUNC "%1.0" "-" COEFFS 0 1 0 0 0 1 /end COMPU_METHOD
/begin COMPU_METHOD swc_CIL_CM_int16__ "Q = V" RAT_FUNC "%5.0" "癈" COEFFS 0 1 0 0 0 1 /end COMPU_METHOD
/begin COMPU_METHOD swc_CIL_CM_int32_kOhm "Q = V" RAT_FUNC "%10.0" "kOhm" COEFFS 0 1 0 0 0 1 /end COMPU_METHOD
/begin COMPU_METHOD swc_CIL_CM_single__ "Q = V" RAT_FUNC "%8.6" "癈" COEFFS 0 1 0 0 0 1 /end COMPU_METHOD
/begin COMPU_METHOD swc_CIL_CM_single_A "Q = V" RAT_FUNC "%8.6" "A" COEFFS 0 1 0 0 0 1 /end COMPU_METHOD
/begin COMPU_METHOD swc_CIL_CM_single_dash_ "Q = V" RAT_FUNC "%8.6" "-" COEFFS 0 1 0 0 0 1 /end COMPU_METHOD
/begin COMPU_METHOD swc_CIL_CM_single_km "Q = V" RAT_FUNC "%8.6" "km" COEFFS 0 1 0 0 0 1 /end COMPU_METHOD
/begin COMPU_METHOD swc_CIL_CM_single_km_per_h "Q = V" RAT_FUNC "%8.6" "km/h" COEFFS 0 1 0 0 0 1 /end COMPU_METHOD
/begin COMPU_METHOD swc_CIL_CM_single_Ohm "Q = V" RAT_FUNC "%8.6" "Ohm" COEFFS 0 1 0 0 0 1 /end COMPU_METHOD
/begin COMPU_METHOD swc_CIL_CM_single_rpm "Q = V" RAT_FUNC "%8.6" "rpm" COEFFS 0 1 0 0 0 1 /end COMPU_METHOD
/begin COMPU_METHOD swc_CIL_CM_single_s "Q = V" RAT_FUNC "%8.6" "s" COEFFS 0 1 0 0 0 1 /end COMPU_METHOD
/begin COMPU_METHOD swc_CIL_CM_single_V "Q = V" RAT_FUNC "%8.6" "V" COEFFS 0 1 0 0 0 1 /end COMPU_METHOD
/begin COMPU_METHOD swc_CIL_CM_uint16_dash_ "Q = V" RAT_FUNC "%5.0" "-" COEFFS 0 1 0 0 0 1 /end COMPU_METHOD
/begin COMPU_METHOD swc_CIL_CM_uint16_min "Q = V" RAT_FUNC "%5.0" "min" COEFFS 0 1 0 0 0 1 /end COMPU_METHOD
/begin COMPU_METHOD swc_CIL_CM_uint16_year "Q = V" RAT_FUNC "%5.0" "year" COEFFS 0 1 0 0 0 1 /end COMPU_METHOD
/begin COMPU_METHOD swc_CIL_CM_uint32_dash_ "Q = V" RAT_FUNC "%10.0" "-" COEFFS 0 1 0 0 0 1 /end COMPU_METHOD
/begin COMPU_METHOD swc_CIL_CM_uint32_Hz "Q = V" RAT_FUNC "%10.0" "Hz" COEFFS 0 1 0 0 0 1 /end COMPU_METHOD
/begin COMPU_METHOD swc_CIL_CM_uint32_ms "Q = V" RAT_FUNC "%10.0" "ms" COEFFS 0 1 0 0 0 1 /end COMPU_METHOD
/begin COMPU_METHOD swc_CIL_CM_uint32_percent_ "Q = V" RAT_FUNC "%10.0" "%" COEFFS 0 1 0 0 0 1 /end COMPU_METHOD
/begin COMPU_METHOD swc_CIL_CM_uint8_dash_ "Q = V" RAT_FUNC "%3.0" "-" COEFFS 0 1 0 0 0 1 /end COMPU_METHOD
/begin COMPU_METHOD swc_CIL_CM_uint8_h "Q = V" RAT_FUNC "%3.0" "h" COEFFS 0 1 0 0 0 1 /end COMPU_METHOD
/begin COMPU_METHOD swc_CIL_CM_uint8_min "Q = V" RAT_FUNC "%3.0" "min" COEFFS 0 1 0 0 0 1 /end COMPU_METHOD
/begin COMPU_METHOD swc_CIL_CM_uint8_s "Q = V" RAT_FUNC "%3.0" "s" COEFFS 0 1 0 0 0 1 /end COMPU_METHOD
/begin COMPU_METHOD swc_COL_CM_single___C "Q = V" RAT_FUNC "%8.6" "??C" COEFFS 0 1 0 0 0 1 /end COMPU_METHOD
/begin COMPU_METHOD swc_COL_CM_single_A "Q = V" RAT_FUNC "%8.6" "A" COEFFS 0 1 0 0 0 1 /end COMPU_METHOD
/begin COMPU_METHOD swc_COL_CM_single_min "Q = V" RAT_FUNC "%8.6" "min" COEFFS 0 1 0 0 0 1 /end COMPU_METHOD
/begin COMPU_METHOD swc_COL_CM_single_percent_ "Q = V" RAT_FUNC "%8.6" "%" COEFFS 0 1 0 0 0 1 /end COMPU_METHOD
/begin COMPU_METHOD swc_COL_CM_single_V "Q = V" RAT_FUNC "%8.6" "V" COEFFS 0 1 0 0 0 1 /end COMPU_METHOD
/begin COMPU_METHOD swc_COL_CM_uint16_dash_ "Q = V" RAT_FUNC "%5.0" "-" COEFFS 0 1 0 0 0 1 /end COMPU_METHOD
/begin COMPU_METHOD swc_COL_CM_uint16_kOhm "Q = V" RAT_FUNC "%5.0" "kOhm" COEFFS 0 1 0 0 0 1 /end COMPU_METHOD
/begin COMPU_METHOD swc_COL_CM_uint16_kWh "Q = V" RAT_FUNC "%5.0" "kWh" COEFFS 0 1 0 0 0 1 /end COMPU_METHOD
/begin COMPU_METHOD swc_COL_CM_uint16_percent_ "Q = V" RAT_FUNC "%5.0" "%" COEFFS 0 1 0 0 0 1 /end COMPU_METHOD
/begin COMPU_METHOD swc_COL_CM_uint32_dash_ "Q = V" RAT_FUNC "%10.0" "-" COEFFS 0 1 0 0 0 1 /end COMPU_METHOD
/begin COMPU_METHOD swc_COL_CM_uint8_dash_ "Q = V" RAT_FUNC "%3.0" "-" COEFFS 0 1 0 0 0 1 /end COMPU_METHOD
/begin COMPU_METHOD swc_EltlLnkHzrdProtnNet_CM_boolean_dash_ "Q = V" RAT_FUNC "%1.0" "-" COEFFS 0 1 0 0 0 1 /end COMPU_METHOD
/begin CHARACTERISTIC BBC_IdxMdulInCfg_P "The mapping between controller temperature sensors and modules" VAL_BLK 0x20017DD0 Scalar_FLOAT32_IEEE 0 swc_BatBalnCtl_CM_single_dash_ -3.40282346639e+038 3.40282346639e+038 MATRIX_DIM 576 1 1 /end CHARACTERISTIC
/begin CHARACTERISTIC BCC_TDcChrgrRstDig139_P "parameter for temperature of DC  charger" VALUE 0x2001671C Scalar_FLOAT32_IEEE 0 swc_BatChCtl_CM_single__ -3.40282346639e+038 3.40282346639e+038 /end CHARACTERISTIC
/begin CHARACTERISTIC BCC_TDcChrgrSetDig139_P "parameter for temperature of DC  charger" VALUE 0x20016720 Scalar_FLOAT32_IEEE 0 swc_BatChCtl_CM_single__ -3.40282346639e+038 3.40282346639e+038 /end CHARACTERISTIC
/begin CHARACTERISTIC BCC_TDcChrgrSetDig54_P "parameter for temperature of DC  charger" VALUE 0x20016724 Scalar_FLOAT32_IEEE 0 swc_BatChCtl_CM_single__ -3.40282346639e+038 3.40282346639e+038 /end CHARACTERISTIC
/begin CHARACTERISTIC BCC_TiOffDig139_P "turn off delay for diganosis 139" VALUE 0x20016748 Scalar_FLOAT32_IEEE 0 swc_BatChCtl_CM_single_s -3.40282346639e+038 3.40282346639e+038 /end CHARACTERISTIC
/begin CHARACTERISTIC BCC_TiOffDig249_P "turn off delay for diganosis 249" VALUE 0x2001674C Scalar_FLOAT32_IEEE 0 swc_BatChCtl_CM_single_s -3.40282346639e+038 3.40282346639e+038 /end CHARACTERISTIC
/begin CHARACTERISTIC BCC_TiOffDig33_P "turn off delay for diganosis 63" VALUE 0x20016750 Scalar_FLOAT32_IEEE 0 swc_BatChCtl_CM_single_s -3.40282346639e+038 3.40282346639e+038 /end CHARACTERISTIC
/begin CHARACTERISTIC BCC_TiOffDig54_P "turn off delay for diganosis 54" VALUE 0x20016758 Scalar_FLOAT32_IEEE 0 swc_BatChCtl_CM_single_s -3.40282346639e+038 3.40282346639e+038 /end CHARACTERISTIC
/begin CHARACTERISTIC BCC_TiOffDig55_P "turn off delay for diganosis 55" VALUE 0x2001675C Scalar_FLOAT32_IEEE 0 swc_BatChCtl_CM_single_s -3.40282346639e+038 3.40282346639e+038 /end CHARACTERISTIC
/begin CHARACTERISTIC BCC_TiOffDig69_P "turn off delay for diganosis 69" VALUE 0x20016760 Scalar_FLOAT32_IEEE 0 swc_BatChCtl_CM_single_s -3.40282346639e+038 3.40282346639e+038 /end CHARACTERISTIC
/begin CHARACTERISTIC BCC_TiOffDig72_P "turn off delay for diganosis 72" VALUE 0x20016768 Scalar_FLOAT32_IEEE 0 swc_BatChCtl_CM_single_s -3.40282346639e+038 3.40282346639e+038 /end CHARACTERISTIC
/begin CHARACTERISTIC BCC_TiOnDig139_P "turn on delay for diganosis 139" VALUE 0x20016774 Scalar_FLOAT32_IEEE 0 swc_BatChCtl_CM_single_s -3.40282346639e+038 3.40282346639e+038 /end CHARACTERISTIC
/begin CHARACTERISTIC BCC_TiOnDig249_P "turn on delay for diganosis 249" VALUE 0x20016778 Scalar_FLOAT32_IEEE 0 swc_BatChCtl_CM_single_s -3.40282346639e+038 3.40282346639e+038 /end CHARACTERISTIC
/begin CHARACTERISTIC BCC_TiOnDig33_P "turn on delay for diganosis 63" VALUE 0x2001677C Scalar_FLOAT32_IEEE 0 swc_BatChCtl_CM_single_s -3.40282346639e+038 3.40282346639e+038 /end CHARACTERISTIC
/begin CHARACTERISTIC BCC_TiOnDig54_P "turn on delay for diganosis 54" VALUE 0x20016784 Scalar_FLOAT32_IEEE 0 swc_BatChCtl_CM_single_s -3.40282346639e+038 3.40282346639e+038 /end CHARACTERISTIC
/begin CHARACTERISTIC BCC_TiOnDig55_P "turn on delay for diganosis 55" VALUE 0x20016788 Scalar_FLOAT32_IEEE 0 swc_BatChCtl_CM_single_s -3.40282346639e+038 3.40282346639e+038 /end CHARACTERISTIC
/begin CHARACTERISTIC BCC_TiOnDig69_P "turn on delay for diganosis 69" VALUE 0x2001678C Scalar_FLOAT32_IEEE 0 swc_BatChCtl_CM_single_s -3.40282346639e+038 3.40282346639e+038 /end CHARACTERISTIC
/begin CHARACTERISTIC BCC_TiOnDig72_P "turn on delay for diganosis 72" VALUE 0x20016794 Scalar_FLOAT32_IEEE 0 swc_BatChCtl_CM_single_s -3.40282346639e+038 3.40282346639e+038 /end CHARACTERISTIC
/begin CHARACTERISTIC BCC_UDcChrgrSetDig55Max_P "parameter for voltage of charger" VALUE 0x200167B0 Scalar_FLOAT32_IEEE 0 swc_BatChCtl_CM_single_dash_ -3.40282346639e+038 3.40282346639e+038 /end CHARACTERISTIC
/begin CHARACTERISTIC BCC_UDcChrgrSetDig55Min_P "parameter for voltage of charger" VALUE 0x200167B4 Scalar_FLOAT32_IEEE 0 swc_BatChCtl_CM_single_dash_ -3.40282346639e+038 3.40282346639e+038 /end CHARACTERISTIC
/begin CHARACTERISTIC BCC_ValDig33_P "parameter for diagnosis 33" VALUE 0x20019C3C Scalar_BOOLEAN 0 swc_BatChCtl_CM_boolean_s 0 1 /end CHARACTERISTIC
/begin CHARACTERISTIC BCF_CMdulAgiFacInvldErrMin_M "Error threshold when the signal is valid but outside the determined operating region" CURVE 0x1FFE7F50 Lookup1D_FLOAT32_IEEE 0 swc_BatCoreFct_CM_single_dash_ -3.40282346639e+038 3.40282346639e+038
 /begin AXIS_DESCR COM_AXIS NO_INPUT_QUANTITY swc_BatCoreFct_CM_uint32_s 5 0 4294967295 DEPOSIT ABSOLUTE AXIS_PTS_REF BCF_TiBatOffForAgiFac_A /end AXIS_DESCR
/end CHARACTERISTIC
/begin CHARACTERISTIC BCF_CMdulAgiFacLowrLim_P "Module Capacity Ageing Factor saturation lower limit" VALUE 0x1FFE7F64 Scalar_FLOAT32_IEEE 0 swc_BatCoreFct_CM_single_dash_ -3.40282346639e+038 3.40282346639e+038 /end CHARACTERISTIC
/begin CHARACTERISTIC BCF_CMdulAgiFacSatn_M "Saturation Curve of the CMdulDelta Ageing Factor Update Step based on stand-still time" CURVE 0x1FFE7F68 Lookup1D_FLOAT32_IEEE 0 swc_BatCoreFct_CM_single_dash_ -3.40282346639e+038 3.40282346639e+038
 /begin AXIS_DESCR COM_AXIS NO_INPUT_QUANTITY swc_BatCoreFct_CM_uint32_s 5 0 4294967295 DEPOSIT ABSOLUTE AXIS_PTS_REF BCF_TiBatOffForAgiFac_A /end AXIS_DESCR
/end CHARACTERISTIC
/begin CHARACTERISTIC BCF_CMdulAgiFacUpd_P "Step size for CMdul updates" VALUE 0x1FFE7F7C Scalar_FLOAT32_IEEE 0 swc_BatCoreFct_CM_single_dash_ -3.40282346639e+038 3.40282346639e+038 /end CHARACTERISTIC
/begin CHARACTERISTIC BCF_CMdulAgiFacUpprLim_P "Module Capacity Ageing Factor saturation upper limit" VALUE 0x1FFE7F80 Scalar_FLOAT32_IEEE 0 swc_BatCoreFct_CM_single_dash_ -3.40282346639e+038 3.40282346639e+038 /end CHARACTERISTIC
/begin CHARACTERISTIC BCF_CMdulAgiFacVldErrMin_M "Error threshold when the signal is valid and inside the determined operating region" CURVE 0x1FFE7F84 Lookup1D_FLOAT32_IEEE 0 swc_BatCoreFct_CM_single_dash_ -3.40282346639e+038 3.40282346639e+038
 /begin AXIS_DESCR COM_AXIS NO_INPUT_QUANTITY swc_BatCoreFct_CM_uint32_s 5 0 4294967295 DEPOSIT ABSOLUTE AXIS_PTS_REF BCF_TiBatOffForAgiFac_A /end AXIS_DESCR
/end CHARACTERISTIC
/begin CHARACTERISTIC BCF_CMdulDeltaUpprLimOfTrip_P "Upper limit to saturate Mdul C Delta" VALUE 0x1FFE7FC4 Scalar_FLOAT32_IEEE 0 swc_BatCoreFct_CM_single_dash_ 0 100000000 /end CHARACTERISTIC
/begin CHARACTERISTIC BCF_CMdulTripLamWithBaln_P "Forgetting factor of MdulCObsr with Balancing" VALUE 0x1FFE7FC8 Scalar_FLOAT32_IEEE 0 swc_BatCoreFct_CM_single_V -3.40282346639e+038 3.40282346639e+038 /end CHARACTERISTIC
/begin CHARACTERISTIC BCF_CMdulTripLamWoutBaln_P "Forgetting factor of MdulCObsr without Balancing" VALUE 0x1FFE7FCC Scalar_FLOAT32_IEEE 0 swc_BatCoreFct_CM_single_V -3.40282346639e+038 3.40282346639e+038 /end CHARACTERISTIC
/begin CHARACTERISTIC BCF_CSysMtrxCdngNrLimHi_P "Limit of the conditioning number of delta capacity observer system matrix" VALUE 0x1FFE7FD8 Scalar_FLOAT32_IEEE 0 swc_BatCoreFct_CM_single_dash_ -3.40282346639e+038 3.40282346639e+038 /end CHARACTERISTIC
/begin CHARACTERISTIC BCF_SocLowrLimForSohVeri_P "Soc upper limit for Soh calculation in capacity test mode." VALUE 0x20000F98 Scalar_FLOAT32_IEEE 0 swc_BatCoreFct_CM_single_dash_ -3.40282346639e+038 3.40282346639e+038 /end CHARACTERISTIC
/begin CHARACTERISTIC BCF_SocUpprLimForSohVeri_P "Soc upper limit for Soh calculation in capacity test mode." VALUE 0x20000FA4 Scalar_FLOAT32_IEEE 0 swc_BatCoreFct_CM_single_dash_ -3.40282346639e+038 3.40282346639e+038 /end CHARACTERISTIC
/begin CHARACTERISTIC BCF_TTsForSohVeri_P "Temperature sampling time for Soh calculation in capacity test mode." VALUE 0x1FFEB514 Scalar_UWORD 0 swc_BatCoreFct_CM_uint16_dash_ 0 65535 /end CHARACTERISTIC
/begin CHARACTERISTIC BCF_TdOffDig1004_P "Battery Core Function TimeDelay Off Digital _Parameter" VALUE 0x1FFEA5C4 Scalar_FLOAT32_IEEE 0 swc_BatCoreFct_CM_single_s -3.40282346639e+038 3.40282346639e+038 /end CHARACTERISTIC
/begin CHARACTERISTIC BCF_TdOnDig1004_P "Battery Core Function TimeDelay On Digital _Parameter" VALUE 0x1FFEA5DC Scalar_FLOAT32_IEEE 0 swc_BatCoreFct_CM_single_s -3.40282346639e+038 3.40282346639e+038 /end CHARACTERISTIC
/begin AXIS_PTS BCF_TiBatOffForAgiFac_A "Time axis of the for Saturation Curve of the Ageing Factor Update Steps based on stand still time" 0x1FFEA5E8 NO_INPUT_QUANTITY Lookup1D_X_ULONG 0 swc_BatCoreFct_CM_uint32_s 5 0 4294967295 DEPOSIT ABSOLUTE /end AXIS_PTS
/begin CHARACTERISTIC BCF_UMdulMeasdToMdlFilTcFac_P "Time Constant factor of module voltage measurement to model voltage prediction deviation filtering" VALUE 0x1FFEB0E8 Scalar_FLOAT32_IEEE 0 swc_BatCoreFct_CM_single_dash_ -3.40282346639e+038 3.40282346639e+038 /end CHARACTERISTIC
/begin CHARACTERISTIC BMS_HVIsolationSts_P "High voltage insulation status (0x0: No error\n      0x1: Level1\n      0x2: Level2\n      0x7: Invalid)" VALUE 0x20019CDD Scalar_UBYTE 0 swc_COL_CM_uint8_dash_ 0 255 /end CHARACTERISTIC
/begin CHARACTERISTIC BMS_HVLoopWorkSts_P "High voltage circuit working status (0x0: Open\n      0x1: Precharging\n      0x2: Precharg Finish\n      0x3: Prechage Fault\n      0x4: Precharge lock\n      0x5: Normal drive)" VALUE 0x20019CDE Scalar_UBYTE 0 swc_COL_CM_uint8_dash_ 0 255 /end CHARACTERISTIC
/begin CHARACTERISTIC BMS_HeatPosRelayFault_Reserved_P "Heating positive relay failure (0x0: No error\n      0x1: Drive Error\n      0x2: Welded\n      0x3: Invalid)" VALUE 0x20019CE2 Scalar_UBYTE 0 swc_COL_CM_uint8_dash_ 0 255 /end CHARACTERISTIC
/begin CHARACTERISTIC BMS_HeatRelaySts_P "BMS heating relay status (0x0: Open \n      0x1: Close \n      0x2: Reserved\n      0x3: Invalid )" VALUE 0x20019CE3 Scalar_UBYTE 0 swc_COL_CM_uint8_dash_ 0 255 /end CHARACTERISTIC
/begin CHARACTERISTIC BMS_IsolationFault_P "Insulation fault alarm (0x0: No error\n      0x1: Positive isolation fault\n      0x2: Negtive isolation fault\n      0x3: Both P and N fault\n      0x4: Isolation test circuit fault\n      0x1F: Invalid)" VALUE 0x20019CE6 Scalar_UBYTE 0 swc_COL_CM_uint8_dash_ 0 255 /end CHARACTERISTIC
/begin CHARACTERISTIC BMS_MILTelltale_P "Request MIL lamp status (0x0: Off\n      0x1: ON\n      0x2: Blink)" VALUE 0x20019CE7 Scalar_UBYTE 0 swc_COL_CM_uint8_dash_ 0 255 /end CHARACTERISTIC
/begin CHARACTERISTIC BMS_MainPosConnSts_P "Main positive contactor status feedback (0x0: Open \n      0x1: Close \n      0x2: Reserved\n      0x3: Invalid )" VALUE 0x20019CEA Scalar_UBYTE 0 swc_COL_CM_uint8_dash_ 0 255 /end CHARACTERISTIC
/begin CHARACTERISTIC BMS_MaxChgCurrent_P "Maximum allowable charging current (0xFFFF: Invalid)" VALUE 0x2001965C Scalar_FLOAT32_IEEE 0 swc_COL_CM_single_A 0 65535 /end CHARACTERISTIC
/begin CHARACTERISTIC BMS_MaxChgVoltage_P "Maximum allowable charging voltage (0xFFFF: Invalid)" VALUE 0x20019660 Scalar_FLOAT32_IEEE 0 swc_COL_CM_single_V 0 65535 /end CHARACTERISTIC
/begin CHARACTERISTIC BMS_NegIsolationRes_P "Insulation resistance between the high-voltage negative electrode and the chassis (0xFFFF: Invalid)" VALUE 0x20019C14 Scalar_UWORD 0 swc_COL_CM_uint16_kOhm 0 65535 /end CHARACTERISTIC
/begin CHARACTERISTIC BMS_OBCChgContrlCmd_P "Slow charge charge control command (0x0: Stop charge\n      0x1:Start charge\n      0x2: Reserved\n      0x3: Invalid)" VALUE 0x20019CF3 Scalar_UBYTE 0 swc_COL_CM_uint8_dash_ 0 255 /end CHARACTERISTIC
/begin CHARACTERISTIC BMS_PTCConnStsFb_P "BMS_PTCConnStsFb" VALUE 0x20019CF4 Scalar_UBYTE 0 swc_COL_CM_uint8_dash_ 0 255 /end CHARACTERISTIC
/begin CHARACTERISTIC BMS_PosIsolationRes_P "The insulation resistance between the high voltage positive electrode and the chassis (0xFFFF: Invalid)" VALUE 0x20019C16 Scalar_UWORD 0 swc_COL_CM_uint16_kOhm 0 65535 /end CHARACTERISTIC
/begin CHARACTERISTIC BMS_PreChgConnSts_P "Pre-charged contactor status feedback (0x0: Open \n      0x1: Close \n      0x2: Reserved\n      0x3: Invalid )" VALUE 0x20019CF7 Scalar_UBYTE 0 swc_COL_CM_uint8_dash_ 0 255 /end CHARACTERISTIC
/begin CHARACTERISTIC BMS_PreChgRelayFlt_P "Pre-charge contactor failure (0x0: No fault\n      0x1: Driver Fault\n      0x2: Welded\n      0x3: Invalid)" VALUE 0x20019CF8 Scalar_UBYTE 0 swc_COL_CM_uint8_dash_ 0 255 /end CHARACTERISTIC
/begin CHARACTERISTIC BMS_SOC1_P "Battery pack SOC" VALUE 0x20019678 Scalar_FLOAT32_IEEE 0 swc_COL_CM_single_percent_ 0 65535 /end CHARACTERISTIC
/begin CHARACTERISTIC BMS_SOCJumpFault_P "Battery SOC trip alarm (0x0: No error\n      0x1: Error\n      0x2: Reserved\n      0x3: Invalid)" VALUE 0x20019CF9 Scalar_UBYTE 0 swc_COL_CM_uint8_dash_ 0 255 /end CHARACTERISTIC
/begin CHARACTERISTIC BMS_ST1_Flt_HVIL_P "High voltage interlock alarm (0x0: No error\n      0x1: Error\n      0x2: Reserved\n      0x3: Invalid)" VALUE 0x20019CFA Scalar_UBYTE 0 swc_COL_CM_uint8_dash_ 0 255 /end CHARACTERISTIC
/begin CHARACTERISTIC BMS_SetTgtTemp_P "The BMS sets the target temperature" VALUE 0x2001967C Scalar_FLOAT32_IEEE 0 swc_COL_CM_single___C 0 255 /end CHARACTERISTIC
/begin CHARACTERISTIC BMS_TempOutofCtr_P "Battery thermal runaway alarm (0x0: No error\n      0x1: Error\n      0x2: Reserved\n      0x3: Invalid)" VALUE 0x20019CFC Scalar_UBYTE 0 swc_COL_CM_uint8_dash_ 0 255 /end CHARACTERISTIC
/begin CHARACTERISTIC BMS_TempSnsNum_P "Total number of temperature probes" VALUE 0x20019CFD Scalar_UBYTE 0 swc_COL_CM_uint8_dash_ 0 255 /end CHARACTERISTIC
/begin CHARACTERISTIC BPIU_TiChkOnDig141_P "Time Check On Diag" VALUE 0x200188F4 Scalar_FLOAT32_IEEE 0 swc_BatProtnIU_CM_single_s -3.40282346639e+038 3.40282346639e+038 /end CHARACTERISTIC
/begin CHARACTERISTIC BPIU_TiOffDig115_P "Time delay off for DTC115." VALUE 0x20018904 Scalar_FLOAT32_IEEE 0 swc_BatProtnIU_CM_single_s -3.40282346639e+038 3.40282346639e+038 /end CHARACTERISTIC
/begin CHARACTERISTIC BPIU_TiOffDig173_P "Time delay off for DTC173." VALUE 0x20018918 Scalar_FLOAT32_IEEE 0 swc_BatProtnIU_CM_single_s -3.40282346639e+038 3.40282346639e+038 /end CHARACTERISTIC
/begin CHARACTERISTIC BPIU_TiOffDig189_P "Time delay off for DTC189." VALUE 0x20018924 Scalar_FLOAT32_IEEE 0 swc_BatProtnIU_CM_single_s -3.40282346639e+038 3.40282346639e+038 /end CHARACTERISTIC
/begin CHARACTERISTIC BPIU_TiOffDig247_P "Time delay off for DTC247." VALUE 0x20018928 Scalar_FLOAT32_IEEE 0 swc_BatProtnIU_CM_single_s -3.40282346639e+038 3.40282346639e+038 /end CHARACTERISTIC
/begin CHARACTERISTIC BPIU_TiOffDig248_P "Time delay off for DTC248." VALUE 0x2001892C Scalar_FLOAT32_IEEE 0 swc_BatProtnIU_CM_single_s -3.40282346639e+038 3.40282346639e+038 /end CHARACTERISTIC
/begin CHARACTERISTIC BPIU_TiOffDig3_P "Time delay off for DTC3." VALUE 0x20018930 Scalar_FLOAT32_IEEE 0 swc_BatProtnIU_CM_single_s -3.40282346639e+038 3.40282346639e+038 /end CHARACTERISTIC
/begin CHARACTERISTIC BPIU_TiOffDig56_P "Time delay off for DTC56." VALUE 0x20018938 Scalar_FLOAT32_IEEE 0 swc_BatProtnIU_CM_single_s -3.40282346639e+038 3.40282346639e+038 /end CHARACTERISTIC
/begin CHARACTERISTIC BPIU_TiOffDig62_P "Time delay off for DTC62." VALUE 0x2001893C Scalar_FLOAT32_IEEE 0 swc_BatProtnIU_CM_single_s -3.40282346639e+038 3.40282346639e+038 /end CHARACTERISTIC
/begin CHARACTERISTIC BPIU_TiOffDig88_P "Time delay off for DTC88." VALUE 0x20018948 Scalar_FLOAT32_IEEE 0 swc_BatProtnIU_CM_single_s -3.40282346639e+038 3.40282346639e+038 /end CHARACTERISTIC
/begin CHARACTERISTIC BPIU_TiOnDig115_P "Time delay on for DTC115." VALUE 0x20018964 Scalar_FLOAT32_IEEE 0 swc_BatProtnIU_CM_single_s -3.40282346639e+038 3.40282346639e+038 /end CHARACTERISTIC
/begin CHARACTERISTIC BPIU_TiOnDig173_P "Time delay on for DTC173." VALUE 0x20018978 Scalar_FLOAT32_IEEE 0 swc_BatProtnIU_CM_single_s -3.40282346639e+038 3.40282346639e+038 /end CHARACTERISTIC
/begin CHARACTERISTIC BPIU_TiOnDig189_P "Time delay on for DTC189." VALUE 0x20018984 Scalar_FLOAT32_IEEE 0 swc_BatProtnIU_CM_single_s -3.40282346639e+038 3.40282346639e+038 /end CHARACTERISTIC
/begin CHARACTERISTIC BPIU_TiOnDig247_P "Time delay on for DTC247." VALUE 0x20018988 Scalar_FLOAT32_IEEE 0 swc_BatProtnIU_CM_single_s -3.40282346639e+038 3.40282346639e+038 /end CHARACTERISTIC
/begin CHARACTERISTIC BPIU_TiOnDig248_P "Time delay on for DTC248." VALUE 0x2001898C Scalar_FLOAT32_IEEE 0 swc_BatProtnIU_CM_single_s -3.40282346639e+038 3.40282346639e+038 /end CHARACTERISTIC
/begin CHARACTERISTIC BPIU_TiOnDig3_P "Time delay on for DTC3." VALUE 0x20018990 Scalar_FLOAT32_IEEE 0 swc_BatProtnIU_CM_single_s -3.40282346639e+038 3.40282346639e+038 /end CHARACTERISTIC
/begin CHARACTERISTIC BPIU_TiOnDig56_P "Time delay on for DTC56." VALUE 0x20018998 Scalar_FLOAT32_IEEE 0 swc_BatProtnIU_CM_single_s -3.40282346639e+038 3.40282346639e+038 /end CHARACTERISTIC
/begin CHARACTERISTIC BPIU_TiOnDig62_P "Time delay on for DTC62." VALUE 0x2001899C Scalar_FLOAT32_IEEE 0 swc_BatProtnIU_CM_single_s -3.40282346639e+038 3.40282346639e+038 /end CHARACTERISTIC
/begin CHARACTERISTIC BPIU_TiOnDig88_P "Time delay on for DTC88." VALUE 0x200189A8 Scalar_FLOAT32_IEEE 0 swc_BatProtnIU_CM_single_s -3.40282346639e+038 3.40282346639e+038 /end CHARACTERISTIC
/begin CHARACTERISTIC BPIU_UCellDifMax_P "Maximum allowed difference between minimum and maximum cell voltage" VALUE 0x200189C8 Scalar_FLOAT32_IEEE 0 swc_BatProtnIU_CM_single_V 0 100 /end CHARACTERISTIC
/begin CHARACTERISTIC BPIU_UCellDifMin_P "Voltage Cell Difference Minimum" VALUE 0x200189CC Scalar_FLOAT32_IEEE 0 swc_BatProtnIU_CM_single_V -3.40282346639e+038 3.40282346639e+038 /end CHARACTERISTIC
/begin CHARACTERISTIC BPIU_UCellMaxLim1_P "Voltage Cell Maximum Limit 1" VALUE 0x200189D0 Scalar_FLOAT32_IEEE 0 swc_BatProtnIU_CM_single_V -3.40282346639e+038 3.40282346639e+038 /end CHARACTERISTIC
/begin CHARACTERISTIC BPIU_UCellMaxLim2_P "Voltage Cell Maximum Limit  2" VALUE 0x200189D4 Scalar_FLOAT32_IEEE 0 swc_BatProtnIU_CM_single_V -3.40282346639e+038 3.40282346639e+038 /end CHARACTERISTIC
/begin CHARACTERISTIC BPIU_UCellMaxLim3_P "Voltage Cell Maximum Limit" VALUE 0x200189D8 Scalar_FLOAT32_IEEE 0 swc_BatProtnIU_CM_single_V -3.40282346639e+038 3.40282346639e+038 /end CHARACTERISTIC
/begin CHARACTERISTIC BPIU_UCellMaxOff_P "Voltage Cell Maximum normol" VALUE 0x200189E0 Scalar_FLOAT32_IEEE 0 swc_BatProtnIU_CM_single_V -3.40282346639e+038 3.40282346639e+038 /end CHARACTERISTIC
/begin CHARACTERISTIC BPIU_UCellOverMax2_P "Voltage Cell Over Maximum 2" VALUE 0x200189E8 Scalar_FLOAT32_IEEE 0 swc_BatProtnIU_CM_single_V -3.40282346639e+038 3.40282346639e+038 /end CHARACTERISTIC
/begin CHARACTERISTIC BPIU_UCellOverMax_P "Voltage Cell Over Maximum 1" VALUE 0x200189EC Scalar_FLOAT32_IEEE 0 swc_BatProtnIU_CM_single_V -3.40282346639e+038 3.40282346639e+038 /end CHARACTERISTIC
/begin CHARACTERISTIC BPIU_UCellRateMaxLim_P "Voltage Cell Rate Maximum Limit " VALUE 0x200189F8 Scalar_FLOAT32_IEEE 0 swc_BatProtnIU_CM_single_V -3.40282346639e+038 3.40282346639e+038 /end CHARACTERISTIC
/begin CHARACTERISTIC BPIU_UCellRateOff_P "Voltage Cell Rate normol" VALUE 0x200189FC Scalar_FLOAT32_IEEE 0 swc_BatProtnIU_CM_single_V -3.40282346639e+038 3.40282346639e+038 /end CHARACTERISTIC
/begin CHARACTERISTIC BPIU_UMdulMax_P "Voltage Module Maximum" VALUE 0x20018A3C Scalar_FLOAT32_IEEE 0 swc_BatProtnIU_CM_single_V -3.40282346639e+038 3.40282346639e+038 /end CHARACTERISTIC
/begin CHARACTERISTIC BPIU_UMdulMin_P "Voltage Module Minimum " VALUE 0x20018A40 Scalar_FLOAT32_IEEE 0 swc_BatProtnIU_CM_single_V -3.40282346639e+038 3.40282346639e+038 /end CHARACTERISTIC
/begin CHARACTERISTIC BSOF_AcvChManSuspd_P "Reason for charger charging suspension: Manual suspension(replacement value)" VALUE 0x20019C68 Scalar_UBYTE 0 swc_CIL_CM_uint8_dash_ 0 255 /end CHARACTERISTIC
/begin CHARACTERISTIC BSOF_AcvChSuspdByBms_P "Reason for charger charging suspension: Active suspension by BMS(replacement value)" VALUE 0x20019C69 Scalar_UBYTE 0 swc_CIL_CM_uint8_dash_ 0 255 /end CHARACTERISTIC
/begin CHARACTERISTIC BSOF_AcvChSuspdCdnRchd_P "Reason for charger charging suspension: reach the set suspension condition of charger(replacement value)" VALUE 0x20019C6A Scalar_UBYTE 0 swc_CIL_CM_uint8_dash_ 0 255 /end CHARACTERISTIC
/begin CHARACTERISTIC BSOF_AcvChSuspdFlt_P "Reason for charger charging suspension: Suspension due to fault(replacement value)" VALUE 0x20019C6B Scalar_UBYTE 0 swc_CIL_CM_uint8_dash_ 0 255 /end CHARACTERISTIC
/begin CHARACTERISTIC BSOF_ChAllwd_P "Charging allowed 0x00:pause 0x01:permit(replacement value)" VALUE 0x20019C6C Scalar_UBYTE 0 swc_CIL_CM_uint8_dash_ 0 255 /end CHARACTERISTIC
/begin CHARACTERISTIC BSOF_ErrChImpo_P "Reason for charger charging suspension fault: Unable to transmit the required electric energy(replacement value)" VALUE 0x20019C6E Scalar_UBYTE 0 swc_CIL_CM_uint8_dash_ 0 255 /end CHARACTERISTIC
/begin CHARACTERISTIC BSOF_ErrChrgrOutpFlt_P "Reason for charger charging suspension fault: Charger connector fault(replacement value)" VALUE 0x20019C6F Scalar_UBYTE 0 swc_CIL_CM_uint8_dash_ 0 255 /end CHARACTERISTIC
/begin CHARACTERISTIC BSOF_ErrChrgrOvtempFlt_P "Reason for charger charging suspension fault: Charger over-temperature fault(replacement value)" VALUE 0x20019C70 Scalar_UBYTE 0 swc_CIL_CM_uint8_dash_ 0 255 /end CHARACTERISTIC
/begin CHARACTERISTIC BSOF_ErrChrgrOvtempIntFlt_P "Reason for charger charging suspension fault: Internal over-temperature fault of charger(replacement value)" VALUE 0x20019C71 Scalar_UBYTE 0 swc_CIL_CM_uint8_dash_ 0 255 /end CHARACTERISTIC
/begin CHARACTERISTIC BSOF_ErrChrgrShtdnEmcy_P "Reason for charger charging suspension fault: Charger emergency shutdown fault(replacement value)" VALUE 0x20019C72 Scalar_UBYTE 0 swc_CIL_CM_uint8_dash_ 0 255 /end CHARACTERISTIC
/begin CHARACTERISTIC BSOF_ErrIDe_P "Reason for charger charging suspension error: Current not matching(replacement value)" VALUE 0x20019C73 Scalar_UBYTE 0 swc_CIL_CM_uint8_dash_ 0 255 /end CHARACTERISTIC
/begin CHARACTERISTIC BSOF_ErrUAbno_P "Reason for charger charging suspension error: Abnormal voltage(replacement value)" VALUE 0x20019C77 Scalar_UBYTE 0 swc_CIL_CM_uint8_dash_ 0 255 /end CHARACTERISTIC
/begin CHARACTERISTIC BSOF_ErrUndfnd_P "Reason for charger charging suspension fault: Other fault(replacement value)" VALUE 0x20019C78 Scalar_UBYTE 0 swc_CIL_CM_uint8_dash_ 0 255 /end CHARACTERISTIC
/begin CHARACTERISTIC BSOF_IChrgr_P "Current output (A)(replacement value)" VALUE 0x200192E8 Scalar_FLOAT32_IEEE 0 swc_CIL_CM_single_A 0 65535 /end CHARACTERISTIC
/begin CHARACTERISTIC BSOF_TiChAccumd_P "Accumulated charging time (min)(replacement value)" VALUE 0x20019BE6 Scalar_UWORD 0 swc_CIL_CM_uint16_min 0 65535 /end CHARACTERISTIC
/begin CHARACTERISTIC BSOF_TiDcChrgrPlgOff_P "Dc charger plug off  delay time" VALUE 0x200192F4 Scalar_FLOAT32_IEEE 0 swc_CIL_CM_single_s -3.40282346639e+038 3.40282346639e+038 /end CHARACTERISTIC
/begin CHARACTERISTIC BSOF_TiDcChrgrPlgOn_P "Dc charger plug on delay time" VALUE 0x200192F8 Scalar_FLOAT32_IEEE 0 swc_CIL_CM_single_s -3.40282346639e+038 3.40282346639e+038 /end CHARACTERISTIC
/begin CHARACTERISTIC BSOF_TiMsgChrgrChDetd_P "Delay time when flag of CCD recieved is 1." VALUE 0x200192FC Scalar_FLOAT32_IEEE 0 swc_CIL_CM_single_s -3.40282346639e+038 3.40282346639e+038 /end CHARACTERISTIC
/begin CHARACTERISTIC BSOF_TiMsgChrgrChSt_P "Delay time when flag of CCS recieved is 1." VALUE 0x20019300 Scalar_FLOAT32_IEEE 0 swc_CIL_CM_single_s -3.40282346639e+038 3.40282346639e+038 /end CHARACTERISTIC
/begin CHARACTERISTIC BSOF_TiMsgChrgrChSuspd_P "Delay time when flag of CST recieved is 1." VALUE 0x20019304 Scalar_FLOAT32_IEEE 0 swc_CIL_CM_single_s -3.40282346639e+038 3.40282346639e+038 /end CHARACTERISTIC
/begin CHARACTERISTIC BSOF_TiMsgChrgrDetnCnct_P "Delay time when flag of CDC recieved is 1." VALUE 0x20019308 Scalar_FLOAT32_IEEE 0 swc_CIL_CM_single_s -3.40282346639e+038 3.40282346639e+038 /end CHARACTERISTIC
/begin CHARACTERISTIC BSOF_TiMsgChrgrErr_P "Delay time when flag of CEM recieved is 1." VALUE 0x2001930C Scalar_FLOAT32_IEEE 0 swc_CIL_CM_single_s -3.40282346639e+038 3.40282346639e+038 /end CHARACTERISTIC
/begin CHARACTERISTIC BSOF_TiMsgChrgrHdshk_P "Delay time when flag of CHM recieved is 1." VALUE 0x20019310 Scalar_FLOAT32_IEEE 0 swc_CIL_CM_single_s -3.40282346639e+038 3.40282346639e+038 /end CHARACTERISTIC
/begin CHARACTERISTIC BSOF_TiMsgChrgrMaxOutPgtn_P "Delay time when flag of CMLP recieved is 1." VALUE 0x20019314 Scalar_FLOAT32_IEEE 0 swc_CIL_CM_single_s -3.40282346639e+038 3.40282346639e+038 /end CHARACTERISTIC
/begin CHARACTERISTIC BSOF_TiMsgChrgrMaxOut_P "Delay time when flag of CML recieved is 1." VALUE 0x20019318 Scalar_FLOAT32_IEEE 0 swc_CIL_CM_single_s -3.40282346639e+038 3.40282346639e+038 /end CHARACTERISTIC
/begin CHARACTERISTIC BSOF_TiMsgChrgrRcgtn_P "Delay time when flag of CHM recieved is 1." VALUE 0x2001931C Scalar_FLOAT32_IEEE 0 swc_CIL_CM_single_s -3.40282346639e+038 3.40282346639e+038 /end CHARACTERISTIC
/begin CHARACTERISTIC BSOF_TiMsgChrgrRdy_P "Delay time when flag of CRO recieved is 1." VALUE 0x20019320 Scalar_FLOAT32_IEEE 0 swc_CIL_CM_single_s -3.40282346639e+038 3.40282346639e+038 /end CHARACTERISTIC
/begin CHARACTERISTIC BSOF_TiMsgChrgrStstcForPgtn_P "Delay time when flag of CSDP recieved is 1." VALUE 0x20019324 Scalar_FLOAT32_IEEE 0 swc_CIL_CM_single_s -3.40282346639e+038 3.40282346639e+038 /end CHARACTERISTIC
/begin CHARACTERISTIC BSOF_TiMsgChrgrStstc_P "Delay time when flag of CSD recieved is 1." VALUE 0x20019328 Scalar_FLOAT32_IEEE 0 swc_CIL_CM_single_s -3.40282346639e+038 3.40282346639e+038 /end CHARACTERISTIC
/begin CHARACTERISTIC BSOF_UChrgr_P "Voltage output (V)(replacement value)" VALUE 0x20019334 Scalar_FLOAT32_IEEE 0 swc_CIL_CM_single_V 0 65535 /end CHARACTERISTIC
/begin CHARACTERISTIC BSOF_ValDcChrgrPlgRHi_P "The upper limit of CC2 resistance when the charging plug is in the connected state" VALUE 0x20019340 Scalar_FLOAT32_IEEE 0 swc_CIL_CM_single_Ohm 0 65535 /end CHARACTERISTIC
/begin CHARACTERISTIC BSOF_ValDcChrgrPlgRLo_P "The lower limit of CC2 resistance when the charging plug is in the connected state" VALUE 0x20019344 Scalar_FLOAT32_IEEE 0 swc_CIL_CM_single_Ohm 0 65535 /end CHARACTERISTIC
/begin CHARACTERISTIC BSOF_bAcvDcChrgrPlg_P "flag of DC charger plug (CC2): 0-unplugged 1-plugged(replacement value)" VALUE 0x20019CA4 Scalar_BOOLEAN 0 swc_CIL_CM_boolean_dash_ 0 1 /end CHARACTERISTIC
/begin CHARACTERISTIC BSOF_bEnaMsgChrgrChDetd_P "flag of CCD recieved : 0-unrecieved, 1-received(replacement value)" VALUE 0x20019CA5 Scalar_BOOLEAN 0 swc_CIL_CM_boolean_dash_ 0 1 /end CHARACTERISTIC
/begin CHARACTERISTIC BSOF_bEnaMsgChrgrChSt_P "flag of CCS recieved : 0-unrecieved, 1-received(replacement value)" VALUE 0x20019CA6 Scalar_BOOLEAN 0 swc_CIL_CM_boolean_dash_ 0 1 /end CHARACTERISTIC
/begin CHARACTERISTIC BSOF_bEnaMsgChrgrChSuspd_P "flag of CST recieved : 0-unrecieved, 1-received(replacement value)" VALUE 0x20019CA7 Scalar_BOOLEAN 0 swc_CIL_CM_boolean_dash_ 0 1 /end CHARACTERISTIC
/begin CHARACTERISTIC BSOF_bEnaMsgChrgrDetnCnct_P "flag of CDC recieved : 0-unrecieved, 1-received(replacement value)" VALUE 0x20019CA8 Scalar_BOOLEAN 0 swc_CIL_CM_boolean_dash_ 0 1 /end CHARACTERISTIC
/begin CHARACTERISTIC BSOF_bEnaMsgChrgrErr_P "flag of CEM recieved : 0-unrecieved, 1-received(replacement value)" VALUE 0x20019CA9 Scalar_BOOLEAN 0 swc_CIL_CM_boolean_dash_ 0 1 /end CHARACTERISTIC
/begin CHARACTERISTIC BSOF_bEnaMsgChrgrHdshk_P "flag of CHM recieved : 0-unrecieved, 1-received(replacement value)" VALUE 0x20019CAA Scalar_BOOLEAN 0 swc_CIL_CM_boolean_dash_ 0 1 /end CHARACTERISTIC
/begin CHARACTERISTIC BSOF_bEnaMsgChrgrMaxOutPgtn_P "flag of CMLP recieved : 0-unrecieved, 1-received(replacement value)" VALUE 0x20019CAB Scalar_BOOLEAN 0 swc_CIL_CM_boolean_dash_ 0 1 /end CHARACTERISTIC
/begin CHARACTERISTIC BSOF_bEnaMsgChrgrMaxOut_P "flag of CML recieved : 0-unrecieved, 1-received(replacement value)" VALUE 0x20019CAC Scalar_BOOLEAN 0 swc_CIL_CM_boolean_dash_ 0 1 /end CHARACTERISTIC
/begin CHARACTERISTIC BSOF_bEnaMsgChrgrRcgtn_P "flag of CHM recieved : 0-unrecieved, 1-received(replacement value)" VALUE 0x20019CAD Scalar_BOOLEAN 0 swc_CIL_CM_boolean_dash_ 0 1 /end CHARACTERISTIC
/begin CHARACTERISTIC BSOF_bEnaMsgChrgrRdy_P "flag of CRO recieved : 0-unrecieved, 1-received(replacement value)" VALUE 0x20019CAE Scalar_BOOLEAN 0 swc_CIL_CM_boolean_dash_ 0 1 /end CHARACTERISTIC
/begin CHARACTERISTIC BSOF_bEnaMsgChrgrStstcForPgtn_P "flag of CSDP recieved : 0-unrecieved, 1-received(replacement value)" VALUE 0x20019CAF Scalar_BOOLEAN 0 swc_CIL_CM_boolean_dash_ 0 1 /end CHARACTERISTIC
/begin CHARACTERISTIC BSOF_bEnaMsgChrgrStstc_P "flag of CSD recieved : 0-unrecieved, 1-received(replacement value)" VALUE 0x20019CB0 Scalar_BOOLEAN 0 swc_CIL_CM_boolean_dash_ 0 1 /end CHARACTERISTIC
/begin CHARACTERISTIC BTHM_CswDig_P "parameter for diagnosis" VALUE 0x20018C5C Scalar_ULONG 0 swc_BatThermHndlgMngt_CM_uint32_dash_ 0 4294967295 /end CHARACTERISTIC
/begin CHARACTERISTIC BTHM_ModeTherm_P "The parameter for selecting thermal management mode" VALUE 0x20019C5B Scalar_UBYTE 0 swc_BatThermHndlgMngt_CM_uint8_dash_ 0 255 /end CHARACTERISTIC
/begin CHARACTERISTIC BTHM_TMaxOptmLim_P "Maximum cell temperature for optimum conditions" VALUE 0x20018D24 Scalar_FLOAT32_IEEE 0 swc_BatThermHndlgMngt_CM_single__ -60 140 /end CHARACTERISTIC
/begin CHARACTERISTIC BTHM_TMinOptmLim_P "Minimum cell temperature for optimum conditions" VALUE 0x20018D8C Scalar_FLOAT32_IEEE 0 swc_BatThermHndlgMngt_CM_single__ -60 140 /end CHARACTERISTIC
/begin CHARACTERISTIC BTHM_TiOffDig641_P "Timer delay off for initial daignosis 64" VALUE 0x20018E58 Scalar_FLOAT32_IEEE 0 swc_BatThermHndlgMngt_CM_single_dash_ -3.40282346639e+038 3.40282346639e+038 /end CHARACTERISTIC
/begin CHARACTERISTIC BTHM_TiOnDig641_P "Timer delay on for initial daignosis 64" VALUE 0x20018E94 Scalar_FLOAT32_IEEE 0 swc_BatThermHndlgMngt_CM_single_dash_ -3.40282346639e+038 3.40282346639e+038 /end CHARACTERISTIC
/begin CHARACTERISTIC BWLD_SocBatRst_P "Parameter to reset the maximum and mimimum state of charge values during battery life cycle" VALUE 0x20019C64 Scalar_BOOLEAN 0 swc_BatWntyLogtcData_CM_boolean_dash_ 0 1 /end CHARACTERISTIC
/begin CHARACTERISTIC BWLD_TMdulSnsrRst_P "Parameter to reset the maximum and mimimum values of module temperature sensors during battery life cycle" VALUE 0x20019C65 Scalar_BOOLEAN 0 swc_BatWntyLogtcData_CM_boolean_dash_ 0 1 /end CHARACTERISTIC
/begin CHARACTERISTIC BWLD_UCellRst_P "Parameter to reset the maximum and mimimum voltage values during battery life cycle" VALUE 0x20019C67 Scalar_BOOLEAN 0 swc_BatWntyLogtcData_CM_boolean_dash_ 0 1 /end CHARACTERISTIC
/begin CHARACTERISTIC BmsReadyForCharging_P "BRO: Whether the vehicle is ready to charge (discharge) (<0x00 >: = idle waiting; <0xAA >: = normal working mode ready; <0xFF>:= invalid)" VALUE 0x20019D19 Scalar_UBYTE 0 swc_COL_CM_uint8_dash_ 0 255 /end CHARACTERISTIC
/begin CHARACTERISTIC BmsRevision_P "BRM software version: send calibration, must be sent, 0x101" VALUE 0x20019D1A Scalar_UBYTE 0 swc_COL_CM_uint8_dash_ 0 255 /end CHARACTERISTIC
/begin CHARACTERISTIC BmsVersion_P "BRM software version: send calibration, must be sent, 0x101" VALUE 0x20019C1C Scalar_UWORD 0 swc_COL_CM_uint16_dash_ 0 65535 /end CHARACTERISTIC
/begin CHARACTERISTIC BsmChargingPermissible_P "BSM: Charging (discharging) permitted" VALUE 0x20019D29 Scalar_UBYTE 0 swc_COL_CM_uint8_dash_ 0 255 /end CHARACTERISTIC
/begin CHARACTERISTIC CIL_Csw1_P "configuration switch for BMS (10ms, Client_Sever Signals)" VALUE 0x20019348 Scalar_ULONG 0 swc_CIL_CM_uint32_dash_ 0 4294967295 /end CHARACTERISTIC
/begin CHARACTERISTIC CIL_Csw2_P "configuration switch for BMS (10ms, Sender_Reciever Signals)" VALUE 0x2001934C Scalar_ULONG 0 swc_CIL_CM_uint32_dash_ 0 4294967295 /end CHARACTERISTIC
/begin CHARACTERISTIC CIL_Csw3_P "configuration switch for BMS (10ms, Sender_Reciever Signals)" VALUE 0x20019350 Scalar_ULONG 0 swc_CIL_CM_uint32_dash_ 0 4294967295 /end CHARACTERISTIC
/begin CHARACTERISTIC CIL_Csw4_P "configuration switch for GB_CAN (10ms)" VALUE 0x20019354 Scalar_ULONG 0 swc_CIL_CM_uint32_dash_ 0 4294967295 /end CHARACTERISTIC
/begin CHARACTERISTIC CIL_Csw5_P "configuration switch for Veh_CAN (10ms)" VALUE 0x20019BE8 Scalar_UWORD 0 swc_CIL_CM_uint16_dash_ 0 65535 /end CHARACTERISTIC
/begin CHARACTERISTIC CIL_CtrIslnRSamplg_P "Insulation resistance sampling count" VALUE 0x20019BF0 Scalar_UWORD 0 swc_CIL_CM_uint16_dash_ 0 65535 /end CHARACTERISTIC
/begin CHARACTERISTIC CIL_DayRtc_P "Real time clcok - day" VALUE 0x20019C7E Scalar_UBYTE 0 swc_CIL_CM_uint8_dash_ 0 255 /end CHARACTERISTIC
/begin CHARACTERISTIC CIL_DucycCrash_P "Crash duty cycle response" VALUE 0x20019358 Scalar_ULONG 0 swc_CIL_CM_uint32_percent_ 0 4294967295 /end CHARACTERISTIC
/begin CHARACTERISTIC CIL_DucycHvil_P "High voltage interlock loop duty cycle response" VALUE 0x2001935C Scalar_ULONG 0 swc_CIL_CM_uint32_percent_ 0 4294967295 /end CHARACTERISTIC
/begin CHARACTERISTIC CIL_ErrAcScktSnsrT_P "Error in the temperature sensor of the AC charging socket\n      1:Hardware failure\n      2:Disconnect\n      4:Short circuit" VALUE 0x20019C80 Scalar_UBYTE 0 swc_CIL_CM_uint8_dash_ 0 255 /end CHARACTERISTIC
/begin CHARACTERISTIC CIL_ErrDcScktSnsrT_P "Error in the temperature sensor of the DC charging socket\n      1:Hardware failure\n      2:Disconnect\n      4:Short circuit" VALUE 0x20019C81 Scalar_UBYTE 0 swc_CIL_CM_uint8_dash_ 0 255 /end CHARACTERISTIC
/begin CHARACTERISTIC CIL_FrqCrash_P "Crash frequency response" VALUE 0x20019360 Scalar_ULONG 0 swc_CIL_CM_uint32_Hz 0 4294967295 /end CHARACTERISTIC
/begin CHARACTERISTIC CIL_FrqHvil_P "High voltage interlock loop frequency response" VALUE 0x20019364 Scalar_ULONG 0 swc_CIL_CM_uint32_Hz 0 4294967295 /end CHARACTERISTIC
/begin CHARACTERISTIC CIL_HourRtc_P "Real time clock - hour" VALUE 0x20019C82 Scalar_UBYTE 0 swc_CIL_CM_uint8_h 0 255 /end CHARACTERISTIC
/begin CHARACTERISTIC CIL_IBatHv_P "HV battery current" VALUE 0x20019368 Scalar_FLOAT32_IEEE 0 swc_CIL_CM_single_A -3.40282346639e+038 3.40282346639e+038 /end CHARACTERISTIC
/begin CHARACTERISTIC CIL_IdxDcChrgrPlgRstr_P "Index for invoking BSW function for the resistance of CC2" VALUE 0x20019374 Scalar_ULONG 0 swc_CIL_CM_uint32_dash_ 0 4294967295 /end CHARACTERISTIC
/begin CHARACTERISTIC CIL_IdxDucycCrash_P "Index for invoking BSW function for crash duty cycle" VALUE 0x20019378 Scalar_ULONG 0 swc_CIL_CM_uint32_dash_ 0 4294967295 /end CHARACTERISTIC
/begin CHARACTERISTIC CIL_IdxFrqCrash_P "Index for invoking BSW function for crash frequency" VALUE 0x2001937C Scalar_ULONG 0 swc_CIL_CM_uint32_dash_ 0 4294967295 /end CHARACTERISTIC
/begin CHARACTERISTIC CIL_IdxHvilDucyc_P "Index for invoking BSW function for high voltage interlock loop duty cycle response" VALUE 0x20019380 Scalar_ULONG 0 swc_CIL_CM_uint32_dash_ 0 4294967295 /end CHARACTERISTIC
/begin CHARACTERISTIC CIL_IdxHvilFrq_P "Index for invoking BSW function for high voltage interlock loop frequency response" VALUE 0x20019384 Scalar_ULONG 0 swc_CIL_CM_uint32_dash_ 0 4294967295 /end CHARACTERISTIC
/begin CHARACTERISTIC CIL_IdxPortAcChTNeg_P "Index for invoking BSW function for slow charging port negative contact temperature" VALUE 0x20019388 Scalar_ULONG 0 swc_CIL_CM_uint32_dash_ 0 4294967295 /end CHARACTERISTIC
/begin CHARACTERISTIC CIL_IdxPortAcChTPos_P "Index for invoking BSW function for slow charging port positive contact temperature" VALUE 0x2001938C Scalar_ULONG 0 swc_CIL_CM_uint32_dash_ 0 4294967295 /end CHARACTERISTIC
/begin CHARACTERISTIC CIL_IdxPortDcChTNeg_P "Index for invoking BSW function for fast charging port negative contact temperature" VALUE 0x20019390 Scalar_ULONG 0 swc_CIL_CM_uint32_dash_ 0 4294967295 /end CHARACTERISTIC
/begin CHARACTERISTIC CIL_IdxPortDcChTPos_P "Index for invoking BSW function for fast charging port positive contact temperature" VALUE 0x20019394 Scalar_ULONG 0 swc_CIL_CM_uint32_dash_ 0 4294967295 /end CHARACTERISTIC
/begin CHARACTERISTIC CIL_IdxStChWup_P "Index for invoking BSW function for Low voltage auxiliary power positive pole status" VALUE 0x20019398 Scalar_ULONG 0 swc_CIL_CM_uint32_dash_ 0 4294967295 /end CHARACTERISTIC
/begin CHARACTERISTIC CIL_IdxStTrml15_P "Index for invoking BSW function for  KL15 state" VALUE 0x2001939C Scalar_ULONG 0 swc_CIL_CM_uint32_dash_ 0 4294967295 /end CHARACTERISTIC
/begin CHARACTERISTIC CIL_IdxUChPoleHiSideDrv_P "Index for invoking BSW function for High side drive voltage of  fast charge relay" VALUE 0x200193A0 Scalar_ULONG 0 swc_CIL_CM_uint32_dash_ 0 4294967295 /end CHARACTERISTIC
/begin CHARACTERISTIC CIL_IdxUHeatPoleHiSideDrv_P "Index for invoking BSW function for High side drive voltage of  heat relay" VALUE 0x200193A4 Scalar_ULONG 0 swc_CIL_CM_uint32_dash_ 0 4294967295 /end CHARACTERISTIC
/begin CHARACTERISTIC CIL_IdxUMainNegPoleHiSideDrv_P "Index for invoking BSW function for High side drive voltage of  main negative relay" VALUE 0x200193A8 Scalar_ULONG 0 swc_CIL_CM_uint32_dash_ 0 4294967295 /end CHARACTERISTIC
/begin CHARACTERISTIC CIL_IdxUMainPosPoleHiSideDrv_P "Index for invoking BSW function for High side drive voltage of  main positive relay" VALUE 0x200193AC Scalar_ULONG 0 swc_CIL_CM_uint32_dash_ 0 4294967295 /end CHARACTERISTIC
/begin CHARACTERISTIC CIL_IdxURlyPrechHiSideDrv_P "Index for invoking BSW function for High side drive voltage of pre charging relay" VALUE 0x200193B0 Scalar_ULONG 0 swc_CIL_CM_uint32_dash_ 0 4294967295 /end CHARACTERISTIC
/begin CHARACTERISTIC CIL_IdxUTrml30_P "Index for invoking BSW function for KL30 state" VALUE 0x200193B4 Scalar_ULONG 0 swc_CIL_CM_uint32_dash_ 0 4294967295 /end CHARACTERISTIC
/begin CHARACTERISTIC CIL_MinuRtc_P "Real time clock - minute" VALUE 0x20019C84 Scalar_UBYTE 0 swc_CIL_CM_uint8_min 0 255 /end CHARACTERISTIC
/begin CHARACTERISTIC CIL_ModeMotDrv_P "Drive motor operation mode (0x0: Idle mode 0x1: Driving mode 0x2: Reverse mode 0x3: Brake power regeneration 0x4: Ready to cut off low voltage or sleep 0x5: Discharging 0x6: Discharge finish 0x7: Initializing 0xF: Invalid)" VALUE 0x20019C85 Scalar_UBYTE 0 swc_CIL_CM_uint8_dash_ 0 255 /end CHARACTERISTIC
/begin CHARACTERISTIC CIL_ModeSysWup_P "Wake-up mode\n      0: Unknown wake-up source.\n      1: This time wake up by hard line.\n      2: Wake up by Rtc this time\n      3: Wake up by Can this time" VALUE 0x20019C86 Scalar_UBYTE 0 swc_CIL_CM_uint8_dash_ 0 255 /end CHARACTERISTIC
/begin CHARACTERISTIC CIL_MonthRtc_P "Real time clock - month" VALUE 0x20019C87 Scalar_UBYTE 0 swc_CIL_CM_uint8_min 0 255 /end CHARACTERISTIC
/begin CHARACTERISTIC CIL_RIslnNeg_P "Negative insulation resistance value" VALUE 0x200193C0 Scalar_LONG 0 swc_CIL_CM_int32_kOhm -2147483648 2147483647 /end CHARACTERISTIC
/begin CHARACTERISTIC CIL_RIslnPos_P "Positive insulation resistance value" VALUE 0x200193C4 Scalar_LONG 0 swc_CIL_CM_int32_kOhm -2147483648 2147483647 /end CHARACTERISTIC
/begin CHARACTERISTIC CIL_RngElec_P "Pure electric range" VALUE 0x200193C8 Scalar_FLOAT32_IEEE 0 swc_CIL_CM_single_km -3.40282346639e+038 3.40282346639e+038 /end CHARACTERISTIC
/begin CHARACTERISTIC CIL_SecRtc_P "Real time clock - second" VALUE 0x20019C89 Scalar_UBYTE 0 swc_CIL_CM_uint8_s 0 255 /end CHARACTERISTIC
/begin CHARACTERISTIC CIL_SpdMot_P "MCU motor speed" VALUE 0x200193CC Scalar_FLOAT32_IEEE 0 swc_CIL_CM_single_rpm -3.40282346639e+038 3.40282346639e+038 /end CHARACTERISTIC
/begin CHARACTERISTIC CIL_SpdVeh_P "Vehicle speed" VALUE 0x200193D0 Scalar_FLOAT32_IEEE 0 swc_CIL_CM_single_km_per_h -3.40282346639e+038 3.40282346639e+038 /end CHARACTERISTIC
/begin CHARACTERISTIC CIL_StCellTSamplgExcpn_P "Cell temperature sampling disconnection status:\n      0 No disconnection\n      1 Single disconnection\n      2 Multiple disconnections" VALUE 0x20019C8D Scalar_UBYTE 0 swc_CIL_CM_uint8_dash_ 0 255 /end CHARACTERISTIC
/begin CHARACTERISTIC CIL_StCellUSamplgExcpn_P "Cell voltage sampling disconnection status:\n      0 No disconnection\n      1 Single disconnection\n      2 Multiple disconnections" VALUE 0x20019C8E Scalar_UBYTE 0 swc_CIL_CM_uint8_dash_ 0 255 /end CHARACTERISTIC
/begin CHARACTERISTIC CIL_StChWup_P "Low voltage auxiliary power positive pole status (0x0: off 0x1: on)" VALUE 0x20019C90 Scalar_UBYTE 0 swc_CIL_CM_uint8_dash_ 0 255 /end CHARACTERISTIC
/begin CHARACTERISTIC CIL_StCrash_P "Crash output status indicated by ACU" VALUE 0x20019C91 Scalar_UBYTE 0 swc_CIL_CM_uint8_dash_ 0 255 /end CHARACTERISTIC
/begin CHARACTERISTIC CIL_StMsgToutForPMS_P "PMS CAN message timeout flag (0x0: no timeout 0x1: timeout)" VALUE 0x20019C92 Scalar_UBYTE 0 swc_CIL_CM_uint8_dash_ 0 255 /end CHARACTERISTIC
/begin CHARACTERISTIC CIL_StTrml15_P "KL15 state (0x0: off 0x1: on)" VALUE 0x20019C96 Scalar_UBYTE 0 swc_CIL_CM_uint8_dash_ 0 255 /end CHARACTERISTIC
/begin CHARACTERISTIC CIL_TAcChPointNeg_P "Slow charging port negative contact temperature" VALUE 0x200193D4 Scalar_FLOAT32_IEEE 0 swc_CIL_CM_single__ -3.40282346639e+038 3.40282346639e+038 /end CHARACTERISTIC
/begin CHARACTERISTIC CIL_TAcChPointPos_P "Slow charging port positive contact temperature" VALUE 0x200193D8 Scalar_FLOAT32_IEEE 0 swc_CIL_CM_single__ -3.40282346639e+038 3.40282346639e+038 /end CHARACTERISTIC
/begin CHARACTERISTIC CIL_TDcChPointNeg_P "Fast charging port negative contact temperature" VALUE 0x20019400 Scalar_FLOAT32_IEEE 0 swc_CIL_CM_single__ -3.40282346639e+038 3.40282346639e+038 /end CHARACTERISTIC
/begin CHARACTERISTIC CIL_TDcChPointPos_P "Fast charging port positive contact temperature" VALUE 0x20019404 Scalar_FLOAT32_IEEE 0 swc_CIL_CM_single__ -3.40282346639e+038 3.40282346639e+038 /end CHARACTERISTIC
/begin CHARACTERISTIC CIL_TSnsrI_P "Current sensor temperature" VALUE 0x20019BF6 Scalar_SWORD 0 swc_CIL_CM_int16__ -32768 32767 /end CHARACTERISTIC
/begin CHARACTERISTIC CIL_TiProc_P "Scheduling cycle of CIL" VALUE 0x20019560 Scalar_FLOAT32_IEEE 0 swc_CIL_CM_single_dash_ -3.40282346639e+038 3.40282346639e+038 /end CHARACTERISTIC
/begin CHARACTERISTIC CIL_TiSysRun_P "System runtime" VALUE 0x20019564 Scalar_ULONG 0 swc_CIL_CM_uint32_ms 0 4294967295 /end CHARACTERISTIC
/begin CHARACTERISTIC CIL_UChPoleHiSideDrv_P "High side drive voltage of  fast charge relay" VALUE 0x20019568 Scalar_FLOAT32_IEEE 0 swc_CIL_CM_single_V -3.40282346639e+038 3.40282346639e+038 /end CHARACTERISTIC
/begin CHARACTERISTIC CIL_UHeatPoleHiSideDrv_P "High side drive voltage of  heat relay" VALUE 0x20019574 Scalar_FLOAT32_IEEE 0 swc_CIL_CM_single_V -3.40282346639e+038 3.40282346639e+038 /end CHARACTERISTIC
/begin CHARACTERISTIC CIL_UMainNegPoleAftRly_P "Pole voltage after Main negative relay" VALUE 0x20019578 Scalar_FLOAT32_IEEE 0 swc_CIL_CM_single_V -3.40282346639e+038 3.40282346639e+038 /end CHARACTERISTIC
/begin CHARACTERISTIC CIL_UMainNegPoleHiSideDrv_P "High side drive voltage of  main negative relay" VALUE 0x2001957C Scalar_FLOAT32_IEEE 0 swc_CIL_CM_single_V -3.40282346639e+038 3.40282346639e+038 /end CHARACTERISTIC
/begin CHARACTERISTIC CIL_UMainPosPoleAftRly_P "Main positive pole voltage after relay" VALUE 0x20019580 Scalar_FLOAT32_IEEE 0 swc_CIL_CM_single_V -3.40282346639e+038 3.40282346639e+038 /end CHARACTERISTIC
/begin CHARACTERISTIC CIL_UMainPosPoleBefRly_P "Main positive pole voltage before relay" VALUE 0x20019584 Scalar_FLOAT32_IEEE 0 swc_CIL_CM_single_V -3.40282346639e+038 3.40282346639e+038 /end CHARACTERISTIC
/begin CHARACTERISTIC CIL_UMainPosPoleHiSideDrv_P "High side drive voltage of  main positive relay" VALUE 0x20019588 Scalar_FLOAT32_IEEE 0 swc_CIL_CM_single_V -3.40282346639e+038 3.40282346639e+038 /end CHARACTERISTIC
/begin CHARACTERISTIC CIL_UPoleAftRlyCh_P "Pole voltage after charge relay" VALUE 0x20019594 Scalar_FLOAT32_IEEE 0 swc_CIL_CM_single_V -3.40282346639e+038 3.40282346639e+038 /end CHARACTERISTIC
/begin CHARACTERISTIC CIL_UPoleAftRlyHeat_P "Pole voltage after heat relay" VALUE 0x20019598 Scalar_FLOAT32_IEEE 0 swc_CIL_CM_single_V -3.40282346639e+038 3.40282346639e+038 /end CHARACTERISTIC
/begin CHARACTERISTIC CIL_URlyPrechHiSideDrv_P "High side drive voltage of pre charging relay" VALUE 0x2001959C Scalar_FLOAT32_IEEE 0 swc_CIL_CM_single_V -3.40282346639e+038 3.40282346639e+038 /end CHARACTERISTIC
/begin CHARACTERISTIC CIL_UThdForStChWup_P "Voltage threshold for Low voltage auxiliary power positive pole status" VALUE 0x200195A0 Scalar_FLOAT32_IEEE 0 swc_CIL_CM_single_V -3.40282346639e+038 3.40282346639e+038 /end CHARACTERISTIC
/begin CHARACTERISTIC CIL_UThdForTrml15_P "Voltage threshold for KL15" VALUE 0x200195A4 Scalar_FLOAT32_IEEE 0 swc_CIL_CM_single_V -3.40282346639e+038 3.40282346639e+038 /end CHARACTERISTIC
/begin CHARACTERISTIC CIL_UTrml30_P "KL30 voltage" VALUE 0x200195A8 Scalar_FLOAT32_IEEE 0 swc_CIL_CM_single_V -3.40282346639e+038 3.40282346639e+038 /end CHARACTERISTIC
/begin CHARACTERISTIC CIL_YearRtc_P "Real time clock - year" VALUE 0x20019BF8 Scalar_UWORD 0 swc_CIL_CM_uint16_year 0 65535 /end CHARACTERISTIC
/begin CHARACTERISTIC CIL_bRdyBswStoreFnshd_P "The sign that the basic software has finished storing data" VALUE 0x20019C97 Scalar_UBYTE 0 swc_CIL_CM_uint8_dash_ 0 255 /end CHARACTERISTIC
/begin CHARACTERISTIC CIL_bVldBatIHv_P "HV battery current sampling valid flag:\n      0 Sampling not ready\n      1 Sampling ready" VALUE 0x20019CB1 Scalar_BOOLEAN 0 swc_CIL_CM_boolean_dash_ 0 1 /end CHARACTERISTIC
/begin CHARACTERISTIC CIL_bVldCellTSamplg_P "Cell temperature sampling valid flag:\n      0 Sampling not ready\n      1 Sampling ready\n      " VALUE 0x20019C98 Scalar_UBYTE 0 swc_CIL_CM_uint8_dash_ 0 255 /end CHARACTERISTIC
/begin CHARACTERISTIC CIL_bVldCellUSamplg_P "Cell voltage sampling valid flag:\n      0 Sampling not ready\n      1 Sampling ready\n      \n      " VALUE 0x20019C99 Scalar_UBYTE 0 swc_CIL_CM_uint8_dash_ 0 255 /end CHARACTERISTIC
/begin CHARACTERISTIC CIL_bVldIslnR_P "Insulation resistance value sampling valid flag:\n      0 Sampling not ready\n      1 Sampling ready" VALUE 0x20019C9A Scalar_UBYTE 0 swc_CIL_CM_uint8_dash_ 0 255 /end CHARACTERISTIC
/begin CHARACTERISTIC CIL_bVldUMainNegPoleAftRly_P "Pole voltage after main negative relay sampling valid flag:\n      0 Sampling not ready\n      1 Sampling ready" VALUE 0x20019C9B Scalar_UBYTE 0 swc_CIL_CM_uint8_dash_ 0 255 /end CHARACTERISTIC
/begin CHARACTERISTIC CIL_bVldUMainPosPoleAftRly_P "Main positive pole voltage after relay sampling valid flag:\n      0 Sampling not ready\n      1 Sampling ready" VALUE 0x20019C9C Scalar_UBYTE 0 swc_CIL_CM_uint8_dash_ 0 255 /end CHARACTERISTIC
/begin CHARACTERISTIC CIL_bVldUMainPosPoleBefRly_P "Main positive pole voltage before relay sampling valid flag:\n      0 Sampling not ready\n      1 Sampling ready\n      \n      \n      " VALUE 0x20019C9D Scalar_UBYTE 0 swc_CIL_CM_uint8_dash_ 0 255 /end CHARACTERISTIC
/begin CHARACTERISTIC CIL_bVldUPoleAftRlyCh_P "Pole voltage after charge relay sampling valid flag:\n      0 Sampling not ready\n      1 Sampling ready" VALUE 0x20019C9E Scalar_UBYTE 0 swc_CIL_CM_uint8_dash_ 0 255 /end CHARACTERISTIC
/begin CHARACTERISTIC CIL_bVldUPoleAftRlyHeat_P "Pole voltage after heat relay sampling valid flag:\n      0 Sampling not ready\n      1 Sampling ready" VALUE 0x20019C9F Scalar_UBYTE 0 swc_CIL_CM_uint8_dash_ 0 255 /end CHARACTERISTIC
/begin CHARACTERISTIC COL_Csw2_P "Code word 1 for activation of replacement values" VALUE 0x200196B0 Scalar_ULONG 0 swc_COL_CM_uint32_dash_ 0 4294967295 /end CHARACTERISTIC
/begin CHARACTERISTIC COL_Csw3_P "Code word 1 for activation of replacement values" VALUE 0x200196B4 Scalar_ULONG 0 swc_COL_CM_uint32_dash_ 0 4294967295 /end CHARACTERISTIC
/begin CHARACTERISTIC COL_Csw4_P "Code word 1 for activation of replacement values" VALUE 0x200196B8 Scalar_ULONG 0 swc_COL_CM_uint32_dash_ 0 4294967295 /end CHARACTERISTIC
/begin CHARACTERISTIC COL_Csw5_P "Code word 1 for activation of replacement values" VALUE 0x200196BC Scalar_ULONG 0 swc_COL_CM_uint32_dash_ 0 4294967295 /end CHARACTERISTIC
/begin CHARACTERISTIC CurrentChargeState_P "BCS: Current state of charge" VALUE 0x200196C4 Scalar_FLOAT32_IEEE 0 swc_COL_CM_single_percent_ 0 255 /end CHARACTERISTIC
/begin CHARACTERISTIC CurrentVehicleBatteryVoltage_P "BCP: The current battery voltage of the vehicle power battery" VALUE 0x200196CC Scalar_FLOAT32_IEEE 0 swc_COL_CM_single_V 0 65535 /end CHARACTERISTIC
/begin CHARACTERISTIC ELHPN_CfgDiag191_P "Configuration for DTC191." VALUE 0x20019D86 Scalar_BOOLEAN 0 swc_EltlLnkHzrdProtnNet_CM_boolean_dash_ 0 1 /end CHARACTERISTIC
/begin CHARACTERISTIC EVCSH_FacTi_P "Number of Ticks (10ms sampling time)" VALUE 0x20017C24 Scalar_FLOAT32_IEEE 0 swc_BatChCtl_CM_single_dash_ -3.40282346639e+038 3.40282346639e+038 /end CHARACTERISTIC
/begin CHARACTERISTIC EVCSH_NrDcChCom_P "Number of DC charging communication version" VALUE 0x20019C2E Scalar_UBYTE 0 swc_BatChCtl_CM_uint8_dash_ 0 255 /end CHARACTERISTIC
/begin CHARACTERISTIC EstimatedRemainingChargingTime_P "BCS: Estimate the remaining charging time" VALUE 0x200196D0 Scalar_FLOAT32_IEEE 0 swc_COL_CM_single_min 0 65535 /end CHARACTERISTIC
/begin CHARACTERISTIC MCC_StMdulCu_P "State of the module control units (CMCs)." VALUE 0x20019CA3 Scalar_UBYTE 0 swc_CIL_CM_uint8_dash_ 0 255 /end CHARACTERISTIC
/begin CHARACTERISTIC MaxChargingVoltage_P "BHM: Maximum allowable total charging voltage" VALUE 0x200196D4 Scalar_FLOAT32_IEEE 0 swc_COL_CM_single_V 0 65535 /end CHARACTERISTIC
/begin CHARACTERISTIC MaxPermChargingCurrent_P "BCP: Maximum allowable charging current" VALUE 0x200196D8 Scalar_FLOAT32_IEEE 0 swc_COL_CM_single_A 0 65535 /end CHARACTERISTIC
/begin CHARACTERISTIC MaxPermTemperature_P "BCP: Maximum permissible temperature" VALUE 0x200196DC Scalar_FLOAT32_IEEE 0 swc_COL_CM_single_A 0 255 /end CHARACTERISTIC
/begin CHARACTERISTIC MaxSingleBattChargingVoltage_P "BCP: The maximum allowable charging voltage of a single power battery" VALUE 0x200196E0 Scalar_FLOAT32_IEEE 0 swc_COL_CM_single_V 0 65535 /end CHARACTERISTIC
/begin CHARACTERISTIC MeasuredChargingCurrent_P "BCS: Charge (discharge) current measurement" VALUE 0x200196E4 Scalar_FLOAT32_IEEE 0 swc_COL_CM_single_A 0 65535 /end CHARACTERISTIC
/begin CHARACTERISTIC MeasuredChargingVoltage_P "BCS: Charging (discharging) voltage measurements" VALUE 0x200196E8 Scalar_FLOAT32_IEEE 0 swc_COL_CM_single_V 0 65535 /end CHARACTERISTIC
/begin CHARACTERISTIC SingleBatteryHighestVoltageGroup_P "BCS: The highest single power battery voltage and its group number" VALUE 0x20019D2C Scalar_UBYTE 0 swc_COL_CM_uint8_dash_ 0 255 /end CHARACTERISTIC
/begin CHARACTERISTIC SingleBatteryHighestVoltageSerNo_P "BSM: The number of the highest single power battery voltage" VALUE 0x20019D2D Scalar_UBYTE 0 swc_COL_CM_uint8_dash_ 0 255 /end CHARACTERISTIC
/begin CHARACTERISTIC SingleBatteryHighestVoltage_P "BCS: Maximum monomer power battery voltage" VALUE 0x200196EC Scalar_FLOAT32_IEEE 0 swc_COL_CM_single_V 0 65535 /end CHARACTERISTIC
/begin CHARACTERISTIC SingleBatteryMaxTemperature_P "BSD: Maximum temperature of the power battery" VALUE 0x200196F0 Scalar_FLOAT32_IEEE 0 swc_COL_CM_single___C 0 255 /end CHARACTERISTIC
/begin CHARACTERISTIC SingleBatteryMaxVoltage_P "BSD: The highest voltage of the power battery unit" VALUE 0x200196F4 Scalar_FLOAT32_IEEE 0 swc_COL_CM_single_V 0 65535 /end CHARACTERISTIC
/begin CHARACTERISTIC SingleBatteryMinTemperature_P "BSD: Minimum temperature of the power battery" VALUE 0x200196F8 Scalar_FLOAT32_IEEE 0 swc_COL_CM_single___C 0 255 /end CHARACTERISTIC
/begin CHARACTERISTIC SingleBatteryMinVoltage_P "BSD: The lowest voltage of the power battery unit" VALUE 0x200196FC Scalar_FLOAT32_IEEE 0 swc_COL_CM_single_V 0 65535 /end CHARACTERISTIC
/begin CHARACTERISTIC SingleBatteryUnusualVoltage_P "BSM: The voltage of the single power battery is too high/too low" VALUE 0x20019D2E Scalar_UBYTE 0 swc_COL_CM_uint8_dash_ 0 255 /end CHARACTERISTIC
/begin CHARACTERISTIC StatusVehiclePowerStorageBattery_P "BCP: the state of charge of the vehicle power battery" VALUE 0x20019C1E Scalar_UWORD 0 swc_COL_CM_uint16_percent_ 0 65535 /end CHARACTERISTIC
/begin CHARACTERISTIC SuspendStateOfChargeSOC_P "BSD: Abort State of Charge SOC" VALUE 0x20019700 Scalar_FLOAT32_IEEE 0 swc_COL_CM_single_percent_ 0 255 /end CHARACTERISTIC
/begin CHARACTERISTIC Timeout_CCS_P "BEM: ccs timeout" VALUE 0x20019D2F Scalar_UBYTE 0 swc_COL_CM_uint8_dash_ 0 255 /end CHARACTERISTIC
/begin CHARACTERISTIC Timeout_CRM_Recognized_P "BEM" VALUE 0x20019D30 Scalar_UBYTE 0 swc_COL_CM_uint8_dash_ 0 255 /end CHARACTERISTIC
/begin CHARACTERISTIC Timeout_CRM_Unrecognized_P "BEM" VALUE 0x20019D31 Scalar_UBYTE 0 swc_COL_CM_uint8_dash_ 0 255 /end CHARACTERISTIC
/begin CHARACTERISTIC Timeout_CRO_P "BEM" VALUE 0x20019D32 Scalar_UBYTE 0 swc_COL_CM_uint8_dash_ 0 255 /end CHARACTERISTIC
/begin CHARACTERISTIC Timeout_CSD_P "BEM" VALUE 0x20019D33 Scalar_UBYTE 0 swc_COL_CM_uint8_dash_ 0 255 /end CHARACTERISTIC
/begin CHARACTERISTIC Timeout_CST_P "BEM" VALUE 0x20019D34 Scalar_UBYTE 0 swc_COL_CM_uint8_dash_ 0 255 /end CHARACTERISTIC
/begin CHARACTERISTIC Timeout_CTS_CML_P "BEM" VALUE 0x20019D35 Scalar_UBYTE 0 swc_COL_CM_uint8_dash_ 0 255 /end CHARACTERISTIC
/begin CHARACTERISTIC TotalMaxPermChargingVoltage_P "BCP: Maximum allowable total charging voltage" VALUE 0x20019704 Scalar_FLOAT32_IEEE 0 swc_COL_CM_single_V 0 65535 /end CHARACTERISTIC
/begin CHARACTERISTIC TotalNominalEnergy_P "BCP: The nominal total energy of the power battery" VALUE 0x20019C20 Scalar_UWORD 0 swc_COL_CM_uint16_kWh 0 65535 /end CHARACTERISTIC
/begin CHARACTERISTIC VehicleBatteryUnusualChargeState_P "VehicleBatteryUnusualChargeState" VALUE 0x20019D36 Scalar_UBYTE 0 swc_COL_CM_uint8_dash_ 0 255 /end CHARACTERISTIC
/begin GROUP S250_BMS_HeatPosRelayFault_Reserved_P "swc_COL/COL_100ms_sys/COL_100ms_sys/BMS_HeatPosRelayFault_Reserved_P" /begin REF_CHARACTERISTIC BMS_HeatPosRelayFault_Reserved_P /end REF_CHARACTERISTIC /end GROUP
/begin GROUP S250_BMS_HeatRelaySts_P "swc_COL/COL_100ms_sys/COL_100ms_sys/BMS_HeatRelaySts_P" /begin REF_CHARACTERISTIC BMS_HeatRelaySts_P /end REF_CHARACTERISTIC /end GROUP
/begin GROUP S250_BMS_HVIsolationSts_P "swc_COL/COL_100ms_sys/COL_100ms_sys/BMS_HVIsolationSts_P" /begin REF_CHARACTERISTIC BMS_HVIsolationSts_P /end REF_CHARACTERISTIC /end GROUP
/begin GROUP S250_BMS_IsolationFault_P "swc_COL/COL_100ms_sys/COL_100ms_sys/BMS_IsolationFault_P" /begin REF_CHARACTERISTIC BMS_IsolationFault_P /end REF_CHARACTERISTIC /end GROUP
/begin GROUP S250_BMS_MaxChgCurrent_P "swc_COL/COL_100ms_sys/COL_100ms_sys/BMS_MaxChgCurrent_P" /begin REF_CHARACTERISTIC BMS_MaxChgCurrent_P /end REF_CHARACTERISTIC /end GROUP
/begin GROUP S250_BMS_MaxChgVoltage_P "swc_COL/COL_100ms_sys/COL_100ms_sys/BMS_MaxChgVoltage_P" /begin REF_CHARACTERISTIC BMS_MaxChgVoltage_P /end REF_CHARACTERISTIC /end GROUP
/begin GROUP S250_BMS_MILTelltale_P "swc_COL/COL_100ms_sys/COL_100ms_sys/BMS_MILTelltale_P" /begin REF_CHARACTERISTIC BMS_MILTelltale_P /end REF_CHARACTERISTIC /end GROUP
/begin GROUP S250_BMS_NegIsolationRes_P "swc_COL/COL_100ms_sys/COL_100ms_sys/BMS_NegIsolationRes_P" /begin REF_CHARACTERISTIC BMS_NegIsolationRes_P /end REF_CHARACTERISTIC /end GROUP
/begin GROUP S250_BMS_OBCChgContrlCmd_P "swc_COL/COL_100ms_sys/COL_100ms_sys/BMS_OBCChgContrlCmd_P" /begin REF_CHARACTERISTIC BMS_OBCChgContrlCmd_P /end REF_CHARACTERISTIC /end GROUP
/begin GROUP S250_BMS_PosIsolationRes_P "swc_COL/COL_100ms_sys/COL_100ms_sys/BMS_PosIsolationRes_P" /begin REF_CHARACTERISTIC BMS_PosIsolationRes_P /end REF_CHARACTERISTIC /end GROUP
/begin GROUP S250_BMS_PTCConnStsFb_P "swc_COL/COL_100ms_sys/COL_100ms_sys/BMS_PTCConnStsFb_P" /begin REF_CHARACTERISTIC BMS_PTCConnStsFb_P /end REF_CHARACTERISTIC /end GROUP
/begin GROUP S250_BMS_RelayInfo_BMS_HVLoopWorkSts_P "swc_COL/COL_100ms_sys/COL_100ms_sys/BMS_RelayInfo_BMS_HVLoopWorkSts_P" /begin REF_CHARACTERISTIC BMS_HVLoopWorkSts_P /end REF_CHARACTERISTIC /end GROUP
/begin GROUP S250_BMS_RelayInfo_BMS_MainPosConnSts_P "swc_COL/COL_100ms_sys/COL_100ms_sys/BMS_RelayInfo_BMS_MainPosConnSts_P" /begin REF_CHARACTERISTIC BMS_MainPosConnSts_P /end REF_CHARACTERISTIC /end GROUP
/begin GROUP S250_BMS_RelayInfo_BMS_PreChgConnSts_P "swc_COL/COL_100ms_sys/COL_100ms_sys/BMS_RelayInfo_BMS_PreChgConnSts_P" /begin REF_CHARACTERISTIC BMS_PreChgConnSts_P /end REF_CHARACTERISTIC /end GROUP
/begin GROUP S250_BMS_RelayInfo_BMS_PreChgRelayFlt_P "swc_COL/COL_100ms_sys/COL_100ms_sys/BMS_RelayInfo_BMS_PreChgRelayFlt_P" /begin REF_CHARACTERISTIC BMS_PreChgRelayFlt_P /end REF_CHARACTERISTIC /end GROUP
/begin GROUP S250_BMS_SetTgtTemp_P "swc_COL/COL_100ms_sys/COL_100ms_sys/BMS_SetTgtTemp_P" /begin REF_CHARACTERISTIC BMS_SetTgtTemp_P /end REF_CHARACTERISTIC /end GROUP
/begin GROUP S250_BMS_SOC1_P "swc_COL/COL_100ms_sys/COL_100ms_sys/BMS_SOC1_P" /begin REF_CHARACTERISTIC BMS_SOC1_P /end REF_CHARACTERISTIC /end GROUP
/begin GROUP S250_BMS_SOCJumpFault_P "swc_COL/COL_100ms_sys/COL_100ms_sys/BMS_SOCJumpFault_P" /begin REF_CHARACTERISTIC BMS_SOCJumpFault_P /end REF_CHARACTERISTIC /end GROUP
/begin GROUP S250_BMS_ST1_Flt_HVIL_P "swc_COL/COL_100ms_sys/COL_100ms_sys/BMS_ST1_Flt_HVIL_P" /begin REF_CHARACTERISTIC BMS_ST1_Flt_HVIL_P /end REF_CHARACTERISTIC /end GROUP
/begin GROUP S250_BMS_TempOutofCtr_P "swc_COL/COL_100ms_sys/COL_100ms_sys/BMS_TempOutofCtr_P" /begin REF_CHARACTERISTIC BMS_TempOutofCtr_P /end REF_CHARACTERISTIC /end GROUP
/begin GROUP S250_BMS_TempSnsNum_P "swc_COL/COL_100ms_sys/COL_100ms_sys/BMS_TempSnsNum_P" /begin REF_CHARACTERISTIC BMS_TempSnsNum_P /end REF_CHARACTERISTIC /end GROUP
/begin GROUP S250_BmsReadyForCharging_P "swc_COL/COL_100ms_sys/COL_100ms_sys/BmsReadyForCharging_P" /begin REF_CHARACTERISTIC BmsReadyForCharging_P /end REF_CHARACTERISTIC /end GROUP
/begin GROUP S250_BmsRevision_P "swc_COL/COL_100ms_sys/COL_100ms_sys/BmsRevision_P" /begin REF_CHARACTERISTIC BmsRevision_P /end REF_CHARACTERISTIC /end GROUP
/begin GROUP S250_BmsVersion_P "swc_COL/COL_100ms_sys/COL_100ms_sys/BmsVersion_P" /begin REF_CHARACTERISTIC BmsVersion_P /end REF_CHARACTERISTIC /end GROUP
/begin GROUP S250_BsmChargingPermissible_P "swc_COL/COL_100ms_sys/COL_100ms_sys/BsmChargingPermissible_P" /begin REF_CHARACTERISTIC BsmChargingPermissible_P /end REF_CHARACTERISTIC /end GROUP
/begin GROUP S250_CurrentChargeState_P "swc_COL/COL_100ms_sys/COL_100ms_sys/CurrentChargeState_P" /begin REF_CHARACTERISTIC CurrentChargeState_P /end REF_CHARACTERISTIC /end GROUP
/begin GROUP S250_CurrentVehicleBatteryVoltage_P "swc_COL/COL_100ms_sys/COL_100ms_sys/CurrentVehicleBatteryVoltage_P" /begin REF_CHARACTERISTIC CurrentVehicleBatteryVoltage_P /end REF_CHARACTERISTIC /end GROUP
/begin GROUP S250_DTRC_Csw_P_1 "swc_COL/COL_100ms_sys/COL_100ms_sys/DTRC_Csw_P.1" /begin REF_CHARACTERISTIC COL_Csw2_P /end REF_CHARACTERISTIC /end GROUP
/begin GROUP S250_DTRC_Csw_P_10 "swc_COL/COL_100ms_sys/COL_100ms_sys/DTRC_Csw_P.10" /begin REF_CHARACTERISTIC COL_Csw2_P /end REF_CHARACTERISTIC /end GROUP
/begin GROUP S250_DTRC_Csw_P_102 "swc_COL/COL_100ms_sys/COL_100ms_sys/DTRC_Csw_P.102" /begin REF_CHARACTERISTIC COL_Csw2_P /end REF_CHARACTERISTIC /end GROUP
/begin GROUP S250_DTRC_Csw_P_104 "swc_COL/COL_100ms_sys/COL_100ms_sys/DTRC_Csw_P.104" /begin REF_CHARACTERISTIC COL_Csw2_P /end REF_CHARACTERISTIC /end GROUP
/begin GROUP S250_DTRC_Csw_P_105 "swc_COL/COL_100ms_sys/COL_100ms_sys/DTRC_Csw_P.105" /begin REF_CHARACTERISTIC COL_Csw2_P /end REF_CHARACTERISTIC /end GROUP
/begin GROUP S250_DTRC_Csw_P_106 "swc_COL/COL_100ms_sys/COL_100ms_sys/DTRC_Csw_P.106" /begin REF_CHARACTERISTIC COL_Csw3_P /end REF_CHARACTERISTIC /end GROUP
/begin GROUP S250_DTRC_Csw_P_107 "swc_COL/COL_100ms_sys/COL_100ms_sys/DTRC_Csw_P.107" /begin REF_CHARACTERISTIC COL_Csw3_P /end REF_CHARACTERISTIC /end GROUP
/begin GROUP S250_DTRC_Csw_P_108 "swc_COL/COL_100ms_sys/COL_100ms_sys/DTRC_Csw_P.108" /begin REF_CHARACTERISTIC COL_Csw3_P /end REF_CHARACTERISTIC /end GROUP
/begin GROUP S250_DTRC_Csw_P_11 "swc_COL/COL_100ms_sys/COL_100ms_sys/DTRC_Csw_P.11" /begin REF_CHARACTERISTIC COL_Csw2_P /end REF_CHARACTERISTIC /end GROUP
/begin GROUP S250_DTRC_Csw_P_111 "swc_COL/COL_100ms_sys/COL_100ms_sys/DTRC_Csw_P.111" /begin REF_CHARACTERISTIC COL_Csw2_P /end REF_CHARACTERISTIC /end GROUP
/begin GROUP S250_DTRC_Csw_P_113 "swc_COL/COL_100ms_sys/COL_100ms_sys/DTRC_Csw_P.113" /begin REF_CHARACTERISTIC COL_Csw3_P /end REF_CHARACTERISTIC /end GROUP
/begin GROUP S250_DTRC_Csw_P_114 "swc_COL/COL_100ms_sys/COL_100ms_sys/DTRC_Csw_P.114" /begin REF_CHARACTERISTIC COL_Csw3_P /end REF_CHARACTERISTIC /end GROUP
/begin GROUP S250_DTRC_Csw_P_115 "swc_COL/COL_100ms_sys/COL_100ms_sys/DTRC_Csw_P.115" /begin REF_CHARACTERISTIC COL_Csw3_P /end REF_CHARACTERISTIC /end GROUP
/begin GROUP S250_DTRC_Csw_P_116 "swc_COL/COL_100ms_sys/COL_100ms_sys/DTRC_Csw_P.116" /begin REF_CHARACTERISTIC COL_Csw3_P /end REF_CHARACTERISTIC /end GROUP
/begin GROUP S250_DTRC_Csw_P_117 "swc_COL/COL_100ms_sys/COL_100ms_sys/DTRC_Csw_P.117" /begin REF_CHARACTERISTIC COL_Csw3_P /end REF_CHARACTERISTIC /end GROUP
/begin GROUP S250_DTRC_Csw_P_118 "swc_COL/COL_100ms_sys/COL_100ms_sys/DTRC_Csw_P.118" /begin REF_CHARACTERISTIC COL_Csw3_P /end REF_CHARACTERISTIC /end GROUP
/begin GROUP S250_DTRC_Csw_P_12 "swc_COL/COL_100ms_sys/COL_100ms_sys/DTRC_Csw_P.12" /begin REF_CHARACTERISTIC COL_Csw2_P /end REF_CHARACTERISTIC /end GROUP
/begin GROUP S250_DTRC_Csw_P_13 "swc_COL/COL_100ms_sys/COL_100ms_sys/DTRC_Csw_P.13" /begin REF_CHARACTERISTIC COL_Csw2_P /end REF_CHARACTERISTIC /end GROUP
/begin GROUP S250_DTRC_Csw_P_136 "swc_COL/COL_100ms_sys/COL_100ms_sys/DTRC_Csw_P.136" /begin REF_CHARACTERISTIC COL_Csw4_P /end REF_CHARACTERISTIC /end GROUP
/begin GROUP S250_DTRC_Csw_P_137 "swc_COL/COL_100ms_sys/COL_100ms_sys/DTRC_Csw_P.137" /begin REF_CHARACTERISTIC COL_Csw4_P /end REF_CHARACTERISTIC /end GROUP
/begin GROUP S250_DTRC_Csw_P_138 "swc_COL/COL_100ms_sys/COL_100ms_sys/DTRC_Csw_P.138" /begin REF_CHARACTERISTIC COL_Csw4_P /end REF_CHARACTERISTIC /end GROUP
/begin GROUP S250_DTRC_Csw_P_139 "swc_COL/COL_100ms_sys/COL_100ms_sys/DTRC_Csw_P.139" /begin REF_CHARACTERISTIC COL_Csw4_P /end REF_CHARACTERISTIC /end GROUP
/begin GROUP S250_DTRC_Csw_P_140 "swc_COL/COL_100ms_sys/COL_100ms_sys/DTRC_Csw_P.140" /begin REF_CHARACTERISTIC COL_Csw4_P /end REF_CHARACTERISTIC /end GROUP
/begin GROUP S250_DTRC_Csw_P_141 "swc_COL/COL_100ms_sys/COL_100ms_sys/DTRC_Csw_P.141" /begin REF_CHARACTERISTIC COL_Csw4_P /end REF_CHARACTERISTIC /end GROUP
/begin GROUP S250_DTRC_Csw_P_142 "swc_COL/COL_100ms_sys/COL_100ms_sys/DTRC_Csw_P.142" /begin REF_CHARACTERISTIC COL_Csw4_P /end REF_CHARACTERISTIC /end GROUP
/begin GROUP S250_DTRC_Csw_P_143 "swc_COL/COL_100ms_sys/COL_100ms_sys/DTRC_Csw_P.143" /begin REF_CHARACTERISTIC COL_Csw4_P /end REF_CHARACTERISTIC /end GROUP
/begin GROUP S250_DTRC_Csw_P_144 "swc_COL/COL_100ms_sys/COL_100ms_sys/DTRC_Csw_P.144" /begin REF_CHARACTERISTIC COL_Csw4_P /end REF_CHARACTERISTIC /end GROUP
/begin GROUP S250_DTRC_Csw_P_145 "swc_COL/COL_100ms_sys/COL_100ms_sys/DTRC_Csw_P.145" /begin REF_CHARACTERISTIC COL_Csw4_P /end REF_CHARACTERISTIC /end GROUP
/begin GROUP S250_DTRC_Csw_P_146 "swc_COL/COL_100ms_sys/COL_100ms_sys/DTRC_Csw_P.146" /begin REF_CHARACTERISTIC COL_Csw4_P /end REF_CHARACTERISTIC /end GROUP
/begin GROUP S250_DTRC_Csw_P_147 "swc_COL/COL_100ms_sys/COL_100ms_sys/DTRC_Csw_P.147" /begin REF_CHARACTERISTIC COL_Csw4_P /end REF_CHARACTERISTIC /end GROUP
/begin GROUP S250_DTRC_Csw_P_148 "swc_COL/COL_100ms_sys/COL_100ms_sys/DTRC_Csw_P.148" /begin REF_CHARACTERISTIC COL_Csw4_P /end REF_CHARACTERISTIC /end GROUP
/begin GROUP S250_DTRC_Csw_P_149 "swc_COL/COL_100ms_sys/COL_100ms_sys/DTRC_Csw_P.149" /begin REF_CHARACTERISTIC COL_Csw4_P /end REF_CHARACTERISTIC /end GROUP
/begin GROUP S250_DTRC_Csw_P_150 "swc_COL/COL_100ms_sys/COL_100ms_sys/DTRC_Csw_P.150" /begin REF_CHARACTERISTIC COL_Csw4_P /end REF_CHARACTERISTIC /end GROUP
/begin GROUP S250_DTRC_Csw_P_151 "swc_COL/COL_100ms_sys/COL_100ms_sys/DTRC_Csw_P.151" /begin REF_CHARACTERISTIC COL_Csw4_P /end REF_CHARACTERISTIC /end GROUP
/begin GROUP S250_DTRC_Csw_P_152 "swc_COL/COL_100ms_sys/COL_100ms_sys/DTRC_Csw_P.152" /begin REF_CHARACTERISTIC COL_Csw4_P /end REF_CHARACTERISTIC /end GROUP
/begin GROUP S250_DTRC_Csw_P_153 "swc_COL/COL_100ms_sys/COL_100ms_sys/DTRC_Csw_P.153" /begin REF_CHARACTERISTIC COL_Csw4_P /end REF_CHARACTERISTIC /end GROUP
/begin GROUP S250_DTRC_Csw_P_154 "swc_COL/COL_100ms_sys/COL_100ms_sys/DTRC_Csw_P.154" /begin REF_CHARACTERISTIC COL_Csw4_P /end REF_CHARACTERISTIC /end GROUP
/begin GROUP S250_DTRC_Csw_P_155 "swc_COL/COL_100ms_sys/COL_100ms_sys/DTRC_Csw_P.155" /begin REF_CHARACTERISTIC COL_Csw4_P /end REF_CHARACTERISTIC /end GROUP
/begin GROUP S250_DTRC_Csw_P_156 "swc_COL/COL_100ms_sys/COL_100ms_sys/DTRC_Csw_P.156" /begin REF_CHARACTERISTIC COL_Csw4_P /end REF_CHARACTERISTIC /end GROUP
/begin GROUP S250_DTRC_Csw_P_157 "swc_COL/COL_100ms_sys/COL_100ms_sys/DTRC_Csw_P.157" /begin REF_CHARACTERISTIC COL_Csw4_P /end REF_CHARACTERISTIC /end GROUP
/begin GROUP S250_DTRC_Csw_P_158 "swc_COL/COL_100ms_sys/COL_100ms_sys/DTRC_Csw_P.158" /begin REF_CHARACTERISTIC COL_Csw4_P /end REF_CHARACTERISTIC /end GROUP
/begin GROUP S250_DTRC_Csw_P_159 "swc_COL/COL_100ms_sys/COL_100ms_sys/DTRC_Csw_P.159" /begin REF_CHARACTERISTIC COL_Csw4_P /end REF_CHARACTERISTIC /end GROUP
/begin GROUP S250_DTRC_Csw_P_160 "swc_COL/COL_100ms_sys/COL_100ms_sys/DTRC_Csw_P.160" /begin REF_CHARACTERISTIC COL_Csw4_P /end REF_CHARACTERISTIC /end GROUP
/begin GROUP S250_DTRC_Csw_P_161 "swc_COL/COL_100ms_sys/COL_100ms_sys/DTRC_Csw_P.161" /begin REF_CHARACTERISTIC COL_Csw4_P /end REF_CHARACTERISTIC /end GROUP
/begin GROUP S250_DTRC_Csw_P_162 "swc_COL/COL_100ms_sys/COL_100ms_sys/DTRC_Csw_P.162" /begin REF_CHARACTERISTIC COL_Csw4_P /end REF_CHARACTERISTIC /end GROUP
/begin GROUP S250_DTRC_Csw_P_163 "swc_COL/COL_100ms_sys/COL_100ms_sys/DTRC_Csw_P.163" /begin REF_CHARACTERISTIC COL_Csw4_P /end REF_CHARACTERISTIC /end GROUP
/begin GROUP S250_DTRC_Csw_P_2 "swc_COL/COL_100ms_sys/COL_100ms_sys/DTRC_Csw_P.2" /begin REF_CHARACTERISTIC COL_Csw2_P /end REF_CHARACTERISTIC /end GROUP
/begin GROUP S250_DTRC_Csw_P_23 "swc_COL/COL_100ms_sys/COL_100ms_sys/DTRC_Csw_P.23" /begin REF_CHARACTERISTIC COL_Csw2_P /end REF_CHARACTERISTIC /end GROUP
/begin GROUP S250_DTRC_Csw_P_28 "swc_COL/COL_100ms_sys/COL_100ms_sys/DTRC_Csw_P.28" /begin REF_CHARACTERISTIC COL_Csw2_P /end REF_CHARACTERISTIC /end GROUP
/begin GROUP S250_DTRC_Csw_P_3 "swc_COL/COL_100ms_sys/COL_100ms_sys/DTRC_Csw_P.3" /begin REF_CHARACTERISTIC COL_Csw2_P /end REF_CHARACTERISTIC /end GROUP
/begin GROUP S250_DTRC_Csw_P_32 "swc_COL/COL_100ms_sys/COL_100ms_sys/DTRC_Csw_P.32" /begin REF_CHARACTERISTIC COL_Csw2_P /end REF_CHARACTERISTIC /end GROUP
/begin GROUP S250_DTRC_Csw_P_33 "swc_COL/COL_100ms_sys/COL_100ms_sys/DTRC_Csw_P.33" /begin REF_CHARACTERISTIC COL_Csw2_P /end REF_CHARACTERISTIC /end GROUP
/begin GROUP S250_DTRC_Csw_P_35 "swc_COL/COL_100ms_sys/COL_100ms_sys/DTRC_Csw_P.35" /begin REF_CHARACTERISTIC COL_Csw2_P /end REF_CHARACTERISTIC /end GROUP
/begin GROUP S250_DTRC_Csw_P_36 "swc_COL/COL_100ms_sys/COL_100ms_sys/DTRC_Csw_P.36" /begin REF_CHARACTERISTIC COL_Csw2_P /end REF_CHARACTERISTIC /end GROUP
/begin GROUP S250_DTRC_Csw_P_37 "swc_COL/COL_100ms_sys/COL_100ms_sys/DTRC_Csw_P.37" /begin REF_CHARACTERISTIC COL_Csw2_P /end REF_CHARACTERISTIC /end GROUP
/begin GROUP S250_DTRC_Csw_P_38 "swc_COL/COL_100ms_sys/COL_100ms_sys/DTRC_Csw_P.38" /begin REF_CHARACTERISTIC COL_Csw2_P /end REF_CHARACTERISTIC /end GROUP
/begin GROUP S250_DTRC_Csw_P_39 "swc_COL/COL_100ms_sys/COL_100ms_sys/DTRC_Csw_P.39" /begin REF_CHARACTERISTIC COL_Csw2_P /end REF_CHARACTERISTIC /end GROUP
/begin GROUP S250_DTRC_Csw_P_4 "swc_COL/COL_100ms_sys/COL_100ms_sys/DTRC_Csw_P.4" /begin REF_CHARACTERISTIC COL_Csw2_P /end REF_CHARACTERISTIC /end GROUP
/begin GROUP S250_DTRC_Csw_P_41 "swc_COL/COL_100ms_sys/COL_100ms_sys/DTRC_Csw_P.41" /begin REF_CHARACTERISTIC COL_Csw2_P /end REF_CHARACTERISTIC /end GROUP
/begin GROUP S250_DTRC_Csw_P_42 "swc_COL/COL_100ms_sys/COL_100ms_sys/DTRC_Csw_P.42" /begin REF_CHARACTERISTIC COL_Csw2_P /end REF_CHARACTERISTIC /end GROUP
/begin GROUP S250_DTRC_Csw_P_44 "swc_COL/COL_100ms_sys/COL_100ms_sys/DTRC_Csw_P.44" /begin REF_CHARACTERISTIC COL_Csw3_P /end REF_CHARACTERISTIC /end GROUP
/begin GROUP S250_DTRC_Csw_P_45 "swc_COL/COL_100ms_sys/COL_100ms_sys/DTRC_Csw_P.45" /begin REF_CHARACTERISTIC COL_Csw3_P /end REF_CHARACTERISTIC /end GROUP
/begin GROUP S250_DTRC_Csw_P_49 "swc_COL/COL_100ms_sys/COL_100ms_sys/DTRC_Csw_P.49" /begin REF_CHARACTERISTIC COL_Csw3_P /end REF_CHARACTERISTIC /end GROUP
/begin GROUP S250_DTRC_Csw_P_5 "swc_COL/COL_100ms_sys/COL_100ms_sys/DTRC_Csw_P.5" /begin REF_CHARACTERISTIC COL_Csw2_P /end REF_CHARACTERISTIC /end GROUP
/begin GROUP S250_DTRC_Csw_P_50 "swc_COL/COL_100ms_sys/COL_100ms_sys/DTRC_Csw_P.50" /begin REF_CHARACTERISTIC COL_Csw3_P /end REF_CHARACTERISTIC /end GROUP
/begin GROUP S250_DTRC_Csw_P_51 "swc_COL/COL_100ms_sys/COL_100ms_sys/DTRC_Csw_P.51" /begin REF_CHARACTERISTIC COL_Csw3_P /end REF_CHARACTERISTIC /end GROUP
/begin GROUP S250_DTRC_Csw_P_52 "swc_COL/COL_100ms_sys/COL_100ms_sys/DTRC_Csw_P.52" /begin REF_CHARACTERISTIC COL_Csw3_P /end REF_CHARACTERISTIC /end GROUP
/begin GROUP S250_DTRC_Csw_P_53 "swc_COL/COL_100ms_sys/COL_100ms_sys/DTRC_Csw_P.53" /begin REF_CHARACTERISTIC COL_Csw3_P /end REF_CHARACTERISTIC /end GROUP
/begin GROUP S250_DTRC_Csw_P_55 "swc_COL/COL_100ms_sys/COL_100ms_sys/DTRC_Csw_P.55" /begin REF_CHARACTERISTIC COL_Csw4_P /end REF_CHARACTERISTIC /end GROUP
/begin GROUP S250_DTRC_Csw_P_56 "swc_COL/COL_100ms_sys/COL_100ms_sys/DTRC_Csw_P.56" /begin REF_CHARACTERISTIC COL_Csw2_P /end REF_CHARACTERISTIC /end GROUP
/begin GROUP S250_DTRC_Csw_P_59 "swc_COL/COL_100ms_sys/COL_100ms_sys/DTRC_Csw_P.59" /begin REF_CHARACTERISTIC COL_Csw5_P /end REF_CHARACTERISTIC /end GROUP
/begin GROUP S250_DTRC_Csw_P_6 "swc_COL/COL_100ms_sys/COL_100ms_sys/DTRC_Csw_P.6" /begin REF_CHARACTERISTIC COL_Csw2_P /end REF_CHARACTERISTIC /end GROUP
/begin GROUP S250_DTRC_Csw_P_7 "swc_COL/COL_100ms_sys/COL_100ms_sys/DTRC_Csw_P.7" /begin REF_CHARACTERISTIC COL_Csw2_P /end REF_CHARACTERISTIC /end GROUP
/begin GROUP S250_DTRC_Csw_P_78 "swc_COL/COL_100ms_sys/COL_100ms_sys/DTRC_Csw_P.78" /begin REF_CHARACTERISTIC COL_Csw2_P /end REF_CHARACTERISTIC /end GROUP
/begin GROUP S250_DTRC_Csw_P_79 "swc_COL/COL_100ms_sys/COL_100ms_sys/DTRC_Csw_P.79" /begin REF_CHARACTERISTIC COL_Csw3_P /end REF_CHARACTERISTIC /end GROUP
/begin GROUP S250_DTRC_Csw_P_80 "swc_COL/COL_100ms_sys/COL_100ms_sys/DTRC_Csw_P.80" /begin REF_CHARACTERISTIC COL_Csw3_P /end REF_CHARACTERISTIC /end GROUP
/begin GROUP S250_DTRC_Csw_P_81 "swc_COL/COL_100ms_sys/COL_100ms_sys/DTRC_Csw_P.81" /begin REF_CHARACTERISTIC COL_Csw2_P /end REF_CHARACTERISTIC /end GROUP
/begin GROUP S250_DTRC_Csw_P_82 "swc_COL/COL_100ms_sys/COL_100ms_sys/DTRC_Csw_P.82" /begin REF_CHARACTERISTIC COL_Csw2_P /end REF_CHARACTERISTIC /end GROUP
/begin GROUP S250_DTRC_Csw_P_83 "swc_COL/COL_100ms_sys/COL_100ms_sys/DTRC_Csw_P.83" /begin REF_CHARACTERISTIC COL_Csw2_P /end REF_CHARACTERISTIC /end GROUP
/begin GROUP S250_DTRC_Csw_P_84 "swc_COL/COL_100ms_sys/COL_100ms_sys/DTRC_Csw_P.84" /begin REF_CHARACTERISTIC COL_Csw4_P /end REF_CHARACTERISTIC /end GROUP
/begin GROUP S250_DTRC_Csw_P_85 "swc_COL/COL_100ms_sys/COL_100ms_sys/DTRC_Csw_P.85" /begin REF_CHARACTERISTIC COL_Csw2_P /end REF_CHARACTERISTIC /end GROUP
/begin GROUP S250_DTRC_Csw_P_86 "swc_COL/COL_100ms_sys/COL_100ms_sys/DTRC_Csw_P.86" /begin REF_CHARACTERISTIC COL_Csw3_P /end REF_CHARACTERISTIC /end GROUP
/begin GROUP S250_DTRC_Csw_P_87 "swc_COL/COL_100ms_sys/COL_100ms_sys/DTRC_Csw_P.87" /begin REF_CHARACTERISTIC COL_Csw3_P /end REF_CHARACTERISTIC /end GROUP
/begin GROUP S250_DTRC_Csw_P_88 "swc_COL/COL_100ms_sys/COL_100ms_sys/DTRC_Csw_P.88" /begin REF_CHARACTERISTIC COL_Csw3_P /end REF_CHARACTERISTIC /end GROUP
/begin GROUP S250_DTRC_Csw_P_91 "swc_COL/COL_100ms_sys/COL_100ms_sys/DTRC_Csw_P.91" /begin REF_CHARACTERISTIC COL_Csw4_P /end REF_CHARACTERISTIC /end GROUP
/begin GROUP S250_DTRC_Csw_P_93 "swc_COL/COL_100ms_sys/COL_100ms_sys/DTRC_Csw_P.93" /begin REF_CHARACTERISTIC COL_Csw5_P /end REF_CHARACTERISTIC /end GROUP
/begin GROUP S250_DTRC_Csw_P_94 "swc_COL/COL_100ms_sys/COL_100ms_sys/DTRC_Csw_P.94" /begin REF_CHARACTERISTIC COL_Csw5_P /end REF_CHARACTERISTIC /end GROUP
/begin GROUP S250_DTRC_Csw_P_95 "swc_COL/COL_100ms_sys/COL_100ms_sys/DTRC_Csw_P.95" /begin REF_CHARACTERISTIC COL_Csw5_P /end REF_CHARACTERISTIC /end GROUP
/begin GROUP S250_DTRC_Csw_P_97 "swc_COL/COL_100ms_sys/COL_100ms_sys/DTRC_Csw_P.97" /begin REF_CHARACTERISTIC COL_Csw4_P /end REF_CHARACTERISTIC /end GROUP
/begin GROUP S250_DTRC_Csw_P_99 "swc_COL/COL_100ms_sys/COL_100ms_sys/DTRC_Csw_P.99" /begin REF_CHARACTERISTIC COL_Csw5_P /end REF_CHARACTERISTIC /end GROUP
/begin GROUP S250_EstimatedRemainingChargingTime_P "swc_COL/COL_100ms_sys/COL_100ms_sys/EstimatedRemainingChargingTime_P" /begin REF_CHARACTERISTIC EstimatedRemainingChargingTime_P /end REF_CHARACTERISTIC /end GROUP
/begin GROUP S250_MaxChargingVoltage_P "swc_COL/COL_100ms_sys/COL_100ms_sys/MaxChargingVoltage_P" /begin REF_CHARACTERISTIC MaxChargingVoltage_P /end REF_CHARACTERISTIC /end GROUP
/begin GROUP S250_MaxPermChargingCurrent_P "swc_COL/COL_100ms_sys/COL_100ms_sys/MaxPermChargingCurrent_P" /begin REF_CHARACTERISTIC MaxPermChargingCurrent_P /end REF_CHARACTERISTIC /end GROUP
/begin GROUP S250_MaxPermTemperature_P "swc_COL/COL_100ms_sys/COL_100ms_sys/MaxPermTemperature_P" /begin REF_CHARACTERISTIC MaxPermTemperature_P /end REF_CHARACTERISTIC /end GROUP
/begin GROUP S250_MaxSingleBattChargingVoltage_P "swc_COL/COL_100ms_sys/COL_100ms_sys/MaxSingleBattChargingVoltage_P" /begin REF_CHARACTERISTIC MaxSingleBattChargingVoltage_P /end REF_CHARACTERISTIC /end GROUP
/begin GROUP S250_MeasuredChargingCurrent_P "swc_COL/COL_100ms_sys/COL_100ms_sys/MeasuredChargingCurrent_P" /begin REF_CHARACTERISTIC MeasuredChargingCurrent_P /end REF_CHARACTERISTIC /end GROUP
/begin GROUP S250_MeasuredChargingVoltage_P "swc_COL/COL_100ms_sys/COL_100ms_sys/MeasuredChargingVoltage_P" /begin REF_CHARACTERISTIC MeasuredChargingVoltage_P /end REF_CHARACTERISTIC /end GROUP
/begin GROUP S250_SingleBatteryHighestVoltage_P "swc_COL/COL_100ms_sys/COL_100ms_sys/SingleBatteryHighestVoltage_P" /begin REF_CHARACTERISTIC SingleBatteryHighestVoltage_P /end REF_CHARACTERISTIC /end GROUP
/begin GROUP S250_SingleBatteryHighestVoltageGroup_P "swc_COL/COL_100ms_sys/COL_100ms_sys/SingleBatteryHighestVoltageGroup_P" /begin REF_CHARACTERISTIC SingleBatteryHighestVoltageGroup_P /end REF_CHARACTERISTIC /end GROUP
/begin GROUP S250_SingleBatteryHighestVoltageSerNo_P "swc_COL/COL_100ms_sys/COL_100ms_sys/SingleBatteryHighestVoltageSerNo_P" /begin REF_CHARACTERISTIC SingleBatteryHighestVoltageSerNo_P /end REF_CHARACTERISTIC /end GROUP
/begin GROUP S250_SingleBatteryMaxTemperature_P "swc_COL/COL_100ms_sys/COL_100ms_sys/SingleBatteryMaxTemperature_P" /begin REF_CHARACTERISTIC SingleBatteryMaxTemperature_P /end REF_CHARACTERISTIC /end GROUP
/begin GROUP S250_SingleBatteryMaxVoltage_P "swc_COL/COL_100ms_sys/COL_100ms_sys/SingleBatteryMaxVoltage_P" /begin REF_CHARACTERISTIC SingleBatteryMaxVoltage_P /end REF_CHARACTERISTIC /end GROUP
/begin GROUP S250_SingleBatteryMinTemperature_P "swc_COL/COL_100ms_sys/COL_100ms_sys/SingleBatteryMinTemperature_P" /begin REF_CHARACTERISTIC SingleBatteryMinTemperature_P /end REF_CHARACTERISTIC /end GROUP
/begin GROUP S250_SingleBatteryMinVoltage_P "swc_COL/COL_100ms_sys/COL_100ms_sys/SingleBatteryMinVoltage_P" /begin REF_CHARACTERISTIC SingleBatteryMinVoltage_P /end REF_CHARACTERISTIC /end GROUP
/begin GROUP S250_SingleBatteryUnusualVoltage_P "swc_COL/COL_100ms_sys/COL_100ms_sys/SingleBatteryUnusualVoltage_P" /begin REF_CHARACTERISTIC SingleBatteryUnusualVoltage_P /end REF_CHARACTERISTIC /end GROUP
/begin GROUP S250_StatusVehiclePowerStorageBattery_P "swc_COL/COL_100ms_sys/COL_100ms_sys/StatusVehiclePowerStorageBattery_P" /begin REF_CHARACTERISTIC StatusVehiclePowerStorageBattery_P /end REF_CHARACTERISTIC /end GROUP
/begin GROUP S250_SuspendStateOfChargeSOC_P "swc_COL/COL_100ms_sys/COL_100ms_sys/SuspendStateOfChargeSOC_P" /begin REF_CHARACTERISTIC SuspendStateOfChargeSOC_P /end REF_CHARACTERISTIC /end GROUP
/begin GROUP S250_Timeout_CCS_P "swc_COL/COL_100ms_sys/COL_100ms_sys/Timeout_CCS_P" /begin REF_CHARACTERISTIC Timeout_CCS_P /end REF_CHARACTERISTIC /end GROUP
/begin GROUP S250_Timeout_CRM_Recognized_P "swc_COL/COL_100ms_sys/COL_100ms_sys/Timeout_CRM_Recognized_P" /begin REF_CHARACTERISTIC Timeout_CRM_Recognized_P /end REF_CHARACTERISTIC /end GROUP
/begin GROUP S250_Timeout_CRM_Unrecognized_P "swc_COL/COL_100ms_sys/COL_100ms_sys/Timeout_CRM_Unrecognized_P" /begin REF_CHARACTERISTIC Timeout_CRM_Unrecognized_P /end REF_CHARACTERISTIC /end GROUP
/begin GROUP S250_Timeout_CRO_P "swc_COL/COL_100ms_sys/COL_100ms_sys/Timeout_CRO_P" /begin REF_CHARACTERISTIC Timeout_CRO_P /end REF_CHARACTERISTIC /end GROUP
/begin GROUP S250_Timeout_CSD_P "swc_COL/COL_100ms_sys/COL_100ms_sys/Timeout_CSD_P" /begin REF_CHARACTERISTIC Timeout_CSD_P /end REF_CHARACTERISTIC /end GROUP
/begin GROUP S250_Timeout_CST_P "swc_COL/COL_100ms_sys/COL_100ms_sys/Timeout_CST_P" /begin REF_CHARACTERISTIC Timeout_CST_P /end REF_CHARACTERISTIC /end GROUP
/begin GROUP S250_Timeout_CTS_CML_P "swc_COL/COL_100ms_sys/COL_100ms_sys/Timeout_CTS_CML_P" /begin REF_CHARACTERISTIC Timeout_CTS_CML_P /end REF_CHARACTERISTIC /end GROUP
/begin GROUP S250_TotalMaxPermChargingVoltage_P "swc_COL/COL_100ms_sys/COL_100ms_sys/TotalMaxPermChargingVoltage_P" /begin REF_CHARACTERISTIC TotalMaxPermChargingVoltage_P /end REF_CHARACTERISTIC /end GROUP
/begin GROUP S250_TotalNominalEnergy_P "swc_COL/COL_100ms_sys/COL_100ms_sys/TotalNominalEnergy_P" /begin REF_CHARACTERISTIC TotalNominalEnergy_P /end REF_CHARACTERISTIC /end GROUP
/begin GROUP S250_VehicleBatteryUnusualChargeState_P "swc_COL/COL_100ms_sys/COL_100ms_sys/VehicleBatteryUnusualChargeState_P" /begin REF_CHARACTERISTIC VehicleBatteryUnusualChargeState_P /end REF_CHARACTERISTIC /end GROUP
/begin GROUP S252_Client_Sever_Signals "swc_CIL/CIL_10ms_sys/BSW/Client_Sever Signals"
 /begin SUB_GROUP S310_BSOF_bAcvDcChrgrPlg_P S310_BSOF_TiDcChrgrPlgOff_P S310_BSOF_TiDcChrgrPlgOn_P S310_BSOF_ValDcChrgrPlgRHi_P S310_BSOF_ValDcChrgrPlgRLo_P S310_CIL_DucycCrash_P S310_CIL_DucycHvil_P S310_CIL_FrqCrash_P S310_CIL_FrqHvil_P S310_CIL_IdxDcChrgrPlgRstr_P S310_CIL_IdxDucycCrash_P S310_CIL_IdxFrqCrash_P S310_CIL_IdxHvilDucyc_P S310_CIL_IdxHvilFrq_P S310_CIL_IdxPortAcChTNeg_P S310_CIL_IdxPortAcChTPos_P S310_CIL_IdxPortDcChTNeg_P S310_CIL_IdxPortDcChTPos_P S310_CIL_IdxStChWup_P S310_CIL_IdxStTrml15_P S310_CIL_IdxUChPoleHiSideDrv_P S310_CIL_IdxUHeatPoleHiSideDrv_P S310_CIL_IdxUMainNegPoleHiSideDrv_P S310_CIL_IdxUMainPosPoleHiSideDrv_P S310_CIL_IdxURlyPrechHiSideDrv_P S310_CIL_IdxUTrml30_P S310_CIL_StChWup_P S310_CIL_StTrml15_P S310_CIL_TAcChPointNeg_P S310_CIL_TAcChPointPos_P S310_CIL_TDcChPointNeg_P S310_CIL_TDcChPointPos_P S310_CIL_TiProc_P S310_CIL_UChPoleHiSideDrv_P S310_CIL_UHeatPoleHiSideDrv_P S310_CIL_UMainNegPoleHiSideDrv_P S310_CIL_UMainPosPoleHiSideDrv_P S310_CIL_URlyPrechHiSideDrv_P S310_CIL_UThdForStChWup_P S310_CIL_UThdForTrml15_P S310_CIL_UTrml30_P S310_DTRC_Csw_P_0 S310_DTRC_Csw_P_1 S310_DTRC_Csw_P_10 S310_DTRC_Csw_P_11 S310_DTRC_Csw_P_12 S310_DTRC_Csw_P_13 S310_DTRC_Csw_P_14 S310_DTRC_Csw_P_15 S310_DTRC_Csw_P_2 S310_DTRC_Csw_P_3 S310_DTRC_Csw_P_4 S310_DTRC_Csw_P_48 S310_DTRC_Csw_P_5 S310_DTRC_Csw_P_6 S310_DTRC_Csw_P_7 S310_DTRC_Csw_P_8 S310_DTRC_Csw_P_9 /end SUB_GROUP
/end GROUP
/begin GROUP S252_Sender_Reciever_Signals "swc_CIL/CIL_10ms_sys/BSW/Sender_Reciever Signals"
 /begin SUB_GROUP S311_BSOF_bEnaMsgChrgrChDetd_P S311_BSOF_bEnaMsgChrgrChSt_P S311_BSOF_bEnaMsgChrgrChSt_P5 S311_BSOF_bEnaMsgChrgrChSuspd_P S311_BSOF_bEnaMsgChrgrDetnCnct_P S311_BSOF_bEnaMsgChrgrErr_P S311_BSOF_bEnaMsgChrgrHdshk_P S311_BSOF_bEnaMsgChrgrMaxOut_P S311_BSOF_bEnaMsgChrgrMaxOutPgtn_P S311_BSOF_bEnaMsgChrgrRcgtn_P S311_BSOF_bEnaMsgChrgrRdy_P S311_BSOF_bEnaMsgChrgrStstc_P S311_BSOF_bEnaMsgChrgrStstcForPgtn_P S311_BSOF_TiMsgChrgrChDetd_P S311_BSOF_TiMsgChrgrChSt_P S311_BSOF_TiMsgChrgrChSuspd_P S311_BSOF_TiMsgChrgrDetnCnct_P S311_BSOF_TiMsgChrgrErr_P S311_BSOF_TiMsgChrgrHdshk_P S311_BSOF_TiMsgChrgrMaxOut_P S311_BSOF_TiMsgChrgrMaxOutPgtn_P S311_BSOF_TiMsgChrgrRcgtn_P S311_BSOF_TiMsgChrgrRdy_P S311_BSOF_TiMsgChrgrStstc_P S311_BSOF_TiMsgChrgrStstcForPgtn_P S311_CIL_bRdyBswStoreFnshd_P S311_CIL_bVldBatIHv_P S311_CIL_bVldCellTSamplg_P S311_CIL_bVldCellUSamplg_P S311_CIL_bVldIslnR_P S311_CIL_bVldUMainNegPoleAftRly_P S311_CIL_bVldUMainPosPoleAftRly_P S311_CIL_bVldUMainPosPoleBefRly_P S311_CIL_bVldUPoleAftRlyCh_P S311_CIL_bVldUPoleAftRlyHeat_P S311_CIL_CtrIslnRSamplg_P S311_CIL_DayRtc_P S311_CIL_ErrAcScktSnsrT_P S311_CIL_ErrDcScktSnsrT_P S311_CIL_HourRtc_P S311_CIL_IBatHv_P S311_CIL_MinuRtc_P S311_CIL_ModeSysWup_P S311_CIL_MonthRtc_P S311_CIL_RIslnNeg_P S311_CIL_RIslnPos_P S311_CIL_SecRtc_P S311_CIL_StCellTSamplgExcpn_P S311_CIL_StCellUSamplgExcpn_P S311_CIL_StMsgToutForPMS_P S311_CIL_TiProc_P S311_CIL_TiProc_P1 S311_CIL_TiProc_P10 S311_CIL_TiProc_P2 S311_CIL_TiProc_P3 S311_CIL_TiProc_P4 S311_CIL_TiProc_P5 S311_CIL_TiProc_P6 S311_CIL_TiProc_P7 S311_CIL_TiProc_P8 S311_CIL_TiProc_P9 S311_CIL_TiSysRun_P S311_CIL_TSnsrI_P S311_CIL_UMainNegPoleAftRly_P S311_CIL_UMainPosPoleAftRly_P S311_CIL_UMainPosPoleBefRly_P S311_CIL_UPoleAftRlyCh_P S311_CIL_UPoleAftRlyHeat_P S311_CIL_YearRtc_P S311_DTRC_Csw_P_1 S311_DTRC_Csw_P_10 S311_DTRC_Csw_P_11 S311_DTRC_Csw_P_12 S311_DTRC_Csw_P_13 S311_DTRC_Csw_P_14 S311_DTRC_Csw_P_15 S311_DTRC_Csw_P_16 S311_DTRC_Csw_P_17 S311_DTRC_Csw_P_2 S311_DTRC_Csw_P_24 S311_DTRC_Csw_P_25 S311_DTRC_Csw_P_26 S311_DTRC_Csw_P_3 S311_DTRC_Csw_P_4 S311_DTRC_Csw_P_43 S311_DTRC_Csw_P_44 S311_DTRC_Csw_P_45 S311_DTRC_Csw_P_49 S311_DTRC_Csw_P_5 S311_DTRC_Csw_P_50 S311_DTRC_Csw_P_51 S311_DTRC_Csw_P_52 S311_DTRC_Csw_P_53 S311_DTRC_Csw_P_54 S311_DTRC_Csw_P_55 S311_DTRC_Csw_P_56 S311_DTRC_Csw_P_6 S311_DTRC_Csw_P_65 S311_DTRC_Csw_P_66 S311_DTRC_Csw_P_67 S311_DTRC_Csw_P_68 S311_DTRC_Csw_P_69 S311_DTRC_Csw_P_7 S311_DTRC_Csw_P_73 S311_DTRC_Csw_P_74 S311_DTRC_Csw_P_75 S311_DTRC_Csw_P_76 S311_DTRC_Csw_P_77 S311_DTRC_Csw_P_78 S311_DTRC_Csw_P_79 S311_DTRC_Csw_P_8 S311_DTRC_Csw_P_84 S311_DTRC_Csw_P_85 S311_DTRC_Csw_P_86 S311_DTRC_Csw_P_9 S311_MCC_StMdulCu_P /end SUB_GROUP
/end GROUP
/begin GROUP S255_BitSelect5 "swc_BatThermHndlgMngt/BTHM_100ms_sys/100ms/DataPrep/Diagnosis/IntialCheck/BitSelect5" /begin REF_CHARACTERISTIC BTHM_CswDig_P /end REF_CHARACTERISTIC /end GROUP
/begin GROUP S255_BTHM_TiOffDig641_P "swc_BatThermHndlgMngt/BTHM_100ms_sys/100ms/DataPrep/Diagnosis/IntialCheck/BTHM_TiOffDig641_P" /begin REF_CHARACTERISTIC BTHM_TiOffDig641_P /end REF_CHARACTERISTIC /end GROUP
/begin GROUP S255_BTHM_TiOnDig641_P "swc_BatThermHndlgMngt/BTHM_100ms_sys/100ms/DataPrep/Diagnosis/IntialCheck/BTHM_TiOnDig641_P" /begin REF_CHARACTERISTIC BTHM_TiOnDig641_P /end REF_CHARACTERISTIC /end GROUP
/begin GROUP S25_BPIU_TiOffDig247_P "swc_BatProtnIU/CellUDiag/100ms/CellVoltageDiagnosis/CellVoltageOutOfRange/BPIU_TiOffDig247_P" /begin REF_CHARACTERISTIC BPIU_TiOffDig247_P /end REF_CHARACTERISTIC /end GROUP
/begin GROUP S25_BPIU_TiOnDig247_P "swc_BatProtnIU/CellUDiag/100ms/CellVoltageDiagnosis/CellVoltageOutOfRange/BPIU_TiOnDig247_P" /begin REF_CHARACTERISTIC BPIU_TiOnDig247_P /end REF_CHARACTERISTIC /end GROUP
/begin GROUP S25_BWLD_SocBatRst_P "swc_BatWntyLogtcData/100ms/100ms/SocBat/BWLD_SocBatRst_P" /begin REF_CHARACTERISTIC BWLD_SocBatRst_P /end REF_CHARACTERISTIC /end GROUP
/begin GROUP S26_BPIU_TiOffDig248_P "swc_BatProtnIU/CellUDiag/100ms/CellVoltageDiagnosis/ModulelVoltageOutOfRange/BPIU_TiOffDig248_P" /begin REF_CHARACTERISTIC BPIU_TiOffDig248_P /end REF_CHARACTERISTIC /end GROUP
/begin GROUP S26_BPIU_TiOnDig248_P "swc_BatProtnIU/CellUDiag/100ms/CellVoltageDiagnosis/ModulelVoltageOutOfRange/BPIU_TiOnDig248_P" /begin REF_CHARACTERISTIC BPIU_TiOnDig248_P /end REF_CHARACTERISTIC /end GROUP
/begin GROUP S26_BPIU_UMdulMax_P "swc_BatProtnIU/CellUDiag/100ms/CellVoltageDiagnosis/ModulelVoltageOutOfRange/BPIU_UMdulMax_P" /begin REF_CHARACTERISTIC BPIU_UMdulMax_P /end REF_CHARACTERISTIC /end GROUP
/begin GROUP S26_BPIU_UMdulMin_P "swc_BatProtnIU/CellUDiag/100ms/CellVoltageDiagnosis/ModulelVoltageOutOfRange/BPIU_UMdulMin_P" /begin REF_CHARACTERISTIC BPIU_UMdulMin_P /end REF_CHARACTERISTIC /end GROUP
/begin GROUP S26_BWLD_TMdulSnsrRst_P1 "swc_BatWntyLogtcData/100ms/100ms/TCell/BWLD_TMdulSnsrRst_P1" /begin REF_CHARACTERISTIC BWLD_TMdulSnsrRst_P /end REF_CHARACTERISTIC /end GROUP
/begin GROUP S277_BCF_SocLowrLimForSohVeri_P "swc_BatCoreFct/BCF_100ms_sys/BatCoreFct/PackObs/PackObsLoop/MdulObs/MdulCObs/CMdulAgiFac Estimation in CTestMode/BCF_SocLowrLimForSohVeri_P" /begin REF_CHARACTERISTIC BCF_SocLowrLimForSohVeri_P /end REF_CHARACTERISTIC /end GROUP
/begin GROUP S277_BCF_SocUpprLimForSohVeri_P "swc_BatCoreFct/BCF_100ms_sys/BatCoreFct/PackObs/PackObsLoop/MdulObs/MdulCObs/CMdulAgiFac Estimation in CTestMode/BCF_SocUpprLimForSohVeri_P" /begin REF_CHARACTERISTIC BCF_SocUpprLimForSohVeri_P /end REF_CHARACTERISTIC /end GROUP
/begin GROUP S277_BCF_TTsForSohVeri_P "swc_BatCoreFct/BCF_100ms_sys/BatCoreFct/PackObs/PackObsLoop/MdulObs/MdulCObs/CMdulAgiFac Estimation in CTestMode/BCF_TTsForSohVeri_P" /begin REF_CHARACTERISTIC BCF_TTsForSohVeri_P /end REF_CHARACTERISTIC /end GROUP
/begin GROUP S278_BCF_CMdulDeltaUpprLimOfTrip_P "swc_BatCoreFct/BCF_100ms_sys/BatCoreFct/PackObs/PackObsLoop/MdulObs/MdulCObs/CMdulDeltaTrip Evaluation/BCF_CMdulDeltaUpprLimOfTrip_P" /begin REF_CHARACTERISTIC BCF_CMdulDeltaUpprLimOfTrip_P /end REF_CHARACTERISTIC /end GROUP
/begin GROUP S27_BPIU_TiOffDig115_P "swc_BatProtnIU/CellUDiag/100ms/CellVoltageDiagnosis/UCellCollectionDiagnosis/BPIU_TiOffDig115_P" /begin REF_CHARACTERISTIC BPIU_TiOffDig115_P /end REF_CHARACTERISTIC /end GROUP
/begin GROUP S27_BPIU_TiOnDig115_P "swc_BatProtnIU/CellUDiag/100ms/CellVoltageDiagnosis/UCellCollectionDiagnosis/BPIU_TiOnDig115_P" /begin REF_CHARACTERISTIC BPIU_TiOnDig115_P /end REF_CHARACTERISTIC /end GROUP
/begin GROUP S27_BWLD_UCellRst_P "swc_BatWntyLogtcData/100ms/100ms/UCell/BWLD_UCellRst_P" /begin REF_CHARACTERISTIC BWLD_UCellRst_P /end REF_CHARACTERISTIC /end GROUP
/begin GROUP S281_BCF_CMdulTripLamWithBaln_P "swc_BatCoreFct/BCF_100ms_sys/BatCoreFct/PackObs/PackObsLoop/MdulObs/MdulCObs/Sensitivity Of Estimation/BCF_CMdulTripLamWithBaln_P" /begin REF_CHARACTERISTIC BCF_CMdulTripLamWithBaln_P /end REF_CHARACTERISTIC /end GROUP
/begin GROUP S281_BCF_CMdulTripLamWoutBaln_P "swc_BatCoreFct/BCF_100ms_sys/BatCoreFct/PackObs/PackObsLoop/MdulObs/MdulCObs/Sensitivity Of Estimation/BCF_CMdulTripLamWoutBaln_P" /begin REF_CHARACTERISTIC BCF_CMdulTripLamWoutBaln_P /end REF_CHARACTERISTIC /end GROUP
/begin GROUP S281_BCF_CSysMtrxCdngNrLimHi_P "swc_BatCoreFct/BCF_100ms_sys/BatCoreFct/PackObs/PackObsLoop/MdulObs/MdulCObs/Sensitivity Of Estimation/BCF_CSysMtrxCdngNrLimHi_P" /begin REF_CHARACTERISTIC BCF_CSysMtrxCdngNrLimHi_P /end REF_CHARACTERISTIC /end GROUP
/begin GROUP S282_Calculate_update_of_aging_factor "swc_BatCoreFct/BCF_100ms_sys/BatCoreFct/PackObs/PackObsLoop/MdulObs/MdulCObs/Update CMdulAgiFac/Calculate update of aging factor" /begin SUB_GROUP S306_BCF_CMdulAgiFacSatn_M S306_BCF_CMdulAgiFacUpd_P /end SUB_GROUP /end GROUP
/begin GROUP S282_Diagnostic_of_module_degradation "swc_BatCoreFct/BCF_100ms_sys/BatCoreFct/PackObs/PackObsLoop/MdulObs/MdulCObs/Update CMdulAgiFac/Diagnostic of module degradation"
 /begin SUB_GROUP S308_BCF_CMdulAgiFacInvldErrMin_M S308_BCF_CMdulAgiFacVldErrMin_M S308_BCF_Td_P S308_BCF_TdOffDig1004_P S308_BCF_TdOnDig1004_P S308_BitSelect3 /end SUB_GROUP
/end GROUP
/begin GROUP S282_Update_new_aging_factor "swc_BatCoreFct/BCF_100ms_sys/BatCoreFct/PackObs/PackObsLoop/MdulObs/MdulCObs/Update CMdulAgiFac/Update new aging factor"
 /begin SUB_GROUP S309_BCF_CMdulAgiFacLowrLim_P S309_BCF_CMdulAgiFacUpprLim_P /end SUB_GROUP
/end GROUP
/begin GROUP S28_BPIU_TiOffDig189_P "swc_BatProtnIU/CellUDiag/100ms/CellVoltageDiagnosis/UCellDiffDiag/BPIU_TiOffDig189_P" /begin REF_CHARACTERISTIC BPIU_TiOffDig189_P /end REF_CHARACTERISTIC /end GROUP
/begin GROUP S28_BPIU_TiOnDig189_P "swc_BatProtnIU/CellUDiag/100ms/CellVoltageDiagnosis/UCellDiffDiag/BPIU_TiOnDig189_P" /begin REF_CHARACTERISTIC BPIU_TiOnDig189_P /end REF_CHARACTERISTIC /end GROUP
/begin GROUP S28_BPIU_UCellDifMax_P1 "swc_BatProtnIU/CellUDiag/100ms/CellVoltageDiagnosis/UCellDiffDiag/BPIU_UCellDifMax_P1" /begin REF_CHARACTERISTIC BPIU_UCellDifMax_P /end REF_CHARACTERISTIC /end GROUP
/begin GROUP S28_BPIU_UCellDifMin_P "swc_BatProtnIU/CellUDiag/100ms/CellVoltageDiagnosis/UCellDiffDiag/BPIU_UCellDifMin_P" /begin REF_CHARACTERISTIC BPIU_UCellDifMin_P /end REF_CHARACTERISTIC /end GROUP
/begin GROUP S29_BatteryTimeCalculation "swc_BcuStTranCtl/BcuStTranCtl_sys/BcuStTranCtl/BatteryTimeCalculation" /begin SUB_GROUP S32_BSTC_TiProc_P S32_BSTC_TiProc_P1 /end SUB_GROUP /end GROUP
/begin GROUP S29_BPIU_TiOffDig173_P "swc_BatProtnIU/CellUDiag/100ms/CellVoltageDiagnosis/UCellMaxDiagnosis/BPIU_TiOffDig173_P" /begin REF_CHARACTERISTIC BPIU_TiOffDig173_P /end REF_CHARACTERISTIC /end GROUP
/begin GROUP S29_BPIU_TiOffDig3_P "swc_BatProtnIU/CellUDiag/100ms/CellVoltageDiagnosis/UCellMaxDiagnosis/BPIU_TiOffDig3_P" /begin REF_CHARACTERISTIC BPIU_TiOffDig3_P /end REF_CHARACTERISTIC /end GROUP
/begin GROUP S29_BPIU_TiOffDig62_P "swc_BatProtnIU/CellUDiag/100ms/CellVoltageDiagnosis/UCellMaxDiagnosis/BPIU_TiOffDig62_P" /begin REF_CHARACTERISTIC BPIU_TiOffDig62_P /end REF_CHARACTERISTIC /end GROUP
/begin GROUP S29_BPIU_TiOffDig88_P "swc_BatProtnIU/CellUDiag/100ms/CellVoltageDiagnosis/UCellMaxDiagnosis/BPIU_TiOffDig88_P" /begin REF_CHARACTERISTIC BPIU_TiOffDig88_P /end REF_CHARACTERISTIC /end GROUP
/begin GROUP S29_BPIU_TiOnDig173_P "swc_BatProtnIU/CellUDiag/100ms/CellVoltageDiagnosis/UCellMaxDiagnosis/BPIU_TiOnDig173_P" /begin REF_CHARACTERISTIC BPIU_TiOnDig173_P /end REF_CHARACTERISTIC /end GROUP
/begin GROUP S29_BPIU_TiOnDig3_P "swc_BatProtnIU/CellUDiag/100ms/CellVoltageDiagnosis/UCellMaxDiagnosis/BPIU_TiOnDig3_P" /begin REF_CHARACTERISTIC BPIU_TiOnDig3_P /end REF_CHARACTERISTIC /end GROUP
/begin GROUP S29_BPIU_TiOnDig62_P "swc_BatProtnIU/CellUDiag/100ms/CellVoltageDiagnosis/UCellMaxDiagnosis/BPIU_TiOnDig62_P" /begin REF_CHARACTERISTIC BPIU_TiOnDig62_P /end REF_CHARACTERISTIC /end GROUP
/begin GROUP S29_BPIU_TiOnDig88_P "swc_BatProtnIU/CellUDiag/100ms/CellVoltageDiagnosis/UCellMaxDiagnosis/BPIU_TiOnDig88_P" /begin REF_CHARACTERISTIC BPIU_TiOnDig88_P /end REF_CHARACTERISTIC /end GROUP
/begin GROUP S29_BPIU_UCellMaxLim1_P "swc_BatProtnIU/CellUDiag/100ms/CellVoltageDiagnosis/UCellMaxDiagnosis/BPIU_UCellMaxLim1_P" /begin REF_CHARACTERISTIC BPIU_UCellMaxLim1_P /end REF_CHARACTERISTIC /end GROUP
/begin GROUP S29_BPIU_UCellMaxLim2_P "swc_BatProtnIU/CellUDiag/100ms/CellVoltageDiagnosis/UCellMaxDiagnosis/BPIU_UCellMaxLim2_P" /begin REF_CHARACTERISTIC BPIU_UCellMaxLim2_P /end REF_CHARACTERISTIC /end GROUP
/begin GROUP S29_BPIU_UCellMaxLim3_P "swc_BatProtnIU/CellUDiag/100ms/CellVoltageDiagnosis/UCellMaxDiagnosis/BPIU_UCellMaxLim3_P" /begin REF_CHARACTERISTIC BPIU_UCellMaxLim3_P /end REF_CHARACTERISTIC /end GROUP
/begin GROUP S29_BPIU_UCellMaxOff_P "swc_BatProtnIU/CellUDiag/100ms/CellVoltageDiagnosis/UCellMaxDiagnosis/BPIU_UCellMaxOff_P" /begin REF_CHARACTERISTIC BPIU_UCellMaxOff_P /end REF_CHARACTERISTIC /end GROUP
/begin GROUP S29_BPIU_UCellMaxOff_P1 "swc_BatProtnIU/CellUDiag/100ms/CellVoltageDiagnosis/UCellMaxDiagnosis/BPIU_UCellMaxOff_P1" /begin REF_CHARACTERISTIC BPIU_UCellMaxOff_P /end REF_CHARACTERISTIC /end GROUP
/begin GROUP S29_BPIU_UCellOverMax2_P "swc_BatProtnIU/CellUDiag/100ms/CellVoltageDiagnosis/UCellMaxDiagnosis/BPIU_UCellOverMax2_P" /begin REF_CHARACTERISTIC BPIU_UCellOverMax2_P /end REF_CHARACTERISTIC /end GROUP
/begin GROUP S29_BPIU_UCellOverMax_P "swc_BatProtnIU/CellUDiag/100ms/CellVoltageDiagnosis/UCellMaxDiagnosis/BPIU_UCellOverMax_P" /begin REF_CHARACTERISTIC BPIU_UCellOverMax_P /end REF_CHARACTERISTIC /end GROUP
/begin GROUP S29_ConditionConfirm "swc_BcuStTranCtl/BcuStTranCtl_sys/BcuStTranCtl/ConditionConfirm"
 /begin SUB_GROUP S37_BSTC_IChScsMin_P S37_BSTC_ReqHvOnFromVcu_P S37_BSTC_StLoopHvNorm_P S37_BSTC_StLoopHvPrechFnshd_P S37_BSTC_ThdILowrLim_P S37_BSTC_ThdIUpprLim_P S37_BSTC_TiBalMaxForCh_P S37_BSTC_TiCutoffLvReqFromVcu_P S37_BSTC_TiProc_P S37_BSTC_TiProc_P1 S37_ShutdownDetection /end SUB_GROUP
/end GROUP
/begin GROUP S29_DTC "swc_BcuStTranCtl/BcuStTranCtl_sys/BcuStTranCtl/DTC"
 /begin SUB_GROUP S38_BitSelect S38_BitSelect1 S38_BitSelect2 S38_BitSelect3 S38_BitSelect4 S38_BSTC_TiOffDigForPwrOff_P S38_BSTC_TiOnDigForPwrOff_P S38_BSTC_TiProc_P S38_BSTC_TiProc_P1 S38_BSTC_TiProc_P2 S38_BSTC_TiProc_P3 S38_BSTC_TiProc_P4 /end SUB_GROUP
/end GROUP
/begin GROUP S29_ExternalResetCalculation "swc_BcuStTranCtl/BcuStTranCtl_sys/BcuStTranCtl/ExternalResetCalculation" /begin SUB_GROUP S39_BSTC_TiProc_P /end SUB_GROUP /end GROUP
/begin GROUP S29_SelfCheck "swc_BatProtnIU/CellUDiag/100ms/CellVoltageDiagnosis/UCellMaxDiagnosis/SelfCheck"
 /begin SUB_GROUP S169_BitSelect S169_BPIU_TiChkOnDig63_P S169_BPIU_TiSample2_P3 /end SUB_GROUP
/end GROUP
/begin GROUP S29_SetWakeUpTime "swc_BcuStTranCtl/BcuStTranCtl_sys/BcuStTranCtl/SetWakeUpTime" /begin SUB_GROUP S41_BSTC_TiRtcWUpNxt_P /end SUB_GROUP /end GROUP
/begin GROUP S29_Time "swc_BcuStTranCtl/BcuStTranCtl_sys/BcuStTranCtl/Time"
 /begin SUB_GROUP S42_BSTC_TiBswStore_P S42_BSTC_TiChkDeb_P S42_BSTC_TiProc_P S42_BSTC_TiVcuShtdn_P S42_BSTC_TiWaitChk_P /end SUB_GROUP
/end GROUP
/begin GROUP S2_100ms "swc_BatWntyLogtcData/100ms/100ms" /begin SUB_GROUP S11_SocBat S11_TCell S11_UCell /end SUB_GROUP /end GROUP
/begin GROUP S2_10ms "swc_BatProtnPack/PackVDiagAndExecutionControl/10ms"
 /begin SUB_GROUP S184_BPP_bInhCtctrRelsDchaIThd_P S184_BPP_bInhCtctrRelsIChThd_P1 S184_BPP_bInhCtctrRelsTiLim_P1 S184_BPP_FacFuseClr_M1 S184_BPP_TiSample1_P S184_Timer S185_BPP_TiIActCutoff_P S185_BPP_TiSample1_P S186_BPP_IFilActNoiseLim_P1 S187_BPP_CHSIGN_P S188_BitSelect S188_BitSelect1 S188_BPP_TCellUMinThd1_P S188_BPP_TCellUMinThd2_P S188_BPP_TiOffDig86_P S188_BPP_TiOffDig87_P S188_BPP_TiOnDig86_P S188_BPP_TiOnDig87_P S188_BPP_TiSample1_P S188_BPP_TiSample1_P1 S188_BPP_UCellMax_P S188_BPP_UPackMin_P1 S188_BPP_UPackMinOff_P S188_BPP_UPackTBlwLoMin_P1 S188_BPP_UPackTBlwLoMinOff_P S188_BPP_UPackTLoMin_P1 S188_BPP_UPackTLoMinOff_P S189_BPP_TiIActCutoff_P S189_BPP_TiSample1_P S190_BPP_bAcvCTest_P S190_BPP_bAcvCTestMan_P /end SUB_GROUP
/end GROUP
/begin GROUP S2_BatBalnCtl "swc_BatBalnCtl/BBC_100ms_sys/BBC_100ms_sys/BatBalnCtl" /begin SUB_GROUP S12_Battery_Balancing_Decision S12_BBC_StBcu_M /end SUB_GROUP /end GROUP
/begin GROUP S2_BatBalnCtl_BalnIClcn "swc_BatBalnCtl/BBC_100ms_sys/BBC_100ms_sys/BatBalnCtl_BalnIClcn" /begin SUB_GROUP S13_BBC_StBcu_M S13_Subsystem /end SUB_GROUP /end GROUP
/begin GROUP S2_BBC_IdxMdulInCfg_P1 "swc_BatBalnCtl/BBC_100ms_sys/BBC_100ms_sys/BBC_IdxMdulInCfg_P1" /begin REF_CHARACTERISTIC BBC_IdxMdulInCfg_P /end REF_CHARACTERISTIC /end GROUP
/begin GROUP S2_BCC_10ms_sys "swc_BatChCtl/BCC_10ms_sys/BCC_10ms_sys"
 /begin SUB_GROUP S154_BatChTiEstimn S154_BatDchaTiEstimn S154_ChargeCalculate /end SUB_GROUP
/end GROUP
/begin GROUP S2_BSW "swc_CIL/CIL_10ms_sys/BSW" /begin SUB_GROUP S252_Client_Sever_Signals S252_Sender_Reciever_Signals /end SUB_GROUP /end GROUP
/begin GROUP S2_BTHM_ModeTherm_P1 "swc_BatThermHndlgMngt/BTHM_100ms_sys/100ms/BTHM_ModeTherm_P1" /begin REF_CHARACTERISTIC BTHM_ModeTherm_P /end REF_CHARACTERISTIC /end GROUP
/begin GROUP S2_BTHM_ModeTherm_P2 "swc_BatThermHndlgMngt/BTHM_100ms_sys/100ms/BTHM_ModeTherm_P2" /begin REF_CHARACTERISTIC BTHM_ModeTherm_P /end REF_CHARACTERISTIC /end GROUP
/begin GROUP S2_BTHM_ModeTherm_P3 "swc_BatThermHndlgMngt/BTHM_100ms_sys/100ms/BTHM_ModeTherm_P3" /begin REF_CHARACTERISTIC BTHM_ModeTherm_P /end REF_CHARACTERISTIC /end GROUP
/begin GROUP S2_BTHM_TMaxOptmLim_P "swc_BatThermHndlgMngt/BTHM_100ms_sys/100ms/BTHM_TMaxOptmLim_P" /begin REF_CHARACTERISTIC BTHM_TMaxOptmLim_P /end REF_CHARACTERISTIC /end GROUP
/begin GROUP S2_BTHM_TMinOptmLim_P "swc_BatThermHndlgMngt/BTHM_100ms_sys/100ms/BTHM_TMinOptmLim_P" /begin REF_CHARACTERISTIC BTHM_TMinOptmLim_P /end REF_CHARACTERISTIC /end GROUP
/begin GROUP S2_COL_100ms_sys "swc_COL/COL_100ms_sys/COL_100ms_sys"
 /begin SUB_GROUP S250_B2V_ST1_ChgMode_P S250_BatteryChargingOvercurrent_P S250_BatteryExcessTemperature_P S250_BatteryHighestTemp_P S250_BatteryHighestTempSerNo_P S250_BatteryInsulationState_P S250_BatteryLowestTemp_P S250_BatteryLowestTempSerNo_P S250_BatteryOutputConnectorState_P S250_BatterySystemCapacity_P S250_BatterySystemVoltage_P S250_BatteryType_P S250_BCPP_Max_Allow_DCCur_P S250_BCPP_Max_Allow_DCV_P S250_BCPP_Min_Allow_CellV_P S250_BCPP_Min_Allow_Soc_P S250_BCSP_Remaining_discharge_time_P S250_BCSP_Remaining_range_P S250_BDC_Battery_capacity_P S250_BDC_Battery_energy_P S250_BDC_Current_V2GCirculate_P S250_BDC_Remainder_CruisingRange_P S250_BDC_Remainder_V2GCirculate_P S250_BDC_Soc_P S250_BDC_Vin1_Copy_10_P S250_BDC_Vin1_Copy_11_P S250_BDC_Vin1_Copy_12_P S250_BDC_Vin1_Copy_13_P S250_BDC_Vin1_Copy_14_P S250_BDC_Vin1_Copy_15_P S250_BDC_Vin1_Copy_16_P S250_BDC_Vin1_Copy_17_P S250_BDC_Vin1_Copy_1_P S250_BDC_Vin1_Copy_2_P S250_BDC_Vin1_Copy_3_P S250_BDC_Vin1_Copy_4_P S250_BDC_Vin1_Copy_5_P S250_BDC_Vin1_Copy_6_P S250_BDC_Vin1_Copy_7_P S250_BDC_Vin1_Copy_8_P S250_BDC_Vin1_Copy_9_P S250_BMS_BattaryFltInfo_BMS_NegRelayFault_P S250_BMS_BattaryFltInfo_BMS_PosRelayFault_P S250_BMS_BattCellsNum_P S250_BMS_BattCellVolFault_P S250_BMS_BattCurr_P S250_BMS_BattEqualizationSts_P S250_BMS_BatteryInfo_BMS_ActWorkSts_P S250_BMS_BatteryInfo_BMS_EmergCutoffHVReq_P S250_BMS_BatteryInfo_BMS_NegRelaySts_P S250_BMS_BatteryInfo_BMS_PmtCutoffLVFb_P S250_BMS_BatteryInfo_BMS_SelfChkState_P S250_BMS_BattIsolationSts_P S250_BMS_BattPackInCoolTemp_P S250_BMS_BattPackNum_P S250_BMS_BattPackOutCoolTemp_P S250_BMS_BattPackVolFault_P S250_BMS_BattSOC_P S250_BMS_BattSOCFault_P S250_BMS_BattSOH_P S250_BMS_BattVol_P S250_BMS_Batty_ThermalMangeReq_P S250_BMS_BBMSensorCurr_P S250_BMS_CellVolDiffFault_P S250_BMS_ChgStatus_P S250_BMS_CutOffLVFbToOBC_P S250_BMS_DCChargRelayCtrl_P S250_BMS_DCChgPlugSts_P S250_BMS_DCChgReady_P S250_BMS_DCChgStage_P S250_BMS_ElectroniclockSts_P S250_BMS_FastChgConnStsFb_P S250_BMS_FastChgRelayFlt_P S250_BMS_FaultLevel_P S250_BMS_HeatingSatus_P S250_BMS_HeatNegRelayFault_Reserved_P S250_BMS_HeatPosRelayFault_Reserved_P S250_BMS_HeatRelaySts_P S250_BMS_HVIsolationSts_P S250_BMS_IsolationFault_P S250_BMS_MaxChgCurrent_P S250_BMS_MaxChgVoltage_P S250_BMS_MILTelltale_P S250_BMS_NegIsolationRes_P S250_BMS_OBCChgContrlCmd_P S250_BMS_PosIsolationRes_P S250_BMS_PTCConnStsFb_P S250_BMS_RelayInfo_BMS_HVLoopWorkSts_P S250_BMS_RelayInfo_BMS_MainPosConnSts_P S250_BMS_RelayInfo_BMS_PreChgConnSts_P S250_BMS_RelayInfo_BMS_PreChgRelayFlt_P S250_BMS_SetTgtTemp_P S250_BMS_SOC1_P S250_BMS_SOCJumpFault_P S250_BMS_ST1_Flt_HVIL_P S250_BMS_TempOutofCtr_P S250_BMS_TempSnsNum_P S250_BmsReadyForCharging_P S250_BmsRevision_P S250_BmsVersion_P S250_BsmChargingPermissible_P S250_CurrentChargeState_P S250_CurrentVehicleBatteryVoltage_P S250_DTRC_Csw_P_1 S250_DTRC_Csw_P_10 S250_DTRC_Csw_P_102 S250_DTRC_Csw_P_104 S250_DTRC_Csw_P_105 S250_DTRC_Csw_P_106 S250_DTRC_Csw_P_107 S250_DTRC_Csw_P_108 S250_DTRC_Csw_P_11 S250_DTRC_Csw_P_111 S250_DTRC_Csw_P_113 S250_DTRC_Csw_P_114 S250_DTRC_Csw_P_115 S250_DTRC_Csw_P_116 S250_DTRC_Csw_P_117 S250_DTRC_Csw_P_118 S250_DTRC_Csw_P_12 S250_DTRC_Csw_P_13 S250_DTRC_Csw_P_136 S250_DTRC_Csw_P_137 S250_DTRC_Csw_P_138 S250_DTRC_Csw_P_139 S250_DTRC_Csw_P_140 S250_DTRC_Csw_P_141 S250_DTRC_Csw_P_142 S250_DTRC_Csw_P_143 S250_DTRC_Csw_P_144 S250_DTRC_Csw_P_145 S250_DTRC_Csw_P_146 S250_DTRC_Csw_P_147 S250_DTRC_Csw_P_148 S250_DTRC_Csw_P_149 S250_DTRC_Csw_P_150 S250_DTRC_Csw_P_151 S250_DTRC_Csw_P_152 S250_DTRC_Csw_P_153 S250_DTRC_Csw_P_154 S250_DTRC_Csw_P_155 S250_DTRC_Csw_P_156 S250_DTRC_Csw_P_157 S250_DTRC_Csw_P_158 S250_DTRC_Csw_P_159 S250_DTRC_Csw_P_160 S250_DTRC_Csw_P_161 S250_DTRC_Csw_P_162 S250_DTRC_Csw_P_163 S250_DTRC_Csw_P_2 S250_DTRC_Csw_P_23 S250_DTRC_Csw_P_28 S250_DTRC_Csw_P_3 S250_DTRC_Csw_P_32 S250_DTRC_Csw_P_33 S250_DTRC_Csw_P_35 S250_DTRC_Csw_P_36 S250_DTRC_Csw_P_37 S250_DTRC_Csw_P_38 S250_DTRC_Csw_P_39 S250_DTRC_Csw_P_4 S250_DTRC_Csw_P_41 S250_DTRC_Csw_P_42 S250_DTRC_Csw_P_44 S250_DTRC_Csw_P_45 S250_DTRC_Csw_P_49 S250_DTRC_Csw_P_5 S250_DTRC_Csw_P_50 S250_DTRC_Csw_P_51 S250_DTRC_Csw_P_52 S250_DTRC_Csw_P_53 S250_DTRC_Csw_P_55 S250_DTRC_Csw_P_56 S250_DTRC_Csw_P_59 S250_DTRC_Csw_P_6 S250_DTRC_Csw_P_7 S250_DTRC_Csw_P_78 S250_DTRC_Csw_P_79 S250_DTRC_Csw_P_80 S250_DTRC_Csw_P_81 S250_DTRC_Csw_P_82 S250_DTRC_Csw_P_83 S250_DTRC_Csw_P_84 S250_DTRC_Csw_P_85 S250_DTRC_Csw_P_86 S250_DTRC_Csw_P_87 S250_DTRC_Csw_P_88 S250_DTRC_Csw_P_91 S250_DTRC_Csw_P_93 S250_DTRC_Csw_P_94 S250_DTRC_Csw_P_95 S250_DTRC_Csw_P_97 S250_DTRC_Csw_P_99 S250_EstimatedRemainingChargingTime_P S250_MaxChargingVoltage_P S250_MaxPermChargingCurrent_P S250_MaxPermTemperature_P S250_MaxSingleBattChargingVoltage_P S250_MeasuredChargingCurrent_P S250_MeasuredChargingVoltage_P S250_SingleBatteryHighestVoltage_P S250_SingleBatteryHighestVoltageGroup_P S250_SingleBatteryHighestVoltageSerNo_P S250_SingleBatteryMaxTemperature_P S250_SingleBatteryMaxVoltage_P S250_SingleBatteryMinTemperature_P S250_SingleBatteryMinVoltage_P S250_SingleBatteryUnusualVoltage_P S250_StatusVehiclePowerStorageBattery_P S250_SuspendStateOfChargeSOC_P S250_Timeout_CCS_P S250_Timeout_CRM_Recognized_P S250_Timeout_CRM_Unrecognized_P S250_Timeout_CRO_P S250_Timeout_CSD_P S250_Timeout_CST_P S250_Timeout_CTS_CML_P S250_TotalMaxPermChargingVoltage_P S250_TotalNominalEnergy_P S250_VehicleBatteryUnusualChargeState_P /end SUB_GROUP
/end GROUP
/begin GROUP S2_CrashErr "swc_EltlLnkHzrdProtnNet/ELHPN_10ms_sys/ELHPN_10ms_sys/CrashErr"
 /begin SUB_GROUP S19_BitSelect S19_BitSelect1 S19_BitSelect2 S19_ELHPN_DucycCrashTolr_P1 S19_ELHPN_FrqCrashTolr_P1 S19_ELHPN_StCrashCfg_P1 S19_ELHPN_TiCrashDebOff_P S19_ELHPN_TiCrashDebOn_P S19_InitialCheck /end SUB_GROUP
/end GROUP
/begin GROUP S2_DataPrep "swc_BatThermHndlgMngt/BTHM_100ms_sys/100ms/DataPrep"
 /begin SUB_GROUP S36_DataChk S36_DataClcn S36_DataCnvnMdulCtrl S36_Diagnosis /end SUB_GROUP
/end GROUP
/begin GROUP S2_ELHPN_CfgDiag191_P "swc_EltlLnkHzrdProtnNet/ELHPN_10ms_sys/ELHPN_10ms_sys/ELHPN_CfgDiag191_P" /begin REF_CHARACTERISTIC ELHPN_CfgDiag191_P /end REF_CHARACTERISTIC /end GROUP
/begin GROUP S2_GB_CAN "swc_CIL/CIL_10ms_sys/GB_CAN"
 /begin SUB_GROUP S307_BSOF_AcvChManSuspd_P S307_BSOF_AcvChSuspdByBms_P S307_BSOF_AcvChSuspdCdnRchd_P S307_BSOF_AcvChSuspdFlt_P S307_BSOF_ChAllwd_P S307_BSOF_ErrChImpo_P S307_BSOF_ErrChrgrOutpFlt_P S307_BSOF_ErrChrgrOvtempFlt_P S307_BSOF_ErrChrgrOvtempIntFlt_P S307_BSOF_ErrChrgrShtdnEmcy_P S307_BSOF_ErrIDe_P S307_BSOF_ErrUAbno_P S307_BSOF_ErrUndfnd_P S307_BSOF_IChrgr_P S307_BSOF_TiChAccumd_P S307_BSOF_UChrgr_P S307_DTRC_Csw_P_11 S307_DTRC_Csw_P_16 S307_DTRC_Csw_P_17 S307_DTRC_Csw_P_18 S307_DTRC_Csw_P_19 S307_DTRC_Csw_P_20 S307_DTRC_Csw_P_21 S307_DTRC_Csw_P_22 S307_DTRC_Csw_P_23 S307_DTRC_Csw_P_27 S307_DTRC_Csw_P_28 S307_DTRC_Csw_P_29 S307_DTRC_Csw_P_30 S307_DTRC_Csw_P_31 S307_DTRC_Csw_P_36 S307_DTRC_Csw_P_37 /end SUB_GROUP
/end GROUP
/begin GROUP S2_HighVoltageInterlock_ "swc_EltlLnkHzrdProtnNet/ELHPN_10ms_sys/ELHPN_10ms_sys/HighVoltageInterlock "
 /begin SUB_GROUP S21_BitSelect S21_ELHPN_CfgHvil2_P S21_ELHPN_DucycHvilReq_P1 S21_ELHPN_DucycHvilTolr_P1 S21_ELHPN_FrqHvilReq_P1 S21_ELHPN_FrqHvilTolr_P1 S21_ELHPN_IdxHvilReq_P1 S21_ELHPN_TiDebOffHvIntlc_P S21_ELHPN_TiDebOnHvIntlc_P S21_ELHPN_TiSample11 S21_InitialCheck /end SUB_GROUP
/end GROUP
/begin GROUP S2_InhibitionIsolationMeasurement "swc_EltlLnkHzrdProtnNet/ELHPN_10ms_sys/ELHPN_10ms_sys/InhibitionIsolationMeasurement" /begin SUB_GROUP S22_ELHPN_bDisaIslnMeas_M /end SUB_GROUP /end GROUP
/begin GROUP S2_SofPackLimn "swc_BatCoreFct/BCF_10ms_sys/SofPackLimn"
 /begin SUB_GROUP S809_SOF_Current_Limits_Derating S809_SOF_Power_Limits_Derating S809_SOF_Voltage_Limits_Derating /end SUB_GROUP
/end GROUP
/begin GROUP S2_StateIsolation "swc_EltlLnkHzrdProtnNet/ELHPN_10ms_sys/ELHPN_10ms_sys/StateIsolation" /begin SUB_GROUP S23_ELHPN_TiIslnIninChk_P1 S23_StIsln /end SUB_GROUP /end GROUP
/begin GROUP S2_Subsystem "swc_BatProtnIU/PackIDiag/Subsystem"
 /begin SUB_GROUP S241_ChargeCurrentDiagnosis S241_DischargeCurrentDiagnosis S241_ISnsrLimDiagnosis S241_SupplyVoltageDiagnosis /end SUB_GROUP
/end GROUP
/begin GROUP S2_ThermManage "swc_BatThermHndlgMngt/BTHM_100ms_sys/100ms/ThermManage"
 /begin SUB_GROUP S37_BTHM_TExitTherm_P S37_BTHM_TiDlyDchaTherm_P S37_BTHM_TiDlyForIDetn_P S37_BTHM_TiDlyForIDetn_P1 S37_BTHM_TiDlyForUDetn_P S37_BTHM_TiDlyForUDetn_P1 S37_BTHM_TiDlyToTClcd_P1 S37_BTHM_TiRlyDlyNegOpen_P S37_BTHM_TiTask100Ms_P S37_BTHM_TiTask100Ms_P1 S37_HeatThermalCondition S37_LiquidThermalCondition /end SUB_GROUP
/end GROUP
/begin GROUP S2_Veh_CAN "swc_CIL/CIL_10ms_sys/Veh_CAN"
 /begin SUB_GROUP S309_CIL_ModeMotDrv_P S309_CIL_RngElec_P S309_CIL_SpdMot_P S309_CIL_SpdVeh_P S309_CIL_StCrash_P S309_DTRC_Csw_P_1 S309_DTRC_Csw_P_2 S309_DTRC_Csw_P_3 S309_DTRC_Csw_P_47 S309_DTRC_Csw_P_80 /end SUB_GROUP
/end GROUP
/begin GROUP S305_ElecVehChegnStHdlr "swc_BatChCtl/DC_10ms_sys/ElecVehChegnStHdlr_Sys/ElecVehChegnStHdlr" /begin SUB_GROUP S307_BCL S307_BSM S307_Diagnosis S307_Main /end SUB_GROUP /end GROUP
/begin GROUP S306_BCF_CMdulAgiFacSatn_M "swc_BatCoreFct/BCF_100ms_sys/BatCoreFct/PackObs/PackObsLoop/MdulObs/MdulCObs/Update CMdulAgiFac/Calculate update of aging factor/BCF_CMdulAgiFacSatn_M" /begin REF_CHARACTERISTIC BCF_CMdulAgiFacSatn_M /end REF_CHARACTERISTIC /end GROUP
/begin GROUP S306_BCF_CMdulAgiFacUpd_P "swc_BatCoreFct/BCF_100ms_sys/BatCoreFct/PackObs/PackObsLoop/MdulObs/MdulCObs/Update CMdulAgiFac/Calculate update of aging factor/BCF_CMdulAgiFacUpd_P" /begin REF_CHARACTERISTIC BCF_CMdulAgiFacUpd_P /end REF_CHARACTERISTIC /end GROUP
/begin GROUP S307_BCL "swc_BatChCtl/DC_10ms_sys/ElecVehChegnStHdlr_Sys/ElecVehChegnStHdlr/BCL"
 /begin SUB_GROUP S308_BCC_EffDcdc_P S308_BCC_IThermReq_P S308_BCC_PwrPtcTherm_P S308_BCC_UOfsThermReq_P /end SUB_GROUP
/end GROUP
/begin GROUP S307_BSM "swc_BatChCtl/DC_10ms_sys/ElecVehChegnStHdlr_Sys/ElecVehChegnStHdlr/BSM"
 /begin SUB_GROUP S310_CompareToCalibrationPara1 S310_CompareToCalibrationPara23 /end SUB_GROUP
/end GROUP
/begin GROUP S307_BSOF_AcvChManSuspd_P "swc_CIL/CIL_10ms_sys/GB_CAN/BSOF_AcvChManSuspd_P" /begin REF_CHARACTERISTIC BSOF_AcvChManSuspd_P /end REF_CHARACTERISTIC /end GROUP
/begin GROUP S307_BSOF_AcvChSuspdByBms_P "swc_CIL/CIL_10ms_sys/GB_CAN/BSOF_AcvChSuspdByBms_P" /begin REF_CHARACTERISTIC BSOF_AcvChSuspdByBms_P /end REF_CHARACTERISTIC /end GROUP
/begin GROUP S307_BSOF_AcvChSuspdCdnRchd_P "swc_CIL/CIL_10ms_sys/GB_CAN/BSOF_AcvChSuspdCdnRchd_P" /begin REF_CHARACTERISTIC BSOF_AcvChSuspdCdnRchd_P /end REF_CHARACTERISTIC /end GROUP
/begin GROUP S307_BSOF_AcvChSuspdFlt_P "swc_CIL/CIL_10ms_sys/GB_CAN/BSOF_AcvChSuspdFlt_P" /begin REF_CHARACTERISTIC BSOF_AcvChSuspdFlt_P /end REF_CHARACTERISTIC /end GROUP
/begin GROUP S307_BSOF_ChAllwd_P "swc_CIL/CIL_10ms_sys/GB_CAN/BSOF_ChAllwd_P" /begin REF_CHARACTERISTIC BSOF_ChAllwd_P /end REF_CHARACTERISTIC /end GROUP
/begin GROUP S307_BSOF_ErrChImpo_P "swc_CIL/CIL_10ms_sys/GB_CAN/BSOF_ErrChImpo_P" /begin REF_CHARACTERISTIC BSOF_ErrChImpo_P /end REF_CHARACTERISTIC /end GROUP
/begin GROUP S307_BSOF_ErrChrgrOutpFlt_P "swc_CIL/CIL_10ms_sys/GB_CAN/BSOF_ErrChrgrOutpFlt_P" /begin REF_CHARACTERISTIC BSOF_ErrChrgrOutpFlt_P /end REF_CHARACTERISTIC /end GROUP
/begin GROUP S307_BSOF_ErrChrgrOvtempFlt_P "swc_CIL/CIL_10ms_sys/GB_CAN/BSOF_ErrChrgrOvtempFlt_P" /begin REF_CHARACTERISTIC BSOF_ErrChrgrOvtempFlt_P /end REF_CHARACTERISTIC /end GROUP
/begin GROUP S307_BSOF_ErrChrgrOvtempIntFlt_P "swc_CIL/CIL_10ms_sys/GB_CAN/BSOF_ErrChrgrOvtempIntFlt_P" /begin REF_CHARACTERISTIC BSOF_ErrChrgrOvtempIntFlt_P /end REF_CHARACTERISTIC /end GROUP
/begin GROUP S307_BSOF_ErrChrgrShtdnEmcy_P "swc_CIL/CIL_10ms_sys/GB_CAN/BSOF_ErrChrgrShtdnEmcy_P" /begin REF_CHARACTERISTIC BSOF_ErrChrgrShtdnEmcy_P /end REF_CHARACTERISTIC /end GROUP
/begin GROUP S307_BSOF_ErrIDe_P "swc_CIL/CIL_10ms_sys/GB_CAN/BSOF_ErrIDe_P" /begin REF_CHARACTERISTIC BSOF_ErrIDe_P /end REF_CHARACTERISTIC /end GROUP
/begin GROUP S307_BSOF_ErrUAbno_P "swc_CIL/CIL_10ms_sys/GB_CAN/BSOF_ErrUAbno_P" /begin REF_CHARACTERISTIC BSOF_ErrUAbno_P /end REF_CHARACTERISTIC /end GROUP
/begin GROUP S307_BSOF_ErrUndfnd_P "swc_CIL/CIL_10ms_sys/GB_CAN/BSOF_ErrUndfnd_P" /begin REF_CHARACTERISTIC BSOF_ErrUndfnd_P /end REF_CHARACTERISTIC /end GROUP
/begin GROUP S307_BSOF_IChrgr_P "swc_CIL/CIL_10ms_sys/GB_CAN/BSOF_IChrgr_P" /begin REF_CHARACTERISTIC BSOF_IChrgr_P /end REF_CHARACTERISTIC /end GROUP
/begin GROUP S307_BSOF_TiChAccumd_P "swc_CIL/CIL_10ms_sys/GB_CAN/BSOF_TiChAccumd_P" /begin REF_CHARACTERISTIC BSOF_TiChAccumd_P /end REF_CHARACTERISTIC /end GROUP
/begin GROUP S307_BSOF_UChrgr_P "swc_CIL/CIL_10ms_sys/GB_CAN/BSOF_UChrgr_P" /begin REF_CHARACTERISTIC BSOF_UChrgr_P /end REF_CHARACTERISTIC /end GROUP
/begin GROUP S307_Diagnosis "swc_BatChCtl/DC_10ms_sys/ElecVehChegnStHdlr_Sys/ElecVehChegnStHdlr/Diagnosis"
 /begin SUB_GROUP S313_BCC_TiOffDig139_P S313_BCC_TiOffDig249_P S313_BCC_TiOffDig33_P S313_BCC_TiOffDig54_P S313_BCC_TiOffDig55_P S313_BCC_TiOffDig69_P S313_BCC_TiOffDig72_P S313_BCC_TiOnDig139_P S313_BCC_TiOnDig249_P S313_BCC_TiOnDig33_P S313_BCC_TiOnDig54_P S313_BCC_TiOnDig55_P S313_BCC_TiOnDig69_P S313_BCC_TiOnDig72_P S313_BCC_ValDig33_P S313_BitSelect S313_BitSelect1 S313_BitSelect10 S313_BitSelect11 S313_BitSelect12 S313_BitSelect13 S313_BitSelect14 S313_BitSelect15 S313_BitSelect16 S313_BitSelect17 S313_BitSelect18 S313_BitSelect2 S313_BitSelect22 S313_BitSelect23 S313_BitSelect3 S313_BitSelect4 S313_BitSelect5 S313_BitSelect6 S313_BitSelect7 S313_BitSelect8 S313_BitSelect9 S313_CompareToCalibrationPara1 S313_CompareToCalibrationPara2 S313_CompareToCalibrationPara3 S313_CompareToCalibrationPara4 S313_CompareToCalibrationPara5 S313_CompareToCalibrationPara6 S313_CompareToCalibrationPara7 S313_CompareToCalibrationPara8 S313_EVCSH_FacTi_P S313_EVCSH_FacTi_P1 S313_EVCSH_FacTi_P2 S313_EVCSH_FacTi_P3 S313_EVCSH_FacTi_P4 S313_EVCSH_FacTi_P5 S313_EVCSH_FacTi_P6 /end SUB_GROUP
/end GROUP
/begin GROUP S307_DTRC_Csw_P_11 "swc_CIL/CIL_10ms_sys/GB_CAN/DTRC_Csw_P.11" /begin REF_CHARACTERISTIC CIL_Csw4_P /end REF_CHARACTERISTIC /end GROUP
/begin GROUP S307_DTRC_Csw_P_16 "swc_CIL/CIL_10ms_sys/GB_CAN/DTRC_Csw_P.16" /begin REF_CHARACTERISTIC CIL_Csw4_P /end REF_CHARACTERISTIC /end GROUP
/begin GROUP S307_DTRC_Csw_P_17 "swc_CIL/CIL_10ms_sys/GB_CAN/DTRC_Csw_P.17" /begin REF_CHARACTERISTIC CIL_Csw4_P /end REF_CHARACTERISTIC /end GROUP
/begin GROUP S307_DTRC_Csw_P_18 "swc_CIL/CIL_10ms_sys/GB_CAN/DTRC_Csw_P.18" /begin REF_CHARACTERISTIC CIL_Csw4_P /end REF_CHARACTERISTIC /end GROUP
/begin GROUP S307_DTRC_Csw_P_19 "swc_CIL/CIL_10ms_sys/GB_CAN/DTRC_Csw_P.19" /begin REF_CHARACTERISTIC CIL_Csw4_P /end REF_CHARACTERISTIC /end GROUP
/begin GROUP S307_DTRC_Csw_P_20 "swc_CIL/CIL_10ms_sys/GB_CAN/DTRC_Csw_P.20" /begin REF_CHARACTERISTIC CIL_Csw4_P /end REF_CHARACTERISTIC /end GROUP
/begin GROUP S307_DTRC_Csw_P_21 "swc_CIL/CIL_10ms_sys/GB_CAN/DTRC_Csw_P.21" /begin REF_CHARACTERISTIC CIL_Csw4_P /end REF_CHARACTERISTIC /end GROUP
/begin GROUP S307_DTRC_Csw_P_22 "swc_CIL/CIL_10ms_sys/GB_CAN/DTRC_Csw_P.22" /begin REF_CHARACTERISTIC CIL_Csw4_P /end REF_CHARACTERISTIC /end GROUP
/begin GROUP S307_DTRC_Csw_P_23 "swc_CIL/CIL_10ms_sys/GB_CAN/DTRC_Csw_P.23" /begin REF_CHARACTERISTIC CIL_Csw4_P /end REF_CHARACTERISTIC /end GROUP
/begin GROUP S307_DTRC_Csw_P_27 "swc_CIL/CIL_10ms_sys/GB_CAN/DTRC_Csw_P.27" /begin REF_CHARACTERISTIC CIL_Csw4_P /end REF_CHARACTERISTIC /end GROUP
/begin GROUP S307_DTRC_Csw_P_28 "swc_CIL/CIL_10ms_sys/GB_CAN/DTRC_Csw_P.28" /begin REF_CHARACTERISTIC CIL_Csw4_P /end REF_CHARACTERISTIC /end GROUP
/begin GROUP S307_DTRC_Csw_P_29 "swc_CIL/CIL_10ms_sys/GB_CAN/DTRC_Csw_P.29" /begin REF_CHARACTERISTIC CIL_Csw4_P /end REF_CHARACTERISTIC /end GROUP
/begin GROUP S307_DTRC_Csw_P_30 "swc_CIL/CIL_10ms_sys/GB_CAN/DTRC_Csw_P.30" /begin REF_CHARACTERISTIC CIL_Csw4_P /end REF_CHARACTERISTIC /end GROUP
/begin GROUP S307_DTRC_Csw_P_31 "swc_CIL/CIL_10ms_sys/GB_CAN/DTRC_Csw_P.31" /begin REF_CHARACTERISTIC CIL_Csw4_P /end REF_CHARACTERISTIC /end GROUP
/begin GROUP S307_DTRC_Csw_P_36 "swc_CIL/CIL_10ms_sys/GB_CAN/DTRC_Csw_P.36" /begin REF_CHARACTERISTIC CIL_Csw4_P /end REF_CHARACTERISTIC /end GROUP
/begin GROUP S307_DTRC_Csw_P_37 "swc_CIL/CIL_10ms_sys/GB_CAN/DTRC_Csw_P.37" /begin REF_CHARACTERISTIC CIL_Csw4_P /end REF_CHARACTERISTIC /end GROUP
/begin GROUP S307_Main "swc_BatChCtl/DC_10ms_sys/ElecVehChegnStHdlr_Sys/ElecVehChegnStHdlr/Main"
 /begin SUB_GROUP S314_EVCSH_NrDcChCom_P S314_OverrideFlags S314_TerminateConditions S314_Timeouts S314_TransitionManager /end SUB_GROUP
/end GROUP
/begin GROUP S308_BCF_CMdulAgiFacInvldErrMin_M "swc_BatCoreFct/BCF_100ms_sys/BatCoreFct/PackObs/PackObsLoop/MdulObs/MdulCObs/Update CMdulAgiFac/Diagnostic of module degradation/BCF_CMdulAgiFacInvldErrMin_M" /begin REF_CHARACTERISTIC BCF_CMdulAgiFacInvldErrMin_M /end REF_CHARACTERISTIC /end GROUP
/begin GROUP S308_BCF_CMdulAgiFacVldErrMin_M "swc_BatCoreFct/BCF_100ms_sys/BatCoreFct/PackObs/PackObsLoop/MdulObs/MdulCObs/Update CMdulAgiFac/Diagnostic of module degradation/BCF_CMdulAgiFacVldErrMin_M" /begin REF_CHARACTERISTIC BCF_CMdulAgiFacVldErrMin_M /end REF_CHARACTERISTIC /end GROUP
/begin GROUP S308_BCF_TdOffDig1004_P "swc_BatCoreFct/BCF_100ms_sys/BatCoreFct/PackObs/PackObsLoop/MdulObs/MdulCObs/Update CMdulAgiFac/Diagnostic of module degradation/BCF_TdOffDig1004_P" /begin REF_CHARACTERISTIC BCF_TdOffDig1004_P /end REF_CHARACTERISTIC /end GROUP
/begin GROUP S308_BCF_TdOnDig1004_P "swc_BatCoreFct/BCF_100ms_sys/BatCoreFct/PackObs/PackObsLoop/MdulObs/MdulCObs/Update CMdulAgiFac/Diagnostic of module degradation/BCF_TdOnDig1004_P" /begin REF_CHARACTERISTIC BCF_TdOnDig1004_P /end REF_CHARACTERISTIC /end GROUP
/begin GROUP S309_BCF_CMdulAgiFacLowrLim_P "swc_BatCoreFct/BCF_100ms_sys/BatCoreFct/PackObs/PackObsLoop/MdulObs/MdulCObs/Update CMdulAgiFac/Update new aging factor/BCF_CMdulAgiFacLowrLim_P" /begin REF_CHARACTERISTIC BCF_CMdulAgiFacLowrLim_P /end REF_CHARACTERISTIC /end GROUP
/begin GROUP S309_BCF_CMdulAgiFacUpprLim_P "swc_BatCoreFct/BCF_100ms_sys/BatCoreFct/PackObs/PackObsLoop/MdulObs/MdulCObs/Update CMdulAgiFac/Update new aging factor/BCF_CMdulAgiFacUpprLim_P" /begin REF_CHARACTERISTIC BCF_CMdulAgiFacUpprLim_P /end REF_CHARACTERISTIC /end GROUP
/begin GROUP S309_CIL_ModeMotDrv_P "swc_CIL/CIL_10ms_sys/Veh_CAN/CIL_ModeMotDrv_P" /begin REF_CHARACTERISTIC CIL_ModeMotDrv_P /end REF_CHARACTERISTIC /end GROUP
/begin GROUP S309_CIL_RngElec_P "swc_CIL/CIL_10ms_sys/Veh_CAN/CIL_RngElec_P" /begin REF_CHARACTERISTIC CIL_RngElec_P /end REF_CHARACTERISTIC /end GROUP
/begin GROUP S309_CIL_SpdMot_P "swc_CIL/CIL_10ms_sys/Veh_CAN/CIL_SpdMot_P" /begin REF_CHARACTERISTIC CIL_SpdMot_P /end REF_CHARACTERISTIC /end GROUP
/begin GROUP S309_CIL_SpdVeh_P "swc_CIL/CIL_10ms_sys/Veh_CAN/CIL_SpdVeh_P" /begin REF_CHARACTERISTIC CIL_SpdVeh_P /end REF_CHARACTERISTIC /end GROUP
/begin GROUP S309_CIL_StCrash_P "swc_CIL/CIL_10ms_sys/Veh_CAN/CIL_StCrash_P" /begin REF_CHARACTERISTIC CIL_StCrash_P /end REF_CHARACTERISTIC /end GROUP
/begin GROUP S309_DTRC_Csw_P_1 "swc_CIL/CIL_10ms_sys/Veh_CAN/DTRC_Csw_P.1" /begin REF_CHARACTERISTIC CIL_Csw5_P /end REF_CHARACTERISTIC /end GROUP
/begin GROUP S309_DTRC_Csw_P_2 "swc_CIL/CIL_10ms_sys/Veh_CAN/DTRC_Csw_P.2" /begin REF_CHARACTERISTIC CIL_Csw5_P /end REF_CHARACTERISTIC /end GROUP
/begin GROUP S309_DTRC_Csw_P_3 "swc_CIL/CIL_10ms_sys/Veh_CAN/DTRC_Csw_P.3" /begin REF_CHARACTERISTIC CIL_Csw5_P /end REF_CHARACTERISTIC /end GROUP
/begin GROUP S309_DTRC_Csw_P_47 "swc_CIL/CIL_10ms_sys/Veh_CAN/DTRC_Csw_P.47" /begin REF_CHARACTERISTIC CIL_Csw5_P /end REF_CHARACTERISTIC /end GROUP
/begin GROUP S309_DTRC_Csw_P_80 "swc_CIL/CIL_10ms_sys/Veh_CAN/DTRC_Csw_P.80" /begin REF_CHARACTERISTIC CIL_Csw5_P /end REF_CHARACTERISTIC /end GROUP
/begin GROUP S30_BPIU_TiOffDig56_P "swc_BatProtnIU/CellUDiag/100ms/CellVoltageDiagnosis/UCellRateDiagnosis/BPIU_TiOffDig56_P" /begin REF_CHARACTERISTIC BPIU_TiOffDig56_P /end REF_CHARACTERISTIC /end GROUP
/begin GROUP S30_BPIU_TiOnDig56_P "swc_BatProtnIU/CellUDiag/100ms/CellVoltageDiagnosis/UCellRateDiagnosis/BPIU_TiOnDig56_P" /begin REF_CHARACTERISTIC BPIU_TiOnDig56_P /end REF_CHARACTERISTIC /end GROUP
/begin GROUP S30_BPIU_UCellRateMaxLim_P "swc_BatProtnIU/CellUDiag/100ms/CellVoltageDiagnosis/UCellRateDiagnosis/BPIU_UCellRateMaxLim_P" /begin REF_CHARACTERISTIC BPIU_UCellRateMaxLim_P /end REF_CHARACTERISTIC /end GROUP
/begin GROUP S30_BPIU_UCellRateOff_P "swc_BatProtnIU/CellUDiag/100ms/CellVoltageDiagnosis/UCellRateDiagnosis/BPIU_UCellRateOff_P" /begin REF_CHARACTERISTIC BPIU_UCellRateOff_P /end REF_CHARACTERISTIC /end GROUP
/begin GROUP S310_BSOF_bAcvDcChrgrPlg_P "swc_CIL/CIL_10ms_sys/BSW/Client_Sever Signals/BSOF_bAcvDcChrgrPlg_P" /begin REF_CHARACTERISTIC BSOF_bAcvDcChrgrPlg_P /end REF_CHARACTERISTIC /end GROUP
/begin GROUP S310_BSOF_TiDcChrgrPlgOff_P "swc_CIL/CIL_10ms_sys/BSW/Client_Sever Signals/BSOF_TiDcChrgrPlgOff_P" /begin REF_CHARACTERISTIC BSOF_TiDcChrgrPlgOff_P /end REF_CHARACTERISTIC /end GROUP
/begin GROUP S310_BSOF_TiDcChrgrPlgOn_P "swc_CIL/CIL_10ms_sys/BSW/Client_Sever Signals/BSOF_TiDcChrgrPlgOn_P" /begin REF_CHARACTERISTIC BSOF_TiDcChrgrPlgOn_P /end REF_CHARACTERISTIC /end GROUP
/begin GROUP S310_BSOF_ValDcChrgrPlgRHi_P "swc_CIL/CIL_10ms_sys/BSW/Client_Sever Signals/BSOF_ValDcChrgrPlgRHi_P" /begin REF_CHARACTERISTIC BSOF_ValDcChrgrPlgRHi_P /end REF_CHARACTERISTIC /end GROUP
/begin GROUP S310_BSOF_ValDcChrgrPlgRLo_P "swc_CIL/CIL_10ms_sys/BSW/Client_Sever Signals/BSOF_ValDcChrgrPlgRLo_P" /begin REF_CHARACTERISTIC BSOF_ValDcChrgrPlgRLo_P /end REF_CHARACTERISTIC /end GROUP
/begin GROUP S310_CIL_DucycCrash_P "swc_CIL/CIL_10ms_sys/BSW/Client_Sever Signals/CIL_DucycCrash_P" /begin REF_CHARACTERISTIC CIL_DucycCrash_P /end REF_CHARACTERISTIC /end GROUP
/begin GROUP S310_CIL_DucycHvil_P "swc_CIL/CIL_10ms_sys/BSW/Client_Sever Signals/CIL_DucycHvil_P" /begin REF_CHARACTERISTIC CIL_DucycHvil_P /end REF_CHARACTERISTIC /end GROUP
/begin GROUP S310_CIL_FrqCrash_P "swc_CIL/CIL_10ms_sys/BSW/Client_Sever Signals/CIL_FrqCrash_P" /begin REF_CHARACTERISTIC CIL_FrqCrash_P /end REF_CHARACTERISTIC /end GROUP
/begin GROUP S310_CIL_FrqHvil_P "swc_CIL/CIL_10ms_sys/BSW/Client_Sever Signals/CIL_FrqHvil_P" /begin REF_CHARACTERISTIC CIL_FrqHvil_P /end REF_CHARACTERISTIC /end GROUP
/begin GROUP S310_CIL_IdxDcChrgrPlgRstr_P "swc_CIL/CIL_10ms_sys/BSW/Client_Sever Signals/CIL_IdxDcChrgrPlgRstr_P" /begin REF_CHARACTERISTIC CIL_IdxDcChrgrPlgRstr_P /end REF_CHARACTERISTIC /end GROUP
/begin GROUP S310_CIL_IdxDucycCrash_P "swc_CIL/CIL_10ms_sys/BSW/Client_Sever Signals/CIL_IdxDucycCrash_P" /begin REF_CHARACTERISTIC CIL_IdxDucycCrash_P /end REF_CHARACTERISTIC /end GROUP
/begin GROUP S310_CIL_IdxFrqCrash_P "swc_CIL/CIL_10ms_sys/BSW/Client_Sever Signals/CIL_IdxFrqCrash_P" /begin REF_CHARACTERISTIC CIL_IdxFrqCrash_P /end REF_CHARACTERISTIC /end GROUP
/begin GROUP S310_CIL_IdxHvilDucyc_P "swc_CIL/CIL_10ms_sys/BSW/Client_Sever Signals/CIL_IdxHvilDucyc_P" /begin REF_CHARACTERISTIC CIL_IdxHvilDucyc_P /end REF_CHARACTERISTIC /end GROUP
/begin GROUP S310_CIL_IdxHvilFrq_P "swc_CIL/CIL_10ms_sys/BSW/Client_Sever Signals/CIL_IdxHvilFrq_P" /begin REF_CHARACTERISTIC CIL_IdxHvilFrq_P /end REF_CHARACTERISTIC /end GROUP
/begin GROUP S310_CIL_IdxPortAcChTNeg_P "swc_CIL/CIL_10ms_sys/BSW/Client_Sever Signals/CIL_IdxPortAcChTNeg_P" /begin REF_CHARACTERISTIC CIL_IdxPortAcChTNeg_P /end REF_CHARACTERISTIC /end GROUP
/begin GROUP S310_CIL_IdxPortAcChTPos_P "swc_CIL/CIL_10ms_sys/BSW/Client_Sever Signals/CIL_IdxPortAcChTPos_P" /begin REF_CHARACTERISTIC CIL_IdxPortAcChTPos_P /end REF_CHARACTERISTIC /end GROUP
/begin GROUP S310_CIL_IdxPortDcChTNeg_P "swc_CIL/CIL_10ms_sys/BSW/Client_Sever Signals/CIL_IdxPortDcChTNeg_P" /begin REF_CHARACTERISTIC CIL_IdxPortDcChTNeg_P /end REF_CHARACTERISTIC /end GROUP
/begin GROUP S310_CIL_IdxPortDcChTPos_P "swc_CIL/CIL_10ms_sys/BSW/Client_Sever Signals/CIL_IdxPortDcChTPos_P" /begin REF_CHARACTERISTIC CIL_IdxPortDcChTPos_P /end REF_CHARACTERISTIC /end GROUP
/begin GROUP S310_CIL_IdxStChWup_P "swc_CIL/CIL_10ms_sys/BSW/Client_Sever Signals/CIL_IdxStChWup_P" /begin REF_CHARACTERISTIC CIL_IdxStChWup_P /end REF_CHARACTERISTIC /end GROUP
/begin GROUP S310_CIL_IdxStTrml15_P "swc_CIL/CIL_10ms_sys/BSW/Client_Sever Signals/CIL_IdxStTrml15_P" /begin REF_CHARACTERISTIC CIL_IdxStTrml15_P /end REF_CHARACTERISTIC /end GROUP
/begin GROUP S310_CIL_IdxUChPoleHiSideDrv_P "swc_CIL/CIL_10ms_sys/BSW/Client_Sever Signals/CIL_IdxUChPoleHiSideDrv_P" /begin REF_CHARACTERISTIC CIL_IdxUChPoleHiSideDrv_P /end REF_CHARACTERISTIC /end GROUP
/begin GROUP S310_CIL_IdxUHeatPoleHiSideDrv_P "swc_CIL/CIL_10ms_sys/BSW/Client_Sever Signals/CIL_IdxUHeatPoleHiSideDrv_P" /begin REF_CHARACTERISTIC CIL_IdxUHeatPoleHiSideDrv_P /end REF_CHARACTERISTIC /end GROUP
/begin GROUP S310_CIL_IdxUMainNegPoleHiSideDrv_P "swc_CIL/CIL_10ms_sys/BSW/Client_Sever Signals/CIL_IdxUMainNegPoleHiSideDrv_P" /begin REF_CHARACTERISTIC CIL_IdxUMainNegPoleHiSideDrv_P /end REF_CHARACTERISTIC /end GROUP
/begin GROUP S310_CIL_IdxUMainPosPoleHiSideDrv_P "swc_CIL/CIL_10ms_sys/BSW/Client_Sever Signals/CIL_IdxUMainPosPoleHiSideDrv_P" /begin REF_CHARACTERISTIC CIL_IdxUMainPosPoleHiSideDrv_P /end REF_CHARACTERISTIC /end GROUP
/begin GROUP S310_CIL_IdxURlyPrechHiSideDrv_P "swc_CIL/CIL_10ms_sys/BSW/Client_Sever Signals/CIL_IdxURlyPrechHiSideDrv_P" /begin REF_CHARACTERISTIC CIL_IdxURlyPrechHiSideDrv_P /end REF_CHARACTERISTIC /end GROUP
/begin GROUP S310_CIL_IdxUTrml30_P "swc_CIL/CIL_10ms_sys/BSW/Client_Sever Signals/CIL_IdxUTrml30_P" /begin REF_CHARACTERISTIC CIL_IdxUTrml30_P /end REF_CHARACTERISTIC /end GROUP
/begin GROUP S310_CIL_StChWup_P "swc_CIL/CIL_10ms_sys/BSW/Client_Sever Signals/CIL_StChWup_P" /begin REF_CHARACTERISTIC CIL_StChWup_P /end REF_CHARACTERISTIC /end GROUP
/begin GROUP S310_CIL_StTrml15_P "swc_CIL/CIL_10ms_sys/BSW/Client_Sever Signals/CIL_StTrml15_P" /begin REF_CHARACTERISTIC CIL_StTrml15_P /end REF_CHARACTERISTIC /end GROUP
/begin GROUP S310_CIL_TAcChPointNeg_P "swc_CIL/CIL_10ms_sys/BSW/Client_Sever Signals/CIL_TAcChPointNeg_P" /begin REF_CHARACTERISTIC CIL_TAcChPointNeg_P /end REF_CHARACTERISTIC /end GROUP
/begin GROUP S310_CIL_TAcChPointPos_P "swc_CIL/CIL_10ms_sys/BSW/Client_Sever Signals/CIL_TAcChPointPos_P" /begin REF_CHARACTERISTIC CIL_TAcChPointPos_P /end REF_CHARACTERISTIC /end GROUP
/begin GROUP S310_CIL_TDcChPointNeg_P "swc_CIL/CIL_10ms_sys/BSW/Client_Sever Signals/CIL_TDcChPointNeg_P" /begin REF_CHARACTERISTIC CIL_TDcChPointNeg_P /end REF_CHARACTERISTIC /end GROUP
/begin GROUP S310_CIL_TDcChPointPos_P "swc_CIL/CIL_10ms_sys/BSW/Client_Sever Signals/CIL_TDcChPointPos_P" /begin REF_CHARACTERISTIC CIL_TDcChPointPos_P /end REF_CHARACTERISTIC /end GROUP
/begin GROUP S310_CIL_TiProc_P "swc_CIL/CIL_10ms_sys/BSW/Client_Sever Signals/CIL_TiProc_P" /begin REF_CHARACTERISTIC CIL_TiProc_P /end REF_CHARACTERISTIC /end GROUP
/begin GROUP S310_CIL_UChPoleHiSideDrv_P "swc_CIL/CIL_10ms_sys/BSW/Client_Sever Signals/CIL_UChPoleHiSideDrv_P" /begin REF_CHARACTERISTIC CIL_UChPoleHiSideDrv_P /end REF_CHARACTERISTIC /end GROUP
/begin GROUP S310_CIL_UHeatPoleHiSideDrv_P "swc_CIL/CIL_10ms_sys/BSW/Client_Sever Signals/CIL_UHeatPoleHiSideDrv_P" /begin REF_CHARACTERISTIC CIL_UHeatPoleHiSideDrv_P /end REF_CHARACTERISTIC /end GROUP
/begin GROUP S310_CIL_UMainNegPoleHiSideDrv_P "swc_CIL/CIL_10ms_sys/BSW/Client_Sever Signals/CIL_UMainNegPoleHiSideDrv_P" /begin REF_CHARACTERISTIC CIL_UMainNegPoleHiSideDrv_P /end REF_CHARACTERISTIC /end GROUP
/begin GROUP S310_CIL_UMainPosPoleHiSideDrv_P "swc_CIL/CIL_10ms_sys/BSW/Client_Sever Signals/CIL_UMainPosPoleHiSideDrv_P" /begin REF_CHARACTERISTIC CIL_UMainPosPoleHiSideDrv_P /end REF_CHARACTERISTIC /end GROUP
/begin GROUP S310_CIL_URlyPrechHiSideDrv_P "swc_CIL/CIL_10ms_sys/BSW/Client_Sever Signals/CIL_URlyPrechHiSideDrv_P" /begin REF_CHARACTERISTIC CIL_URlyPrechHiSideDrv_P /end REF_CHARACTERISTIC /end GROUP
/begin GROUP S310_CIL_UThdForStChWup_P "swc_CIL/CIL_10ms_sys/BSW/Client_Sever Signals/CIL_UThdForStChWup_P" /begin REF_CHARACTERISTIC CIL_UThdForStChWup_P /end REF_CHARACTERISTIC /end GROUP
/begin GROUP S310_CIL_UThdForTrml15_P "swc_CIL/CIL_10ms_sys/BSW/Client_Sever Signals/CIL_UThdForTrml15_P" /begin REF_CHARACTERISTIC CIL_UThdForTrml15_P /end REF_CHARACTERISTIC /end GROUP
/begin GROUP S310_CIL_UTrml30_P "swc_CIL/CIL_10ms_sys/BSW/Client_Sever Signals/CIL_UTrml30_P" /begin REF_CHARACTERISTIC CIL_UTrml30_P /end REF_CHARACTERISTIC /end GROUP
/begin GROUP S310_DTRC_Csw_P_0 "swc_CIL/CIL_10ms_sys/BSW/Client_Sever Signals/DTRC_Csw_P.0" /begin REF_CHARACTERISTIC CIL_Csw1_P /end REF_CHARACTERISTIC /end GROUP
/begin GROUP S310_DTRC_Csw_P_1 "swc_CIL/CIL_10ms_sys/BSW/Client_Sever Signals/DTRC_Csw_P.1" /begin REF_CHARACTERISTIC CIL_Csw1_P /end REF_CHARACTERISTIC /end GROUP
/begin GROUP S310_DTRC_Csw_P_10 "swc_CIL/CIL_10ms_sys/BSW/Client_Sever Signals/DTRC_Csw_P.10" /begin REF_CHARACTERISTIC CIL_Csw1_P /end REF_CHARACTERISTIC /end GROUP
/begin GROUP S310_DTRC_Csw_P_11 "swc_CIL/CIL_10ms_sys/BSW/Client_Sever Signals/DTRC_Csw_P.11" /begin REF_CHARACTERISTIC CIL_Csw1_P /end REF_CHARACTERISTIC /end GROUP
/begin GROUP S310_DTRC_Csw_P_12 "swc_CIL/CIL_10ms_sys/BSW/Client_Sever Signals/DTRC_Csw_P.12" /begin REF_CHARACTERISTIC CIL_Csw1_P /end REF_CHARACTERISTIC /end GROUP
/begin GROUP S310_DTRC_Csw_P_13 "swc_CIL/CIL_10ms_sys/BSW/Client_Sever Signals/DTRC_Csw_P.13" /begin REF_CHARACTERISTIC CIL_Csw1_P /end REF_CHARACTERISTIC /end GROUP
/begin GROUP S310_DTRC_Csw_P_14 "swc_CIL/CIL_10ms_sys/BSW/Client_Sever Signals/DTRC_Csw_P.14" /begin REF_CHARACTERISTIC CIL_Csw1_P /end REF_CHARACTERISTIC /end GROUP
/begin GROUP S310_DTRC_Csw_P_15 "swc_CIL/CIL_10ms_sys/BSW/Client_Sever Signals/DTRC_Csw_P.15" /begin REF_CHARACTERISTIC CIL_Csw1_P /end REF_CHARACTERISTIC /end GROUP
/begin GROUP S310_DTRC_Csw_P_2 "swc_CIL/CIL_10ms_sys/BSW/Client_Sever Signals/DTRC_Csw_P.2" /begin REF_CHARACTERISTIC CIL_Csw1_P /end REF_CHARACTERISTIC /end GROUP
/begin GROUP S310_DTRC_Csw_P_3 "swc_CIL/CIL_10ms_sys/BSW/Client_Sever Signals/DTRC_Csw_P.3" /begin REF_CHARACTERISTIC CIL_Csw1_P /end REF_CHARACTERISTIC /end GROUP
/begin GROUP S310_DTRC_Csw_P_4 "swc_CIL/CIL_10ms_sys/BSW/Client_Sever Signals/DTRC_Csw_P.4" /begin REF_CHARACTERISTIC CIL_Csw1_P /end REF_CHARACTERISTIC /end GROUP
/begin GROUP S310_DTRC_Csw_P_48 "swc_CIL/CIL_10ms_sys/BSW/Client_Sever Signals/DTRC_Csw_P.48" /begin REF_CHARACTERISTIC CIL_Csw1_P /end REF_CHARACTERISTIC /end GROUP
/begin GROUP S310_DTRC_Csw_P_5 "swc_CIL/CIL_10ms_sys/BSW/Client_Sever Signals/DTRC_Csw_P.5" /begin REF_CHARACTERISTIC CIL_Csw1_P /end REF_CHARACTERISTIC /end GROUP
/begin GROUP S310_DTRC_Csw_P_6 "swc_CIL/CIL_10ms_sys/BSW/Client_Sever Signals/DTRC_Csw_P.6" /begin REF_CHARACTERISTIC CIL_Csw1_P /end REF_CHARACTERISTIC /end GROUP
/begin GROUP S310_DTRC_Csw_P_7 "swc_CIL/CIL_10ms_sys/BSW/Client_Sever Signals/DTRC_Csw_P.7" /begin REF_CHARACTERISTIC CIL_Csw1_P /end REF_CHARACTERISTIC /end GROUP
/begin GROUP S310_DTRC_Csw_P_8 "swc_CIL/CIL_10ms_sys/BSW/Client_Sever Signals/DTRC_Csw_P.8" /begin REF_CHARACTERISTIC CIL_Csw1_P /end REF_CHARACTERISTIC /end GROUP
/begin GROUP S310_DTRC_Csw_P_9 "swc_CIL/CIL_10ms_sys/BSW/Client_Sever Signals/DTRC_Csw_P.9" /begin REF_CHARACTERISTIC CIL_Csw1_P /end REF_CHARACTERISTIC /end GROUP
/begin GROUP S311_BSOF_bEnaMsgChrgrChDetd_P "swc_CIL/CIL_10ms_sys/BSW/Sender_Reciever Signals/BSOF_bEnaMsgChrgrChDetd_P" /begin REF_CHARACTERISTIC BSOF_bEnaMsgChrgrChDetd_P /end REF_CHARACTERISTIC /end GROUP
/begin GROUP S311_BSOF_bEnaMsgChrgrChSt_P "swc_CIL/CIL_10ms_sys/BSW/Sender_Reciever Signals/BSOF_bEnaMsgChrgrChSt_P" /begin REF_CHARACTERISTIC BSOF_bEnaMsgChrgrChSt_P /end REF_CHARACTERISTIC /end GROUP
/begin GROUP S311_BSOF_bEnaMsgChrgrChSt_P5 "swc_CIL/CIL_10ms_sys/BSW/Sender_Reciever Signals/BSOF_bEnaMsgChrgrChSt_P5" /begin REF_CHARACTERISTIC CIL_TiProc_P /end REF_CHARACTERISTIC /end GROUP
/begin GROUP S311_BSOF_bEnaMsgChrgrChSuspd_P "swc_CIL/CIL_10ms_sys/BSW/Sender_Reciever Signals/BSOF_bEnaMsgChrgrChSuspd_P" /begin REF_CHARACTERISTIC BSOF_bEnaMsgChrgrChSuspd_P /end REF_CHARACTERISTIC /end GROUP
/begin GROUP S311_BSOF_bEnaMsgChrgrDetnCnct_P "swc_CIL/CIL_10ms_sys/BSW/Sender_Reciever Signals/BSOF_bEnaMsgChrgrDetnCnct_P" /begin REF_CHARACTERISTIC BSOF_bEnaMsgChrgrDetnCnct_P /end REF_CHARACTERISTIC /end GROUP
/begin GROUP S311_BSOF_bEnaMsgChrgrErr_P "swc_CIL/CIL_10ms_sys/BSW/Sender_Reciever Signals/BSOF_bEnaMsgChrgrErr_P" /begin REF_CHARACTERISTIC BSOF_bEnaMsgChrgrErr_P /end REF_CHARACTERISTIC /end GROUP
/begin GROUP S311_BSOF_bEnaMsgChrgrHdshk_P "swc_CIL/CIL_10ms_sys/BSW/Sender_Reciever Signals/BSOF_bEnaMsgChrgrHdshk_P" /begin REF_CHARACTERISTIC BSOF_bEnaMsgChrgrHdshk_P /end REF_CHARACTERISTIC /end GROUP
/begin GROUP S311_BSOF_bEnaMsgChrgrMaxOut_P "swc_CIL/CIL_10ms_sys/BSW/Sender_Reciever Signals/BSOF_bEnaMsgChrgrMaxOut_P" /begin REF_CHARACTERISTIC BSOF_bEnaMsgChrgrMaxOut_P /end REF_CHARACTERISTIC /end GROUP
/begin GROUP S311_BSOF_bEnaMsgChrgrMaxOutPgtn_P "swc_CIL/CIL_10ms_sys/BSW/Sender_Reciever Signals/BSOF_bEnaMsgChrgrMaxOutPgtn_P" /begin REF_CHARACTERISTIC BSOF_bEnaMsgChrgrMaxOutPgtn_P /end REF_CHARACTERISTIC /end GROUP
/begin GROUP S311_BSOF_bEnaMsgChrgrRcgtn_P "swc_CIL/CIL_10ms_sys/BSW/Sender_Reciever Signals/BSOF_bEnaMsgChrgrRcgtn_P" /begin REF_CHARACTERISTIC BSOF_bEnaMsgChrgrRcgtn_P /end REF_CHARACTERISTIC /end GROUP
/begin GROUP S311_BSOF_bEnaMsgChrgrRdy_P "swc_CIL/CIL_10ms_sys/BSW/Sender_Reciever Signals/BSOF_bEnaMsgChrgrRdy_P" /begin REF_CHARACTERISTIC BSOF_bEnaMsgChrgrRdy_P /end REF_CHARACTERISTIC /end GROUP
/begin GROUP S311_BSOF_bEnaMsgChrgrStstc_P "swc_CIL/CIL_10ms_sys/BSW/Sender_Reciever Signals/BSOF_bEnaMsgChrgrStstc_P" /begin REF_CHARACTERISTIC BSOF_bEnaMsgChrgrStstc_P /end REF_CHARACTERISTIC /end GROUP
/begin GROUP S311_BSOF_bEnaMsgChrgrStstcForPgtn_P "swc_CIL/CIL_10ms_sys/BSW/Sender_Reciever Signals/BSOF_bEnaMsgChrgrStstcForPgtn_P" /begin REF_CHARACTERISTIC BSOF_bEnaMsgChrgrStstcForPgtn_P /end REF_CHARACTERISTIC /end GROUP
/begin GROUP S311_BSOF_TiMsgChrgrChDetd_P "swc_CIL/CIL_10ms_sys/BSW/Sender_Reciever Signals/BSOF_TiMsgChrgrChDetd_P" /begin REF_CHARACTERISTIC BSOF_TiMsgChrgrChDetd_P /end REF_CHARACTERISTIC /end GROUP
/begin GROUP S311_BSOF_TiMsgChrgrChSt_P "swc_CIL/CIL_10ms_sys/BSW/Sender_Reciever Signals/BSOF_TiMsgChrgrChSt_P" /begin REF_CHARACTERISTIC BSOF_TiMsgChrgrChSt_P /end REF_CHARACTERISTIC /end GROUP
/begin GROUP S311_BSOF_TiMsgChrgrChSuspd_P "swc_CIL/CIL_10ms_sys/BSW/Sender_Reciever Signals/BSOF_TiMsgChrgrChSuspd_P" /begin REF_CHARACTERISTIC BSOF_TiMsgChrgrChSuspd_P /end REF_CHARACTERISTIC /end GROUP
/begin GROUP S311_BSOF_TiMsgChrgrDetnCnct_P "swc_CIL/CIL_10ms_sys/BSW/Sender_Reciever Signals/BSOF_TiMsgChrgrDetnCnct_P" /begin REF_CHARACTERISTIC BSOF_TiMsgChrgrDetnCnct_P /end REF_CHARACTERISTIC /end GROUP
/begin GROUP S311_BSOF_TiMsgChrgrErr_P "swc_CIL/CIL_10ms_sys/BSW/Sender_Reciever Signals/BSOF_TiMsgChrgrErr_P" /begin REF_CHARACTERISTIC BSOF_TiMsgChrgrErr_P /end REF_CHARACTERISTIC /end GROUP
/begin GROUP S311_BSOF_TiMsgChrgrHdshk_P "swc_CIL/CIL_10ms_sys/BSW/Sender_Reciever Signals/BSOF_TiMsgChrgrHdshk_P" /begin REF_CHARACTERISTIC BSOF_TiMsgChrgrHdshk_P /end REF_CHARACTERISTIC /end GROUP
/begin GROUP S311_BSOF_TiMsgChrgrMaxOut_P "swc_CIL/CIL_10ms_sys/BSW/Sender_Reciever Signals/BSOF_TiMsgChrgrMaxOut_P" /begin REF_CHARACTERISTIC BSOF_TiMsgChrgrMaxOut_P /end REF_CHARACTERISTIC /end GROUP
/begin GROUP S311_BSOF_TiMsgChrgrMaxOutPgtn_P "swc_CIL/CIL_10ms_sys/BSW/Sender_Reciever Signals/BSOF_TiMsgChrgrMaxOutPgtn_P" /begin REF_CHARACTERISTIC BSOF_TiMsgChrgrMaxOutPgtn_P /end REF_CHARACTERISTIC /end GROUP
/begin GROUP S311_BSOF_TiMsgChrgrRcgtn_P "swc_CIL/CIL_10ms_sys/BSW/Sender_Reciever Signals/BSOF_TiMsgChrgrRcgtn_P" /begin REF_CHARACTERISTIC BSOF_TiMsgChrgrRcgtn_P /end REF_CHARACTERISTIC /end GROUP
/begin GROUP S311_BSOF_TiMsgChrgrRdy_P "swc_CIL/CIL_10ms_sys/BSW/Sender_Reciever Signals/BSOF_TiMsgChrgrRdy_P" /begin REF_CHARACTERISTIC BSOF_TiMsgChrgrRdy_P /end REF_CHARACTERISTIC /end GROUP
/begin GROUP S311_BSOF_TiMsgChrgrStstc_P "swc_CIL/CIL_10ms_sys/BSW/Sender_Reciever Signals/BSOF_TiMsgChrgrStstc_P" /begin REF_CHARACTERISTIC BSOF_TiMsgChrgrStstc_P /end REF_CHARACTERISTIC /end GROUP
/begin GROUP S311_BSOF_TiMsgChrgrStstcForPgtn_P "swc_CIL/CIL_10ms_sys/BSW/Sender_Reciever Signals/BSOF_TiMsgChrgrStstcForPgtn_P" /begin REF_CHARACTERISTIC BSOF_TiMsgChrgrStstcForPgtn_P /end REF_CHARACTERISTIC /end GROUP
/begin GROUP S311_CIL_bRdyBswStoreFnshd_P "swc_CIL/CIL_10ms_sys/BSW/Sender_Reciever Signals/CIL_bRdyBswStoreFnshd_P" /begin REF_CHARACTERISTIC CIL_bRdyBswStoreFnshd_P /end REF_CHARACTERISTIC /end GROUP
/begin GROUP S311_CIL_bVldBatIHv_P "swc_CIL/CIL_10ms_sys/BSW/Sender_Reciever Signals/CIL_bVldBatIHv_P" /begin REF_CHARACTERISTIC CIL_bVldBatIHv_P /end REF_CHARACTERISTIC /end GROUP
/begin GROUP S311_CIL_bVldCellTSamplg_P "swc_CIL/CIL_10ms_sys/BSW/Sender_Reciever Signals/CIL_bVldCellTSamplg_P" /begin REF_CHARACTERISTIC CIL_bVldCellTSamplg_P /end REF_CHARACTERISTIC /end GROUP
/begin GROUP S311_CIL_bVldCellUSamplg_P "swc_CIL/CIL_10ms_sys/BSW/Sender_Reciever Signals/CIL_bVldCellUSamplg_P" /begin REF_CHARACTERISTIC CIL_bVldCellUSamplg_P /end REF_CHARACTERISTIC /end GROUP
/begin GROUP S311_CIL_bVldIslnR_P "swc_CIL/CIL_10ms_sys/BSW/Sender_Reciever Signals/CIL_bVldIslnR_P" /begin REF_CHARACTERISTIC CIL_bVldIslnR_P /end REF_CHARACTERISTIC /end GROUP
/begin GROUP S311_CIL_bVldUMainNegPoleAftRly_P "swc_CIL/CIL_10ms_sys/BSW/Sender_Reciever Signals/CIL_bVldUMainNegPoleAftRly_P" /begin REF_CHARACTERISTIC CIL_bVldUMainNegPoleAftRly_P /end REF_CHARACTERISTIC /end GROUP
/begin GROUP S311_CIL_bVldUMainPosPoleAftRly_P "swc_CIL/CIL_10ms_sys/BSW/Sender_Reciever Signals/CIL_bVldUMainPosPoleAftRly_P" /begin REF_CHARACTERISTIC CIL_bVldUMainPosPoleAftRly_P /end REF_CHARACTERISTIC /end GROUP
/begin GROUP S311_CIL_bVldUMainPosPoleBefRly_P "swc_CIL/CIL_10ms_sys/BSW/Sender_Reciever Signals/CIL_bVldUMainPosPoleBefRly_P" /begin REF_CHARACTERISTIC CIL_bVldUMainPosPoleBefRly_P /end REF_CHARACTERISTIC /end GROUP
/begin GROUP S311_CIL_bVldUPoleAftRlyCh_P "swc_CIL/CIL_10ms_sys/BSW/Sender_Reciever Signals/CIL_bVldUPoleAftRlyCh_P" /begin REF_CHARACTERISTIC CIL_bVldUPoleAftRlyCh_P /end REF_CHARACTERISTIC /end GROUP
/begin GROUP S311_CIL_bVldUPoleAftRlyHeat_P "swc_CIL/CIL_10ms_sys/BSW/Sender_Reciever Signals/CIL_bVldUPoleAftRlyHeat_P" /begin REF_CHARACTERISTIC CIL_bVldUPoleAftRlyHeat_P /end REF_CHARACTERISTIC /end GROUP
/begin GROUP S311_CIL_CtrIslnRSamplg_P "swc_CIL/CIL_10ms_sys/BSW/Sender_Reciever Signals/CIL_CtrIslnRSamplg_P" /begin REF_CHARACTERISTIC CIL_CtrIslnRSamplg_P /end REF_CHARACTERISTIC /end GROUP
/begin GROUP S311_CIL_DayRtc_P "swc_CIL/CIL_10ms_sys/BSW/Sender_Reciever Signals/CIL_DayRtc_P" /begin REF_CHARACTERISTIC CIL_DayRtc_P /end REF_CHARACTERISTIC /end GROUP
/begin GROUP S311_CIL_ErrAcScktSnsrT_P "swc_CIL/CIL_10ms_sys/BSW/Sender_Reciever Signals/CIL_ErrAcScktSnsrT_P" /begin REF_CHARACTERISTIC CIL_ErrAcScktSnsrT_P /end REF_CHARACTERISTIC /end GROUP
/begin GROUP S311_CIL_ErrDcScktSnsrT_P "swc_CIL/CIL_10ms_sys/BSW/Sender_Reciever Signals/CIL_ErrDcScktSnsrT_P" /begin REF_CHARACTERISTIC CIL_ErrDcScktSnsrT_P /end REF_CHARACTERISTIC /end GROUP
/begin GROUP S311_CIL_HourRtc_P "swc_CIL/CIL_10ms_sys/BSW/Sender_Reciever Signals/CIL_HourRtc_P" /begin REF_CHARACTERISTIC CIL_HourRtc_P /end REF_CHARACTERISTIC /end GROUP
/begin GROUP S311_CIL_IBatHv_P "swc_CIL/CIL_10ms_sys/BSW/Sender_Reciever Signals/CIL_IBatHv_P" /begin REF_CHARACTERISTIC CIL_IBatHv_P /end REF_CHARACTERISTIC /end GROUP
/begin GROUP S311_CIL_MinuRtc_P "swc_CIL/CIL_10ms_sys/BSW/Sender_Reciever Signals/CIL_MinuRtc_P" /begin REF_CHARACTERISTIC CIL_MinuRtc_P /end REF_CHARACTERISTIC /end GROUP
/begin GROUP S311_CIL_ModeSysWup_P "swc_CIL/CIL_10ms_sys/BSW/Sender_Reciever Signals/CIL_ModeSysWup_P" /begin REF_CHARACTERISTIC CIL_ModeSysWup_P /end REF_CHARACTERISTIC /end GROUP
/begin GROUP S311_CIL_MonthRtc_P "swc_CIL/CIL_10ms_sys/BSW/Sender_Reciever Signals/CIL_MonthRtc_P" /begin REF_CHARACTERISTIC CIL_MonthRtc_P /end REF_CHARACTERISTIC /end GROUP
/begin GROUP S311_CIL_RIslnNeg_P "swc_CIL/CIL_10ms_sys/BSW/Sender_Reciever Signals/CIL_RIslnNeg_P" /begin REF_CHARACTERISTIC CIL_RIslnNeg_P /end REF_CHARACTERISTIC /end GROUP
/begin GROUP S311_CIL_RIslnPos_P "swc_CIL/CIL_10ms_sys/BSW/Sender_Reciever Signals/CIL_RIslnPos_P" /begin REF_CHARACTERISTIC CIL_RIslnPos_P /end REF_CHARACTERISTIC /end GROUP
/begin GROUP S311_CIL_SecRtc_P "swc_CIL/CIL_10ms_sys/BSW/Sender_Reciever Signals/CIL_SecRtc_P" /begin REF_CHARACTERISTIC CIL_SecRtc_P /end REF_CHARACTERISTIC /end GROUP
/begin GROUP S311_CIL_StCellTSamplgExcpn_P "swc_CIL/CIL_10ms_sys/BSW/Sender_Reciever Signals/CIL_StCellTSamplgExcpn_P" /begin REF_CHARACTERISTIC CIL_StCellTSamplgExcpn_P /end REF_CHARACTERISTIC /end GROUP
/begin GROUP S311_CIL_StCellUSamplgExcpn_P "swc_CIL/CIL_10ms_sys/BSW/Sender_Reciever Signals/CIL_StCellUSamplgExcpn_P" /begin REF_CHARACTERISTIC CIL_StCellUSamplgExcpn_P /end REF_CHARACTERISTIC /end GROUP
/begin GROUP S311_CIL_StMsgToutForPMS_P "swc_CIL/CIL_10ms_sys/BSW/Sender_Reciever Signals/CIL_StMsgToutForPMS_P" /begin REF_CHARACTERISTIC CIL_StMsgToutForPMS_P /end REF_CHARACTERISTIC /end GROUP
/begin GROUP S311_CIL_TiProc_P "swc_CIL/CIL_10ms_sys/BSW/Sender_Reciever Signals/CIL_TiProc_P" /begin REF_CHARACTERISTIC CIL_TiProc_P /end REF_CHARACTERISTIC /end GROUP
/begin GROUP S311_CIL_TiProc_P1 "swc_CIL/CIL_10ms_sys/BSW/Sender_Reciever Signals/CIL_TiProc_P1" /begin REF_CHARACTERISTIC CIL_TiProc_P /end REF_CHARACTERISTIC /end GROUP
/begin GROUP S311_CIL_TiProc_P10 "swc_CIL/CIL_10ms_sys/BSW/Sender_Reciever Signals/CIL_TiProc_P10" /begin REF_CHARACTERISTIC CIL_TiProc_P /end REF_CHARACTERISTIC /end GROUP
/begin GROUP S311_CIL_TiProc_P2 "swc_CIL/CIL_10ms_sys/BSW/Sender_Reciever Signals/CIL_TiProc_P2" /begin REF_CHARACTERISTIC CIL_TiProc_P /end REF_CHARACTERISTIC /end GROUP
/begin GROUP S311_CIL_TiProc_P3 "swc_CIL/CIL_10ms_sys/BSW/Sender_Reciever Signals/CIL_TiProc_P3" /begin REF_CHARACTERISTIC CIL_TiProc_P /end REF_CHARACTERISTIC /end GROUP
/begin GROUP S311_CIL_TiProc_P4 "swc_CIL/CIL_10ms_sys/BSW/Sender_Reciever Signals/CIL_TiProc_P4" /begin REF_CHARACTERISTIC CIL_TiProc_P /end REF_CHARACTERISTIC /end GROUP
/begin GROUP S311_CIL_TiProc_P5 "swc_CIL/CIL_10ms_sys/BSW/Sender_Reciever Signals/CIL_TiProc_P5" /begin REF_CHARACTERISTIC CIL_TiProc_P /end REF_CHARACTERISTIC /end GROUP
/begin GROUP S311_CIL_TiProc_P6 "swc_CIL/CIL_10ms_sys/BSW/Sender_Reciever Signals/CIL_TiProc_P6" /begin REF_CHARACTERISTIC CIL_TiProc_P /end REF_CHARACTERISTIC /end GROUP
/begin GROUP S311_CIL_TiProc_P7 "swc_CIL/CIL_10ms_sys/BSW/Sender_Reciever Signals/CIL_TiProc_P7" /begin REF_CHARACTERISTIC CIL_TiProc_P /end REF_CHARACTERISTIC /end GROUP
/begin GROUP S311_CIL_TiProc_P8 "swc_CIL/CIL_10ms_sys/BSW/Sender_Reciever Signals/CIL_TiProc_P8" /begin REF_CHARACTERISTIC CIL_TiProc_P /end REF_CHARACTERISTIC /end GROUP
/begin GROUP S311_CIL_TiProc_P9 "swc_CIL/CIL_10ms_sys/BSW/Sender_Reciever Signals/CIL_TiProc_P9" /begin REF_CHARACTERISTIC CIL_TiProc_P /end REF_CHARACTERISTIC /end GROUP
/begin GROUP S311_CIL_TiSysRun_P "swc_CIL/CIL_10ms_sys/BSW/Sender_Reciever Signals/CIL_TiSysRun_P" /begin REF_CHARACTERISTIC CIL_TiSysRun_P /end REF_CHARACTERISTIC /end GROUP
/begin GROUP S311_CIL_TSnsrI_P "swc_CIL/CIL_10ms_sys/BSW/Sender_Reciever Signals/CIL_TSnsrI_P" /begin REF_CHARACTERISTIC CIL_TSnsrI_P /end REF_CHARACTERISTIC /end GROUP
/begin GROUP S311_CIL_UMainNegPoleAftRly_P "swc_CIL/CIL_10ms_sys/BSW/Sender_Reciever Signals/CIL_UMainNegPoleAftRly_P" /begin REF_CHARACTERISTIC CIL_UMainNegPoleAftRly_P /end REF_CHARACTERISTIC /end GROUP
/begin GROUP S311_CIL_UMainPosPoleAftRly_P "swc_CIL/CIL_10ms_sys/BSW/Sender_Reciever Signals/CIL_UMainPosPoleAftRly_P" /begin REF_CHARACTERISTIC CIL_UMainPosPoleAftRly_P /end REF_CHARACTERISTIC /end GROUP
/begin GROUP S311_CIL_UMainPosPoleBefRly_P "swc_CIL/CIL_10ms_sys/BSW/Sender_Reciever Signals/CIL_UMainPosPoleBefRly_P" /begin REF_CHARACTERISTIC CIL_UMainPosPoleBefRly_P /end REF_CHARACTERISTIC /end GROUP
/begin GROUP S311_CIL_UPoleAftRlyCh_P "swc_CIL/CIL_10ms_sys/BSW/Sender_Reciever Signals/CIL_UPoleAftRlyCh_P" /begin REF_CHARACTERISTIC CIL_UPoleAftRlyCh_P /end REF_CHARACTERISTIC /end GROUP
/begin GROUP S311_CIL_UPoleAftRlyHeat_P "swc_CIL/CIL_10ms_sys/BSW/Sender_Reciever Signals/CIL_UPoleAftRlyHeat_P" /begin REF_CHARACTERISTIC CIL_UPoleAftRlyHeat_P /end REF_CHARACTERISTIC /end GROUP
/begin GROUP S311_CIL_YearRtc_P "swc_CIL/CIL_10ms_sys/BSW/Sender_Reciever Signals/CIL_YearRtc_P" /begin REF_CHARACTERISTIC CIL_YearRtc_P /end REF_CHARACTERISTIC /end GROUP
/begin GROUP S311_DTRC_Csw_P_1 "swc_CIL/CIL_10ms_sys/BSW/Sender_Reciever Signals/DTRC_Csw_P.1" /begin REF_CHARACTERISTIC CIL_Csw2_P /end REF_CHARACTERISTIC /end GROUP
/begin GROUP S311_DTRC_Csw_P_10 "swc_CIL/CIL_10ms_sys/BSW/Sender_Reciever Signals/DTRC_Csw_P.10" /begin REF_CHARACTERISTIC CIL_Csw2_P /end REF_CHARACTERISTIC /end GROUP
/begin GROUP S311_DTRC_Csw_P_11 "swc_CIL/CIL_10ms_sys/BSW/Sender_Reciever Signals/DTRC_Csw_P.11" /begin REF_CHARACTERISTIC CIL_Csw2_P /end REF_CHARACTERISTIC /end GROUP
/begin GROUP S311_DTRC_Csw_P_12 "swc_CIL/CIL_10ms_sys/BSW/Sender_Reciever Signals/DTRC_Csw_P.12" /begin REF_CHARACTERISTIC CIL_Csw2_P /end REF_CHARACTERISTIC /end GROUP
/begin GROUP S311_DTRC_Csw_P_13 "swc_CIL/CIL_10ms_sys/BSW/Sender_Reciever Signals/DTRC_Csw_P.13" /begin REF_CHARACTERISTIC CIL_Csw2_P /end REF_CHARACTERISTIC /end GROUP
/begin GROUP S311_DTRC_Csw_P_14 "swc_CIL/CIL_10ms_sys/BSW/Sender_Reciever Signals/DTRC_Csw_P.14" /begin REF_CHARACTERISTIC CIL_Csw2_P /end REF_CHARACTERISTIC /end GROUP
/begin GROUP S311_DTRC_Csw_P_15 "swc_CIL/CIL_10ms_sys/BSW/Sender_Reciever Signals/DTRC_Csw_P.15" /begin REF_CHARACTERISTIC CIL_Csw3_P /end REF_CHARACTERISTIC /end GROUP
/begin GROUP S311_DTRC_Csw_P_16 "swc_CIL/CIL_10ms_sys/BSW/Sender_Reciever Signals/DTRC_Csw_P.16" /begin REF_CHARACTERISTIC CIL_Csw3_P /end REF_CHARACTERISTIC /end GROUP
/begin GROUP S311_DTRC_Csw_P_17 "swc_CIL/CIL_10ms_sys/BSW/Sender_Reciever Signals/DTRC_Csw_P.17" /begin REF_CHARACTERISTIC CIL_Csw3_P /end REF_CHARACTERISTIC /end GROUP
/begin GROUP S311_DTRC_Csw_P_2 "swc_CIL/CIL_10ms_sys/BSW/Sender_Reciever Signals/DTRC_Csw_P.2" /begin REF_CHARACTERISTIC CIL_Csw2_P /end REF_CHARACTERISTIC /end GROUP
/begin GROUP S311_DTRC_Csw_P_24 "swc_CIL/CIL_10ms_sys/BSW/Sender_Reciever Signals/DTRC_Csw_P.24" /begin REF_CHARACTERISTIC CIL_Csw2_P /end REF_CHARACTERISTIC /end GROUP
/begin GROUP S311_DTRC_Csw_P_25 "swc_CIL/CIL_10ms_sys/BSW/Sender_Reciever Signals/DTRC_Csw_P.25" /begin REF_CHARACTERISTIC CIL_Csw2_P /end REF_CHARACTERISTIC /end GROUP
/begin GROUP S311_DTRC_Csw_P_26 "swc_CIL/CIL_10ms_sys/BSW/Sender_Reciever Signals/DTRC_Csw_P.26" /begin REF_CHARACTERISTIC CIL_Csw2_P /end REF_CHARACTERISTIC /end GROUP
/begin GROUP S311_DTRC_Csw_P_3 "swc_CIL/CIL_10ms_sys/BSW/Sender_Reciever Signals/DTRC_Csw_P.3" /begin REF_CHARACTERISTIC CIL_Csw2_P /end REF_CHARACTERISTIC /end GROUP
/begin GROUP S311_DTRC_Csw_P_4 "swc_CIL/CIL_10ms_sys/BSW/Sender_Reciever Signals/DTRC_Csw_P.4" /begin REF_CHARACTERISTIC CIL_Csw2_P /end REF_CHARACTERISTIC /end GROUP
/begin GROUP S311_DTRC_Csw_P_43 "swc_CIL/CIL_10ms_sys/BSW/Sender_Reciever Signals/DTRC_Csw_P.43" /begin REF_CHARACTERISTIC CIL_Csw2_P /end REF_CHARACTERISTIC /end GROUP
/begin GROUP S311_DTRC_Csw_P_44 "swc_CIL/CIL_10ms_sys/BSW/Sender_Reciever Signals/DTRC_Csw_P.44" /begin REF_CHARACTERISTIC CIL_Csw2_P /end REF_CHARACTERISTIC /end GROUP
/begin GROUP S311_DTRC_Csw_P_45 "swc_CIL/CIL_10ms_sys/BSW/Sender_Reciever Signals/DTRC_Csw_P.45" /begin REF_CHARACTERISTIC CIL_Csw2_P /end REF_CHARACTERISTIC /end GROUP
/begin GROUP S311_DTRC_Csw_P_49 "swc_CIL/CIL_10ms_sys/BSW/Sender_Reciever Signals/DTRC_Csw_P.49" /begin REF_CHARACTERISTIC CIL_Csw3_P /end REF_CHARACTERISTIC /end GROUP
/begin GROUP S311_DTRC_Csw_P_5 "swc_CIL/CIL_10ms_sys/BSW/Sender_Reciever Signals/DTRC_Csw_P.5" /begin REF_CHARACTERISTIC CIL_Csw2_P /end REF_CHARACTERISTIC /end GROUP
/begin GROUP S311_DTRC_Csw_P_50 "swc_CIL/CIL_10ms_sys/BSW/Sender_Reciever Signals/DTRC_Csw_P.50" /begin REF_CHARACTERISTIC CIL_Csw3_P /end REF_CHARACTERISTIC /end GROUP
/begin GROUP S311_DTRC_Csw_P_51 "swc_CIL/CIL_10ms_sys/BSW/Sender_Reciever Signals/DTRC_Csw_P.51" /begin REF_CHARACTERISTIC CIL_Csw3_P /end REF_CHARACTERISTIC /end GROUP
/begin GROUP S311_DTRC_Csw_P_52 "swc_CIL/CIL_10ms_sys/BSW/Sender_Reciever Signals/DTRC_Csw_P.52" /begin REF_CHARACTERISTIC CIL_Csw3_P /end REF_CHARACTERISTIC /end GROUP
/begin GROUP S311_DTRC_Csw_P_53 "swc_CIL/CIL_10ms_sys/BSW/Sender_Reciever Signals/DTRC_Csw_P.53" /begin REF_CHARACTERISTIC CIL_Csw3_P /end REF_CHARACTERISTIC /end GROUP
/begin GROUP S311_DTRC_Csw_P_54 "swc_CIL/CIL_10ms_sys/BSW/Sender_Reciever Signals/DTRC_Csw_P.54" /begin REF_CHARACTERISTIC CIL_Csw3_P /end REF_CHARACTERISTIC /end GROUP
/begin GROUP S311_DTRC_Csw_P_55 "swc_CIL/CIL_10ms_sys/BSW/Sender_Reciever Signals/DTRC_Csw_P.55" /begin REF_CHARACTERISTIC CIL_Csw3_P /end REF_CHARACTERISTIC /end GROUP
/begin GROUP S311_DTRC_Csw_P_56 "swc_CIL/CIL_10ms_sys/BSW/Sender_Reciever Signals/DTRC_Csw_P.56" /begin REF_CHARACTERISTIC CIL_Csw3_P /end REF_CHARACTERISTIC /end GROUP
/begin GROUP S311_DTRC_Csw_P_6 "swc_CIL/CIL_10ms_sys/BSW/Sender_Reciever Signals/DTRC_Csw_P.6" /begin REF_CHARACTERISTIC CIL_Csw2_P /end REF_CHARACTERISTIC /end GROUP
/begin GROUP S311_DTRC_Csw_P_65 "swc_CIL/CIL_10ms_sys/BSW/Sender_Reciever Signals/DTRC_Csw_P.65" /begin REF_CHARACTERISTIC CIL_Csw3_P /end REF_CHARACTERISTIC /end GROUP
/begin GROUP S311_DTRC_Csw_P_66 "swc_CIL/CIL_10ms_sys/BSW/Sender_Reciever Signals/DTRC_Csw_P.66" /begin REF_CHARACTERISTIC CIL_Csw3_P /end REF_CHARACTERISTIC /end GROUP
/begin GROUP S311_DTRC_Csw_P_67 "swc_CIL/CIL_10ms_sys/BSW/Sender_Reciever Signals/DTRC_Csw_P.67" /begin REF_CHARACTERISTIC CIL_Csw3_P /end REF_CHARACTERISTIC /end GROUP
/begin GROUP S311_DTRC_Csw_P_68 "swc_CIL/CIL_10ms_sys/BSW/Sender_Reciever Signals/DTRC_Csw_P.68" /begin REF_CHARACTERISTIC CIL_Csw3_P /end REF_CHARACTERISTIC /end GROUP
/begin GROUP S311_DTRC_Csw_P_69 "swc_CIL/CIL_10ms_sys/BSW/Sender_Reciever Signals/DTRC_Csw_P.69" /begin REF_CHARACTERISTIC CIL_Csw2_P /end REF_CHARACTERISTIC /end GROUP
/begin GROUP S311_DTRC_Csw_P_7 "swc_CIL/CIL_10ms_sys/BSW/Sender_Reciever Signals/DTRC_Csw_P.7" /begin REF_CHARACTERISTIC CIL_Csw2_P /end REF_CHARACTERISTIC /end GROUP
/begin GROUP S311_DTRC_Csw_P_73 "swc_CIL/CIL_10ms_sys/BSW/Sender_Reciever Signals/DTRC_Csw_P.73" /begin REF_CHARACTERISTIC CIL_Csw2_P /end REF_CHARACTERISTIC /end GROUP
/begin GROUP S311_DTRC_Csw_P_74 "swc_CIL/CIL_10ms_sys/BSW/Sender_Reciever Signals/DTRC_Csw_P.74" /begin REF_CHARACTERISTIC CIL_Csw2_P /end REF_CHARACTERISTIC /end GROUP
/begin GROUP S311_DTRC_Csw_P_75 "swc_CIL/CIL_10ms_sys/BSW/Sender_Reciever Signals/DTRC_Csw_P.75" /begin REF_CHARACTERISTIC CIL_Csw2_P /end REF_CHARACTERISTIC /end GROUP
/begin GROUP S311_DTRC_Csw_P_76 "swc_CIL/CIL_10ms_sys/BSW/Sender_Reciever Signals/DTRC_Csw_P.76" /begin REF_CHARACTERISTIC CIL_Csw2_P /end REF_CHARACTERISTIC /end GROUP
/begin GROUP S311_DTRC_Csw_P_77 "swc_CIL/CIL_10ms_sys/BSW/Sender_Reciever Signals/DTRC_Csw_P.77" /begin REF_CHARACTERISTIC CIL_Csw2_P /end REF_CHARACTERISTIC /end GROUP
/begin GROUP S311_DTRC_Csw_P_78 "swc_CIL/CIL_10ms_sys/BSW/Sender_Reciever Signals/DTRC_Csw_P.78" /begin REF_CHARACTERISTIC CIL_Csw2_P /end REF_CHARACTERISTIC /end GROUP
/begin GROUP S311_DTRC_Csw_P_79 "swc_CIL/CIL_10ms_sys/BSW/Sender_Reciever Signals/DTRC_Csw_P.79" /begin REF_CHARACTERISTIC CIL_Csw2_P /end REF_CHARACTERISTIC /end GROUP
/begin GROUP S311_DTRC_Csw_P_8 "swc_CIL/CIL_10ms_sys/BSW/Sender_Reciever Signals/DTRC_Csw_P.8" /begin REF_CHARACTERISTIC CIL_Csw2_P /end REF_CHARACTERISTIC /end GROUP
/begin GROUP S311_DTRC_Csw_P_84 "swc_CIL/CIL_10ms_sys/BSW/Sender_Reciever Signals/DTRC_Csw_P.84" /begin REF_CHARACTERISTIC CIL_Csw2_P /end REF_CHARACTERISTIC /end GROUP
/begin GROUP S311_DTRC_Csw_P_85 "swc_CIL/CIL_10ms_sys/BSW/Sender_Reciever Signals/DTRC_Csw_P.85" /begin REF_CHARACTERISTIC CIL_Csw2_P /end REF_CHARACTERISTIC /end GROUP
/begin GROUP S311_DTRC_Csw_P_86 "swc_CIL/CIL_10ms_sys/BSW/Sender_Reciever Signals/DTRC_Csw_P.86" /begin REF_CHARACTERISTIC CIL_Csw2_P /end REF_CHARACTERISTIC /end GROUP
/begin GROUP S311_DTRC_Csw_P_9 "swc_CIL/CIL_10ms_sys/BSW/Sender_Reciever Signals/DTRC_Csw_P.9" /begin REF_CHARACTERISTIC CIL_Csw2_P /end REF_CHARACTERISTIC /end GROUP
/begin GROUP S311_MCC_StMdulCu_P "swc_CIL/CIL_10ms_sys/BSW/Sender_Reciever Signals/MCC_StMdulCu_P" /begin REF_CHARACTERISTIC MCC_StMdulCu_P /end REF_CHARACTERISTIC /end GROUP
/begin GROUP S313_BCC_TiOffDig139_P "swc_BatChCtl/DC_10ms_sys/ElecVehChegnStHdlr_Sys/ElecVehChegnStHdlr/Diagnosis/BCC_TiOffDig139_P" /begin REF_CHARACTERISTIC BCC_TiOffDig139_P /end REF_CHARACTERISTIC /end GROUP
/begin GROUP S313_BCC_TiOffDig249_P "swc_BatChCtl/DC_10ms_sys/ElecVehChegnStHdlr_Sys/ElecVehChegnStHdlr/Diagnosis/BCC_TiOffDig249_P" /begin REF_CHARACTERISTIC BCC_TiOffDig249_P /end REF_CHARACTERISTIC /end GROUP
/begin GROUP S313_BCC_TiOffDig33_P "swc_BatChCtl/DC_10ms_sys/ElecVehChegnStHdlr_Sys/ElecVehChegnStHdlr/Diagnosis/BCC_TiOffDig33_P" /begin REF_CHARACTERISTIC BCC_TiOffDig33_P /end REF_CHARACTERISTIC /end GROUP
/begin GROUP S313_BCC_TiOffDig54_P "swc_BatChCtl/DC_10ms_sys/ElecVehChegnStHdlr_Sys/ElecVehChegnStHdlr/Diagnosis/BCC_TiOffDig54_P" /begin REF_CHARACTERISTIC BCC_TiOffDig54_P /end REF_CHARACTERISTIC /end GROUP
/begin GROUP S313_BCC_TiOffDig55_P "swc_BatChCtl/DC_10ms_sys/ElecVehChegnStHdlr_Sys/ElecVehChegnStHdlr/Diagnosis/BCC_TiOffDig55_P" /begin REF_CHARACTERISTIC BCC_TiOffDig55_P /end REF_CHARACTERISTIC /end GROUP
/begin GROUP S313_BCC_TiOffDig69_P "swc_BatChCtl/DC_10ms_sys/ElecVehChegnStHdlr_Sys/ElecVehChegnStHdlr/Diagnosis/BCC_TiOffDig69_P" /begin REF_CHARACTERISTIC BCC_TiOffDig69_P /end REF_CHARACTERISTIC /end GROUP
/begin GROUP S313_BCC_TiOffDig72_P "swc_BatChCtl/DC_10ms_sys/ElecVehChegnStHdlr_Sys/ElecVehChegnStHdlr/Diagnosis/BCC_TiOffDig72_P" /begin REF_CHARACTERISTIC BCC_TiOffDig72_P /end REF_CHARACTERISTIC /end GROUP
/begin GROUP S313_BCC_TiOnDig139_P "swc_BatChCtl/DC_10ms_sys/ElecVehChegnStHdlr_Sys/ElecVehChegnStHdlr/Diagnosis/BCC_TiOnDig139_P" /begin REF_CHARACTERISTIC BCC_TiOnDig139_P /end REF_CHARACTERISTIC /end GROUP
/begin GROUP S313_BCC_TiOnDig249_P "swc_BatChCtl/DC_10ms_sys/ElecVehChegnStHdlr_Sys/ElecVehChegnStHdlr/Diagnosis/BCC_TiOnDig249_P" /begin REF_CHARACTERISTIC BCC_TiOnDig249_P /end REF_CHARACTERISTIC /end GROUP
/begin GROUP S313_BCC_TiOnDig33_P "swc_BatChCtl/DC_10ms_sys/ElecVehChegnStHdlr_Sys/ElecVehChegnStHdlr/Diagnosis/BCC_TiOnDig33_P" /begin REF_CHARACTERISTIC BCC_TiOnDig33_P /end REF_CHARACTERISTIC /end GROUP
/begin GROUP S313_BCC_TiOnDig54_P "swc_BatChCtl/DC_10ms_sys/ElecVehChegnStHdlr_Sys/ElecVehChegnStHdlr/Diagnosis/BCC_TiOnDig54_P" /begin REF_CHARACTERISTIC BCC_TiOnDig54_P /end REF_CHARACTERISTIC /end GROUP
/begin GROUP S313_BCC_TiOnDig55_P "swc_BatChCtl/DC_10ms_sys/ElecVehChegnStHdlr_Sys/ElecVehChegnStHdlr/Diagnosis/BCC_TiOnDig55_P" /begin REF_CHARACTERISTIC BCC_TiOnDig55_P /end REF_CHARACTERISTIC /end GROUP
/begin GROUP S313_BCC_TiOnDig69_P "swc_BatChCtl/DC_10ms_sys/ElecVehChegnStHdlr_Sys/ElecVehChegnStHdlr/Diagnosis/BCC_TiOnDig69_P" /begin REF_CHARACTERISTIC BCC_TiOnDig69_P /end REF_CHARACTERISTIC /end GROUP
/begin GROUP S313_BCC_TiOnDig72_P "swc_BatChCtl/DC_10ms_sys/ElecVehChegnStHdlr_Sys/ElecVehChegnStHdlr/Diagnosis/BCC_TiOnDig72_P" /begin REF_CHARACTERISTIC BCC_TiOnDig72_P /end REF_CHARACTERISTIC /end GROUP
/begin GROUP S313_BCC_ValDig33_P "swc_BatChCtl/DC_10ms_sys/ElecVehChegnStHdlr_Sys/ElecVehChegnStHdlr/Diagnosis/BCC_ValDig33_P" /begin REF_CHARACTERISTIC BCC_ValDig33_P /end REF_CHARACTERISTIC /end GROUP
/begin GROUP S313_CompareToCalibrationPara1 "swc_BatChCtl/DC_10ms_sys/ElecVehChegnStHdlr_Sys/ElecVehChegnStHdlr/Diagnosis/CompareToCalibrationPara1" /begin REF_CHARACTERISTIC BCC_TDcChrgrSetDig54_P /end REF_CHARACTERISTIC /end GROUP
/begin GROUP S313_CompareToCalibrationPara2 "swc_BatChCtl/DC_10ms_sys/ElecVehChegnStHdlr_Sys/ElecVehChegnStHdlr/Diagnosis/CompareToCalibrationPara2" /begin REF_CHARACTERISTIC BCC_UDcChrgrSetDig55Max_P /end REF_CHARACTERISTIC /end GROUP
/begin GROUP S313_CompareToCalibrationPara3 "swc_BatChCtl/DC_10ms_sys/ElecVehChegnStHdlr_Sys/ElecVehChegnStHdlr/Diagnosis/CompareToCalibrationPara3" /begin REF_CHARACTERISTIC BCC_UDcChrgrSetDig55Min_P /end REF_CHARACTERISTIC /end GROUP
/begin GROUP S313_CompareToCalibrationPara4 "swc_BatChCtl/DC_10ms_sys/ElecVehChegnStHdlr_Sys/ElecVehChegnStHdlr/Diagnosis/CompareToCalibrationPara4" /begin REF_CHARACTERISTIC BCC_TDcChrgrSetDig139_P /end REF_CHARACTERISTIC /end GROUP
/begin GROUP S313_CompareToCalibrationPara5 "swc_BatChCtl/DC_10ms_sys/ElecVehChegnStHdlr_Sys/ElecVehChegnStHdlr/Diagnosis/CompareToCalibrationPara5" /begin REF_CHARACTERISTIC BCC_TDcChrgrSetDig139_P /end REF_CHARACTERISTIC /end GROUP
/begin GROUP S313_CompareToCalibrationPara6 "swc_BatChCtl/DC_10ms_sys/ElecVehChegnStHdlr_Sys/ElecVehChegnStHdlr/Diagnosis/CompareToCalibrationPara6" /begin REF_CHARACTERISTIC BCC_TDcChrgrRstDig139_P /end REF_CHARACTERISTIC /end GROUP
/begin GROUP S313_CompareToCalibrationPara7 "swc_BatChCtl/DC_10ms_sys/ElecVehChegnStHdlr_Sys/ElecVehChegnStHdlr/Diagnosis/CompareToCalibrationPara7" /begin REF_CHARACTERISTIC BCC_TDcChrgrSetDig54_P /end REF_CHARACTERISTIC /end GROUP
/begin GROUP S313_CompareToCalibrationPara8 "swc_BatChCtl/DC_10ms_sys/ElecVehChegnStHdlr_Sys/ElecVehChegnStHdlr/Diagnosis/CompareToCalibrationPara8" /begin REF_CHARACTERISTIC BCC_TDcChrgrRstDig139_P /end REF_CHARACTERISTIC /end GROUP
/begin GROUP S313_EVCSH_FacTi_P "swc_BatChCtl/DC_10ms_sys/ElecVehChegnStHdlr_Sys/ElecVehChegnStHdlr/Diagnosis/EVCSH_FacTi_P" /begin REF_CHARACTERISTIC EVCSH_FacTi_P /end REF_CHARACTERISTIC /end GROUP
/begin GROUP S313_EVCSH_FacTi_P1 "swc_BatChCtl/DC_10ms_sys/ElecVehChegnStHdlr_Sys/ElecVehChegnStHdlr/Diagnosis/EVCSH_FacTi_P1" /begin REF_CHARACTERISTIC EVCSH_FacTi_P /end REF_CHARACTERISTIC /end GROUP
/begin GROUP S313_EVCSH_FacTi_P2 "swc_BatChCtl/DC_10ms_sys/ElecVehChegnStHdlr_Sys/ElecVehChegnStHdlr/Diagnosis/EVCSH_FacTi_P2" /begin REF_CHARACTERISTIC EVCSH_FacTi_P /end REF_CHARACTERISTIC /end GROUP
/begin GROUP S313_EVCSH_FacTi_P3 "swc_BatChCtl/DC_10ms_sys/ElecVehChegnStHdlr_Sys/ElecVehChegnStHdlr/Diagnosis/EVCSH_FacTi_P3" /begin REF_CHARACTERISTIC EVCSH_FacTi_P /end REF_CHARACTERISTIC /end GROUP
/begin GROUP S313_EVCSH_FacTi_P4 "swc_BatChCtl/DC_10ms_sys/ElecVehChegnStHdlr_Sys/ElecVehChegnStHdlr/Diagnosis/EVCSH_FacTi_P4" /begin REF_CHARACTERISTIC EVCSH_FacTi_P /end REF_CHARACTERISTIC /end GROUP
/begin GROUP S313_EVCSH_FacTi_P5 "swc_BatChCtl/DC_10ms_sys/ElecVehChegnStHdlr_Sys/ElecVehChegnStHdlr/Diagnosis/EVCSH_FacTi_P5" /begin REF_CHARACTERISTIC EVCSH_FacTi_P /end REF_CHARACTERISTIC /end GROUP
/begin GROUP S313_EVCSH_FacTi_P6 "swc_BatChCtl/DC_10ms_sys/ElecVehChegnStHdlr_Sys/ElecVehChegnStHdlr/Diagnosis/EVCSH_FacTi_P6" /begin REF_CHARACTERISTIC EVCSH_FacTi_P /end REF_CHARACTERISTIC /end GROUP
/begin GROUP S314_EVCSH_NrDcChCom_P "swc_BatChCtl/DC_10ms_sys/ElecVehChegnStHdlr_Sys/ElecVehChegnStHdlr/Main/EVCSH_NrDcChCom_P" /begin REF_CHARACTERISTIC EVCSH_NrDcChCom_P /end REF_CHARACTERISTIC /end GROUP
/begin GROUP S314_OverrideFlags "swc_BatChCtl/DC_10ms_sys/ElecVehChegnStHdlr_Sys/ElecVehChegnStHdlr/Main/OverrideFlags" /begin SUB_GROUP S458_OptionalMessages /end SUB_GROUP /end GROUP
/begin GROUP S314_TerminateConditions "swc_BatChCtl/DC_10ms_sys/ElecVehChegnStHdlr_Sys/ElecVehChegnStHdlr/Main/TerminateConditions" /begin SUB_GROUP S461_Start_Conditions /end SUB_GROUP /end GROUP
/begin GROUP S314_Timeouts "swc_BatChCtl/DC_10ms_sys/ElecVehChegnStHdlr_Sys/ElecVehChegnStHdlr/Main/Timeouts"
 /begin SUB_GROUP S462_EVCSH_FacTi_P S462_EVCSH_TiChrgrChSt_P S462_EVCSH_TiChrgrChSuspd_P S462_EVCSH_TiChrgrErrWait_P S462_EVCSH_TiChrgrHdshk_P S462_EVCSH_TiChrgrMsgDly_P S462_EVCSH_TiChrgrNotRdy_P S462_EVCSH_TiChrgrRcgtn1_P S462_EVCSH_TiChrgrRcgtn2_P S462_EVCSH_TiChrgrRdy_P S462_EVCSH_TiChrgrStstc_P S462_EVCSH_TiChrgrSync_P S462_EVCSH_TiChSuspd1_P S462_EVCSH_TiChSuspd2_P S462_EVCSH_TiDlyComSeq_P S462_EVCSH_TiSysWup_P S462_EVCSH_TiToutChgDetnCnct_P S462_EVCSH_TiToutHdshkDly_P S462_EVCSH_TiToutHdshkDly_P1 S462_EVCSH_TiToutHdshkDly_P3 /end SUB_GROUP
/end GROUP
/begin GROUP S314_TransitionManager "swc_BatChCtl/DC_10ms_sys/ElecVehChegnStHdlr_Sys/ElecVehChegnStHdlr/Main/TransitionManager"
 /begin SUB_GROUP S463_CCD S463_CCS S463_CDC S463_CEM S463_CHM S463_CML S463_CMLP S463_CRM S463_CRO S463_CSD S463_CST S463_TranIChDecr /end SUB_GROUP
/end GROUP
/begin GROUP S335_BCF_UMdulMeasdToMdlFilTcFac_P "swc_BatCoreFct/BCF_100ms_sys/BatCoreFct/PackObs/PackObsLoop/MdulObs/MdulRObs/1st order low pass filter/BCF_UMdulMeasdToMdlFilTcFac_P" /begin REF_CHARACTERISTIC BCF_UMdulMeasdToMdlFilTcFac_P /end REF_CHARACTERISTIC /end GROUP
/begin GROUP S335_BPIU_TiChkOnDig141_P "swc_BatProtnIU/PackIDiag/Subsystem/SupplyVoltageDiagnosis/SelfCheck/BPIU_TiChkOnDig141_P" /begin REF_CHARACTERISTIC BPIU_TiChkOnDig141_P /end REF_CHARACTERISTIC /end GROUP
/begin GROUP S336_BPIU_TiChkOnDig141_P "swc_BatProtnIU/PackIDiag/Subsystem/SupplyVoltageDiagnosis/SelfCheck1/BPIU_TiChkOnDig141_P" /begin REF_CHARACTERISTIC BPIU_TiChkOnDig141_P /end REF_CHARACTERISTIC /end GROUP
/begin GROUP S42_BitSelect "swc_BatThermHndlgMngt/BTHM_100ms_sys/100ms/DataPrep/Diagnosis/BitSelect" /begin REF_CHARACTERISTIC BTHM_CswDig_P /end REF_CHARACTERISTIC /end GROUP
/begin GROUP S42_BitSelect1 "swc_BatThermHndlgMngt/BTHM_100ms_sys/100ms/DataPrep/Diagnosis/BitSelect1" /begin REF_CHARACTERISTIC BTHM_CswDig_P /end REF_CHARACTERISTIC /end GROUP
/begin GROUP S42_BitSelect10 "swc_BatThermHndlgMngt/BTHM_100ms_sys/100ms/DataPrep/Diagnosis/BitSelect10" /begin REF_CHARACTERISTIC BTHM_CswDig_P /end REF_CHARACTERISTIC /end GROUP
/begin GROUP S42_BitSelect11 "swc_BatThermHndlgMngt/BTHM_100ms_sys/100ms/DataPrep/Diagnosis/BitSelect11" /begin REF_CHARACTERISTIC BTHM_CswDig_P /end REF_CHARACTERISTIC /end GROUP
/begin GROUP S42_BitSelect12 "swc_BatThermHndlgMngt/BTHM_100ms_sys/100ms/DataPrep/Diagnosis/BitSelect12" /begin REF_CHARACTERISTIC BTHM_CswDig_P /end REF_CHARACTERISTIC /end GROUP
/begin GROUP S42_BitSelect13 "swc_BatThermHndlgMngt/BTHM_100ms_sys/100ms/DataPrep/Diagnosis/BitSelect13" /begin REF_CHARACTERISTIC BTHM_CswDig_P /end REF_CHARACTERISTIC /end GROUP
/begin GROUP S42_BitSelect14 "swc_BatThermHndlgMngt/BTHM_100ms_sys/100ms/DataPrep/Diagnosis/BitSelect14" /begin REF_CHARACTERISTIC BTHM_CswDig_P /end REF_CHARACTERISTIC /end GROUP
/begin GROUP S42_BitSelect15 "swc_BatThermHndlgMngt/BTHM_100ms_sys/100ms/DataPrep/Diagnosis/BitSelect15" /begin REF_CHARACTERISTIC BTHM_CswDig_P /end REF_CHARACTERISTIC /end GROUP
/begin GROUP S42_BitSelect2 "swc_BatThermHndlgMngt/BTHM_100ms_sys/100ms/DataPrep/Diagnosis/BitSelect2" /begin REF_CHARACTERISTIC BTHM_CswDig_P /end REF_CHARACTERISTIC /end GROUP
/begin GROUP S42_BitSelect3 "swc_BatThermHndlgMngt/BTHM_100ms_sys/100ms/DataPrep/Diagnosis/BitSelect3" /begin REF_CHARACTERISTIC BTHM_CswDig_P /end REF_CHARACTERISTIC /end GROUP
/begin GROUP S42_BitSelect4 "swc_BatThermHndlgMngt/BTHM_100ms_sys/100ms/DataPrep/Diagnosis/BitSelect4" /begin REF_CHARACTERISTIC BTHM_CswDig_P /end REF_CHARACTERISTIC /end GROUP
/begin GROUP S42_BitSelect5 "swc_BatThermHndlgMngt/BTHM_100ms_sys/100ms/DataPrep/Diagnosis/BitSelect5" /begin REF_CHARACTERISTIC BTHM_CswDig_P /end REF_CHARACTERISTIC /end GROUP
/begin GROUP S42_BitSelect6 "swc_BatThermHndlgMngt/BTHM_100ms_sys/100ms/DataPrep/Diagnosis/BitSelect6" /begin REF_CHARACTERISTIC BTHM_CswDig_P /end REF_CHARACTERISTIC /end GROUP
/begin GROUP S42_BitSelect7 "swc_BatThermHndlgMngt/BTHM_100ms_sys/100ms/DataPrep/Diagnosis/BitSelect7" /begin REF_CHARACTERISTIC BTHM_CswDig_P /end REF_CHARACTERISTIC /end GROUP
/begin GROUP S42_BitSelect8 "swc_BatThermHndlgMngt/BTHM_100ms_sys/100ms/DataPrep/Diagnosis/BitSelect8" /begin REF_CHARACTERISTIC BTHM_CswDig_P /end REF_CHARACTERISTIC /end GROUP
/begin GROUP S42_BitSelect9 "swc_BatThermHndlgMngt/BTHM_100ms_sys/100ms/DataPrep/Diagnosis/BitSelect9" /begin REF_CHARACTERISTIC BTHM_CswDig_P /end REF_CHARACTERISTIC /end GROUP
/begin GROUP S462_EVCSH_FacTi_P "swc_BatChCtl/DC_10ms_sys/ElecVehChegnStHdlr_Sys/ElecVehChegnStHdlr/Main/Timeouts/EVCSH_FacTi_P" /begin REF_CHARACTERISTIC EVCSH_FacTi_P /end REF_CHARACTERISTIC /end GROUP
/begin GROUP S74_BitSelect "swc_BatThermHndlgMngt/BTHM_100ms_sys/100ms/DataPrep/DataClcn/TPackDif/BitSelect" /begin REF_CHARACTERISTIC BTHM_CswDig_P /end REF_CHARACTERISTIC /end GROUP
/begin RECORD_LAYOUT Lookup1D_FLOAT32_IEEE FNC_VALUES 1 FLOAT32_IEEE COLUMN_DIR DIRECT /end RECORD_LAYOUT
/begin RECORD_LAYOUT Lookup1D_X_ULONG AXIS_PTS_X 1 ULONG INDEX_INCR DIRECT /end RECORD_LAYOUT
/begin RECORD_LAYOUT Lookup2D_ULONG FNC_VALUES 1 ULONG COLUMN_DIR DIRECT /end RECORD_LAYOUT
/begin RECORD_LAYOUT Lookup2D_UWORD FNC_VALUES 1 UWORD COLUMN_DIR DIRECT /end RECORD_LAYOUT
/begin RECORD_LAYOUT Lookup2D_WORD FNC_VALUES 1 SWORD COLUMN_DIR DIRECT /end RECORD_LAYOUT
/begin RECORD_LAYOUT Lookup2D_X_BOOLEAN AXIS_PTS_X 1 UBYTE INDEX_INCR DIRECT /end RECORD_LAYOUT
/begin RECORD_LAYOUT Lookup2D_X_FLOAT64_IEEE AXIS_PTS_X 1 FLOAT64_IEEE INDEX_INCR DIRECT /end RECORD_LAYOUT
/begin RECORD_LAYOUT Lookup2D_X_LONG AXIS_PTS_X 1 SLONG INDEX_INCR DIRECT /end RECORD_LAYOUT
/begin RECORD_LAYOUT Lookup2D_X_UBYTE AXIS_PTS_X 1 UBYTE INDEX_INCR DIRECT /end RECORD_LAYOUT
/begin RECORD_LAYOUT Lookup2D_X_ULONG AXIS_PTS_X 1 ULONG INDEX_INCR DIRECT /end RECORD_LAYOUT
/begin RECORD_LAYOUT Scalar_BOOLEAN FNC_VALUES 1 UBYTE COLUMN_DIR DIRECT /end RECORD_LAYOUT
/begin RECORD_LAYOUT Scalar_FLOAT32_IEEE FNC_VALUES 1 FLOAT32_IEEE COLUMN_DIR DIRECT /end RECORD_LAYOUT
/begin RECORD_LAYOUT Scalar_LONG FNC_VALUES 1 SLONG COLUMN_DIR DIRECT /end RECORD_LAYOUT
/begin RECORD_LAYOUT Scalar_SWORD FNC_VALUES 1 SWORD COLUMN_DIR DIRECT /end RECORD_LAYOUT
/begin RECORD_LAYOUT Scalar_UBYTE FNC_VALUES 1 UBYTE COLUMN_DIR DIRECT /end RECORD_LAYOUT
/begin RECORD_LAYOUT Scalar_ULONG FNC_VALUES 1 ULONG COLUMN_DIR DIRECT /end RECORD_LAYOUT
/begin RECORD_LAYOUT Scalar_UWORD FNC_VALUES 1 UWORD COLUMN_DIR DIRECT /end RECORD_LAYOUT
/end MODULE
/end PROJECT
