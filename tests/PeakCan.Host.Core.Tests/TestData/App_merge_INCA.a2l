/* @@@@ File written by CANAPE_VERSION 14 0 35 @@@@ */
ASAP2_VERSION 1 40
/begin PROJECT ProjectName "Project Comment Goes Here"
/begin HEADER "Header Comments go here" /end HEADER
/begin MODULE ModuleName "Module Comment Goes Here"
/begin MOD_COMMON "Mod Common Comment Here" BYTE_ORDER MSB_LAST ALIGNMENT_BYTE 1 ALIGNMENT_WORD 1 ALIGNMENT_LONG 1 ALIGNMENT_FLOAT32_IEEE 1 ALIGNMENT_FLOAT64_IEEE 1 /end MOD_COMMON
/begin IF_DATA XCP
 /begin PROTOCOL_LAYER 0x0100 0x07D0 0x2710 0x00 0x00 0x00 0x00 0x00 0x08 0x08 BYTE_ORDER_MSB_FIRST ADDRESS_GRANULARITY_BYTE OPTIONAL_CMD GET_DAQ_EVENT_INFO OPTIONAL_CMD GET_DAQ_LIST_INFO OPTIONAL_CMD GET_DAQ_RESOLUTION_INFO OPTIONAL_CMD GET_DAQ_PROCESSOR_INFO OPTIONAL_CMD START_STOP_SYNCH OPTIONAL_CMD START_STOP_DAQ_LIST OPTIONAL_CMD SET_DAQ_LIST_MODE OPTIONAL_CMD WRITE_DAQ OPTIONAL_CMD SET_DAQ_PTR OPTIONAL_CMD CLEAR_DAQ_LIST OPTIONAL_CMD DOWNLOAD OPTIONAL_CMD SHORT_UPLOAD OPTIONAL_CMD UPLOAD OPTIONAL_CMD SET_MTA OPTIONAL_CMD GET_COMM_MODE_INFO COMMUNICATION_MODE_SUPPORTED BLOCK SLAVE /end PROTOCOL_LAYER
 /begin DAQ STATIC 0x01 0x01 0x00 OPTIMISATION_TYPE_DEFAULT ADDRESS_EXTENSION_FREE IDENTIFICATION_FIELD_TYPE_ABSOLUTE GRANULARITY_ODT_ENTRY_SIZE_DAQ_BYTE 0x04 NO_OVERLOAD_INDICATION
  /begin DAQ_LIST 0x00 DAQ_LIST_TYPE DAQ MAX_ODT 0x0F MAX_ODT_ENTRIES 0x64 FIRST_PID 0x00 EVENT_FIXED 0x00 /end DAQ_LIST
  /begin EVENT "Event0" "Event0" 0x00 DAQ 0x01 0x0A 0x06 0x00 /end EVENT
 /end DAQ
 /begin PAG 0x01 /end PAG
 /begin PGM PGM_MODE_ABSOLUTE 0x01 0x00 /begin SECTOR "FLASH" 0x00 0x10000000 0x8000 0x00 0x00 0x00 /end SECTOR /end PGM
 /begin XCP_ON_CAN 0x0100 CAN_ID_MASTER 0x98FFF666 CAN_ID_SLAVE 0x98FFF667 BAUDRATE 0x07A120 SAMPLE_POINT 0x4B SAMPLE_RATE SINGLE BTL_CYCLES 0x08 SJW 0x02 SYNC_EDGE SINGLE /end XCP_ON_CAN
/end IF_DATA
/begin MOD_PAR "MOD PAR Comment Goes Here"
 /begin MEMORY_SEGMENT CALROM "" DATA FLASH INTERN 0x20015F00 0x8000 -1 -1 -1 -1 -1
  /begin IF_DATA XCP
   /begin SEGMENT 0x00 0x02 0x00 0x00 0x00 /begin ADDRESS_MAPPING 0x20015F00 0x20015F00 0x8000 /end ADDRESS_MAPPING /end SEGMENT
  /end IF_DATA
 /end MEMORY_SEGMENT
/end MOD_PAR
/begin COMPU_METHOD swc_BatBalnCtl_CM_boolean_dash_ "Q = V" RAT_FUNC "%1.0" "-" COEFFS 0 1 0 0 0 1 /end COMPU_METHOD
/begin COMPU_METHOD swc_BatBalnCtl_CM_single_dash_ "Q = V" RAT_FUNC "%8.6" "-" COEFFS 0 1 0 0 0 1 /end COMPU_METHOD
/begin COMPU_METHOD swc_BatBalnCtl_CM_single_J_per_K "Q = V" RAT_FUNC "%8.6" "J/K" COEFFS 0 1 0 0 0 1 /end COMPU_METHOD
/begin COMPU_METHOD swc_BatBalnCtl_CM_single_Ohm "Q = V" RAT_FUNC "%8.6" "Ohm" COEFFS 0 1 0 0 0 1 /end COMPU_METHOD
/begin COMPU_METHOD swc_BatBalnCtl_CM_single_s "Q = V" RAT_FUNC "%8.6" "s" COEFFS 0 1 0 0 0 1 /end COMPU_METHOD
/begin COMPU_METHOD swc_BatBalnCtl_CM_uint32_dash_ "Q = V" RAT_FUNC "%10.0" "-" COEFFS 0 1 0 0 0 1 /end COMPU_METHOD
/begin COMPU_METHOD swc_BatBalnCtl_CM_uint8_dash_ "Q = V" RAT_FUNC "%3.0" "-" COEFFS 0 1 0 0 0 1 /end COMPU_METHOD
/begin COMPU_METHOD swc_BatChCtl_CM_boolean_dash_ "Q = V" RAT_FUNC "%1.0" "-" COEFFS 0 1 0 0 0 1 /end COMPU_METHOD
/begin COMPU_METHOD swc_BatChCtl_CM_int8_dash_ "Q = V" RAT_FUNC "%3.0" "-" COEFFS 0 1 0 0 0 1 /end COMPU_METHOD
/begin COMPU_METHOD swc_BatChCtl_CM_single__ "Q = V" RAT_FUNC "%8.6" "癈" COEFFS 0 1 0 0 0 1 /end COMPU_METHOD
/begin COMPU_METHOD swc_BatChCtl_CM_single_A "Q = V" RAT_FUNC "%8.6" "A" COEFFS 0 1 0 0 0 1 /end COMPU_METHOD
/begin COMPU_METHOD swc_BatChCtl_CM_single_dash_ "Q = V" RAT_FUNC "%8.6" "-" COEFFS 0 1 0 0 0 1 /end COMPU_METHOD
/begin COMPU_METHOD swc_BatChCtl_CM_single_h "Q = V" RAT_FUNC "%8.6" "h" COEFFS 0 1 0 0 0 1 /end COMPU_METHOD
/begin COMPU_METHOD swc_BatChCtl_CM_single_kW "Q = V" RAT_FUNC "%8.6" "kW" COEFFS 0 1 0 0 0 1 /end COMPU_METHOD
/begin COMPU_METHOD swc_BatChCtl_CM_single_min "Q = V" RAT_FUNC "%8.6" "min" COEFFS 0 1 0 0 0 1 /end COMPU_METHOD
/begin COMPU_METHOD swc_BatChCtl_CM_single_percent_ "Q = V" RAT_FUNC "%8.6" "%" COEFFS 0 1 0 0 0 1 /end COMPU_METHOD
/begin COMPU_METHOD swc_BatChCtl_CM_single_s "Q = V" RAT_FUNC "%8.6" "s" COEFFS 0 1 0 0 0 1 /end COMPU_METHOD
/begin COMPU_METHOD swc_BatChCtl_CM_single_V "Q = V" RAT_FUNC "%8.6" "V" COEFFS 0 1 0 0 0 1 /end COMPU_METHOD
/begin COMPU_METHOD swc_BatChCtl_CM_uint32_dash_ "Q = V" RAT_FUNC "%10.0" "-" COEFFS 0 1 0 0 0 1 /end COMPU_METHOD
/begin COMPU_METHOD swc_BatCoreFct_CM_boolean_dash_ "Q = V" RAT_FUNC "%1.0" "-" COEFFS 0 1 0 0 0 1 /end COMPU_METHOD
/begin COMPU_METHOD swc_BatCoreFct_CM_int8_dash_ "Q = V" RAT_FUNC "%3.0" "-" COEFFS 0 1 0 0 0 1 /end COMPU_METHOD
/begin COMPU_METHOD swc_BatCoreFct_CM_single__ "Q = V" RAT_FUNC "%8.6" "癈" COEFFS 0 1 0 0 0 1 /end COMPU_METHOD
/begin COMPU_METHOD swc_BatCoreFct_CM_single_A "Q = V" RAT_FUNC "%8.6" "A" COEFFS 0 1 0 0 0 1 /end COMPU_METHOD
/begin COMPU_METHOD swc_BatCoreFct_CM_single_Ah "Q = V" RAT_FUNC "%8.6" "Ah" COEFFS 0 1 0 0 0 1 /end COMPU_METHOD
/begin COMPU_METHOD swc_BatCoreFct_CM_single_dash_ "Q = V" RAT_FUNC "%8.6" "-" COEFFS 0 1 0 0 0 1 /end COMPU_METHOD
/begin COMPU_METHOD swc_BatCoreFct_CM_single_Ohm "Q = V" RAT_FUNC "%8.6" "Ohm" COEFFS 0 1 0 0 0 1 /end COMPU_METHOD
/begin COMPU_METHOD swc_BatCoreFct_CM_single_s "Q = V" RAT_FUNC "%8.6" "s" COEFFS 0 1 0 0 0 1 /end COMPU_METHOD
/begin COMPU_METHOD swc_BatCoreFct_CM_single_V "Q = V" RAT_FUNC "%8.6" "V" COEFFS 0 1 0 0 0 1 /end COMPU_METHOD
/begin COMPU_METHOD swc_BatCoreFct_CM_uint16_dash_ "Q = V" RAT_FUNC "%5.0" "-" COEFFS 0 1 0 0 0 1 /end COMPU_METHOD
/begin COMPU_METHOD swc_BatCoreFct_CM_uint32_dash_ "Q = V" RAT_FUNC "%10.0" "-" COEFFS 0 1 0 0 0 1 /end COMPU_METHOD
/begin COMPU_METHOD swc_BatCoreFct_CM_uint32_s "Q = V" RAT_FUNC "%10.0" "s" COEFFS 0 1 0 0 0 1 /end COMPU_METHOD
/begin COMPU_METHOD swc_BatProtnIU_CM_single_s "Q = V" RAT_FUNC "%8.6" "s" COEFFS 0 1 0 0 0 1 /end COMPU_METHOD
/begin COMPU_METHOD swc_BatProtnIU_CM_single_V "Q = V" RAT_FUNC "%8.6" "V" COEFFS 0 1 0 0 0 1 /end COMPU_METHOD
/begin COMPU_METHOD swc_BatProtnIU_CM_uint32_dash_ "Q = V" RAT_FUNC "%10.0" "-" COEFFS 0 1 0 0 0 1 /end COMPU_METHOD
/begin COMPU_METHOD swc_BatThermHndlgMngt_CM_boolean_dash_ "Q = V" RAT_FUNC "%1.0" "-" COEFFS 0 1 0 0 0 1 /end COMPU_METHOD
/begin COMPU_METHOD swc_BatThermHndlgMngt_CM_single__ "Q = V" RAT_FUNC "%8.6" "癈" COEFFS 0 1 0 0 0 1 /end COMPU_METHOD
/begin COMPU_METHOD swc_BatThermHndlgMngt_CM_single_A "Q = V" RAT_FUNC "%8.6" "A" COEFFS 0 1 0 0 0 1 /end COMPU_METHOD
/begin COMPU_METHOD swc_BatThermHndlgMngt_CM_single_dash_ "Q = V" RAT_FUNC "%8.6" "-" COEFFS 0 1 0 0 0 1 /end COMPU_METHOD
/begin COMPU_METHOD swc_BatThermHndlgMngt_CM_uint8_dash_ "Q = V" RAT_FUNC "%3.0" "-" COEFFS 0 1 0 0 0 1 /end COMPU_METHOD
/begin COMPU_METHOD swc_BcuStTranCtl_CM_single_s "Q = V" RAT_FUNC "%8.6" "s" COEFFS 0 1 0 0 0 1 /end COMPU_METHOD
/begin COMPU_METHOD swc_CtctrTranCtl_CM_single_dash_ "Q = V" RAT_FUNC "%8.6" "-" COEFFS 0 1 0 0 0 1 /end COMPU_METHOD
/begin COMPU_METHOD swc_CtctrTranCtl_CM_single_s "Q = V" RAT_FUNC "%8.6" "s" COEFFS 0 1 0 0 0 1 /end COMPU_METHOD
/begin COMPU_METHOD swc_DiagcEveHndlg_CM_single_dash_ "Q = V" RAT_FUNC "%8.6" "-" COEFFS 0 1 0 0 0 1 /end COMPU_METHOD
/begin COMPU_METHOD swc_DiagcEveHndlg_CM_single_kWh "Q = V" RAT_FUNC "%8.6" "kWh" COEFFS 0 1 0 0 0 1 /end COMPU_METHOD
/begin COMPU_METHOD swc_DiagcEveHndlg_CM_single_s "Q = V" RAT_FUNC "%8.6" "s" COEFFS 0 1 0 0 0 1 /end COMPU_METHOD
/begin COMPU_METHOD swc_EltlLnkHzrdProtnNet_CM_single_dash_ "Q = V" RAT_FUNC "%8.6" "-" COEFFS 0 1 0 0 0 1 /end COMPU_METHOD
/begin COMPU_METHOD swc_EltlLnkHzrdProtnNet_CM_single_s "Q = V" RAT_FUNC "%8.6" "s" COEFFS 0 1 0 0 0 1 /end COMPU_METHOD
/begin COMPU_METHOD swc_EltlLnkHzrdProtnNet_CM_uint8_dash_ "Q = V" RAT_FUNC "%3.0" "-" COEFFS 0 1 0 0 0 1 /end COMPU_METHOD
/begin CHARACTERISTIC BBC_ChtBalnPas_P "Heat capacity of the balancing resistor in J/degC" VALUE 0x20017D68 Scalar_FLOAT32_IEEE 0 swc_BatBalnCtl_CM_single_dash_ -10000 10000 /end CHARACTERISTIC
/begin MEASUREMENT BBC_DucycMdulBalnOffNotOk "Balancing not active due to module duty cycle currently off (bit coded)" ULONG swc_BatBalnCtl_CM_uint32_dash_ 0 0 0 4294967295 ECU_ADDRESS 0x1FFE3820 /end MEASUREMENT
/begin CHARACTERISTIC BBC_EnaTestBaln_P "Test mode enable flag" VALUE 0x20019C45 Scalar_UBYTE 0 swc_BatBalnCtl_CM_uint8_dash_ 0 255 /end CHARACTERISTIC
/begin CHARACTERISTIC BBC_HtcEfc_P "Heat exchange coeff between PCB and resistor" VAL_BLK 0x20017D6C Scalar_FLOAT32_IEEE 0 swc_BatBalnCtl_CM_single_J_per_K -10000 10000 MATRIX_DIM 24 1 1 /end CHARACTERISTIC
/begin CHARACTERISTIC BBC_NrMdulTest_P "Defines the number of modules used for bench testing" VALUE 0x20019C47 Scalar_UBYTE 0 swc_BatBalnCtl_CM_uint8_dash_ 0 255 /end CHARACTERISTIC
/begin CHARACTERISTIC BBC_RCellBaln_P "Passive balancing resistance" VALUE 0x200186F8 Scalar_FLOAT32_IEEE 0 swc_BatBalnCtl_CM_single_Ohm -10000 10000 /end CHARACTERISTIC
/begin AXIS_PTS BBC_StBcu_A "Battery Balancing Control State BatteryControlUnit Axis" 0x200188C0 NO_INPUT_QUANTITY Lookup1D_X_UBYTE 0 swc_BatBalnCtl_CM_uint8_dash_ 7 0 255 DEPOSIT ABSOLUTE /end AXIS_PTS
/begin CHARACTERISTIC BBC_StBcu_M "Battery Balancing Control State BatteryControlUnit active Map" CURVE 0x200188C8 Lookup1D_UBYTE 0 swc_BatBalnCtl_CM_uint8_dash_ 0 255
 /begin AXIS_DESCR COM_AXIS NO_INPUT_QUANTITY swc_BatBalnCtl_CM_uint8_dash_ 7 0 255 DEPOSIT ABSOLUTE AXIS_PTS_REF BBC_StBcu_A /end AXIS_DESCR
/end CHARACTERISTIC
/begin MEASUREMENT BBC_TBalnRAvgOvrheatd "Balancing Resistor Temperatures Average Overheated Flag per module" UBYTE swc_BatBalnCtl_CM_boolean_dash_ 0 0 0 1 ECU_ADDRESS 0x1FFE40E4 MATRIX_DIM 24 1 1 /end MEASUREMENT
/begin MEASUREMENT BBC_TMdulCtlrNotOk "Balancing not active due to module controller temperature (bit coded)" ULONG swc_BatBalnCtl_CM_uint32_dash_ 0 0 0 4294967295 ECU_ADDRESS 0x1FFE407C /end MEASUREMENT
/begin MEASUREMENT BBC_TMdulNotOk "Balancing not active due to module temperature (bit coded)" ULONG swc_BatBalnCtl_CM_uint32_dash_ 0 0 0 4294967295 ECU_ADDRESS 0x1FFE4080 /end MEASUREMENT
/begin CHARACTERISTIC BBC_TiDly_P "BBC time constant - used for heat exchange model\n      " VALUE 0x20018884 Scalar_FLOAT32_IEEE 0 swc_BatBalnCtl_CM_single_s -10000 10000 /end CHARACTERISTIC
/begin MEASUREMENT BBC_bAcvBalnOn "Balancing enabled flag for pack" UBYTE swc_BatBalnCtl_CM_uint8_dash_ 0 0 0 255 ECU_ADDRESS 0x1FFE7550 /end MEASUREMENT
/begin CHARACTERISTIC BCC_CswReplDig_P "parameter for replace switch diagnosis" VALUE 0x20015F00 Scalar_ULONG 0 swc_BatChCtl_CM_uint32_dash_ 0 4294967295 /end CHARACTERISTIC
/begin CHARACTERISTIC BCC_EffDcdc_P "Efficiency for dcdc" VALUE 0x20015F04 Scalar_FLOAT32_IEEE 0 swc_BatChCtl_CM_single_dash_ -3.40282346639e+038 3.40282346639e+038 /end CHARACTERISTIC
/begin CHARACTERISTIC BCC_EffObc_P "Efficiency for OBC" VALUE 0x20015F08 Scalar_FLOAT32_IEEE 0 swc_BatChCtl_CM_single_dash_ -3.40282346639e+038 3.40282346639e+038 /end CHARACTERISTIC
/begin CHARACTERISTIC BCC_FacPwrChLim1_P "factor for charge power limitation 1" VALUE 0x20015F0C Scalar_FLOAT32_IEEE 0 swc_BatChCtl_CM_single_dash_ -3.40282346639e+038 3.40282346639e+038 /end CHARACTERISTIC
/begin CHARACTERISTIC BCC_FacPwrChLim2_P "factor for charge power limitation 2" VALUE 0x20015F10 Scalar_FLOAT32_IEEE 0 swc_BatChCtl_CM_single_dash_ -3.40282346639e+038 3.40282346639e+038 /end CHARACTERISTIC
/begin CHARACTERISTIC BCC_GainIDig101_P "the gain for current over." VALUE 0x20015F14 Scalar_FLOAT32_IEEE 0 swc_BatChCtl_CM_single_dash_ -3.40282346639e+038 3.40282346639e+038 /end CHARACTERISTIC
/begin CHARACTERISTIC BCC_GainIDig102_P "the gain for current over." VALUE 0x20015F18 Scalar_FLOAT32_IEEE 0 swc_BatChCtl_CM_single_dash_ -3.40282346639e+038 3.40282346639e+038 /end CHARACTERISTIC
/begin CHARACTERISTIC BCC_IBatFull_P "parameter for cell current full" VALUE 0x20015F1C Scalar_FLOAT32_IEEE 0 swc_BatChCtl_CM_single_A -3.40282346639e+038 3.40282346639e+038 /end CHARACTERISTIC
/begin CHARACTERISTIC BCC_IChReq_M "charge current request for map" MAP 0x20015F20 Lookup2D_FLOAT32_IEEE 0 swc_BatChCtl_CM_single_dash_ -3.40282346639e+038 3.40282346639e+038
 /begin AXIS_DESCR COM_AXIS NO_INPUT_QUANTITY swc_BatChCtl_CM_single_percent_ 13 -3.40282346639e+038 3.40282346639e+038 DEPOSIT ABSOLUTE AXIS_PTS_REF BCC_SocBatForCh_A /end AXIS_DESCR
 /begin AXIS_DESCR COM_AXIS NO_INPUT_QUANTITY swc_BatChCtl_CM_int8_dash_ 12 -128 127 DEPOSIT ABSOLUTE AXIS_PTS_REF BCC_TBatForMapCh_A /end AXIS_DESCR
/end CHARACTERISTIC
/begin CHARACTERISTIC BCC_IDchaReq_M "discharge current request for map" MAP 0x20016190 Lookup2D_FLOAT32_IEEE 0 swc_BatChCtl_CM_single_dash_ -3.40282346639e+038 3.40282346639e+038
 /begin AXIS_DESCR COM_AXIS NO_INPUT_QUANTITY swc_BatChCtl_CM_single_percent_ 13 -3.40282346639e+038 3.40282346639e+038 DEPOSIT ABSOLUTE AXIS_PTS_REF BCC_SocBatForDcha_A /end AXIS_DESCR
 /begin AXIS_DESCR COM_AXIS NO_INPUT_QUANTITY swc_BatChCtl_CM_int8_dash_ 19 -128 127 DEPOSIT ABSOLUTE AXIS_PTS_REF BCC_TBatForMapDcha_A /end AXIS_DESCR
/end CHARACTERISTIC
/begin CHARACTERISTIC BCC_IDig10_P "current for diagnosis 10" VALUE 0x2001656C Scalar_FLOAT32_IEEE 0 swc_BatChCtl_CM_single_A -3.40282346639e+038 3.40282346639e+038 /end CHARACTERISTIC
/begin CHARACTERISTIC BCC_ILimByRAcChCnctn_M "current limitation for cc resistance" CURVE 0x20016570 Lookup1D_FLOAT32_IEEE 0 swc_BatChCtl_CM_single_A -3.40282346639e+038 3.40282346639e+038
 /begin AXIS_DESCR COM_AXIS NO_INPUT_QUANTITY swc_BatChCtl_CM_single_dash_ 7 -3.40282346639e+038 3.40282346639e+038 DEPOSIT ABSOLUTE AXIS_PTS_REF BCC_RAcChCnctn_A /end AXIS_DESCR
/end CHARACTERISTIC
/begin CHARACTERISTIC BCC_IRlyCh_P "value of charge current hysteresis" VALUE 0x2001658C Scalar_FLOAT32_IEEE 0 swc_BatChCtl_CM_single_A -3.40282346639e+038 3.40282346639e+038 /end CHARACTERISTIC
/begin CHARACTERISTIC BCC_IThermReq_P "Thermal current request" VALUE 0x20016590 Scalar_FLOAT32_IEEE 0 swc_BatChCtl_CM_single_A -3.40282346639e+038 3.40282346639e+038 /end CHARACTERISTIC
/begin CHARACTERISTIC BCC_PwrPtcTherm_P "Parameter for heat film power" VALUE 0x20016594 Scalar_FLOAT32_IEEE 0 swc_BatChCtl_CM_single_kW 0 2000 /end CHARACTERISTIC
/begin AXIS_PTS BCC_RAcChCnctn_A "axis for cc resistance" 0x20016598 NO_INPUT_QUANTITY Lookup1D_X_FLOAT32_IEEE 0 swc_BatChCtl_CM_single_dash_ 7 -3.40282346639e+038 3.40282346639e+038 DEPOSIT ABSOLUTE /end AXIS_PTS
/begin AXIS_PTS BCC_SocBatForCh_A "Axis soc for charge currnet calculate" 0x200165B4 NO_INPUT_QUANTITY Lookup2D_X_FLOAT32_IEEE 0 swc_BatChCtl_CM_single_percent_ 13 -3.40282346639e+038 3.40282346639e+038 DEPOSIT ABSOLUTE /end AXIS_PTS
/begin AXIS_PTS BCC_SocBatForDcha_A "Axis soc for discharge currnet calculate" 0x200165E8 NO_INPUT_QUANTITY Lookup2D_X_FLOAT32_IEEE 0 swc_BatChCtl_CM_single_percent_ 13 -3.40282346639e+038 3.40282346639e+038 DEPOSIT ABSOLUTE /end AXIS_PTS
/begin CHARACTERISTIC BCC_SocBatFull_P "Soc for battery full" VALUE 0x2001661C Scalar_FLOAT32_IEEE 0 swc_BatChCtl_CM_single_dash_ 0 1 /end CHARACTERISTIC
/begin CHARACTERISTIC BCC_TAcChrgrRstDig53_P "parameter for temperature of AC  charger" VALUE 0x20016620 Scalar_FLOAT32_IEEE 0 swc_BatChCtl_CM_single__ -3.40282346639e+038 3.40282346639e+038 /end CHARACTERISTIC
/begin CHARACTERISTIC BCC_TAcChrgrRstDig71_P "parameter for temperature of AC  charger" VALUE 0x20016624 Scalar_FLOAT32_IEEE 0 swc_BatChCtl_CM_single__ -3.40282346639e+038 3.40282346639e+038 /end CHARACTERISTIC
/begin CHARACTERISTIC BCC_TAcChrgrSetDig53_P "parameter for temperature of AC  charger" VALUE 0x20016628 Scalar_FLOAT32_IEEE 0 swc_BatChCtl_CM_single__ -3.40282346639e+038 3.40282346639e+038 /end CHARACTERISTIC
/begin CHARACTERISTIC BCC_TAcChrgrSetDig71_P "parameter for temperature of AC  charger" VALUE 0x2001662C Scalar_FLOAT32_IEEE 0 swc_BatChCtl_CM_single__ -3.40282346639e+038 3.40282346639e+038 /end CHARACTERISTIC
/begin AXIS_PTS BCC_TBatForCh_A "Axis temperature for charge currnet calculate" 0x20016630 NO_INPUT_QUANTITY Lookup1D_X_FLOAT32_IEEE 0 swc_BatChCtl_CM_single__ 20 -3.40282346639e+038 3.40282346639e+038 DEPOSIT ABSOLUTE /end AXIS_PTS
/begin AXIS_PTS BCC_TBatForDcha_A "Axis temperature for discharge currnet calculate" 0x20016680 NO_INPUT_QUANTITY Lookup1D_X_FLOAT32_IEEE 0 swc_BatChCtl_CM_single__ 37 -3.40282346639e+038 3.40282346639e+038 DEPOSIT ABSOLUTE /end AXIS_PTS
/begin AXIS_PTS BCC_TBatForMapCh_A "Axis temperature for discharge currnet calculate" 0x20017C4C NO_INPUT_QUANTITY Lookup2D_X_BYTE 0 swc_BatChCtl_CM_int8_dash_ 12 -128 127 DEPOSIT ABSOLUTE /end AXIS_PTS
/begin CHARACTERISTIC BCC_TBatForMapCh_M "temperature for charge map" CURVE 0x20017C58 Lookup1D_BYTE 0 swc_BatChCtl_CM_int8_dash_ -128 127
 /begin AXIS_DESCR COM_AXIS NO_INPUT_QUANTITY swc_BatChCtl_CM_single__ 20 -3.40282346639e+038 3.40282346639e+038 DEPOSIT ABSOLUTE AXIS_PTS_REF BCC_TBatForCh_A /end AXIS_DESCR
/end CHARACTERISTIC
/begin AXIS_PTS BCC_TBatForMapDcha_A "Axis temperature for discharge currnet calculate" 0x20017C6C NO_INPUT_QUANTITY Lookup2D_X_BYTE 0 swc_BatChCtl_CM_int8_dash_ 19 -128 127 DEPOSIT ABSOLUTE /end AXIS_PTS
/begin CHARACTERISTIC BCC_TBatForMapDcha_M "temperature for discharge map" CURVE 0x20017C80 Lookup1D_BYTE 0 swc_BatChCtl_CM_int8_dash_ -128 127
 /begin AXIS_DESCR COM_AXIS NO_INPUT_QUANTITY swc_BatChCtl_CM_single__ 37 -3.40282346639e+038 3.40282346639e+038 DEPOSIT ABSOLUTE AXIS_PTS_REF BCC_TBatForDcha_A /end AXIS_DESCR
/end CHARACTERISTIC
/begin CHARACTERISTIC BCC_TCswChForMap_P "Temperature for charge map" VALUE 0x20016714 Scalar_FLOAT32_IEEE 0 swc_BatChCtl_CM_single_dash_ -3.40282346639e+038 3.40282346639e+038 /end CHARACTERISTIC
/begin CHARACTERISTIC BCC_TCswDchaForMap_P "Temperature for discharge map" VALUE 0x20016718 Scalar_FLOAT32_IEEE 0 swc_BatChCtl_CM_single_dash_ -3.40282346639e+038 3.40282346639e+038 /end CHARACTERISTIC
/begin CHARACTERISTIC BCC_TMaxDig10_P "Max temperature for diagnosis 10" VALUE 0x20016728 Scalar_FLOAT32_IEEE 0 swc_BatChCtl_CM_single__ -3.40282346639e+038 3.40282346639e+038 /end CHARACTERISTIC
/begin CHARACTERISTIC BCC_TMinDig10_P "Min temperature for diagnosis 10" VALUE 0x2001672C Scalar_FLOAT32_IEEE 0 swc_BatChCtl_CM_single__ -3.40282346639e+038 3.40282346639e+038 /end CHARACTERISTIC
/begin CHARACTERISTIC BCC_TiBatFull_P "Time delay for battery charge full" VALUE 0x20016730 Scalar_FLOAT32_IEEE 0 swc_BatChCtl_CM_single_s -3.40282346639e+038 3.40282346639e+038 /end CHARACTERISTIC
/begin CHARACTERISTIC BCC_TiChAllwdOffDig_P "turn off delay for charge allowed diganosis" VALUE 0x20016734 Scalar_FLOAT32_IEEE 0 swc_BatChCtl_CM_single_s -3.40282346639e+038 3.40282346639e+038 /end CHARACTERISTIC
/begin CHARACTERISTIC BCC_TiChAllwdOnDig_P "turn on delay for charge allowed diganosis" VALUE 0x20016738 Scalar_FLOAT32_IEEE 0 swc_BatChCtl_CM_single_s -3.40282346639e+038 3.40282346639e+038 /end CHARACTERISTIC
/begin CHARACTERISTIC BCC_TiChCnctOffDig_P "turn off delay for ac charger diganosis" VALUE 0x2001673C Scalar_FLOAT32_IEEE 0 swc_BatChCtl_CM_single_s -3.40282346639e+038 3.40282346639e+038 /end CHARACTERISTIC
/begin CHARACTERISTIC BCC_TiChCnctOnDig_P "turn on delay for ac charger diganosis" VALUE 0x20016740 Scalar_FLOAT32_IEEE 0 swc_BatChCtl_CM_single_s -3.40282346639e+038 3.40282346639e+038 /end CHARACTERISTIC
/begin CHARACTERISTIC BCC_TiOffDig10_P "turn off delay for diganosis 10" VALUE 0x20016744 Scalar_FLOAT32_IEEE 0 swc_BatChCtl_CM_single_s -3.40282346639e+038 3.40282346639e+038 /end CHARACTERISTIC
/begin CHARACTERISTIC BCC_TiOffDig53_P "turn off delay for diganosis 53" VALUE 0x20016754 Scalar_FLOAT32_IEEE 0 swc_BatChCtl_CM_single_s -3.40282346639e+038 3.40282346639e+038 /end CHARACTERISTIC
/begin CHARACTERISTIC BCC_TiOffDig71_P "turn off delay for diganosis 71" VALUE 0x20016764 Scalar_FLOAT32_IEEE 0 swc_BatChCtl_CM_single_s -3.40282346639e+038 3.40282346639e+038 /end CHARACTERISTIC
/begin CHARACTERISTIC BCC_TiOffDig73_P "turn off delay for diganosis 73" VALUE 0x2001676C Scalar_FLOAT32_IEEE 0 swc_BatChCtl_CM_single_s -3.40282346639e+038 3.40282346639e+038 /end CHARACTERISTIC
/begin CHARACTERISTIC BCC_TiOnDig10_P "turn on delay for diganosis 10" VALUE 0x20016770 Scalar_FLOAT32_IEEE 0 swc_BatChCtl_CM_single_s -3.40282346639e+038 3.40282346639e+038 /end CHARACTERISTIC
/begin CHARACTERISTIC BCC_TiOnDig53_P "turn on delay for diganosis 53" VALUE 0x20016780 Scalar_FLOAT32_IEEE 0 swc_BatChCtl_CM_single_s -3.40282346639e+038 3.40282346639e+038 /end CHARACTERISTIC
/begin CHARACTERISTIC BCC_TiOnDig71_P "turn on delay for diganosis 71" VALUE 0x20016790 Scalar_FLOAT32_IEEE 0 swc_BatChCtl_CM_single_s -3.40282346639e+038 3.40282346639e+038 /end CHARACTERISTIC
/begin CHARACTERISTIC BCC_TiOnDig73_P "turn on delay for diganosis 73" VALUE 0x20016798 Scalar_FLOAT32_IEEE 0 swc_BatChCtl_CM_single_s -3.40282346639e+038 3.40282346639e+038 /end CHARACTERISTIC
/begin CHARACTERISTIC BCC_TiProc_P "time for process" VALUE 0x2001679C Scalar_FLOAT32_IEEE 0 swc_BatChCtl_CM_single_s -3.40282346639e+038 3.40282346639e+038 /end CHARACTERISTIC
/begin CHARACTERISTIC BCC_TiPwrUpOffDig_P "turn off delay for power up diganosis" VALUE 0x200167A0 Scalar_FLOAT32_IEEE 0 swc_BatChCtl_CM_single_s -3.40282346639e+038 3.40282346639e+038 /end CHARACTERISTIC
/begin CHARACTERISTIC BCC_TiPwrUpOnDig_P "turn on delay for power up diganosis" VALUE 0x200167A4 Scalar_FLOAT32_IEEE 0 swc_BatChCtl_CM_single_s -3.40282346639e+038 3.40282346639e+038 /end CHARACTERISTIC
/begin CHARACTERISTIC BCC_UBatCellFull_P "parameter for cell voltage full" VALUE 0x200167A8 Scalar_FLOAT32_IEEE 0 swc_BatChCtl_CM_single_V -3.40282346639e+038 3.40282346639e+038 /end CHARACTERISTIC
/begin CHARACTERISTIC BCC_UChReqOfs_P "charge voltage offset" VALUE 0x200167AC Scalar_FLOAT32_IEEE 0 swc_BatChCtl_CM_single_V -3.40282346639e+038 3.40282346639e+038 /end CHARACTERISTIC
/begin CHARACTERISTIC BCC_UOfsThermReq_P "Thermal Voltage offfset" VALUE 0x200167B8 Scalar_FLOAT32_IEEE 0 swc_BatChCtl_CM_single_V 0 2000 /end CHARACTERISTIC
/begin CHARACTERISTIC BCC_ValOfsDig101_P "the offset for current over." VALUE 0x200167BC Scalar_FLOAT32_IEEE 0 swc_BatChCtl_CM_single_A -3.40282346639e+038 3.40282346639e+038 /end CHARACTERISTIC
/begin CHARACTERISTIC BCC_ValOfsDig102_P "the offset for current over." VALUE 0x200167C0 Scalar_FLOAT32_IEEE 0 swc_BatChCtl_CM_single_A -3.40282346639e+038 3.40282346639e+038 /end CHARACTERISTIC
/begin CHARACTERISTIC BCC_ValReplDig_P "parameter for replace value diagnosis" VALUE 0x200167C4 Scalar_ULONG 0 swc_BatChCtl_CM_uint32_dash_ 0 4294967295 /end CHARACTERISTIC
/begin CHARACTERISTIC BCC_bAcvSwtDtc_P "parameter for active flag switch diagnosis" VALUE 0x200167C8 Scalar_ULONG 0 swc_BatChCtl_CM_uint32_dash_ 0 4294967295 /end CHARACTERISTIC
/begin CHARACTERISTIC BCF_CCellNom_M "Nominal capacity of cell dependent on temperature" CURVE 0x1FFE7F2C Lookup1D_FLOAT32_IEEE 0 swc_BatCoreFct_CM_single_Ah -3.40282346639e+038 3.40282346639e+038
 /begin AXIS_DESCR COM_AXIS NO_INPUT_QUANTITY swc_BatCoreFct_CM_single__ 9 -3.40282346639e+038 3.40282346639e+038 DEPOSIT ABSOLUTE AXIS_PTS_REF BCF_TRngVld_A /end AXIS_DESCR
/end CHARACTERISTIC
/begin CHARACTERISTIC BCF_DirIChgMgn_P "Magnitude of current direction hysteresis output" VALUE 0x1FFEB52B Scalar_BYTE 0 swc_BatCoreFct_CM_int8_dash_ -128 127 /end CHARACTERISTIC
/begin CHARACTERISTIC BCF_DirIChgThd_P "Switching threshold for current direction determination hysteresis" VALUE 0x1FFE8028 Scalar_FLOAT32_IEEE 0 swc_BatCoreFct_CM_single_A -3.40282346639e+038 3.40282346639e+038 /end CHARACTERISTIC
/begin CHARACTERISTIC BCF_EnaDiag_P "Battery Core Function Enable Diagnosis _Parameter" VALUE 0x20000AD4 Scalar_ULONG 0 swc_BatCoreFct_CM_uint32_dash_ 0 4294967295 /end CHARACTERISTIC
/begin CHARACTERISTIC BCF_RCellCnct_P "Cell-to-cell connection resistance" VAL_BLK 0x20000AD8 Scalar_FLOAT32_IEEE 0 swc_BatCoreFct_CM_single_Ohm -3.40282346639e+038 3.40282346639e+038 MATRIX_DIM 255 1 1 /end CHARACTERISTIC
/begin CHARACTERISTIC BCF_SocInin_M "SOC map for Initialization of SOC" CURVE 0x1FFEA1D0 Lookup1D_FLOAT32_IEEE 0 swc_BatCoreFct_CM_single_dash_ -3.40282346639e+038 3.40282346639e+038
 /begin AXIS_DESCR COM_AXIS NO_INPUT_QUANTITY swc_BatCoreFct_CM_single_V 23 -3.40282346639e+038 3.40282346639e+038 DEPOSIT ABSOLUTE AXIS_PTS_REF BCF_UMdulSocInin_A /end AXIS_DESCR
/end CHARACTERISTIC
/begin CHARACTERISTIC BCF_SocLnrznDelta_P "Cell Observer delta x for linearization (see state description xEst)" VALUE 0x1FFEA230 Scalar_FLOAT32_IEEE 0 swc_BatCoreFct_CM_single_dash_ -3.40282346639e+038 3.40282346639e+038 /end CHARACTERISTIC
/begin CHARACTERISTIC BCF_SocMdulIninDeLim_M "Module SOC Initialization Deviation Limit Curve" CURVE 0x1FFEA23C Lookup1D_FLOAT32_IEEE 0 swc_BatCoreFct_CM_single_dash_ -3.40282346639e+038 3.40282346639e+038
 /begin AXIS_DESCR COM_AXIS NO_INPUT_QUANTITY swc_BatCoreFct_CM_uint32_s 3 0 4294967295 DEPOSIT ABSOLUTE AXIS_PTS_REF BCF_TiBatOff_A /end AXIS_DESCR
/end CHARACTERISTIC
/begin CHARACTERISTIC BCF_TDifForThrwy_P "Temperature difference limit for thermal runaway" VALUE 0x1FFEA578 Scalar_FLOAT32_IEEE 0 swc_BatCoreFct_CM_single__ -3.40282346639e+038 3.40282346639e+038 /end CHARACTERISTIC
/begin CHARACTERISTIC BCF_TMaxForThrwy_P "Maximum temperature limit for thermal runaway" VALUE 0x1FFEA580 Scalar_FLOAT32_IEEE 0 swc_BatCoreFct_CM_single__ -3.40282346639e+038 3.40282346639e+038 /end CHARACTERISTIC
/begin CHARACTERISTIC BCF_TRateForThrwy_P "Temperature rate limit for thermal runaway" VALUE 0x1FFEA58C Scalar_FLOAT32_IEEE 0 swc_BatCoreFct_CM_single__ -3.40282346639e+038 3.40282346639e+038 /end CHARACTERISTIC
/begin AXIS_PTS BCF_TRngVld_A "Valid Temperature range of of the model" 0x1FFEA590 NO_INPUT_QUANTITY Lookup2D_X_FLOAT32_IEEE 0 swc_BatCoreFct_CM_single__ 9 -3.40282346639e+038 3.40282346639e+038 DEPOSIT ABSOLUTE /end AXIS_PTS
/begin CHARACTERISTIC BCF_TdOffDig1000_P "Battery Core Function TimeDelay Off Digital _Parameter" VALUE 0x1FFEA5B4 Scalar_FLOAT32_IEEE 0 swc_BatCoreFct_CM_single_s -3.40282346639e+038 3.40282346639e+038 /end CHARACTERISTIC
/begin CHARACTERISTIC BCF_TdOffDig1006_P "Battery Core Function TimeDelay Off Digital _Parameter" VALUE 0x2000106C Scalar_FLOAT32_IEEE 0 swc_BatCoreFct_CM_single_s -3.40282346639e+038 3.40282346639e+038 /end CHARACTERISTIC
/begin CHARACTERISTIC BCF_TdOnDig1000_P "Battery Core Function TimeDelay On Digital _Parameter" VALUE 0x1FFEA5CC Scalar_FLOAT32_IEEE 0 swc_BatCoreFct_CM_single_s -3.40282346639e+038 3.40282346639e+038 /end CHARACTERISTIC
/begin CHARACTERISTIC BCF_TdOnDig1006_P "Battery Core Function TimeDelay On Digital _Parameter" VALUE 0x20001070 Scalar_FLOAT32_IEEE 0 swc_BatCoreFct_CM_single_s -3.40282346639e+038 3.40282346639e+038 /end CHARACTERISTIC
/begin CHARACTERISTIC BCF_Td_P "Sample time" VALUE 0x1FFEA5E4 Scalar_FLOAT32_IEEE 0 swc_BatCoreFct_CM_single_s -3.40282346639e+038 3.40282346639e+038 /end CHARACTERISTIC
/begin AXIS_PTS BCF_TiBatOffForWtngSoc_A "Time axis for the weighting between SOC stored in the flash and SOC based on the OCV curve" 0x1FFEA5FC NO_INPUT_QUANTITY Lookup1D_X_ULONG 0 swc_BatCoreFct_CM_uint32_s 3 0 4294967295 DEPOSIT ABSOLUTE /end AXIS_PTS
/begin CHARACTERISTIC BCF_TiBatOffForWtngSoc_M "Weighting between SOC stored in flash (= 0) and SOC based on the OCV curve (= 1); curve over time since last battery off" CURVE 0x1FFEA608 Lookup1D_FLOAT32_IEEE 0 swc_BatCoreFct_CM_single_dash_ -3.40282346639e+038 3.40282346639e+038
 /begin AXIS_DESCR COM_AXIS NO_INPUT_QUANTITY swc_BatCoreFct_CM_uint32_s 3 0 4294967295 DEPOSIT ABSOLUTE AXIS_PTS_REF BCF_TiBatOffForWtngSoc_A /end AXIS_DESCR
/end CHARACTERISTIC
/begin AXIS_PTS BCF_TiBatOff_A "Battery Off Time axis of Soc Initialization Deviation Limit Curve" 0x1FFEA614 NO_INPUT_QUANTITY Lookup1D_X_ULONG 0 swc_BatCoreFct_CM_uint32_s 3 0 4294967295 DEPOSIT ABSOLUTE /end AXIS_PTS
/begin CHARACTERISTIC BCF_TiDlyForThrwyT_P "Time delay for temperature signals which are to be used in temperature gradient calculation." VALUE 0x1FFEA620 Scalar_FLOAT32_IEEE 0 swc_BatCoreFct_CM_single_s -3.40282346639e+038 3.40282346639e+038 /end CHARACTERISTIC
/begin CHARACTERISTIC BCF_TsCtrCMdulObsr_P "Counter limit for running MdulCObsr with another sample time than 100ms" VALUE 0x1FFEB51E Scalar_UWORD 0 swc_BatCoreFct_CM_uint16_dash_ 0 65535 /end CHARACTERISTIC
/begin CHARACTERISTIC BCF_UDeThdForThrwy_P "Allowed cell voltage deviation threshold from the mean cell voltage" VALUE 0x1FFEB0DC Scalar_FLOAT32_IEEE 0 swc_BatCoreFct_CM_single_V -3.40282346639e+038 3.40282346639e+038 /end CHARACTERISTIC
/begin AXIS_PTS BCF_UMdulSocInin_A "OCV axis of the OCV-SOC curve of the Initialization Function" 0x1FFEB0EC NO_INPUT_QUANTITY Lookup1D_X_FLOAT32_IEEE 0 swc_BatCoreFct_CM_single_V 23 -3.40282346639e+038 3.40282346639e+038 DEPOSIT ABSOLUTE /end AXIS_PTS
/begin CHARACTERISTIC BCF_UMinForThrwy_P "Minimum cell voltage limit for thermal runaway" VALUE 0x1FFEB148 Scalar_FLOAT32_IEEE 0 swc_BatCoreFct_CM_single_V -3.40282346639e+038 3.40282346639e+038 /end CHARACTERISTIC
/begin CHARACTERISTIC BCF_bAcvCellUCorrn_P "Activation flag for cell voltage measurement correction." VALUE 0x20008A7F Scalar_BOOLEAN 0 swc_BatCoreFct_CM_boolean_dash_ 0 1 /end CHARACTERISTIC
/begin CHARACTERISTIC BCF_bAcvTEstimnForSoc_P "Activation of temperature estimation for SOC" VALUE 0x20008A82 Scalar_BOOLEAN 0 swc_BatCoreFct_CM_boolean_dash_ 0 1 /end CHARACTERISTIC
/begin CHARACTERISTIC BCTE_ChTiRmngSrc_P "Charging Time estimation Source Switch: \n      1 = Charging Time output based on calculation\n      0 = Charging Time output is constant " VALUE 0x20019C3D Scalar_BOOLEAN 0 swc_BatChCtl_CM_boolean_dash_ 0 1 /end CHARACTERISTIC
/begin CHARACTERISTIC BCTE_CtrIFlucForStaby_P "Minimum counter value until when current remains under acceptable fluctuation threshold before it is considered to be stable." VALUE 0x200167CC Scalar_FLOAT32_IEEE 0 swc_BatChCtl_CM_single_dash_ -3.40282346639e+038 3.40282346639e+038 /end CHARACTERISTIC
/begin CHARACTERISTIC BCTE_FacFil1ChTiEstimn_P "Filter coefficient for predicted charge time" VALUE 0x200167D0 Scalar_FLOAT32_IEEE 0 swc_BatChCtl_CM_single_dash_ -3.40282346639e+038 3.40282346639e+038 /end CHARACTERISTIC
/begin CHARACTERISTIC BCTE_FacFil3ChTiEstimn_P "Filter coefficient for weighted charge time" VALUE 0x200167D8 Scalar_FLOAT32_IEEE 0 swc_BatChCtl_CM_single_dash_ -3.40282346639e+038 3.40282346639e+038 /end CHARACTERISTIC
/begin CHARACTERISTIC BCTE_FacFilDchaTiEstimn_P "Filter coefficient for predicted discharge time" VALUE 0x200167DC Scalar_FLOAT32_IEEE 0 swc_BatChCtl_CM_single_dash_ -3.40282346639e+038 3.40282346639e+038 /end CHARACTERISTIC
/begin CHARACTERISTIC BCTE_FacTiClcdFromSoh_M "lookup table for calibration of calculated time based on SOH" CURVE 0x200167E4 Lookup1D_FLOAT32_IEEE 0 swc_BatChCtl_CM_single_dash_ -3.40282346639e+038 3.40282346639e+038
 /begin AXIS_DESCR COM_AXIS NO_INPUT_QUANTITY swc_BatChCtl_CM_single_dash_ 6 -3.40282346639e+038 3.40282346639e+038 DEPOSIT ABSOLUTE AXIS_PTS_REF BCTE_SohForTiClcd_A /end AXIS_DESCR
/end CHARACTERISTIC
/begin CHARACTERISTIC BCTE_FacTiPredFromSoh_M "lookup table for calibration of predicted time based on SOH" CURVE 0x200167FC Lookup1D_FLOAT32_IEEE 0 swc_BatChCtl_CM_single_dash_ -3.40282346639e+038 3.40282346639e+038
 /begin AXIS_DESCR COM_AXIS NO_INPUT_QUANTITY swc_BatChCtl_CM_single_dash_ 6 -3.40282346639e+038 3.40282346639e+038 DEPOSIT ABSOLUTE AXIS_PTS_REF BCTE_SohForTiPred_A /end AXIS_DESCR
/end CHARACTERISTIC
/begin CHARACTERISTIC BCTE_FacTranForAcPrednClcn_M "Factor for switching between calculation approach and calibration approach for AC charging." MAP 0x20016814 Lookup2D_FLOAT32_IEEE 0 swc_BatChCtl_CM_single_dash_ -3.40282346639e+038 3.40282346639e+038
 /begin AXIS_DESCR COM_AXIS NO_INPUT_QUANTITY swc_BatChCtl_CM_single_dash_ 8 -3.40282346639e+038 3.40282346639e+038 DEPOSIT ABSOLUTE AXIS_PTS_REF BCTE_SocForAcFacTran_A /end AXIS_DESCR
 /begin AXIS_DESCR COM_AXIS NO_INPUT_QUANTITY swc_BatChCtl_CM_single__ 11 -3.40282346639e+038 3.40282346639e+038 DEPOSIT ABSOLUTE AXIS_PTS_REF BCTE_TForAcFacTran_A /end AXIS_DESCR
/end CHARACTERISTIC
/begin CHARACTERISTIC BCTE_FacTranForDcPrednClcn_M "Factor for switching between calculation approach and calibration approach for DC charging." MAP 0x20016974 Lookup2D_FLOAT32_IEEE 0 swc_BatChCtl_CM_single_dash_ -3.40282346639e+038 3.40282346639e+038
 /begin AXIS_DESCR COM_AXIS NO_INPUT_QUANTITY swc_BatChCtl_CM_single_dash_ 8 -3.40282346639e+038 3.40282346639e+038 DEPOSIT ABSOLUTE AXIS_PTS_REF BCTE_SocForDcFacTran_A /end AXIS_DESCR
 /begin AXIS_DESCR COM_AXIS NO_INPUT_QUANTITY swc_BatChCtl_CM_single__ 11 -3.40282346639e+038 3.40282346639e+038 DEPOSIT ABSOLUTE AXIS_PTS_REF BCTE_TForDcFacTran_A /end AXIS_DESCR
/end CHARACTERISTIC
/begin CHARACTERISTIC BCTE_IChRat_P "1C charge current" VALUE 0x20016BB0 Scalar_FLOAT32_IEEE 0 swc_BatChCtl_CM_single_A -3.40282346639e+038 3.40282346639e+038 /end CHARACTERISTIC
/begin CHARACTERISTIC BCTE_ICpbyOfChrgrAcMax_A "Maximun current capability of AC charger axis for time prediction lookup table for AC charging" VAL_BLK 0x20016BB4 Scalar_FLOAT32_IEEE 0 swc_BatChCtl_CM_single_A -3.40282346639e+038 3.40282346639e+038 MATRIX_DIM 2 1 1 /end CHARACTERISTIC
/begin CHARACTERISTIC BCTE_ICpbyOfChrgrAcMax_P "maximum current capability of AC charger" VALUE 0x20016BBC Scalar_FLOAT32_IEEE 0 swc_BatChCtl_CM_single_A -3.40282346639e+038 3.40282346639e+038 /end CHARACTERISTIC
/begin CHARACTERISTIC BCTE_ICpbyOfChrgrDcMax_A "Maximun current capability of DC charger axis for time prediction lookup table for DC charging" VAL_BLK 0x20016BC0 Scalar_FLOAT32_IEEE 0 swc_BatChCtl_CM_single_A -3.40282346639e+038 3.40282346639e+038 MATRIX_DIM 2 1 1 /end CHARACTERISTIC
/begin CHARACTERISTIC BCTE_ICpbyOfChrgrDcMax_P "maximum current capability of DC charger" VALUE 0x20016BC8 Scalar_FLOAT32_IEEE 0 swc_BatChCtl_CM_single_A -3.40282346639e+038 3.40282346639e+038 /end CHARACTERISTIC
/begin CHARACTERISTIC BCTE_SocCellMaxForAcTiPred_A "maximum cell SOC axis for time prediction lookup table for AC charging" VAL_BLK 0x20016D00 Scalar_FLOAT32_IEEE 0 swc_BatChCtl_CM_single_percent_ -3.40282346639e+038 3.40282346639e+038 MATRIX_DIM 10 1 1 /end CHARACTERISTIC
/begin CHARACTERISTIC BCTE_SocCellMaxForDcTiPred_A "maximum cell SOC axis for time prediction lookup table for DC charging" VAL_BLK 0x20016D28 Scalar_FLOAT32_IEEE 0 swc_BatChCtl_CM_single_percent_ -3.40282346639e+038 3.40282346639e+038 MATRIX_DIM 9 1 1 /end CHARACTERISTIC
/begin CHARACTERISTIC BCTE_SocChFnshd_P "SOC for charging to be considered as finished." VALUE 0x20016D4C Scalar_FLOAT32_IEEE 0 swc_BatChCtl_CM_single_percent_ -3.40282346639e+038 3.40282346639e+038 /end CHARACTERISTIC
/begin CHARACTERISTIC BCTE_SocDeltaForChTiEstimn_P "Delta SOC for charge time estimation" VALUE 0x20016D50 Scalar_FLOAT32_IEEE 0 swc_BatChCtl_CM_single_percent_ -3.40282346639e+038 3.40282346639e+038 /end CHARACTERISTIC
/begin AXIS_PTS BCTE_SocForAcFacTran_A "SOC axis for transition Factor for switching between calculation approach and calibration approach for AC charging" 0x20016D54 NO_INPUT_QUANTITY Lookup2D_X_FLOAT32_IEEE 0 swc_BatChCtl_CM_single_dash_ 8 -3.40282346639e+038 3.40282346639e+038 DEPOSIT ABSOLUTE /end AXIS_PTS
/begin AXIS_PTS BCTE_SocForDcFacTran_A "SOC axis for transition Factor for switching between calculation approach and calibration approach for DC charging" 0x20016D74 NO_INPUT_QUANTITY Lookup2D_X_FLOAT32_IEEE 0 swc_BatChCtl_CM_single_dash_ 8 -3.40282346639e+038 3.40282346639e+038 DEPOSIT ABSOLUTE /end AXIS_PTS
/begin AXIS_PTS BCTE_SohForTiClcd_A "State of Health axis for lookup table for calibrating calculated time" 0x20016D94 NO_INPUT_QUANTITY Lookup1D_X_FLOAT32_IEEE 0 swc_BatChCtl_CM_single_dash_ 6 -3.40282346639e+038 3.40282346639e+038 DEPOSIT ABSOLUTE /end AXIS_PTS
/begin AXIS_PTS BCTE_SohForTiPred_A "State of Health axis for lookup table for calibrating predicted time" 0x20016DAC NO_INPUT_QUANTITY Lookup1D_X_FLOAT32_IEEE 0 swc_BatChCtl_CM_single_dash_ 6 -3.40282346639e+038 3.40282346639e+038 DEPOSIT ABSOLUTE /end AXIS_PTS
/begin CHARACTERISTIC BCTE_TCooltAvgForAcTiPred_A "Average coolant temperature axis for time prediction lookup table for AC charging" VAL_BLK 0x20016DC4 Scalar_FLOAT32_IEEE 0 swc_BatChCtl_CM_single__ -3.40282346639e+038 3.40282346639e+038 MATRIX_DIM 6 1 1 /end CHARACTERISTIC
/begin CHARACTERISTIC BCTE_TCooltAvgForDcTiPred_A "Average coolant temperature axis for time prediction lookup table for DC charging" VAL_BLK 0x20016DDC Scalar_FLOAT32_IEEE 0 swc_BatChCtl_CM_single__ -3.40282346639e+038 3.40282346639e+038 MATRIX_DIM 2 1 1 /end CHARACTERISTIC
/begin AXIS_PTS BCTE_TForAcFacTran_A "Temperature axis for transition Factor for switching between calculation approach and calibration approach for AC charging" 0x20016DE4 NO_INPUT_QUANTITY Lookup2D_X_FLOAT32_IEEE 0 swc_BatChCtl_CM_single__ 11 -3.40282346639e+038 3.40282346639e+038 DEPOSIT ABSOLUTE /end AXIS_PTS
/begin AXIS_PTS BCTE_TForDcFacTran_A "Temperature axis for transition Factor for switching between calculation approach and calibration approach for DC charging" 0x20016E24 NO_INPUT_QUANTITY Lookup2D_X_FLOAT32_IEEE 0 swc_BatChCtl_CM_single__ 11 -3.40282346639e+038 3.40282346639e+038 DEPOSIT ABSOLUTE /end AXIS_PTS
/begin CHARACTERISTIC BCTE_TMdulAvgForAcTiPred_A "Average module temperature axis for time prediction lookup table for AC charging" VAL_BLK 0x20016E64 Scalar_FLOAT32_IEEE 0 swc_BatChCtl_CM_single__ -3.40282346639e+038 3.40282346639e+038 MATRIX_DIM 6 1 1 /end CHARACTERISTIC
/begin CHARACTERISTIC BCTE_TMdulAvgForDcTiPred_A "Average module temperature axis for time prediction lookup table for DC charging" VAL_BLK 0x20016E7C Scalar_FLOAT32_IEEE 0 swc_BatChCtl_CM_single__ -3.40282346639e+038 3.40282346639e+038 MATRIX_DIM 4 1 1 /end CHARACTERISTIC
/begin CHARACTERISTIC BCTE_TiAcTiPred_M "Time value for calibration based approach for AC charging. Based on Based on Cell SOC, module temperature, coolant temperature and maximum current output of the charger" VAL_BLK 0x20016E90 Scalar_FLOAT32_IEEE 0 swc_BatChCtl_CM_single_s -3.40282346639e+038 3.40282346639e+038 MATRIX_DIM 720 1 1 /end CHARACTERISTIC
/begin CHARACTERISTIC BCTE_TiBatChConByHour_P "Fixed value for Battery charge time in Hours." VALUE 0x200179D0 Scalar_FLOAT32_IEEE 0 swc_BatChCtl_CM_single_h -3.40282346639e+038 3.40282346639e+038 /end CHARACTERISTIC
/begin CHARACTERISTIC BCTE_TiBatChConByMinu_P "Fixed value for Battery charge time in minutes." VALUE 0x200179D4 Scalar_FLOAT32_IEEE 0 swc_BatChCtl_CM_single_min -3.40282346639e+038 3.40282346639e+038 /end CHARACTERISTIC
/begin CHARACTERISTIC BCTE_TiBatChMaxByHour_P "Default charge time in hour when battery is not charging." VALUE 0x200179D8 Scalar_FLOAT32_IEEE 0 swc_BatChCtl_CM_single_h -3.40282346639e+038 3.40282346639e+038 /end CHARACTERISTIC
/begin CHARACTERISTIC BCTE_TiBatChMaxByMinu_P "Default charge time in minutes when battery is not charging." VALUE 0x200179DC Scalar_FLOAT32_IEEE 0 swc_BatChCtl_CM_single_min -3.40282346639e+038 3.40282346639e+038 /end CHARACTERISTIC
/begin CHARACTERISTIC BCTE_TiBatChMax_P "Maximum allowed charge time." VALUE 0x200179E0 Scalar_FLOAT32_IEEE 0 swc_BatChCtl_CM_single_s -3.40282346639e+038 3.40282346639e+038 /end CHARACTERISTIC
/begin CHARACTERISTIC BCTE_TiDcTiPred_M "Time value for calibration based approach for DC charging. Based on Based on Cell SOC, module temperature, coolant temperature and maximum current output of the charger" VAL_BLK 0x200179E4 Scalar_FLOAT32_IEEE 0 swc_BatChCtl_CM_single_s -3.40282346639e+038 3.40282346639e+038 MATRIX_DIM 144 1 1 /end CHARACTERISTIC
/begin CHARACTERISTIC BCTE_bAcvChTiEstimn_P "Activates the charge time estimation function." VALUE 0x20019C3E Scalar_BOOLEAN 0 swc_BatChCtl_CM_boolean_dash_ 0 1 /end CHARACTERISTIC
/begin CHARACTERISTIC BPIU_TiChkOnDig63_P "Time Check On Diag 63" VALUE 0x200188F8 Scalar_FLOAT32_IEEE 0 swc_BatProtnIU_CM_single_s -3.40282346639e+038 3.40282346639e+038 /end CHARACTERISTIC
/begin CHARACTERISTIC BPIU_TiOffDig81_P "Time delay off for DTC81." VALUE 0x20018944 Scalar_FLOAT32_IEEE 0 swc_BatProtnIU_CM_single_s -3.40282346639e+038 3.40282346639e+038 /end CHARACTERISTIC
/begin CHARACTERISTIC BPIU_TiOnDig81_P "Time delay on for DTC81." VALUE 0x200189A4 Scalar_FLOAT32_IEEE 0 swc_BatProtnIU_CM_single_s -3.40282346639e+038 3.40282346639e+038 /end CHARACTERISTIC
/begin CHARACTERISTIC BPIU_TiSample2_P "100ms" VALUE 0x200189C0 Scalar_FLOAT32_IEEE 0 swc_BatProtnIU_CM_single_s -3.40282346639e+038 3.40282346639e+038 /end CHARACTERISTIC
/begin CHARACTERISTIC BPIU_UAcqnDeMax_P "Maximum allowed voltage acquisition deviation" VALUE 0x200189C4 Scalar_FLOAT32_IEEE 0 swc_BatProtnIU_CM_single_V 0 1000 /end CHARACTERISTIC
/begin CHARACTERISTIC BPIU_UCellMinLim_P "2V" VALUE 0x200189E4 Scalar_FLOAT32_IEEE 0 swc_BatProtnIU_CM_single_V -3.40282346639e+038 3.40282346639e+038 /end CHARACTERISTIC
/begin CHARACTERISTIC BPIU_bAcvSwtDtc_P "Active Flag Switch DiagnosisTroubleCodes" VALUE 0x20018A5C Scalar_ULONG 0 swc_BatProtnIU_CM_uint32_dash_ 0 255 /end CHARACTERISTIC
/begin CHARACTERISTIC BSTC_TiProc_P "Calculation time of BSTC" VALUE 0x20018C38 Scalar_FLOAT32_IEEE 0 swc_BcuStTranCtl_CM_single_s -3.40282346639e+038 3.40282346639e+038 /end CHARACTERISTIC
/begin CHARACTERISTIC BSTC_TiRxVldMsg_P "Wait time for receiving a valid message from VCU" VALUE 0x20018C50 Scalar_FLOAT32_IEEE 0 swc_BcuStTranCtl_CM_single_s -3.40282346639e+038 3.40282346639e+038 /end CHARACTERISTIC
/begin AXIS_PTS BTHM_IActForTCorrn1_A "Axis for the temperature correction map 1." 0x20018C68 NO_INPUT_QUANTITY Lookup1D_X_FLOAT32_IEEE 0 swc_BatThermHndlgMngt_CM_single_A 15 -3.40282346639e+038 3.40282346639e+038 DEPOSIT ABSOLUTE /end AXIS_PTS
/begin CHARACTERISTIC BTHM_TCorrnFil1Fac0_P "First factor in the transfer function denominator of the first filter used for the module temperature correction" VALUE 0x20018D00 Scalar_FLOAT32_IEEE 0 swc_BatThermHndlgMngt_CM_single_dash_ -3.40282346639e+038 3.40282346639e+038 /end CHARACTERISTIC
/begin CHARACTERISTIC BTHM_TCorrnFil1Fac1_P "Second factor in the transfer function denominator of the first filter used for the module temperature correction" VALUE 0x20018D04 Scalar_FLOAT32_IEEE 0 swc_BatThermHndlgMngt_CM_single_dash_ -3.40282346639e+038 3.40282346639e+038 /end CHARACTERISTIC
/begin CHARACTERISTIC BTHM_TCorrnFil1Gain_P "Gain of the first filter used for module temperature correction" VALUE 0x20018D08 Scalar_FLOAT32_IEEE 0 swc_BatThermHndlgMngt_CM_single_dash_ -3.40282346639e+038 3.40282346639e+038 /end CHARACTERISTIC
/begin CHARACTERISTIC BTHM_TMdulSnsrCorrn1_M "Module temperature correction map 1." CURVE 0x20018D38 Lookup1D_FLOAT32_IEEE 0 swc_BatThermHndlgMngt_CM_single__ -3.40282346639e+038 3.40282346639e+038
 /begin AXIS_DESCR COM_AXIS NO_INPUT_QUANTITY swc_BatThermHndlgMngt_CM_single_A 15 -3.40282346639e+038 3.40282346639e+038 DEPOSIT ABSOLUTE AXIS_PTS_REF BTHM_IActForTCorrn1_A /end AXIS_DESCR
/end CHARACTERISTIC
/begin CHARACTERISTIC BTHM_TMdulSnsrSeln_P "Cell temperature sensor selection: 0-NTC1, 1-NTC2;" VALUE 0x20019C5E Scalar_UBYTE 0 swc_BatThermHndlgMngt_CM_uint8_dash_ 0 255 /end CHARACTERISTIC
/begin CHARACTERISTIC BTHM_TiTask100Ms_P "Time delta in 100 ms task." VALUE 0x20018EBC Scalar_FLOAT32_IEEE 0 swc_BatThermHndlgMngt_CM_single_dash_ 0 3.40282346639e+038 /end CHARACTERISTIC
/begin CHARACTERISTIC BTHM_bEnaMdulSnsrCorrnT_P "Flag for enabling module temperature measurement correction based on current flow" VALUE 0x20019C5F Scalar_BOOLEAN 0 swc_BatThermHndlgMngt_CM_boolean_dash_ 0 1 /end CHARACTERISTIC
/begin CHARACTERISTIC CTC_CtrCtctrAgiRstVal_P "If the contactor deterioration (aging) value of a contactor is reset (e.b. by service command), the new value is set to this threshold. If set to -1, the value entered through the GUI tool is used. For new contactors, 0 should be used." VALUE 0x200197F8 Scalar_FLOAT32_IEEE 0 swc_CtctrTranCtl_CM_single_dash_ -1 10000000 /end CHARACTERISTIC
/begin CHARACTERISTIC CTC_TiCtctrAgiDetmnRngCh_P "After contactor switching, the maximum absolute current flow occured within this time range will be taken for charge contactor aging value calculation." VALUE 0x20019934 Scalar_FLOAT32_IEEE 0 swc_CtctrTranCtl_CM_single_s 0 1 /end CHARACTERISTIC
/begin CHARACTERISTIC CTC_TiCtctrAgiDetmnRngNeg_P "After contactor switching, the maximum absolute current flow occured within this time range will be taken for negative contactor aging value calculation." VALUE 0x20019938 Scalar_FLOAT32_IEEE 0 swc_CtctrTranCtl_CM_single_s 0 1 /end CHARACTERISTIC
/begin CHARACTERISTIC CTC_TiCtctrAgiDetmnRngPos_P "After contactor switching, the maximum absolute current flow occured within this time range will be taken for positive contactor aging value calculation." VALUE 0x2001993C Scalar_FLOAT32_IEEE 0 swc_CtctrTranCtl_CM_single_s 0 1 /end CHARACTERISTIC
/begin CHARACTERISTIC CTC_TiCtctrAgiDetmnRngPrech_P "After contactor switching, the maximum absolute current flow occured within this time range will be taken for precharge contactor aging value calculation." VALUE 0x20019940 Scalar_FLOAT32_IEEE 0 swc_CtctrTranCtl_CM_single_s 0 1 /end CHARACTERISTIC
/begin MEASUREMENT DEH_CMdulAgiFacMem "Modules capacity ageing factor array" FLOAT32_IEEE swc_DiagcEveHndlg_CM_single_dash_ 0 0 -3.40282346639e+038 3.40282346639e+038 ECU_ADDRESS 0x1FFE61D8 MATRIX_DIM 24 1 1 /end MEASUREMENT
/begin CHARACTERISTIC DEH_CMdulAgiFacThd_P "Modules capacity ageing factor threshold" VALUE 0x20019AAC Scalar_FLOAT32_IEEE 0 swc_DiagcEveHndlg_CM_single_dash_ -3.40282346639e+038 3.40282346639e+038 /end CHARACTERISTIC
/begin MEASUREMENT DEH_EBatChTotMem "total energy charged to battery array" FLOAT32_IEEE swc_DiagcEveHndlg_CM_single_kWh 0 0 -3.40282346639e+038 3.40282346639e+038 ECU_ADDRESS 0x1FFE6238 /end MEASUREMENT
/begin CHARACTERISTIC DEH_EBatChTotMemThd_P "total energy stored in battery during its life cycle threshold" VALUE 0x20019AB4 Scalar_FLOAT32_IEEE 0 swc_DiagcEveHndlg_CM_single_kWh -3.40282346639e+038 3.40282346639e+038 /end CHARACTERISTIC
/begin MEASUREMENT DEH_EBatDchaTotMem "total energy supplied by battery during its life cycle array" FLOAT32_IEEE swc_DiagcEveHndlg_CM_single_kWh 0 0 -3.40282346639e+038 3.40282346639e+038 ECU_ADDRESS 0x1FFE623C /end MEASUREMENT
/begin CHARACTERISTIC DEH_EBatDchaTotThd_P "total energy stored in battery during its life cycle threshold" VALUE 0x20019AB8 Scalar_FLOAT32_IEEE 0 swc_DiagcEveHndlg_CM_single_kWh -3.40282346639e+038 3.40282346639e+038 /end CHARACTERISTIC
/begin MEASUREMENT DEH_RMdulAgiFacMem "Module resistance ageing factors array" FLOAT32_IEEE swc_DiagcEveHndlg_CM_single_dash_ 0 0 -3.40282346639e+038 3.40282346639e+038 ECU_ADDRESS 0x1FFE6258 MATRIX_DIM 24 1 1 /end MEASUREMENT
/begin CHARACTERISTIC DEH_RMdulAgiFacThd_P "Module resistance ageing factors threshold" VALUE 0x20019ABC Scalar_FLOAT32_IEEE 0 swc_DiagcEveHndlg_CM_single_dash_ -3.40282346639e+038 3.40282346639e+038 /end CHARACTERISTIC
/begin MEASUREMENT DEH_SocMdulMem "Module SOC array" FLOAT32_IEEE swc_DiagcEveHndlg_CM_single_dash_ 0 0 -3.40282346639e+038 3.40282346639e+038 ECU_ADDRESS 0x1FFE62B8 MATRIX_DIM 24 1 1 /end MEASUREMENT
/begin CHARACTERISTIC DEH_SocMdulThd_P "Module SOC threshold" VALUE 0x20019AC0 Scalar_FLOAT32_IEEE 0 swc_DiagcEveHndlg_CM_single_dash_ -3.40282346639e+038 3.40282346639e+038 /end CHARACTERISTIC
/begin MEASUREMENT DEH_SohRDeltaMem "Delta R based SOH value" FLOAT32_IEEE swc_DiagcEveHndlg_CM_single_dash_ 0 0 -3.40282346639e+038 3.40282346639e+038 ECU_ADDRESS 0x1FFE6318 MATRIX_DIM 24 1 1 /end MEASUREMENT
/begin CHARACTERISTIC DEH_SohRDeltaThd_P "Delta R based SOH value threshold" VALUE 0x20019AC4 Scalar_FLOAT32_IEEE 0 swc_DiagcEveHndlg_CM_single_dash_ -3.40282346639e+038 3.40282346639e+038 /end CHARACTERISTIC
/begin MEASUREMENT DEH_SohSocDeltaMem "DeltaSOC based SOH value" FLOAT32_IEEE swc_DiagcEveHndlg_CM_single_dash_ 0 0 -3.40282346639e+038 3.40282346639e+038 ECU_ADDRESS 0x1FFE6378 MATRIX_DIM 24 1 1 /end MEASUREMENT
/begin CHARACTERISTIC DEH_SohSocDeltaThd_P "DeltaSOC based SOH value threshold" VALUE 0x20019AC8 Scalar_FLOAT32_IEEE 0 swc_DiagcEveHndlg_CM_single_dash_ -3.40282346639e+038 3.40282346639e+038 /end CHARACTERISTIC
/begin CHARACTERISTIC DEH_TiRstThd_P "Reset time threshold" VALUE 0x20019ACC Scalar_FLOAT32_IEEE 0 swc_DiagcEveHndlg_CM_single_s -3.40282346639e+038 3.40282346639e+038 /end CHARACTERISTIC
/begin CHARACTERISTIC DEH_TiSample_P "sample time" VALUE 0x20019AD0 Scalar_FLOAT32_IEEE 0 swc_DiagcEveHndlg_CM_single_s -3.40282346639e+038 3.40282346639e+038 /end CHARACTERISTIC
/begin CHARACTERISTIC ELHPN_Csw_P "Configuration switch. (Bit0: Crash, Bit1: Isolation initialization chek, Bit2: High voltage interlock, Bit3: Isolation state)." VALUE 0x20019D84 Scalar_UBYTE 0 swc_EltlLnkHzrdProtnNet_CM_uint8_dash_ 0 255 /end CHARACTERISTIC
/begin CHARACTERISTIC ELHPN_StIslnDebOff_P "Counter off for debounce isolation state." VALUE 0x20019B08 Scalar_FLOAT32_IEEE 0 swc_EltlLnkHzrdProtnNet_CM_single_dash_ 0 4294967296 /end CHARACTERISTIC
/begin CHARACTERISTIC ELHPN_StIslnDebOn_P "Counter on for debounce isolation state." VALUE 0x20019B0C Scalar_FLOAT32_IEEE 0 swc_EltlLnkHzrdProtnNet_CM_single_dash_ 0 4294967296 /end CHARACTERISTIC
/begin CHARACTERISTIC ELHPN_StIslnDebShoOff_P "Short counter off for debounce of isolation state after initialization." VALUE 0x20019B10 Scalar_FLOAT32_IEEE 0 swc_EltlLnkHzrdProtnNet_CM_single_dash_ 0 4294967296 /end CHARACTERISTIC
/begin CHARACTERISTIC ELHPN_StIslnDebShoOn_P "Short counter on for debounce of isolation state after initialization." VALUE 0x20019B14 Scalar_FLOAT32_IEEE 0 swc_EltlLnkHzrdProtnNet_CM_single_dash_ 0 4294967296 /end CHARACTERISTIC
/begin CHARACTERISTIC ELHPN_StIslnDebShoPerd_P "Time period for short debounce setp after initialize." VALUE 0x20019B18 Scalar_FLOAT32_IEEE 0 swc_EltlLnkHzrdProtnNet_CM_single_s -3.40282346639e+038 3.40282346639e+038 /end CHARACTERISTIC
/begin CHARACTERISTIC ELHPN_TiDiagDebIniOff18_P "Short time dalay off for debounce of DTC18 while initializing." VALUE 0x20019B4C Scalar_FLOAT32_IEEE 0 swc_EltlLnkHzrdProtnNet_CM_single_s -3.40282346639e+038 3.40282346639e+038 /end CHARACTERISTIC
/begin CHARACTERISTIC ELHPN_TiDiagDebIniOn18_P "Short time dalay on for debounce of DTC18 while initializing." VALUE 0x20019B50 Scalar_FLOAT32_IEEE 0 swc_EltlLnkHzrdProtnNet_CM_single_s -3.40282346639e+038 3.40282346639e+038 /end CHARACTERISTIC
/begin CHARACTERISTIC ELHPN_TiSample1 "Sampling time for runnable 1." VALUE 0x20019B80 Scalar_FLOAT32_IEEE 0 swc_EltlLnkHzrdProtnNet_CM_single_s -3.40282346639e+038 3.40282346639e+038 /end CHARACTERISTIC
/begin CHARACTERISTIC SMObc_TMdulSnsrMax_P "Max emperature for charge allowed" VALUE 0x20017C34 Scalar_FLOAT32_IEEE 0 swc_BatChCtl_CM_single__ -3.40282346639e+038 3.40282346639e+038 /end CHARACTERISTIC
/begin CHARACTERISTIC SMObc_TMdulSnsrMin_P "Min temperature for charge allowed" VALUE 0x20017C38 Scalar_FLOAT32_IEEE 0 swc_BatChCtl_CM_single__ -3.40282346639e+038 3.40282346639e+038 /end CHARACTERISTIC
/begin CHARACTERISTIC SMObc_TiProc_P "Process sample time" VALUE 0x20017C3C Scalar_FLOAT32_IEEE 0 swc_BatChCtl_CM_single_s -3.40282346639e+038 3.40282346639e+038 /end CHARACTERISTIC
/begin GROUP Root_100ms "swc_BatWntyLogtcData/100ms" /begin SUB_GROUP S2_100ms /end SUB_GROUP /end GROUP
/begin GROUP Root_10ms "swc_BatWntyLogtcData/10ms" /begin SUB_GROUP S3_10ms /end SUB_GROUP /end GROUP
/begin GROUP Root_AC_10ms_sys "swc_BatChCtl/AC_10ms_sys" /begin SUB_GROUP S1_AC_10ms_sys /end SUB_GROUP /end GROUP
/begin GROUP Root_BBC_100ms_sys "swc_BatBalnCtl/BBC_100ms_sys" /begin SUB_GROUP S1_BBC_100ms_sys /end SUB_GROUP /end GROUP
/begin GROUP Root_BCC_10ms_sys "swc_BatChCtl/BCC_10ms_sys" /begin SUB_GROUP S2_BCC_10ms_sys /end SUB_GROUP /end GROUP
/begin GROUP Root_BCF_100ms_sys "swc_BatCoreFct/BCF_100ms_sys" /begin SUB_GROUP S1_BatCoreFct /end SUB_GROUP /end GROUP
/begin GROUP Root_BCF_10ms_sys "swc_BatCoreFct/BCF_10ms_sys" /begin SUB_GROUP S2_SofPackLimn /end SUB_GROUP /end GROUP
/begin GROUP Root_BcuStTranCtl_sys "swc_BcuStTranCtl/BcuStTranCtl_sys" /begin SUB_GROUP S1_BcuStTranCtl /end SUB_GROUP /end GROUP
/begin GROUP Root_BTHM_100ms_sys "swc_BatThermHndlgMngt/BTHM_100ms_sys" /begin SUB_GROUP S1_100ms /end SUB_GROUP /end GROUP
/begin GROUP Root_CellUDiag "swc_BatProtnIU/CellUDiag" /begin SUB_GROUP S1_100ms /end SUB_GROUP /end GROUP
/begin GROUP Root_CIL_100ms_sys "swc_CIL/CIL_100ms_sys" /begin SUB_GROUP S1_BMS_customer_config S1_BSW S1_GB_CAN S1_Veh_CAN /end SUB_GROUP /end GROUP
/begin GROUP Root_CIL_10ms_sys "swc_CIL/CIL_10ms_sys" /begin SUB_GROUP S2_BSW S2_GB_CAN S2_Veh_CAN /end SUB_GROUP /end GROUP
/begin GROUP Root_COL_1000ms_sys "swc_COL/COL_1000ms_sys" /begin SUB_GROUP S1_COL_1000ms_sys /end SUB_GROUP /end GROUP
/begin GROUP Root_COL_100ms_sys "swc_COL/COL_100ms_sys" /begin SUB_GROUP S2_COL_100ms_sys /end SUB_GROUP /end GROUP
/begin GROUP Root_COL_10ms_sys "swc_COL/COL_10ms_sys" /begin SUB_GROUP S3_COL_10ms_sys /end SUB_GROUP /end GROUP
/begin GROUP Root_CtcrtTranCtl_sys "swc_CtctrTranCtl/CtcrtTranCtl_sys" /begin SUB_GROUP S1_CtcrtTranCtl /end SUB_GROUP /end GROUP
/begin GROUP Root_DC_10ms_sys "swc_BatChCtl/DC_10ms_sys" /begin SUB_GROUP S3_ElecVehChegnStHdlr_Sys /end SUB_GROUP /end GROUP
/begin GROUP Root_DEH_10ms_sys "swc_DiagcEveHndlg/DEH_10ms_sys" /begin SUB_GROUP S1_DEH_10ms_sys /end SUB_GROUP /end GROUP
/begin GROUP Root_ELHPN_10ms_sys "swc_EltlLnkHzrdProtnNet/ELHPN_10ms_sys" /begin SUB_GROUP S1_ELHPN_10ms_sys /end SUB_GROUP /end GROUP
/begin GROUP Root_NVM_Read_10ms_sys "swc_DiagcEveHndlg/NVM_Read_10ms_sys" /begin SUB_GROUP S4_DEH_bAcvSwt_P /end SUB_GROUP /end GROUP
/begin GROUP Root_NVM_Write_100ms_sys "swc_DiagcEveHndlg/NVM_Write_100ms_sys" /begin SUB_GROUP S5_NVM_Write /end SUB_GROUP /end GROUP
/begin GROUP Root_PackIDiag "swc_BatProtnIU/PackIDiag" /begin SUB_GROUP S2_Subsystem /end SUB_GROUP /end GROUP
/begin GROUP S100_ModuleSocInitializationEitherFromFlashorOCV "swc_BatCoreFct/BCF_100ms_sys/BatCoreFct/BatCoreInit/StateInitialization/SocMdulInit/ModuleSocInitializationEitherFromFlashorOCV" /begin SUB_GROUP S109_BCF_SocInin_M S109_BCF_TiBatOffForWtngSoc_M /end SUB_GROUP /end GROUP
/begin GROUP S100_SOCInitializationDiagnostics "swc_BatCoreFct/BCF_100ms_sys/BatCoreFct/BatCoreInit/StateInitialization/SocMdulInit/SOCInitializationDiagnostics" /begin SUB_GROUP S110_DiagnosticofSocMdulInin /end SUB_GROUP /end GROUP
/begin GROUP S103_BTHM_bEnaMdulSnsrCorrnT_P "swc_BatThermHndlgMngt/BTHM_100ms_sys/100ms/DataPrep/DataCnvnMdulCtrl/MeasCorrn/BTHM_bEnaMdulSnsrCorrnT_P" /begin REF_CHARACTERISTIC BTHM_bEnaMdulSnsrCorrnT_P /end REF_CHARACTERISTIC /end GROUP
/begin GROUP S103_Filter "swc_BatThermHndlgMngt/BTHM_100ms_sys/100ms/DataPrep/DataCnvnMdulCtrl/MeasCorrn/Filter" /begin SUB_GROUP S105_BTHM_TMdulSnsrCorrn1_M1 S105_Filter1 /end SUB_GROUP /end GROUP
/begin GROUP S103_MeasCorrnSnsrSeln "swc_BatThermHndlgMngt/BTHM_100ms_sys/100ms/DataPrep/DataCnvnMdulCtrl/MeasCorrn/MeasCorrnSnsrSeln" /begin SUB_GROUP S106_BTHM_TMdulSnsrSeln_P /end SUB_GROUP /end GROUP
/begin GROUP S105_BTHM_TMdulSnsrCorrn1_M1 "swc_BatThermHndlgMngt/BTHM_100ms_sys/100ms/DataPrep/DataCnvnMdulCtrl/MeasCorrn/Filter/BTHM_TMdulSnsrCorrn1_M1" /begin REF_CHARACTERISTIC BTHM_TMdulSnsrCorrn1_M /end REF_CHARACTERISTIC /end GROUP
/begin GROUP S105_Filter1 "swc_BatThermHndlgMngt/BTHM_100ms_sys/100ms/DataPrep/DataCnvnMdulCtrl/MeasCorrn/Filter/Filter1"
 /begin SUB_GROUP S108_BTHM_TCorrnFil1Fac0_P S108_BTHM_TCorrnFil1Fac1_P S108_BTHM_TCorrnFil1Gain_P S108_BTHM_TiTask100Ms_P /end SUB_GROUP
/end GROUP
/begin GROUP S106_BTHM_TMdulSnsrSeln_P "swc_BatThermHndlgMngt/BTHM_100ms_sys/100ms/DataPrep/DataCnvnMdulCtrl/MeasCorrn/MeasCorrnSnsrSeln/BTHM_TMdulSnsrSeln_P" /begin REF_CHARACTERISTIC BTHM_TMdulSnsrSeln_P /end REF_CHARACTERISTIC /end GROUP
/begin GROUP S106_CTC_TiCtctrAgiDetmnRngCh_P "swc_CtctrTranCtl/CtcrtTranCtl_sys/CtcrtTranCtl/ContactorAgingObserver/TimerCh/CTC_TiCtctrAgiDetmnRngCh_P" /begin REF_CHARACTERISTIC CTC_TiCtctrAgiDetmnRngCh_P /end REF_CHARACTERISTIC /end GROUP
/begin GROUP S107_CTC_TiCtctrAgiDetmnRngNeg_P "swc_CtctrTranCtl/CtcrtTranCtl_sys/CtcrtTranCtl/ContactorAgingObserver/TimerNeg/CTC_TiCtctrAgiDetmnRngNeg_P" /begin REF_CHARACTERISTIC CTC_TiCtctrAgiDetmnRngNeg_P /end REF_CHARACTERISTIC /end GROUP
/begin GROUP S108_BTHM_TCorrnFil1Fac0_P "swc_BatThermHndlgMngt/BTHM_100ms_sys/100ms/DataPrep/DataCnvnMdulCtrl/MeasCorrn/Filter/Filter1/BTHM_TCorrnFil1Fac0_P" /begin REF_CHARACTERISTIC BTHM_TCorrnFil1Fac0_P /end REF_CHARACTERISTIC /end GROUP
/begin GROUP S108_BTHM_TCorrnFil1Fac1_P "swc_BatThermHndlgMngt/BTHM_100ms_sys/100ms/DataPrep/DataCnvnMdulCtrl/MeasCorrn/Filter/Filter1/BTHM_TCorrnFil1Fac1_P" /begin REF_CHARACTERISTIC BTHM_TCorrnFil1Fac1_P /end REF_CHARACTERISTIC /end GROUP
/begin GROUP S108_BTHM_TCorrnFil1Gain_P "swc_BatThermHndlgMngt/BTHM_100ms_sys/100ms/DataPrep/DataCnvnMdulCtrl/MeasCorrn/Filter/Filter1/BTHM_TCorrnFil1Gain_P" /begin REF_CHARACTERISTIC BTHM_TCorrnFil1Gain_P /end REF_CHARACTERISTIC /end GROUP
/begin GROUP S108_BTHM_TiTask100Ms_P "swc_BatThermHndlgMngt/BTHM_100ms_sys/100ms/DataPrep/DataCnvnMdulCtrl/MeasCorrn/Filter/Filter1/BTHM_TiTask100Ms_P" /begin REF_CHARACTERISTIC BTHM_TiTask100Ms_P /end REF_CHARACTERISTIC /end GROUP
/begin GROUP S108_CTC_TiCtctrAgiDetmnRngPos_P "swc_CtctrTranCtl/CtcrtTranCtl_sys/CtcrtTranCtl/ContactorAgingObserver/TimerPos/CTC_TiCtctrAgiDetmnRngPos_P" /begin REF_CHARACTERISTIC CTC_TiCtctrAgiDetmnRngPos_P /end REF_CHARACTERISTIC /end GROUP
/begin GROUP S109_BCF_SocInin_M "swc_BatCoreFct/BCF_100ms_sys/BatCoreFct/BatCoreInit/StateInitialization/SocMdulInit/ModuleSocInitializationEitherFromFlashorOCV/BCF_SocInin_M" /begin REF_CHARACTERISTIC BCF_SocInin_M /end REF_CHARACTERISTIC /end GROUP
/begin GROUP S109_BCF_TiBatOffForWtngSoc_M "swc_BatCoreFct/BCF_100ms_sys/BatCoreFct/BatCoreInit/StateInitialization/SocMdulInit/ModuleSocInitializationEitherFromFlashorOCV/BCF_TiBatOffForWtngSoc_M" /begin REF_CHARACTERISTIC BCF_TiBatOffForWtngSoc_M /end REF_CHARACTERISTIC /end GROUP
/begin GROUP S109_CTC_TiCtctrAgiDetmnRngPrech_P "swc_CtctrTranCtl/CtcrtTranCtl_sys/CtcrtTranCtl/ContactorAgingObserver/TimerPrec/CTC_TiCtctrAgiDetmnRngPrech_P" /begin REF_CHARACTERISTIC CTC_TiCtctrAgiDetmnRngPrech_P /end REF_CHARACTERISTIC /end GROUP
/begin GROUP S10_CompareToCalibrationPara1 "swc_BatChCtl/AC_10ms_sys/AC_10ms_sys/AC_Condition/CompareToCalibrationPara1" /begin REF_CHARACTERISTIC SMObc_TMdulSnsrMax_P /end REF_CHARACTERISTIC /end GROUP
/begin GROUP S10_CompareToCalibrationPara23 "swc_BatChCtl/AC_10ms_sys/AC_10ms_sys/AC_Condition/CompareToCalibrationPara23" /begin REF_CHARACTERISTIC SMObc_TMdulSnsrMin_P /end REF_CHARACTERISTIC /end GROUP
/begin GROUP S110_DiagnosticofSocMdulInin "swc_BatCoreFct/BCF_100ms_sys/BatCoreFct/BatCoreInit/StateInitialization/SocMdulInit/SOCInitializationDiagnostics/DiagnosticofSocMdulInin"
 /begin SUB_GROUP S115_BCF_SocMdulIninDeLim_M S115_BCF_Td_P S115_BCF_TdOffDig1006_P S115_BCF_TdOnDig1006_P S115_BitSelect3 /end SUB_GROUP
/end GROUP
/begin GROUP S110_ResetCtctrChDtrt "swc_CtctrTranCtl/CtcrtTranCtl_sys/CtcrtTranCtl/ContactorAgingObserver/WriteCtctrChDtrt/ResetCtctrChDtrt" /begin SUB_GROUP S152_CTC_CtrCtctrAgiRstVal_P /end SUB_GROUP /end GROUP
/begin GROUP S111_ResetCtctrNegDtrt "swc_CtctrTranCtl/CtcrtTranCtl_sys/CtcrtTranCtl/ContactorAgingObserver/WriteCtctrNegDtrt/ResetCtctrNegDtrt" /begin SUB_GROUP S156_CTC_CtrCtctrAgiRstVal_P /end SUB_GROUP /end GROUP
/begin GROUP S1122_NVM_store_contions "swc_DiagcEveHndlg/NVM_Write_100ms_sys/NVM Write/NVM store contions"
 /begin SUB_GROUP S1124_DEH_TiRstThd_P S1124_DEH_TiSample_P S1124_Trigger_CMdulAgiFacFls S1124_Trigger_EBatChTot S1124_Trigger_EBatDchaTot S1124_Trigger_RMdulAgiFacFls S1124_Trigger_SOC S1124_Trigger_SohRDeltaFls S1124_Trigger_SohSocDeltaFls /end SUB_GROUP
/end GROUP
/begin GROUP S1124_DEH_TiRstThd_P "swc_DiagcEveHndlg/NVM_Write_100ms_sys/NVM Write/NVM store contions/DEH_TiRstThd_P" /begin REF_CHARACTERISTIC DEH_TiRstThd_P /end REF_CHARACTERISTIC /end GROUP
/begin GROUP S1124_DEH_TiSample_P "swc_DiagcEveHndlg/NVM_Write_100ms_sys/NVM Write/NVM store contions/DEH_TiSample_P" /begin REF_CHARACTERISTIC DEH_TiSample_P /end REF_CHARACTERISTIC /end GROUP
/begin GROUP S1124_Trigger_CMdulAgiFacFls "swc_DiagcEveHndlg/NVM_Write_100ms_sys/NVM Write/NVM store contions/Trigger_CMdulAgiFacFls" /begin SUB_GROUP S1446_DEH_CMdulAgiFacThd_P /end SUB_GROUP /begin REF_MEASUREMENT DEH_CMdulAgiFacMem /end REF_MEASUREMENT /end GROUP
/begin GROUP S1124_Trigger_EBatChTot "swc_DiagcEveHndlg/NVM_Write_100ms_sys/NVM Write/NVM store contions/Trigger_EBatChTot" /begin SUB_GROUP S1447_DEH_EBatChTotMemThd_P /end SUB_GROUP /begin REF_MEASUREMENT DEH_EBatChTotMem /end REF_MEASUREMENT /end GROUP
/begin GROUP S1124_Trigger_EBatDchaTot "swc_DiagcEveHndlg/NVM_Write_100ms_sys/NVM Write/NVM store contions/Trigger_EBatDchaTot" /begin SUB_GROUP S1448_DEH_EBatDchaTotThd_P /end SUB_GROUP /begin REF_MEASUREMENT DEH_EBatDchaTotMem /end REF_MEASUREMENT /end GROUP
/begin GROUP S1124_Trigger_RMdulAgiFacFls "swc_DiagcEveHndlg/NVM_Write_100ms_sys/NVM Write/NVM store contions/Trigger_RMdulAgiFacFls" /begin SUB_GROUP S1449_DEH_RMdulAgiFacThd_P /end SUB_GROUP /begin REF_MEASUREMENT DEH_RMdulAgiFacMem /end REF_MEASUREMENT /end GROUP
/begin GROUP S1124_Trigger_SOC "swc_DiagcEveHndlg/NVM_Write_100ms_sys/NVM Write/NVM store contions/Trigger_SOC" /begin SUB_GROUP S1450_DEH_SocMdulThd_P /end SUB_GROUP /begin REF_MEASUREMENT DEH_SocMdulMem /end REF_MEASUREMENT /end GROUP
/begin GROUP S1124_Trigger_SohRDeltaFls "swc_DiagcEveHndlg/NVM_Write_100ms_sys/NVM Write/NVM store contions/Trigger_SohRDeltaFls" /begin SUB_GROUP S1451_DEH_SohRDeltaThd_P /end SUB_GROUP /begin REF_MEASUREMENT DEH_SohRDeltaMem /end REF_MEASUREMENT /end GROUP
/begin GROUP S1124_Trigger_SohSocDeltaFls "swc_DiagcEveHndlg/NVM_Write_100ms_sys/NVM Write/NVM store contions/Trigger_SohSocDeltaFls" /begin SUB_GROUP S1452_DEH_SohSocDeltaThd_P /end SUB_GROUP /begin REF_MEASUREMENT DEH_SohSocDeltaMem /end REF_MEASUREMENT /end GROUP
/begin GROUP S112_ResetCtctrPosDtrt "swc_CtctrTranCtl/CtcrtTranCtl_sys/CtcrtTranCtl/ContactorAgingObserver/WriteCtctrPosDtrt/ResetCtctrPosDtrt" /begin SUB_GROUP S160_CTC_CtrCtctrAgiRstVal_P /end SUB_GROUP /end GROUP
/begin GROUP S113_ResetCtctrPrechDtrt "swc_CtctrTranCtl/CtcrtTranCtl_sys/CtcrtTranCtl/ContactorAgingObserver/WriteCtctrPrecDtrt/ResetCtctrPrechDtrt" /begin SUB_GROUP S164_CTC_CtrCtctrAgiRstVal_P /end SUB_GROUP /end GROUP
/begin GROUP S114_BSTC_TiProc_P "swc_BcuStTranCtl/BcuStTranCtl_sys/BcuStTranCtl/ConditionConfirm/ShutdownDetection/Subsystem/BSTC_TiProc_P" /begin REF_CHARACTERISTIC BSTC_TiProc_P /end REF_CHARACTERISTIC /end GROUP
/begin GROUP S114_BSTC_TiRxVldMsg_P "swc_BcuStTranCtl/BcuStTranCtl_sys/BcuStTranCtl/ConditionConfirm/ShutdownDetection/Subsystem/BSTC_TiRxVldMsg_P" /begin REF_CHARACTERISTIC BSTC_TiRxVldMsg_P /end REF_CHARACTERISTIC /end GROUP
/begin GROUP S115_BCF_SocMdulIninDeLim_M "swc_BatCoreFct/BCF_100ms_sys/BatCoreFct/BatCoreInit/StateInitialization/SocMdulInit/SOCInitializationDiagnostics/DiagnosticofSocMdulInin/BCF_SocMdulIninDeLim_M" /begin REF_CHARACTERISTIC BCF_SocMdulIninDeLim_M /end REF_CHARACTERISTIC /end GROUP
/begin GROUP S115_BCF_Td_P "swc_BatCoreFct/BCF_100ms_sys/BatCoreFct/BatCoreInit/StateInitialization/SocMdulInit/SOCInitializationDiagnostics/DiagnosticofSocMdulInin/BCF_Td_P" /begin REF_CHARACTERISTIC BCF_Td_P /end REF_CHARACTERISTIC /end GROUP
/begin GROUP S115_BCF_TdOffDig1006_P "swc_BatCoreFct/BCF_100ms_sys/BatCoreFct/BatCoreInit/StateInitialization/SocMdulInit/SOCInitializationDiagnostics/DiagnosticofSocMdulInin/BCF_TdOffDig1006_P" /begin REF_CHARACTERISTIC BCF_TdOffDig1006_P /end REF_CHARACTERISTIC /end GROUP
/begin GROUP S115_BCF_TdOnDig1006_P "swc_BatCoreFct/BCF_100ms_sys/BatCoreFct/BatCoreInit/StateInitialization/SocMdulInit/SOCInitializationDiagnostics/DiagnosticofSocMdulInin/BCF_TdOnDig1006_P" /begin REF_CHARACTERISTIC BCF_TdOnDig1006_P /end REF_CHARACTERISTIC /end GROUP
/begin GROUP S115_BitSelect3 "swc_BatCoreFct/BCF_100ms_sys/BatCoreFct/BatCoreInit/StateInitialization/SocMdulInit/SOCInitializationDiagnostics/DiagnosticofSocMdulInin/BitSelect3" /begin REF_CHARACTERISTIC BCF_EnaDiag_P /end REF_CHARACTERISTIC /end GROUP
/begin GROUP S11_BCC_EffDcdc_P "swc_BatChCtl/AC_10ms_sys/AC_10ms_sys/Current and Voltage Calculated/BCC_EffDcdc_P" /begin REF_CHARACTERISTIC BCC_EffDcdc_P /end REF_CHARACTERISTIC /end GROUP
/begin GROUP S11_BCC_EffObc_P "swc_BatChCtl/AC_10ms_sys/AC_10ms_sys/Current and Voltage Calculated/BCC_EffObc_P" /begin REF_CHARACTERISTIC BCC_EffObc_P /end REF_CHARACTERISTIC /end GROUP
/begin GROUP S11_BCC_ILimByRAcChCnctn_M "swc_BatChCtl/AC_10ms_sys/AC_10ms_sys/Current and Voltage Calculated/BCC_ILimByRAcChCnctn_M" /begin REF_CHARACTERISTIC BCC_ILimByRAcChCnctn_M /end REF_CHARACTERISTIC /end GROUP
/begin GROUP S11_BCC_IThermReq_P "swc_BatChCtl/AC_10ms_sys/AC_10ms_sys/Current and Voltage Calculated/BCC_IThermReq_P" /begin REF_CHARACTERISTIC BCC_IThermReq_P /end REF_CHARACTERISTIC /end GROUP
/begin GROUP S11_BCC_PwrPtcTherm_P "swc_BatChCtl/AC_10ms_sys/AC_10ms_sys/Current and Voltage Calculated/BCC_PwrPtcTherm_P" /begin REF_CHARACTERISTIC BCC_PwrPtcTherm_P /end REF_CHARACTERISTIC /end GROUP
/begin GROUP S11_BCC_UOfsThermReq_P "swc_BatChCtl/AC_10ms_sys/AC_10ms_sys/Current and Voltage Calculated/BCC_UOfsThermReq_P" /begin REF_CHARACTERISTIC BCC_UOfsThermReq_P /end REF_CHARACTERISTIC /end GROUP
/begin GROUP S11_SocBat "swc_BatWntyLogtcData/100ms/100ms/SocBat" /begin SUB_GROUP S25_BWLD_SocBatRst_P /end SUB_GROUP /end GROUP
/begin GROUP S11_TCell "swc_BatWntyLogtcData/100ms/100ms/TCell" /begin SUB_GROUP S26_BWLD_TMdulSnsrRst_P1 /end SUB_GROUP /end GROUP
/begin GROUP S11_UCell "swc_BatWntyLogtcData/100ms/100ms/UCell" /begin SUB_GROUP S27_BWLD_UCellRst_P /end SUB_GROUP /end GROUP
/begin GROUP S128_Extract_Mdul_Data "swc_BatCoreFct/BCF_100ms_sys/BatCoreFct/PackObs/PackObsLoop/Extract Mdul Data"
 /begin SUB_GROUP S132_BCF_RCellCnct_P S132_Current_Direction_Determination S132_UCell_Measurement_Correction /end SUB_GROUP
/end GROUP
/begin GROUP S128_MdulObs "swc_BatCoreFct/BCF_100ms_sys/BatCoreFct/PackObs/PackObsLoop/MdulObs"
 /begin SUB_GROUP S133_CellObsr S133_Internal_Short_Circuit_Detection S133_MdulCObs S133_MdulRObs S133_MdulSocObsr /end SUB_GROUP
/end GROUP
/begin GROUP S12_Battery_Balancing_Decision "swc_BatBalnCtl/BBC_100ms_sys/BBC_100ms_sys/BatBalnCtl/Battery Balancing Decision"
 /begin SUB_GROUP S17_BatBalnCtl S17_BBC_ChtBalnPas_P S17_BBC_EnaTestBaln_P S17_BBC_EnaTestBaln_P1 S17_BBC_HtcEfc_P S17_BBC_NrMdulTest_P S17_BBC_NrMdulTest_P1 S17_BBC_RCellBaln_P S17_BBC_TiDly_P S17_ManualSwitch /end SUB_GROUP
/end GROUP
/begin GROUP S12_BBC_StBcu_M "swc_BatBalnCtl/BBC_100ms_sys/BBC_100ms_sys/BatBalnCtl/BBC_StBcu_M" /begin REF_CHARACTERISTIC BBC_StBcu_M /end REF_CHARACTERISTIC /end GROUP
/begin GROUP S12_BCC_GainIDig101_P "swc_BatChCtl/AC_10ms_sys/AC_10ms_sys/Diagnosis/BCC_GainIDig101_P" /begin REF_CHARACTERISTIC BCC_GainIDig101_P /end REF_CHARACTERISTIC /end GROUP
/begin GROUP S12_BCC_GainIDig102_P "swc_BatChCtl/AC_10ms_sys/AC_10ms_sys/Diagnosis/BCC_GainIDig102_P" /begin REF_CHARACTERISTIC BCC_GainIDig102_P /end REF_CHARACTERISTIC /end GROUP
/begin GROUP S12_BCC_TiChAllwdOffDig_P "swc_BatChCtl/AC_10ms_sys/AC_10ms_sys/Diagnosis/BCC_TiChAllwdOffDig_P" /begin REF_CHARACTERISTIC BCC_TiChAllwdOffDig_P /end REF_CHARACTERISTIC /end GROUP
/begin GROUP S12_BCC_TiChAllwdOnDig_P "swc_BatChCtl/AC_10ms_sys/AC_10ms_sys/Diagnosis/BCC_TiChAllwdOnDig_P" /begin REF_CHARACTERISTIC BCC_TiChAllwdOnDig_P /end REF_CHARACTERISTIC /end GROUP
/begin GROUP S12_BCC_TiChCnctOffDig_P "swc_BatChCtl/AC_10ms_sys/AC_10ms_sys/Diagnosis/BCC_TiChCnctOffDig_P" /begin REF_CHARACTERISTIC BCC_TiChCnctOffDig_P /end REF_CHARACTERISTIC /end GROUP
/begin GROUP S12_BCC_TiChCnctOnDig_P "swc_BatChCtl/AC_10ms_sys/AC_10ms_sys/Diagnosis/BCC_TiChCnctOnDig_P" /begin REF_CHARACTERISTIC BCC_TiChCnctOnDig_P /end REF_CHARACTERISTIC /end GROUP
/begin GROUP S12_BCC_TiOffDig10_P "swc_BatChCtl/AC_10ms_sys/AC_10ms_sys/Diagnosis/BCC_TiOffDig10_P" /begin REF_CHARACTERISTIC BCC_TiOffDig10_P /end REF_CHARACTERISTIC /end GROUP
/begin GROUP S12_BCC_TiOffDig53_P "swc_BatChCtl/AC_10ms_sys/AC_10ms_sys/Diagnosis/BCC_TiOffDig53_P" /begin REF_CHARACTERISTIC BCC_TiOffDig53_P /end REF_CHARACTERISTIC /end GROUP
/begin GROUP S12_BCC_TiOffDig71_P "swc_BatChCtl/AC_10ms_sys/AC_10ms_sys/Diagnosis/BCC_TiOffDig71_P" /begin REF_CHARACTERISTIC BCC_TiOffDig71_P /end REF_CHARACTERISTIC /end GROUP
/begin GROUP S12_BCC_TiOffDig73_P "swc_BatChCtl/AC_10ms_sys/AC_10ms_sys/Diagnosis/BCC_TiOffDig73_P" /begin REF_CHARACTERISTIC BCC_TiOffDig73_P /end REF_CHARACTERISTIC /end GROUP
/begin GROUP S12_BCC_TiOnDig10_P "swc_BatChCtl/AC_10ms_sys/AC_10ms_sys/Diagnosis/BCC_TiOnDig10_P" /begin REF_CHARACTERISTIC BCC_TiOnDig10_P /end REF_CHARACTERISTIC /end GROUP
/begin GROUP S12_BCC_TiOnDig53_P "swc_BatChCtl/AC_10ms_sys/AC_10ms_sys/Diagnosis/BCC_TiOnDig53_P" /begin REF_CHARACTERISTIC BCC_TiOnDig53_P /end REF_CHARACTERISTIC /end GROUP
/begin GROUP S12_BCC_TiOnDig71_P "swc_BatChCtl/AC_10ms_sys/AC_10ms_sys/Diagnosis/BCC_TiOnDig71_P" /begin REF_CHARACTERISTIC BCC_TiOnDig71_P /end REF_CHARACTERISTIC /end GROUP
/begin GROUP S12_BCC_TiOnDig73_P "swc_BatChCtl/AC_10ms_sys/AC_10ms_sys/Diagnosis/BCC_TiOnDig73_P" /begin REF_CHARACTERISTIC BCC_TiOnDig73_P /end REF_CHARACTERISTIC /end GROUP
/begin GROUP S12_BCC_TiPwrUpOffDig_P "swc_BatChCtl/AC_10ms_sys/AC_10ms_sys/Diagnosis/BCC_TiPwrUpOffDig_P" /begin REF_CHARACTERISTIC BCC_TiPwrUpOffDig_P /end REF_CHARACTERISTIC /end GROUP
/begin GROUP S12_BCC_TiPwrUpOnDig_P "swc_BatChCtl/AC_10ms_sys/AC_10ms_sys/Diagnosis/BCC_TiPwrUpOnDig_P" /begin REF_CHARACTERISTIC BCC_TiPwrUpOnDig_P /end REF_CHARACTERISTIC /end GROUP
/begin GROUP S12_BCC_ValOfsDig101_P "swc_BatChCtl/AC_10ms_sys/AC_10ms_sys/Diagnosis/BCC_ValOfsDig101_P" /begin REF_CHARACTERISTIC BCC_ValOfsDig101_P /end REF_CHARACTERISTIC /end GROUP
/begin GROUP S12_BCC_ValOfsDig102_P "swc_BatChCtl/AC_10ms_sys/AC_10ms_sys/Diagnosis/BCC_ValOfsDig102_P" /begin REF_CHARACTERISTIC BCC_ValOfsDig102_P /end REF_CHARACTERISTIC /end GROUP
/begin GROUP S12_BitSelect "swc_BatChCtl/AC_10ms_sys/AC_10ms_sys/Diagnosis/BitSelect" /begin REF_CHARACTERISTIC BCC_bAcvSwtDtc_P /end REF_CHARACTERISTIC /end GROUP
/begin GROUP S12_BitSelect1 "swc_BatChCtl/AC_10ms_sys/AC_10ms_sys/Diagnosis/BitSelect1" /begin REF_CHARACTERISTIC BCC_bAcvSwtDtc_P /end REF_CHARACTERISTIC /end GROUP
/begin GROUP S12_BitSelect10 "swc_BatChCtl/AC_10ms_sys/AC_10ms_sys/Diagnosis/BitSelect10" /begin REF_CHARACTERISTIC BCC_ValReplDig_P /end REF_CHARACTERISTIC /end GROUP
/begin GROUP S12_BitSelect11 "swc_BatChCtl/AC_10ms_sys/AC_10ms_sys/Diagnosis/BitSelect11" /begin REF_CHARACTERISTIC BCC_CswReplDig_P /end REF_CHARACTERISTIC /end GROUP
/begin GROUP S12_BitSelect12 "swc_BatChCtl/AC_10ms_sys/AC_10ms_sys/Diagnosis/BitSelect12" /begin REF_CHARACTERISTIC BCC_ValReplDig_P /end REF_CHARACTERISTIC /end GROUP
/begin GROUP S12_BitSelect13 "swc_BatChCtl/AC_10ms_sys/AC_10ms_sys/Diagnosis/BitSelect13" /begin REF_CHARACTERISTIC BCC_CswReplDig_P /end REF_CHARACTERISTIC /end GROUP
/begin GROUP S12_BitSelect14 "swc_BatChCtl/AC_10ms_sys/AC_10ms_sys/Diagnosis/BitSelect14" /begin REF_CHARACTERISTIC BCC_ValReplDig_P /end REF_CHARACTERISTIC /end GROUP
/begin GROUP S12_BitSelect15 "swc_BatChCtl/AC_10ms_sys/AC_10ms_sys/Diagnosis/BitSelect15" /begin REF_CHARACTERISTIC BCC_CswReplDig_P /end REF_CHARACTERISTIC /end GROUP
/begin GROUP S12_BitSelect16 "swc_BatChCtl/AC_10ms_sys/AC_10ms_sys/Diagnosis/BitSelect16" /begin REF_CHARACTERISTIC BCC_ValReplDig_P /end REF_CHARACTERISTIC /end GROUP
/begin GROUP S12_BitSelect17 "swc_BatChCtl/AC_10ms_sys/AC_10ms_sys/Diagnosis/BitSelect17" /begin REF_CHARACTERISTIC BCC_CswReplDig_P /end REF_CHARACTERISTIC /end GROUP
/begin GROUP S12_BitSelect18 "swc_BatChCtl/AC_10ms_sys/AC_10ms_sys/Diagnosis/BitSelect18" /begin REF_CHARACTERISTIC BCC_ValReplDig_P /end REF_CHARACTERISTIC /end GROUP
/begin GROUP S12_BitSelect2 "swc_BatChCtl/AC_10ms_sys/AC_10ms_sys/Diagnosis/BitSelect2" /begin REF_CHARACTERISTIC BCC_bAcvSwtDtc_P /end REF_CHARACTERISTIC /end GROUP
/begin GROUP S12_BitSelect22 "swc_BatChCtl/AC_10ms_sys/AC_10ms_sys/Diagnosis/BitSelect22" /begin REF_CHARACTERISTIC BCC_CswReplDig_P /end REF_CHARACTERISTIC /end GROUP
/begin GROUP S12_BitSelect23 "swc_BatChCtl/AC_10ms_sys/AC_10ms_sys/Diagnosis/BitSelect23" /begin REF_CHARACTERISTIC BCC_ValReplDig_P /end REF_CHARACTERISTIC /end GROUP
/begin GROUP S12_BitSelect3 "swc_BatChCtl/AC_10ms_sys/AC_10ms_sys/Diagnosis/BitSelect3" /begin REF_CHARACTERISTIC BCC_bAcvSwtDtc_P /end REF_CHARACTERISTIC /end GROUP
/begin GROUP S12_BitSelect4 "swc_BatChCtl/AC_10ms_sys/AC_10ms_sys/Diagnosis/BitSelect4" /begin REF_CHARACTERISTIC BCC_bAcvSwtDtc_P /end REF_CHARACTERISTIC /end GROUP
/begin GROUP S12_BitSelect5 "swc_BatChCtl/AC_10ms_sys/AC_10ms_sys/Diagnosis/BitSelect5" /begin REF_CHARACTERISTIC BCC_bAcvSwtDtc_P /end REF_CHARACTERISTIC /end GROUP
/begin GROUP S12_BitSelect6 "swc_BatChCtl/AC_10ms_sys/AC_10ms_sys/Diagnosis/BitSelect6" /begin REF_CHARACTERISTIC BCC_bAcvSwtDtc_P /end REF_CHARACTERISTIC /end GROUP
/begin GROUP S12_BitSelect7 "swc_BatChCtl/AC_10ms_sys/AC_10ms_sys/Diagnosis/BitSelect7" /begin REF_CHARACTERISTIC BCC_CswReplDig_P /end REF_CHARACTERISTIC /end GROUP
/begin GROUP S12_BitSelect8 "swc_BatChCtl/AC_10ms_sys/AC_10ms_sys/Diagnosis/BitSelect8" /begin REF_CHARACTERISTIC BCC_ValReplDig_P /end REF_CHARACTERISTIC /end GROUP
/begin GROUP S12_BitSelect9 "swc_BatChCtl/AC_10ms_sys/AC_10ms_sys/Diagnosis/BitSelect9" /begin REF_CHARACTERISTIC BCC_CswReplDig_P /end REF_CHARACTERISTIC /end GROUP
/begin GROUP S12_CompareToCalibrationPara "swc_BatChCtl/AC_10ms_sys/AC_10ms_sys/Diagnosis/CompareToCalibrationPara" /begin REF_CHARACTERISTIC BCC_IDig10_P /end REF_CHARACTERISTIC /end GROUP
/begin GROUP S12_CompareToCalibrationPara1 "swc_BatChCtl/AC_10ms_sys/AC_10ms_sys/Diagnosis/CompareToCalibrationPara1" /begin REF_CHARACTERISTIC BCC_TMaxDig10_P /end REF_CHARACTERISTIC /end GROUP
/begin GROUP S12_CompareToCalibrationPara10 "swc_BatChCtl/AC_10ms_sys/AC_10ms_sys/Diagnosis/CompareToCalibrationPara10" /begin REF_CHARACTERISTIC BCC_TAcChrgrSetDig71_P /end REF_CHARACTERISTIC /end GROUP
/begin GROUP S12_CompareToCalibrationPara11 "swc_BatChCtl/AC_10ms_sys/AC_10ms_sys/Diagnosis/CompareToCalibrationPara11" /begin REF_CHARACTERISTIC BCC_TAcChrgrSetDig71_P /end REF_CHARACTERISTIC /end GROUP
/begin GROUP S12_CompareToCalibrationPara12 "swc_BatChCtl/AC_10ms_sys/AC_10ms_sys/Diagnosis/CompareToCalibrationPara12" /begin REF_CHARACTERISTIC BCC_TAcChrgrRstDig71_P /end REF_CHARACTERISTIC /end GROUP
/begin GROUP S12_CompareToCalibrationPara13 "swc_BatChCtl/AC_10ms_sys/AC_10ms_sys/Diagnosis/CompareToCalibrationPara13" /begin REF_CHARACTERISTIC BCC_TAcChrgrRstDig53_P /end REF_CHARACTERISTIC /end GROUP
/begin GROUP S12_CompareToCalibrationPara2 "swc_BatChCtl/AC_10ms_sys/AC_10ms_sys/Diagnosis/CompareToCalibrationPara2" /begin REF_CHARACTERISTIC BCC_TMinDig10_P /end REF_CHARACTERISTIC /end GROUP
/begin GROUP S12_CompareToCalibrationPara3 "swc_BatChCtl/AC_10ms_sys/AC_10ms_sys/Diagnosis/CompareToCalibrationPara3" /begin REF_CHARACTERISTIC BCC_IDig10_P /end REF_CHARACTERISTIC /end GROUP
/begin GROUP S12_CompareToCalibrationPara4 "swc_BatChCtl/AC_10ms_sys/AC_10ms_sys/Diagnosis/CompareToCalibrationPara4" /begin REF_CHARACTERISTIC BCC_IDig10_P /end REF_CHARACTERISTIC /end GROUP
/begin GROUP S12_CompareToCalibrationPara5 "swc_BatChCtl/AC_10ms_sys/AC_10ms_sys/Diagnosis/CompareToCalibrationPara5" /begin REF_CHARACTERISTIC BCC_IDig10_P /end REF_CHARACTERISTIC /end GROUP
/begin GROUP S12_CompareToCalibrationPara6 "swc_BatChCtl/AC_10ms_sys/AC_10ms_sys/Diagnosis/CompareToCalibrationPara6" /begin REF_CHARACTERISTIC BCC_TAcChrgrSetDig53_P /end REF_CHARACTERISTIC /end GROUP
/begin GROUP S12_CompareToCalibrationPara7 "swc_BatChCtl/AC_10ms_sys/AC_10ms_sys/Diagnosis/CompareToCalibrationPara7" /begin REF_CHARACTERISTIC BCC_TAcChrgrSetDig53_P /end REF_CHARACTERISTIC /end GROUP
/begin GROUP S12_CompareToCalibrationPara8 "swc_BatChCtl/AC_10ms_sys/AC_10ms_sys/Diagnosis/CompareToCalibrationPara8" /begin REF_CHARACTERISTIC BCC_TAcChrgrRstDig53_P /end REF_CHARACTERISTIC /end GROUP
/begin GROUP S12_CompareToCalibrationPara9 "swc_BatChCtl/AC_10ms_sys/AC_10ms_sys/Diagnosis/CompareToCalibrationPara9" /begin REF_CHARACTERISTIC BCC_TAcChrgrRstDig53_P /end REF_CHARACTERISTIC /end GROUP
/begin GROUP S12_SMObc_TiProc_P "swc_BatChCtl/AC_10ms_sys/AC_10ms_sys/Diagnosis/SMObc_TiProc_P" /begin REF_CHARACTERISTIC SMObc_TiProc_P /end REF_CHARACTERISTIC /end GROUP
/begin GROUP S12_SMObc_TiProc_P1 "swc_BatChCtl/AC_10ms_sys/AC_10ms_sys/Diagnosis/SMObc_TiProc_P1" /begin REF_CHARACTERISTIC SMObc_TiProc_P /end REF_CHARACTERISTIC /end GROUP
/begin GROUP S12_SMObc_TiProc_P2 "swc_BatChCtl/AC_10ms_sys/AC_10ms_sys/Diagnosis/SMObc_TiProc_P2" /begin REF_CHARACTERISTIC SMObc_TiProc_P /end REF_CHARACTERISTIC /end GROUP
/begin GROUP S12_SMObc_TiProc_P3 "swc_BatChCtl/AC_10ms_sys/AC_10ms_sys/Diagnosis/SMObc_TiProc_P3" /begin REF_CHARACTERISTIC SMObc_TiProc_P /end REF_CHARACTERISTIC /end GROUP
/begin GROUP S12_SMObc_TiProc_P4 "swc_BatChCtl/AC_10ms_sys/AC_10ms_sys/Diagnosis/SMObc_TiProc_P4" /begin REF_CHARACTERISTIC SMObc_TiProc_P /end REF_CHARACTERISTIC /end GROUP
/begin GROUP S12_SMObc_TiProc_P5 "swc_BatChCtl/AC_10ms_sys/AC_10ms_sys/Diagnosis/SMObc_TiProc_P5" /begin REF_CHARACTERISTIC SMObc_TiProc_P /end REF_CHARACTERISTIC /end GROUP
/begin GROUP S12_SMObc_TiProc_P6 "swc_BatChCtl/AC_10ms_sys/AC_10ms_sys/Diagnosis/SMObc_TiProc_P6" /begin REF_CHARACTERISTIC SMObc_TiProc_P /end REF_CHARACTERISTIC /end GROUP
/begin GROUP S130_BCF_TsCtrCMdulObsr_P "swc_BatCoreFct/BCF_100ms_sys/BatCoreFct/PackObs/TriggerMdulCObsr/BCF_TsCtrCMdulObsr_P" /begin REF_CHARACTERISTIC BCF_TsCtrCMdulObsr_P /end REF_CHARACTERISTIC /end GROUP
/begin GROUP S132_BCF_RCellCnct_P "swc_BatCoreFct/BCF_100ms_sys/BatCoreFct/PackObs/PackObsLoop/Extract Mdul Data/BCF_RCellCnct_P" /begin REF_CHARACTERISTIC BCF_RCellCnct_P /end REF_CHARACTERISTIC /end GROUP
/begin GROUP S132_Current_Direction_Determination "swc_BatCoreFct/BCF_100ms_sys/BatCoreFct/PackObs/PackObsLoop/Extract Mdul Data/Current Direction Determination" /begin SUB_GROUP S170_BCF_DirIChgMgn_P S170_BCF_DirIChgThd_P /end SUB_GROUP /end GROUP
/begin GROUP S132_UCell_Measurement_Correction "swc_BatCoreFct/BCF_100ms_sys/BatCoreFct/PackObs/PackObsLoop/Extract Mdul Data/UCell Measurement Correction" /begin SUB_GROUP S173_BCF_bAcvCellUCorrn_P /end SUB_GROUP /end GROUP
/begin GROUP S133_CellObsr "swc_BatCoreFct/BCF_100ms_sys/BatCoreFct/PackObs/PackObsLoop/MdulObs/CellObsr"
 /begin SUB_GROUP S181_Balancing_Charge S181_Cell_Wear_Detection S181_MdulModelLin S181_Sensitivity_of_Estimation S181_Validation_of_Estimation /end SUB_GROUP
/end GROUP
/begin GROUP S133_DebounceStepSelect "swc_EltlLnkHzrdProtnNet/ELHPN_10ms_sys/ELHPN_10ms_sys/StateIsolation/StIsln/IsolationLevel/Debounce/DebounceStepSelect" /begin SUB_GROUP S139_ELHPN_StIslnDebShoPerd_P /end SUB_GROUP /end GROUP
/begin GROUP S133_DebounceStepSelect1 "swc_EltlLnkHzrdProtnNet/ELHPN_10ms_sys/ELHPN_10ms_sys/StateIsolation/StIsln/IsolationLevel/Debounce/DebounceStepSelect1" /begin SUB_GROUP S140_ELHPN_StIslnDebShoPerd_P /end SUB_GROUP /end GROUP
/begin GROUP S133_DebounceStepSelect2 "swc_EltlLnkHzrdProtnNet/ELHPN_10ms_sys/ELHPN_10ms_sys/StateIsolation/StIsln/IsolationLevel/Debounce/DebounceStepSelect2" /begin SUB_GROUP S141_ELHPN_StIslnDebShoPerd_P /end SUB_GROUP /end GROUP
/begin GROUP S133_DebounceStepSelect3 "swc_EltlLnkHzrdProtnNet/ELHPN_10ms_sys/ELHPN_10ms_sys/StateIsolation/StIsln/IsolationLevel/Debounce/DebounceStepSelect3" /begin SUB_GROUP S142_ELHPN_StIslnDebShoPerd_P /end SUB_GROUP /end GROUP
/begin GROUP S133_ELHPN_StIslnDebOff_P "swc_EltlLnkHzrdProtnNet/ELHPN_10ms_sys/ELHPN_10ms_sys/StateIsolation/StIsln/IsolationLevel/Debounce/ELHPN_StIslnDebOff_P" /begin REF_CHARACTERISTIC ELHPN_StIslnDebOff_P /end REF_CHARACTERISTIC /end GROUP
/begin GROUP S133_ELHPN_StIslnDebOff_P1 "swc_EltlLnkHzrdProtnNet/ELHPN_10ms_sys/ELHPN_10ms_sys/StateIsolation/StIsln/IsolationLevel/Debounce/ELHPN_StIslnDebOff_P1" /begin REF_CHARACTERISTIC ELHPN_StIslnDebOff_P /end REF_CHARACTERISTIC /end GROUP
/begin GROUP S133_ELHPN_StIslnDebOff_P2 "swc_EltlLnkHzrdProtnNet/ELHPN_10ms_sys/ELHPN_10ms_sys/StateIsolation/StIsln/IsolationLevel/Debounce/ELHPN_StIslnDebOff_P2" /begin REF_CHARACTERISTIC ELHPN_StIslnDebOff_P /end REF_CHARACTERISTIC /end GROUP
/begin GROUP S133_ELHPN_StIslnDebOff_P3 "swc_EltlLnkHzrdProtnNet/ELHPN_10ms_sys/ELHPN_10ms_sys/StateIsolation/StIsln/IsolationLevel/Debounce/ELHPN_StIslnDebOff_P3" /begin REF_CHARACTERISTIC ELHPN_StIslnDebOff_P /end REF_CHARACTERISTIC /end GROUP
/begin GROUP S133_ELHPN_StIslnDebOn_P "swc_EltlLnkHzrdProtnNet/ELHPN_10ms_sys/ELHPN_10ms_sys/StateIsolation/StIsln/IsolationLevel/Debounce/ELHPN_StIslnDebOn_P" /begin REF_CHARACTERISTIC ELHPN_StIslnDebOn_P /end REF_CHARACTERISTIC /end GROUP
/begin GROUP S133_ELHPN_StIslnDebOn_P1 "swc_EltlLnkHzrdProtnNet/ELHPN_10ms_sys/ELHPN_10ms_sys/StateIsolation/StIsln/IsolationLevel/Debounce/ELHPN_StIslnDebOn_P1" /begin REF_CHARACTERISTIC ELHPN_StIslnDebOn_P /end REF_CHARACTERISTIC /end GROUP
/begin GROUP S133_ELHPN_StIslnDebOn_P2 "swc_EltlLnkHzrdProtnNet/ELHPN_10ms_sys/ELHPN_10ms_sys/StateIsolation/StIsln/IsolationLevel/Debounce/ELHPN_StIslnDebOn_P2" /begin REF_CHARACTERISTIC ELHPN_StIslnDebOn_P /end REF_CHARACTERISTIC /end GROUP
/begin GROUP S133_ELHPN_StIslnDebOn_P3 "swc_EltlLnkHzrdProtnNet/ELHPN_10ms_sys/ELHPN_10ms_sys/StateIsolation/StIsln/IsolationLevel/Debounce/ELHPN_StIslnDebOn_P3" /begin REF_CHARACTERISTIC ELHPN_StIslnDebOn_P /end REF_CHARACTERISTIC /end GROUP
/begin GROUP S133_ELHPN_StIslnDebShoOff_P "swc_EltlLnkHzrdProtnNet/ELHPN_10ms_sys/ELHPN_10ms_sys/StateIsolation/StIsln/IsolationLevel/Debounce/ELHPN_StIslnDebShoOff_P" /begin REF_CHARACTERISTIC ELHPN_StIslnDebShoOff_P /end REF_CHARACTERISTIC /end GROUP
/begin GROUP S133_ELHPN_StIslnDebShoOff_P1 "swc_EltlLnkHzrdProtnNet/ELHPN_10ms_sys/ELHPN_10ms_sys/StateIsolation/StIsln/IsolationLevel/Debounce/ELHPN_StIslnDebShoOff_P1" /begin REF_CHARACTERISTIC ELHPN_StIslnDebShoOff_P /end REF_CHARACTERISTIC /end GROUP
/begin GROUP S133_ELHPN_StIslnDebShoOff_P2 "swc_EltlLnkHzrdProtnNet/ELHPN_10ms_sys/ELHPN_10ms_sys/StateIsolation/StIsln/IsolationLevel/Debounce/ELHPN_StIslnDebShoOff_P2" /begin REF_CHARACTERISTIC ELHPN_StIslnDebShoOff_P /end REF_CHARACTERISTIC /end GROUP
/begin GROUP S133_ELHPN_StIslnDebShoOff_P3 "swc_EltlLnkHzrdProtnNet/ELHPN_10ms_sys/ELHPN_10ms_sys/StateIsolation/StIsln/IsolationLevel/Debounce/ELHPN_StIslnDebShoOff_P3" /begin REF_CHARACTERISTIC ELHPN_StIslnDebShoOff_P /end REF_CHARACTERISTIC /end GROUP
/begin GROUP S133_ELHPN_StIslnDebShoOn_P1 "swc_EltlLnkHzrdProtnNet/ELHPN_10ms_sys/ELHPN_10ms_sys/StateIsolation/StIsln/IsolationLevel/Debounce/ELHPN_StIslnDebShoOn_P1" /begin REF_CHARACTERISTIC ELHPN_StIslnDebShoOn_P /end REF_CHARACTERISTIC /end GROUP
/begin GROUP S133_ELHPN_StIslnDebShoOn_P2 "swc_EltlLnkHzrdProtnNet/ELHPN_10ms_sys/ELHPN_10ms_sys/StateIsolation/StIsln/IsolationLevel/Debounce/ELHPN_StIslnDebShoOn_P2" /begin REF_CHARACTERISTIC ELHPN_StIslnDebShoOn_P /end REF_CHARACTERISTIC /end GROUP
/begin GROUP S133_ELHPN_StIslnDebShoOn_P3 "swc_EltlLnkHzrdProtnNet/ELHPN_10ms_sys/ELHPN_10ms_sys/StateIsolation/StIsln/IsolationLevel/Debounce/ELHPN_StIslnDebShoOn_P3" /begin REF_CHARACTERISTIC ELHPN_StIslnDebShoOn_P /end REF_CHARACTERISTIC /end GROUP
/begin GROUP S133_ELHPN_StIslnDebShoOn_P4 "swc_EltlLnkHzrdProtnNet/ELHPN_10ms_sys/ELHPN_10ms_sys/StateIsolation/StIsln/IsolationLevel/Debounce/ELHPN_StIslnDebShoOn_P4" /begin REF_CHARACTERISTIC ELHPN_StIslnDebShoOn_P /end REF_CHARACTERISTIC /end GROUP
/begin GROUP S133_ELHPN_TiSample1 "swc_EltlLnkHzrdProtnNet/ELHPN_10ms_sys/ELHPN_10ms_sys/StateIsolation/StIsln/IsolationLevel/Debounce/ELHPN_TiSample1" /begin REF_CHARACTERISTIC ELHPN_TiSample1 /end REF_CHARACTERISTIC /end GROUP
/begin GROUP S133_ELHPN_TiSample11 "swc_EltlLnkHzrdProtnNet/ELHPN_10ms_sys/ELHPN_10ms_sys/StateIsolation/StIsln/IsolationLevel/Debounce/ELHPN_TiSample11" /begin REF_CHARACTERISTIC ELHPN_TiSample1 /end REF_CHARACTERISTIC /end GROUP
/begin GROUP S133_ELHPN_TiSample12 "swc_EltlLnkHzrdProtnNet/ELHPN_10ms_sys/ELHPN_10ms_sys/StateIsolation/StIsln/IsolationLevel/Debounce/ELHPN_TiSample12" /begin REF_CHARACTERISTIC ELHPN_TiSample1 /end REF_CHARACTERISTIC /end GROUP
/begin GROUP S133_ELHPN_TiSample13 "swc_EltlLnkHzrdProtnNet/ELHPN_10ms_sys/ELHPN_10ms_sys/StateIsolation/StIsln/IsolationLevel/Debounce/ELHPN_TiSample13" /begin REF_CHARACTERISTIC ELHPN_TiSample1 /end REF_CHARACTERISTIC /end GROUP
/begin GROUP S133_Internal_Short_Circuit_Detection "swc_BatCoreFct/BCF_100ms_sys/BatCoreFct/PackObs/PackObsLoop/MdulObs/Internal Short Circuit Detection"
 /begin SUB_GROUP S182_BCF_Td_P S182_BCF_TDifForThrwy_P S182_BCF_TdOffDig1000_P S182_BCF_TdOnDig1000_P S182_BCF_TiDlyForThrwyT_P S182_BCF_TMaxForThrwy_P S182_BCF_TRateForThrwy_P S182_BCF_UDeThdForThrwy_P S182_BCF_UMinForThrwy_P S182_BitSelect3 /end SUB_GROUP
/end GROUP
/begin GROUP S133_MdulCObs "swc_BatCoreFct/BCF_100ms_sys/BatCoreFct/PackObs/PackObsLoop/MdulObs/MdulCObs"
 /begin SUB_GROUP S183_Calculate_Soc_Reference S183_CMdulAgiFac_Estimation_in_CTestMode S183_CMdulDeltaTrip_Evaluation S183_Sensitivity_Of_Estimation S183_Update_CMdulAgiFac /end SUB_GROUP
/end GROUP
/begin GROUP S133_MdulRObs "swc_BatCoreFct/BCF_100ms_sys/BatCoreFct/PackObs/PackObsLoop/MdulObs/MdulRObs"
 /begin SUB_GROUP S184_1st_order_low_pass_filter S184_RMdulDeltaTripSatn S184_Sensitivity_of_Estimation S184_UMdulOffSho_Diagnosis S184_Update_RMdulAgiFac /end SUB_GROUP
/end GROUP
/begin GROUP S133_MdulSocObsr "swc_BatCoreFct/BCF_100ms_sys/BatCoreFct/PackObs/PackObsLoop/MdulObs/MdulSocObsr"
 /begin SUB_GROUP S185_Evaluate_Estimate S185_MdulStateObs S185_MdulTObs S185_Temperature_Source_Switch /end SUB_GROUP
/end GROUP
/begin GROUP S139_ELHPN_StIslnDebShoPerd_P "swc_EltlLnkHzrdProtnNet/ELHPN_10ms_sys/ELHPN_10ms_sys/StateIsolation/StIsln/IsolationLevel/Debounce/DebounceStepSelect/ELHPN_StIslnDebShoPerd_P" /begin REF_CHARACTERISTIC ELHPN_StIslnDebShoPerd_P /end REF_CHARACTERISTIC /end GROUP
/begin GROUP S13_BBC_StBcu_M "swc_BatBalnCtl/BBC_100ms_sys/BBC_100ms_sys/BatBalnCtl_BalnIClcn/BBC_StBcu_M" /begin REF_CHARACTERISTIC BBC_StBcu_M /end REF_CHARACTERISTIC /end GROUP
/begin GROUP S13_Subsystem "swc_BatBalnCtl/BBC_100ms_sys/BBC_100ms_sys/BatBalnCtl_BalnIClcn/Subsystem" /begin SUB_GROUP S93_Balancing_Current_Calculation_Loop /end SUB_GROUP /end GROUP
/begin GROUP S140_ELHPN_StIslnDebShoPerd_P "swc_EltlLnkHzrdProtnNet/ELHPN_10ms_sys/ELHPN_10ms_sys/StateIsolation/StIsln/IsolationLevel/Debounce/DebounceStepSelect1/ELHPN_StIslnDebShoPerd_P" /begin REF_CHARACTERISTIC ELHPN_StIslnDebShoPerd_P /end REF_CHARACTERISTIC /end GROUP
/begin GROUP S141_ELHPN_StIslnDebShoPerd_P "swc_EltlLnkHzrdProtnNet/ELHPN_10ms_sys/ELHPN_10ms_sys/StateIsolation/StIsln/IsolationLevel/Debounce/DebounceStepSelect2/ELHPN_StIslnDebShoPerd_P" /begin REF_CHARACTERISTIC ELHPN_StIslnDebShoPerd_P /end REF_CHARACTERISTIC /end GROUP
/begin GROUP S142_ELHPN_StIslnDebShoPerd_P "swc_EltlLnkHzrdProtnNet/ELHPN_10ms_sys/ELHPN_10ms_sys/StateIsolation/StIsln/IsolationLevel/Debounce/DebounceStepSelect3/ELHPN_StIslnDebShoPerd_P" /begin REF_CHARACTERISTIC ELHPN_StIslnDebShoPerd_P /end REF_CHARACTERISTIC /end GROUP
/begin GROUP S1446_DEH_CMdulAgiFacThd_P "swc_DiagcEveHndlg/NVM_Write_100ms_sys/NVM Write/NVM store contions/Trigger_CMdulAgiFacFls/DEH_CMdulAgiFacThd_P" /begin REF_CHARACTERISTIC DEH_CMdulAgiFacThd_P /end REF_CHARACTERISTIC /end GROUP
/begin GROUP S1447_DEH_EBatChTotMemThd_P "swc_DiagcEveHndlg/NVM_Write_100ms_sys/NVM Write/NVM store contions/Trigger_EBatChTot/DEH_EBatChTotMemThd_P" /begin REF_CHARACTERISTIC DEH_EBatChTotMemThd_P /end REF_CHARACTERISTIC /end GROUP
/begin GROUP S1448_DEH_EBatDchaTotThd_P "swc_DiagcEveHndlg/NVM_Write_100ms_sys/NVM Write/NVM store contions/Trigger_EBatDchaTot/DEH_EBatDchaTotThd_P" /begin REF_CHARACTERISTIC DEH_EBatDchaTotThd_P /end REF_CHARACTERISTIC /end GROUP
/begin GROUP S1449_DEH_RMdulAgiFacThd_P "swc_DiagcEveHndlg/NVM_Write_100ms_sys/NVM Write/NVM store contions/Trigger_RMdulAgiFacFls/DEH_RMdulAgiFacThd_P" /begin REF_CHARACTERISTIC DEH_RMdulAgiFacThd_P /end REF_CHARACTERISTIC /end GROUP
/begin GROUP S1450_DEH_SocMdulThd_P "swc_DiagcEveHndlg/NVM_Write_100ms_sys/NVM Write/NVM store contions/Trigger_SOC/DEH_SocMdulThd_P" /begin REF_CHARACTERISTIC DEH_SocMdulThd_P /end REF_CHARACTERISTIC /end GROUP
/begin GROUP S1451_DEH_SohRDeltaThd_P "swc_DiagcEveHndlg/NVM_Write_100ms_sys/NVM Write/NVM store contions/Trigger_SohRDeltaFls/DEH_SohRDeltaThd_P" /begin REF_CHARACTERISTIC DEH_SohRDeltaThd_P /end REF_CHARACTERISTIC /end GROUP
/begin GROUP S1452_DEH_SohSocDeltaThd_P "swc_DiagcEveHndlg/NVM_Write_100ms_sys/NVM Write/NVM store contions/Trigger_SohSocDeltaFls/DEH_SohSocDeltaThd_P" /begin REF_CHARACTERISTIC DEH_SohSocDeltaThd_P /end REF_CHARACTERISTIC /end GROUP
/begin GROUP S152_CTC_CtrCtctrAgiRstVal_P "swc_CtctrTranCtl/CtcrtTranCtl_sys/CtcrtTranCtl/ContactorAgingObserver/WriteCtctrChDtrt/ResetCtctrChDtrt/CTC_CtrCtctrAgiRstVal_P" /begin REF_CHARACTERISTIC CTC_CtrCtctrAgiRstVal_P /end REF_CHARACTERISTIC /end GROUP
/begin GROUP S154_BatChTiEstimn "swc_BatChCtl/BCC_10ms_sys/BCC_10ms_sys/BatChTiEstimn"
 /begin SUB_GROUP S168_BatChTiEstimn S168_BCTE_TiBatChMaxByHour_P S168_BCTE_TiBatChMaxByMinu_P /end SUB_GROUP
/end GROUP
/begin GROUP S154_BatDchaTiEstimn "swc_BatChCtl/BCC_10ms_sys/BCC_10ms_sys/BatDchaTiEstimn" /begin SUB_GROUP S169_BCTE_FacFilDchaTiEstimn_P /end SUB_GROUP /end GROUP
/begin GROUP S154_ChargeCalculate "swc_BatChCtl/BCC_10ms_sys/BCC_10ms_sys/ChargeCalculate"
 /begin SUB_GROUP S170_BCC_FacPwrChLim1_P S170_BCC_FacPwrChLim2_P S170_BCC_IChReq_M S170_BCC_IDchaReq_M1 S170_BCC_IRlyCh_P S170_BCC_TBatForMapCh_M S170_BCC_TBatForMapDcha_M S170_BCC_TiBatFull_P S170_BCC_TiProc_P S170_BCC_UBatCellFull_P S170_BCC_UChReqOfs_P S170_CompareToCalibrationPara1 S170_CompareToCalibrationPara2 S170_CompareToCalibrationPara3 S170_CompareToCalibrationPara4 S170_CompareToCalibrationPara5 /end SUB_GROUP
/end GROUP
/begin GROUP S156_CTC_CtrCtctrAgiRstVal_P "swc_CtctrTranCtl/CtcrtTranCtl_sys/CtcrtTranCtl/ContactorAgingObserver/WriteCtctrNegDtrt/ResetCtctrNegDtrt/CTC_CtrCtctrAgiRstVal_P" /begin REF_CHARACTERISTIC CTC_CtrCtctrAgiRstVal_P /end REF_CHARACTERISTIC /end GROUP
/begin GROUP S160_CTC_CtrCtctrAgiRstVal_P "swc_CtctrTranCtl/CtcrtTranCtl_sys/CtcrtTranCtl/ContactorAgingObserver/WriteCtctrPosDtrt/ResetCtctrPosDtrt/CTC_CtrCtctrAgiRstVal_P" /begin REF_CHARACTERISTIC CTC_CtrCtctrAgiRstVal_P /end REF_CHARACTERISTIC /end GROUP
/begin GROUP S164_CTC_CtrCtctrAgiRstVal_P "swc_CtctrTranCtl/CtcrtTranCtl_sys/CtcrtTranCtl/ContactorAgingObserver/WriteCtctrPrecDtrt/ResetCtctrPrechDtrt/CTC_CtrCtctrAgiRstVal_P" /begin REF_CHARACTERISTIC CTC_CtrCtctrAgiRstVal_P /end REF_CHARACTERISTIC /end GROUP
/begin GROUP S168_BatChTiEstimn "swc_BatChCtl/BCC_10ms_sys/BCC_10ms_sys/BatChTiEstimn/BatChTiEstimn"
 /begin SUB_GROUP S173_remaining_charge_time_calculation S173_remaining_charge_time_prediction S173_SecToHourAndMinu S173_Transition_factor_AC_charging S173_Transition_factor_DC_charging /end SUB_GROUP
/end GROUP
/begin GROUP S168_BCTE_TiBatChMaxByHour_P "swc_BatChCtl/BCC_10ms_sys/BCC_10ms_sys/BatChTiEstimn/BCTE_TiBatChMaxByHour_P" /begin REF_CHARACTERISTIC BCTE_TiBatChMaxByHour_P /end REF_CHARACTERISTIC /end GROUP
/begin GROUP S168_BCTE_TiBatChMaxByMinu_P "swc_BatChCtl/BCC_10ms_sys/BCC_10ms_sys/BatChTiEstimn/BCTE_TiBatChMaxByMinu_P" /begin REF_CHARACTERISTIC BCTE_TiBatChMaxByMinu_P /end REF_CHARACTERISTIC /end GROUP
/begin GROUP S169_BCTE_FacFilDchaTiEstimn_P "swc_BatChCtl/BCC_10ms_sys/BCC_10ms_sys/BatDchaTiEstimn/BCTE_FacFilDchaTiEstimn_P" /begin REF_CHARACTERISTIC BCTE_FacFilDchaTiEstimn_P /end REF_CHARACTERISTIC /end GROUP
/begin GROUP S169_BitSelect "swc_BatProtnIU/CellUDiag/100ms/CellVoltageDiagnosis/UCellMaxDiagnosis/SelfCheck/BitSelect" /begin REF_CHARACTERISTIC BPIU_bAcvSwtDtc_P /end REF_CHARACTERISTIC /end GROUP
/begin GROUP S169_BPIU_TiChkOnDig63_P "swc_BatProtnIU/CellUDiag/100ms/CellVoltageDiagnosis/UCellMaxDiagnosis/SelfCheck/BPIU_TiChkOnDig63_P" /begin REF_CHARACTERISTIC BPIU_TiChkOnDig63_P /end REF_CHARACTERISTIC /end GROUP
/begin GROUP S169_BPIU_TiSample2_P3 "swc_BatProtnIU/CellUDiag/100ms/CellVoltageDiagnosis/UCellMaxDiagnosis/SelfCheck/BPIU_TiSample2_P3" /begin REF_CHARACTERISTIC BPIU_TiSample2_P /end REF_CHARACTERISTIC /end GROUP
/begin GROUP S16_CellVoltageLimitCore "swc_BatProtnIU/CellUDiag/100ms/CellVoltageDiagnosis/CellVoltageLimitCore"
 /begin SUB_GROUP S23_BitSelect S23_BitSelect1 S23_BitSelect2 S23_BitSelect3 S23_BPIU_TiOffDig174_P S23_BPIU_TiOffDig4_P S23_BPIU_TiOffDig63_P S23_BPIU_TiOffDig89_P S23_BPIU_TiOnDig174_P S23_BPIU_TiOnDig4_P S23_BPIU_TiOnDig63_P S23_BPIU_TiOnDig89_P S23_BPIU_TiSample2_P1 S23_BPIU_TiSample2_P2 S23_BPIU_TiSample2_P3 S23_BPIU_TiSample2_P4 S23_BPIU_UCellOverMin1_P S23_BPIU_UCellOverMin2_P S23_BPIU_UCellWarnMin2_P S23_BPIU_UCellWarnMin3_P S23_BPIU_UCellWarnMin_P S23_BPIU_UCellWarnMinOff2_P S23_BPIU_UCellWarnMinOff_P S23_BPIU_UCellWarnTBlwLoMin2_P S23_BPIU_UCellWarnTBlwLoMin3_P S23_BPIU_UCellWarnTBlwLoMin_P S23_BPIU_UCellWarnTBlwLoMinOff2_P S23_BPIU_UCellWarnTBlwLoMinOff_P S23_BPIU_UCellWarnTLoMin2_P S23_BPIU_UCellWarnTLoMin3_P S23_BPIU_UCellWarnTLoMin_P S23_BPIU_UCellWarnTLoMinOff2_P S23_BPIU_UCellWarnTLoMinOff_P S23_SelfCheck S23_Subsystem /end SUB_GROUP
/end GROUP
/begin GROUP S16_CellVoltageOutOfRange "swc_BatProtnIU/CellUDiag/100ms/CellVoltageDiagnosis/CellVoltageOutOfRange"
 /begin SUB_GROUP S25_BitSelect S25_BPIU_TiOffDig247_P S25_BPIU_TiOnDig247_P S25_BPIU_TiSample2_P S25_BPIU_UCellMaxLim_P /end SUB_GROUP
/end GROUP
/begin GROUP S16_ModulelVoltageOutOfRange "swc_BatProtnIU/CellUDiag/100ms/CellVoltageDiagnosis/ModulelVoltageOutOfRange"
 /begin SUB_GROUP S26_BitSelect S26_BPIU_TiOffDig248_P S26_BPIU_TiOnDig248_P S26_BPIU_TiSample2_P S26_BPIU_UMdulMax_P S26_BPIU_UMdulMin_P /end SUB_GROUP
/end GROUP
/begin GROUP S16_UCellCollectionDiagnosis "swc_BatProtnIU/CellUDiag/100ms/CellVoltageDiagnosis/UCellCollectionDiagnosis"
 /begin SUB_GROUP S27_BitSelect S27_BPIU_TiOffDig115_P S27_BPIU_TiOnDig115_P S27_BPIU_TiSample2_P /end SUB_GROUP
/end GROUP
/begin GROUP S16_UCellDiffDiag "swc_BatProtnIU/CellUDiag/100ms/CellVoltageDiagnosis/UCellDiffDiag"
 /begin SUB_GROUP S28_BitSelect1 S28_BPIU_TiOffDig189_P S28_BPIU_TiOnDig189_P S28_BPIU_TiSample2_P1 S28_BPIU_UCellDifMax_P1 S28_BPIU_UCellDifMin_P /end SUB_GROUP
/end GROUP
/begin GROUP S16_UCellMaxDiagnosis "swc_BatProtnIU/CellUDiag/100ms/CellVoltageDiagnosis/UCellMaxDiagnosis"
 /begin SUB_GROUP S29_BitSelect S29_BitSelect1 S29_BitSelect2 S29_BitSelect3 S29_BPIU_TiOffDig173_P S29_BPIU_TiOffDig3_P S29_BPIU_TiOffDig62_P S29_BPIU_TiOffDig88_P S29_BPIU_TiOnDig173_P S29_BPIU_TiOnDig3_P S29_BPIU_TiOnDig62_P S29_BPIU_TiOnDig88_P S29_BPIU_TiSample2_P S29_BPIU_TiSample2_P1 S29_BPIU_TiSample2_P2 S29_BPIU_TiSample2_P3 S29_BPIU_UCellMaxLim1_P S29_BPIU_UCellMaxLim2_P S29_BPIU_UCellMaxLim3_P S29_BPIU_UCellMaxOff_P S29_BPIU_UCellMaxOff_P1 S29_BPIU_UCellOverMax2_P S29_BPIU_UCellOverMax_P S29_SelfCheck /end SUB_GROUP
/end GROUP
/begin GROUP S16_UCellRateDiagnosis "swc_BatProtnIU/CellUDiag/100ms/CellVoltageDiagnosis/UCellRateDiagnosis"
 /begin SUB_GROUP S30_BitSelect S30_BPIU_TiOffDig56_P S30_BPIU_TiOnDig56_P S30_BPIU_TiSample2_P1 S30_BPIU_UCellRateMaxLim_P S30_BPIU_UCellRateOff_P /end SUB_GROUP
/end GROUP
/begin GROUP S170_BCC_FacPwrChLim1_P "swc_BatChCtl/BCC_10ms_sys/BCC_10ms_sys/ChargeCalculate/BCC_FacPwrChLim1_P" /begin REF_CHARACTERISTIC BCC_FacPwrChLim1_P /end REF_CHARACTERISTIC /end GROUP
/begin GROUP S170_BCC_FacPwrChLim2_P "swc_BatChCtl/BCC_10ms_sys/BCC_10ms_sys/ChargeCalculate/BCC_FacPwrChLim2_P" /begin REF_CHARACTERISTIC BCC_FacPwrChLim2_P /end REF_CHARACTERISTIC /end GROUP
/begin GROUP S170_BCC_IChReq_M "swc_BatChCtl/BCC_10ms_sys/BCC_10ms_sys/ChargeCalculate/BCC_IChReq_M" /begin REF_CHARACTERISTIC BCC_IChReq_M /end REF_CHARACTERISTIC /end GROUP
/begin GROUP S170_BCC_IDchaReq_M1 "swc_BatChCtl/BCC_10ms_sys/BCC_10ms_sys/ChargeCalculate/BCC_IDchaReq_M1" /begin REF_CHARACTERISTIC BCC_IDchaReq_M /end REF_CHARACTERISTIC /end GROUP
/begin GROUP S170_BCC_IRlyCh_P "swc_BatChCtl/BCC_10ms_sys/BCC_10ms_sys/ChargeCalculate/BCC_IRlyCh_P" /begin REF_CHARACTERISTIC BCC_IRlyCh_P /end REF_CHARACTERISTIC /end GROUP
/begin GROUP S170_BCC_TBatForMapCh_M "swc_BatChCtl/BCC_10ms_sys/BCC_10ms_sys/ChargeCalculate/BCC_TBatForMapCh_M" /begin REF_CHARACTERISTIC BCC_TBatForMapCh_M /end REF_CHARACTERISTIC /end GROUP
/begin GROUP S170_BCC_TBatForMapDcha_M "swc_BatChCtl/BCC_10ms_sys/BCC_10ms_sys/ChargeCalculate/BCC_TBatForMapDcha_M" /begin REF_CHARACTERISTIC BCC_TBatForMapDcha_M /end REF_CHARACTERISTIC /end GROUP
/begin GROUP S170_BCC_TiBatFull_P "swc_BatChCtl/BCC_10ms_sys/BCC_10ms_sys/ChargeCalculate/BCC_TiBatFull_P" /begin REF_CHARACTERISTIC BCC_TiBatFull_P /end REF_CHARACTERISTIC /end GROUP
/begin GROUP S170_BCC_TiProc_P "swc_BatChCtl/BCC_10ms_sys/BCC_10ms_sys/ChargeCalculate/BCC_TiProc_P" /begin REF_CHARACTERISTIC BCC_TiProc_P /end REF_CHARACTERISTIC /end GROUP
/begin GROUP S170_BCC_UBatCellFull_P "swc_BatChCtl/BCC_10ms_sys/BCC_10ms_sys/ChargeCalculate/BCC_UBatCellFull_P" /begin REF_CHARACTERISTIC BCC_UBatCellFull_P /end REF_CHARACTERISTIC /end GROUP
/begin GROUP S170_BCC_UChReqOfs_P "swc_BatChCtl/BCC_10ms_sys/BCC_10ms_sys/ChargeCalculate/BCC_UChReqOfs_P" /begin REF_CHARACTERISTIC BCC_UChReqOfs_P /end REF_CHARACTERISTIC /end GROUP
/begin GROUP S170_BCF_DirIChgMgn_P "swc_BatCoreFct/BCF_100ms_sys/BatCoreFct/PackObs/PackObsLoop/Extract Mdul Data/Current Direction Determination/BCF_DirIChgMgn_P" /begin REF_CHARACTERISTIC BCF_DirIChgMgn_P /end REF_CHARACTERISTIC /end GROUP
/begin GROUP S170_BCF_DirIChgThd_P "swc_BatCoreFct/BCF_100ms_sys/BatCoreFct/PackObs/PackObsLoop/Extract Mdul Data/Current Direction Determination/BCF_DirIChgThd_P" /begin REF_CHARACTERISTIC BCF_DirIChgThd_P /end REF_CHARACTERISTIC /end GROUP
/begin GROUP S170_CompareToCalibrationPara1 "swc_BatChCtl/BCC_10ms_sys/BCC_10ms_sys/ChargeCalculate/CompareToCalibrationPara1" /begin REF_CHARACTERISTIC BCC_SocBatFull_P /end REF_CHARACTERISTIC /end GROUP
/begin GROUP S170_CompareToCalibrationPara2 "swc_BatChCtl/BCC_10ms_sys/BCC_10ms_sys/ChargeCalculate/CompareToCalibrationPara2" /begin REF_CHARACTERISTIC BCC_UBatCellFull_P /end REF_CHARACTERISTIC /end GROUP
/begin GROUP S170_CompareToCalibrationPara3 "swc_BatChCtl/BCC_10ms_sys/BCC_10ms_sys/ChargeCalculate/CompareToCalibrationPara3" /begin REF_CHARACTERISTIC BCC_IBatFull_P /end REF_CHARACTERISTIC /end GROUP
/begin GROUP S170_CompareToCalibrationPara4 "swc_BatChCtl/BCC_10ms_sys/BCC_10ms_sys/ChargeCalculate/CompareToCalibrationPara4" /begin REF_CHARACTERISTIC BCC_TCswDchaForMap_P /end REF_CHARACTERISTIC /end GROUP
/begin GROUP S170_CompareToCalibrationPara5 "swc_BatChCtl/BCC_10ms_sys/BCC_10ms_sys/ChargeCalculate/CompareToCalibrationPara5" /begin REF_CHARACTERISTIC BCC_TCswChForMap_P /end REF_CHARACTERISTIC /end GROUP
/begin GROUP S173_BCF_bAcvCellUCorrn_P "swc_BatCoreFct/BCF_100ms_sys/BatCoreFct/PackObs/PackObsLoop/Extract Mdul Data/UCell Measurement Correction/BCF_bAcvCellUCorrn_P" /begin REF_CHARACTERISTIC BCF_bAcvCellUCorrn_P /end REF_CHARACTERISTIC /end GROUP
/begin GROUP S173_remaining_charge_time_calculation "swc_BatChCtl/BCC_10ms_sys/BCC_10ms_sys/BatChTiEstimn/BatChTiEstimn/remaining_charge_time_calculation"
 /begin SUB_GROUP S182_BCTE_CtrIFlucForStaby_P S182_BCTE_FacTiClcdFromSoh_M S182_BCTE_IChRat_P S182_BCTE_SocChFnshd_P1 S182_BCTE_SocDeltaForChTiEstimn_P S182_ConterCalculate S182_Filter S182_For_Iterator_Subsystem /end SUB_GROUP
/end GROUP
/begin GROUP S173_remaining_charge_time_prediction "swc_BatChCtl/BCC_10ms_sys/BCC_10ms_sys/BatChTiEstimn/BatChTiEstimn/remaining_charge_time_prediction"
 /begin SUB_GROUP S183_AC_charging S183_BCTE_FacFil1ChTiEstimn_P S183_BCTE_FacTiPredFromSoh_M S183_BCTE_ICpbyOfChrgrAcMax_P S183_BCTE_ICpbyOfChrgrDcMax_P S183_BCTE_SocChFnshd_P1 S183_BCTE_TiBatChMax_P S183_DC_charging /end SUB_GROUP
/end GROUP
/begin GROUP S173_SecToHourAndMinu "swc_BatChCtl/BCC_10ms_sys/BCC_10ms_sys/BatChTiEstimn/BatChTiEstimn/SecToHourAndMinu"
 /begin SUB_GROUP S178_BCTE_bAcvChTiEstimn_P1 S178_BCTE_ChTiRmngSrc_P S178_BCTE_ChTiRmngSrc_P1 S178_BCTE_SocChFnshd_P1 S178_BCTE_TiBatChConByHour_P S178_BCTE_TiBatChConByMinu_P S178_Filter /end SUB_GROUP
/end GROUP
/begin GROUP S173_Transition_factor_AC_charging "swc_BatChCtl/BCC_10ms_sys/BCC_10ms_sys/BatChTiEstimn/BatChTiEstimn/Transition_factor_AC_charging" /begin SUB_GROUP S179_BCTE_FacTranForAcPrednClcn_M /end SUB_GROUP /end GROUP
/begin GROUP S173_Transition_factor_DC_charging "swc_BatChCtl/BCC_10ms_sys/BCC_10ms_sys/BatChTiEstimn/BatChTiEstimn/Transition_factor_DC_charging" /begin SUB_GROUP S180_BCTE_FacTranForDcPrednClcn_M /end SUB_GROUP /end GROUP
/begin GROUP S178_BCTE_bAcvChTiEstimn_P1 "swc_BatChCtl/BCC_10ms_sys/BCC_10ms_sys/BatChTiEstimn/BatChTiEstimn/SecToHourAndMinu/BCTE_bAcvChTiEstimn_P1" /begin REF_CHARACTERISTIC BCTE_bAcvChTiEstimn_P /end REF_CHARACTERISTIC /end GROUP
/begin GROUP S178_BCTE_ChTiRmngSrc_P "swc_BatChCtl/BCC_10ms_sys/BCC_10ms_sys/BatChTiEstimn/BatChTiEstimn/SecToHourAndMinu/BCTE_ChTiRmngSrc_P" /begin REF_CHARACTERISTIC BCTE_ChTiRmngSrc_P /end REF_CHARACTERISTIC /end GROUP
/begin GROUP S178_BCTE_ChTiRmngSrc_P1 "swc_BatChCtl/BCC_10ms_sys/BCC_10ms_sys/BatChTiEstimn/BatChTiEstimn/SecToHourAndMinu/BCTE_ChTiRmngSrc_P1" /begin REF_CHARACTERISTIC BCTE_ChTiRmngSrc_P /end REF_CHARACTERISTIC /end GROUP
/begin GROUP S178_BCTE_SocChFnshd_P1 "swc_BatChCtl/BCC_10ms_sys/BCC_10ms_sys/BatChTiEstimn/BatChTiEstimn/SecToHourAndMinu/BCTE_SocChFnshd_P1" /begin REF_CHARACTERISTIC BCTE_SocChFnshd_P /end REF_CHARACTERISTIC /end GROUP
/begin GROUP S178_BCTE_TiBatChConByHour_P "swc_BatChCtl/BCC_10ms_sys/BCC_10ms_sys/BatChTiEstimn/BatChTiEstimn/SecToHourAndMinu/BCTE_TiBatChConByHour_P" /begin REF_CHARACTERISTIC BCTE_TiBatChConByHour_P /end REF_CHARACTERISTIC /end GROUP
/begin GROUP S178_BCTE_TiBatChConByMinu_P "swc_BatChCtl/BCC_10ms_sys/BCC_10ms_sys/BatChTiEstimn/BatChTiEstimn/SecToHourAndMinu/BCTE_TiBatChConByMinu_P" /begin REF_CHARACTERISTIC BCTE_TiBatChConByMinu_P /end REF_CHARACTERISTIC /end GROUP
/begin GROUP S178_Filter "swc_BatChCtl/BCC_10ms_sys/BCC_10ms_sys/BatChTiEstimn/BatChTiEstimn/SecToHourAndMinu/Filter" /begin SUB_GROUP S190_BCTE_FacFil3ChTiEstimn_P S190_BCTE_TiBatChMax_P1 /end SUB_GROUP /end GROUP
/begin GROUP S179_BCTE_FacTranForAcPrednClcn_M "swc_BatChCtl/BCC_10ms_sys/BCC_10ms_sys/BatChTiEstimn/BatChTiEstimn/Transition_factor_AC_charging/BCTE_FacTranForAcPrednClcn_M" /begin REF_CHARACTERISTIC BCTE_FacTranForAcPrednClcn_M /end REF_CHARACTERISTIC /end GROUP
/begin GROUP S17_BatBalnCtl "swc_BatBalnCtl/BBC_100ms_sys/BBC_100ms_sys/BatBalnCtl/Battery Balancing Decision/BatBalnCtl"
 /begin SUB_GROUP S37_BBC_bAcvSocRefForBalnSeln_P S37_BBC_EnaTestBaln_P S37_BBC_ErrLvlMaxAllwd_P S37_BBC_IPackBalnMax_P S37_BBC_NrCellDchaInMdulAllwd_M S37_BBC_NrMdulTest_P S37_BBC_SocCellLowrLim_P S37_BBC_SocCellUpprLim_P S37_BBC_SocCellVldTiDlyDelta_P S37_BBC_SofFac_P S37_BBC_TBalnRAvgHys_P S37_BBC_TBalnRAvgUpprLim_P S37_BBC_TBalnRPasHys_P S37_BBC_TBalnRPasUpprLim_P S37_BBC_TiCellBalnAcvMax_P S37_BBC_TiCellBalnOffMin_P S37_BBC_TiMdulBalnOff_P S37_BBC_TiMdulBalnPerd_P S37_BBC_TMdulBalnHiLim_P S37_BBC_TMdulBalnLoLim_P S37_BBC_TMdulCtlrLim_P S37_BBC_UCellBalnHiLim_P S37_BBC_UCellBalnLoLim_P S37_Determine_Balancing_Thresholds /end SUB_GROUP
 /begin REF_MEASUREMENT BBC_DucycMdulBalnOffNotOk BBC_TBalnRAvgOvrheatd BBC_TMdulCtlrNotOk BBC_TMdulNotOk BBC_bAcvBalnOn /end REF_MEASUREMENT
/end GROUP
/begin GROUP S17_BBC_ChtBalnPas_P "swc_BatBalnCtl/BBC_100ms_sys/BBC_100ms_sys/BatBalnCtl/Battery Balancing Decision/BBC_ChtBalnPas_P" /begin REF_CHARACTERISTIC BBC_ChtBalnPas_P /end REF_CHARACTERISTIC /end GROUP
/begin GROUP S17_BBC_EnaTestBaln_P "swc_BatBalnCtl/BBC_100ms_sys/BBC_100ms_sys/BatBalnCtl/Battery Balancing Decision/BBC_EnaTestBaln_P" /begin REF_CHARACTERISTIC BBC_EnaTestBaln_P /end REF_CHARACTERISTIC /end GROUP
/begin GROUP S17_BBC_EnaTestBaln_P1 "swc_BatBalnCtl/BBC_100ms_sys/BBC_100ms_sys/BatBalnCtl/Battery Balancing Decision/BBC_EnaTestBaln_P1" /begin REF_CHARACTERISTIC BBC_EnaTestBaln_P /end REF_CHARACTERISTIC /end GROUP
/begin GROUP S17_BBC_HtcEfc_P "swc_BatBalnCtl/BBC_100ms_sys/BBC_100ms_sys/BatBalnCtl/Battery Balancing Decision/BBC_HtcEfc_P" /begin REF_CHARACTERISTIC BBC_HtcEfc_P /end REF_CHARACTERISTIC /end GROUP
/begin GROUP S17_BBC_NrMdulTest_P "swc_BatBalnCtl/BBC_100ms_sys/BBC_100ms_sys/BatBalnCtl/Battery Balancing Decision/BBC_NrMdulTest_P" /begin REF_CHARACTERISTIC BBC_NrMdulTest_P /end REF_CHARACTERISTIC /end GROUP
/begin GROUP S17_BBC_NrMdulTest_P1 "swc_BatBalnCtl/BBC_100ms_sys/BBC_100ms_sys/BatBalnCtl/Battery Balancing Decision/BBC_NrMdulTest_P1" /begin REF_CHARACTERISTIC BBC_NrMdulTest_P /end REF_CHARACTERISTIC /end GROUP
/begin GROUP S17_BBC_RCellBaln_P "swc_BatBalnCtl/BBC_100ms_sys/BBC_100ms_sys/BatBalnCtl/Battery Balancing Decision/BBC_RCellBaln_P" /begin REF_CHARACTERISTIC BBC_RCellBaln_P /end REF_CHARACTERISTIC /end GROUP
/begin GROUP S17_BBC_TiDly_P "swc_BatBalnCtl/BBC_100ms_sys/BBC_100ms_sys/BatBalnCtl/Battery Balancing Decision/BBC_TiDly_P" /begin REF_CHARACTERISTIC BBC_TiDly_P /end REF_CHARACTERISTIC /end GROUP
/begin GROUP S17_BitSelect "swc_BatProtnIU/CellUDiag/100ms/HighVoltageDiagnosis/BitSelect" /begin REF_CHARACTERISTIC BPIU_bAcvSwtDtc_P /end REF_CHARACTERISTIC /end GROUP
/begin GROUP S17_BitSelect1 "swc_BatProtnPack/PackSocAndSohDiag/1000ms/CellTemperatureDiagnosis/CellTemperatureMaxLimitCore/BitSelect1" /end GROUP
/begin GROUP S17_BitSelect2 "swc_BatProtnPack/PackSocAndSohDiag/1000ms/CellTemperatureDiagnosis/CellTemperatureMaxLimitCore/BitSelect2" /end GROUP
/begin GROUP S17_BPIU_TiOffDig81_P "swc_BatProtnIU/CellUDiag/100ms/HighVoltageDiagnosis/BPIU_TiOffDig81_P" /begin REF_CHARACTERISTIC BPIU_TiOffDig81_P /end REF_CHARACTERISTIC /end GROUP
/begin GROUP S17_BPIU_TiOnDig81_P "swc_BatProtnIU/CellUDiag/100ms/HighVoltageDiagnosis/BPIU_TiOnDig81_P" /begin REF_CHARACTERISTIC BPIU_TiOnDig81_P /end REF_CHARACTERISTIC /end GROUP
/begin GROUP S17_BPIU_TiSample2_P1 "swc_BatProtnIU/CellUDiag/100ms/HighVoltageDiagnosis/BPIU_TiSample2_P1" /begin REF_CHARACTERISTIC BPIU_TiSample2_P /end REF_CHARACTERISTIC /end GROUP
/begin GROUP S17_BPIU_UAcqnDeMax_P "swc_BatProtnIU/CellUDiag/100ms/HighVoltageDiagnosis/BPIU_UAcqnDeMax_P" /begin REF_CHARACTERISTIC BPIU_UAcqnDeMax_P /end REF_CHARACTERISTIC /end GROUP
/begin GROUP S17_BPIU_UCellMinLim_P "swc_BatProtnIU/CellUDiag/100ms/HighVoltageDiagnosis/BPIU_UCellMinLim_P" /begin REF_CHARACTERISTIC BPIU_UCellMinLim_P /end REF_CHARACTERISTIC /end GROUP
/begin GROUP S17_BPP_TCellWarnMax2_P "swc_BatProtnPack/PackSocAndSohDiag/1000ms/CellTemperatureDiagnosis/CellTemperatureMaxLimitCore/BPP_TCellWarnMax2_P" /end GROUP
/begin GROUP S17_BPP_TCellWarnMax3_P "swc_BatProtnPack/PackSocAndSohDiag/1000ms/CellTemperatureDiagnosis/CellTemperatureMaxLimitCore/BPP_TCellWarnMax3_P" /end GROUP
/begin GROUP S17_BPP_TCellWarnMax_P "swc_BatProtnPack/PackSocAndSohDiag/1000ms/CellTemperatureDiagnosis/CellTemperatureMaxLimitCore/BPP_TCellWarnMax_P" /end GROUP
/begin GROUP S17_BPP_TCellWarnMaxOff2_P "swc_BatProtnPack/PackSocAndSohDiag/1000ms/CellTemperatureDiagnosis/CellTemperatureMaxLimitCore/BPP_TCellWarnMaxOff2_P" /end GROUP
/begin GROUP S17_BPP_TCellWarnMaxOff3_P "swc_BatProtnPack/PackSocAndSohDiag/1000ms/CellTemperatureDiagnosis/CellTemperatureMaxLimitCore/BPP_TCellWarnMaxOff3_P" /end GROUP
/begin GROUP S17_BPP_TCellWarnMaxOff_P "swc_BatProtnPack/PackSocAndSohDiag/1000ms/CellTemperatureDiagnosis/CellTemperatureMaxLimitCore/BPP_TCellWarnMaxOff_P" /end GROUP
/begin GROUP S17_BPP_TiOffDig176_P "swc_BatProtnPack/PackSocAndSohDiag/1000ms/CellTemperatureDiagnosis/CellTemperatureMaxLimitCore/BPP_TiOffDig176_P" /end GROUP
/begin GROUP S17_BPP_TiOffDig6_P "swc_BatProtnPack/PackSocAndSohDiag/1000ms/CellTemperatureDiagnosis/CellTemperatureMaxLimitCore/BPP_TiOffDig6_P" /end GROUP
/begin GROUP S17_BPP_TiOffDig91_P "swc_BatProtnPack/PackSocAndSohDiag/1000ms/CellTemperatureDiagnosis/CellTemperatureMaxLimitCore/BPP_TiOffDig91_P" /end GROUP
/begin GROUP S17_BPP_TiOnDig176_P "swc_BatProtnPack/PackSocAndSohDiag/1000ms/CellTemperatureDiagnosis/CellTemperatureMaxLimitCore/BPP_TiOnDig176_P" /end GROUP
/begin GROUP S17_BPP_TiOnDig6_P "swc_BatProtnPack/PackSocAndSohDiag/1000ms/CellTemperatureDiagnosis/CellTemperatureMaxLimitCore/BPP_TiOnDig6_P" /end GROUP
/begin GROUP S17_BPP_TiOnDig91_P "swc_BatProtnPack/PackSocAndSohDiag/1000ms/CellTemperatureDiagnosis/CellTemperatureMaxLimitCore/BPP_TiOnDig91_P" /end GROUP
/begin GROUP S17_BPP_TiSample2_P "swc_BatProtnPack/PackSocAndSohDiag/1000ms/CellTemperatureDiagnosis/CellTemperatureMaxLimitCore/BPP_TiSample2_P" /end GROUP
/begin GROUP S17_BPP_TiSample2_P1 "swc_BatProtnPack/PackSocAndSohDiag/1000ms/CellTemperatureDiagnosis/CellTemperatureMaxLimitCore/BPP_TiSample2_P1" /end GROUP
/begin GROUP S17_BPP_TiSample2_P2 "swc_BatProtnPack/PackSocAndSohDiag/1000ms/CellTemperatureDiagnosis/CellTemperatureMaxLimitCore/BPP_TiSample2_P2" /end GROUP
/begin GROUP S17_BPP_TMdulSnsrSeln_P1 "swc_BatProtnPack/PackSocAndSohDiag/1000ms/CellTemperatureDiagnosis/CellTemperatureMaxLimitCore/BPP_TMdulSnsrSeln_P1" /end GROUP
/begin GROUP S17_ManualSwitch "swc_BatBalnCtl/BBC_100ms_sys/BBC_100ms_sys/BatBalnCtl/Battery Balancing Decision/ManualSwitch"
 /begin SUB_GROUP S40_BBC_AcvCellTestSrc_P S40_BBC_AcvCellTestTgt_P S40_BBC_CtrBalnTestMan_P S40_BBC_EnaCellAcvBalnManSrc_P S40_BBC_EnaCellAcvBalnManTgt_P S40_BBC_EnaCellBalnMan_P S40_BBC_EnaMdulNrBalnManSrc_P S40_BBC_EnaMdulNrBalnManTgt_P S40_BBC_NrMdulTestSrc_P S40_BBC_NrMdulTestTgt_P /end SUB_GROUP
/end GROUP
/begin GROUP S180_BCTE_FacTranForDcPrednClcn_M "swc_BatChCtl/BCC_10ms_sys/BCC_10ms_sys/BatChTiEstimn/BatChTiEstimn/Transition_factor_DC_charging/BCTE_FacTranForDcPrednClcn_M" /begin REF_CHARACTERISTIC BCTE_FacTranForDcPrednClcn_M /end REF_CHARACTERISTIC /end GROUP
/begin GROUP S181_Balancing_Charge "swc_BatCoreFct/BCF_100ms_sys/BatCoreFct/PackObs/PackObsLoop/MdulObs/CellObsr/Balancing Charge"
 /begin SUB_GROUP S188_BCF_bAcvTEstimnForSoc_P S188_BCF_CCellNom_M S188_BCF_Td_P /end SUB_GROUP
/end GROUP
/begin GROUP S181_Cell_Wear_Detection "swc_BatCoreFct/BCF_100ms_sys/BatCoreFct/PackObs/PackObsLoop/MdulObs/CellObsr/Cell Wear Detection"
 /begin SUB_GROUP S190_R_Cell_Delta_Wear_Detection S190_Soc_Cell_Delta_Wear_Detection /end SUB_GROUP
/end GROUP
/begin GROUP S181_MdulModelLin "swc_BatCoreFct/BCF_100ms_sys/BatCoreFct/PackObs/PackObsLoop/MdulObs/CellObsr/MdulModelLin"
 /begin SUB_GROUP S192_BCF_SocLnrznDelta_P S192_BCF_UChOc_M S192_BCF_UDchaOc_M /end SUB_GROUP
/end GROUP
/begin GROUP S181_Sensitivity_of_Estimation "swc_BatCoreFct/BCF_100ms_sys/BatCoreFct/PackObs/PackObsLoop/MdulObs/CellObsr/Sensitivity of Estimation"
 /begin SUB_GROUP S194_BCF_FacRCellDelta_P S194_BCF_RMdulLamWithBaln_P S194_BCF_RMdulLamWoutBaln_P S194_BCF_RMdulWtngWithBaln_P S194_BCF_ValSysMtrxCdngNrLoLim_P /end SUB_GROUP
/end GROUP
/begin GROUP S181_Validation_of_Estimation "swc_BatCoreFct/BCF_100ms_sys/BatCoreFct/PackObs/PackObsLoop/MdulObs/CellObsr/Validation of Estimation" /begin SUB_GROUP S196_Cell_Delta_Assignment S196_Monitor_Balancing_Activity /end SUB_GROUP /end GROUP
/begin GROUP S182_BCF_Td_P "swc_BatCoreFct/BCF_100ms_sys/BatCoreFct/PackObs/PackObsLoop/MdulObs/Internal Short Circuit Detection/BCF_Td_P" /begin REF_CHARACTERISTIC BCF_Td_P /end REF_CHARACTERISTIC /end GROUP
/begin GROUP S182_BCF_TDifForThrwy_P "swc_BatCoreFct/BCF_100ms_sys/BatCoreFct/PackObs/PackObsLoop/MdulObs/Internal Short Circuit Detection/BCF_TDifForThrwy_P" /begin REF_CHARACTERISTIC BCF_TDifForThrwy_P /end REF_CHARACTERISTIC /end GROUP
/begin GROUP S182_BCF_TdOffDig1000_P "swc_BatCoreFct/BCF_100ms_sys/BatCoreFct/PackObs/PackObsLoop/MdulObs/Internal Short Circuit Detection/BCF_TdOffDig1000_P" /begin REF_CHARACTERISTIC BCF_TdOffDig1000_P /end REF_CHARACTERISTIC /end GROUP
/begin GROUP S182_BCF_TdOnDig1000_P "swc_BatCoreFct/BCF_100ms_sys/BatCoreFct/PackObs/PackObsLoop/MdulObs/Internal Short Circuit Detection/BCF_TdOnDig1000_P" /begin REF_CHARACTERISTIC BCF_TdOnDig1000_P /end REF_CHARACTERISTIC /end GROUP
/begin GROUP S182_BCF_TiDlyForThrwyT_P "swc_BatCoreFct/BCF_100ms_sys/BatCoreFct/PackObs/PackObsLoop/MdulObs/Internal Short Circuit Detection/BCF_TiDlyForThrwyT_P" /begin REF_CHARACTERISTIC BCF_TiDlyForThrwyT_P /end REF_CHARACTERISTIC /end GROUP
/begin GROUP S182_BCF_TMaxForThrwy_P "swc_BatCoreFct/BCF_100ms_sys/BatCoreFct/PackObs/PackObsLoop/MdulObs/Internal Short Circuit Detection/BCF_TMaxForThrwy_P" /begin REF_CHARACTERISTIC BCF_TMaxForThrwy_P /end REF_CHARACTERISTIC /end GROUP
/begin GROUP S182_BCF_TRateForThrwy_P "swc_BatCoreFct/BCF_100ms_sys/BatCoreFct/PackObs/PackObsLoop/MdulObs/Internal Short Circuit Detection/BCF_TRateForThrwy_P" /begin REF_CHARACTERISTIC BCF_TRateForThrwy_P /end REF_CHARACTERISTIC /end GROUP
/begin GROUP S182_BCF_UDeThdForThrwy_P "swc_BatCoreFct/BCF_100ms_sys/BatCoreFct/PackObs/PackObsLoop/MdulObs/Internal Short Circuit Detection/BCF_UDeThdForThrwy_P" /begin REF_CHARACTERISTIC BCF_UDeThdForThrwy_P /end REF_CHARACTERISTIC /end GROUP
/begin GROUP S182_BCF_UMinForThrwy_P "swc_BatCoreFct/BCF_100ms_sys/BatCoreFct/PackObs/PackObsLoop/MdulObs/Internal Short Circuit Detection/BCF_UMinForThrwy_P" /begin REF_CHARACTERISTIC BCF_UMinForThrwy_P /end REF_CHARACTERISTIC /end GROUP
/begin GROUP S182_BCTE_CtrIFlucForStaby_P "swc_BatChCtl/BCC_10ms_sys/BCC_10ms_sys/BatChTiEstimn/BatChTiEstimn/remaining_charge_time_calculation/BCTE_CtrIFlucForStaby_P" /begin REF_CHARACTERISTIC BCTE_CtrIFlucForStaby_P /end REF_CHARACTERISTIC /end GROUP
/begin GROUP S182_BCTE_FacTiClcdFromSoh_M "swc_BatChCtl/BCC_10ms_sys/BCC_10ms_sys/BatChTiEstimn/BatChTiEstimn/remaining_charge_time_calculation/BCTE_FacTiClcdFromSoh_M" /begin REF_CHARACTERISTIC BCTE_FacTiClcdFromSoh_M /end REF_CHARACTERISTIC /end GROUP
/begin GROUP S182_BCTE_IChRat_P "swc_BatChCtl/BCC_10ms_sys/BCC_10ms_sys/BatChTiEstimn/BatChTiEstimn/remaining_charge_time_calculation/BCTE_IChRat_P" /begin REF_CHARACTERISTIC BCTE_IChRat_P /end REF_CHARACTERISTIC /end GROUP
/begin GROUP S182_BCTE_SocChFnshd_P1 "swc_BatChCtl/BCC_10ms_sys/BCC_10ms_sys/BatChTiEstimn/BatChTiEstimn/remaining_charge_time_calculation/BCTE_SocChFnshd_P1" /begin REF_CHARACTERISTIC BCTE_SocChFnshd_P /end REF_CHARACTERISTIC /end GROUP
/begin GROUP S182_BCTE_SocDeltaForChTiEstimn_P "swc_BatChCtl/BCC_10ms_sys/BCC_10ms_sys/BatChTiEstimn/BatChTiEstimn/remaining_charge_time_calculation/BCTE_SocDeltaForChTiEstimn_P" /begin REF_CHARACTERISTIC BCTE_SocDeltaForChTiEstimn_P /end REF_CHARACTERISTIC /end GROUP
/begin GROUP S182_BitSelect3 "swc_BatCoreFct/BCF_100ms_sys/BatCoreFct/PackObs/PackObsLoop/MdulObs/Internal Short Circuit Detection/BitSelect3" /begin REF_CHARACTERISTIC BCF_EnaDiag_P /end REF_CHARACTERISTIC /end GROUP
/begin GROUP S182_ConterCalculate "swc_BatChCtl/BCC_10ms_sys/BCC_10ms_sys/BatChTiEstimn/BatChTiEstimn/remaining_charge_time_calculation/ConterCalculate" /begin SUB_GROUP S202_BCTE_FacFilIMeasd_P S202_BCTE_ThdFlucInIMeasd_P /end SUB_GROUP /end GROUP
/begin GROUP S182_Filter "swc_BatChCtl/BCC_10ms_sys/BCC_10ms_sys/BatChTiEstimn/BatChTiEstimn/remaining_charge_time_calculation/Filter" /begin SUB_GROUP S203_BCTE_FacFil2ChTiEstimn_P S203_BCTE_TiBatChMax_P /end SUB_GROUP /end GROUP
/begin GROUP S182_For_Iterator_Subsystem "swc_BatChCtl/BCC_10ms_sys/BCC_10ms_sys/BatChTiEstimn/BatChTiEstimn/remaining_charge_time_calculation/For Iterator Subsystem" /begin SUB_GROUP S204_BCTE_IAcLimnFromTSoc_M S204_BCTE_IDcLimnFromTSoc_M /end SUB_GROUP /end GROUP
/begin GROUP S183_AC_charging "swc_BatChCtl/BCC_10ms_sys/BCC_10ms_sys/BatChTiEstimn/BatChTiEstimn/remaining_charge_time_prediction/AC charging"
 /begin REF_CHARACTERISTIC BCTE_ICpbyOfChrgrAcMax_A BCTE_SocCellMaxForAcTiPred_A BCTE_TCooltAvgForAcTiPred_A BCTE_TMdulAvgForAcTiPred_A BCTE_TiAcTiPred_M BCTE_TiBatChMax_P /end REF_CHARACTERISTIC
/end GROUP
/begin GROUP S183_BCTE_FacFil1ChTiEstimn_P "swc_BatChCtl/BCC_10ms_sys/BCC_10ms_sys/BatChTiEstimn/BatChTiEstimn/remaining_charge_time_prediction/BCTE_FacFil1ChTiEstimn_P" /begin REF_CHARACTERISTIC BCTE_FacFil1ChTiEstimn_P /end REF_CHARACTERISTIC /end GROUP
/begin GROUP S183_BCTE_FacTiPredFromSoh_M "swc_BatChCtl/BCC_10ms_sys/BCC_10ms_sys/BatChTiEstimn/BatChTiEstimn/remaining_charge_time_prediction/BCTE_FacTiPredFromSoh_M" /begin REF_CHARACTERISTIC BCTE_FacTiPredFromSoh_M /end REF_CHARACTERISTIC /end GROUP
/begin GROUP S183_BCTE_ICpbyOfChrgrAcMax_P "swc_BatChCtl/BCC_10ms_sys/BCC_10ms_sys/BatChTiEstimn/BatChTiEstimn/remaining_charge_time_prediction/BCTE_ICpbyOfChrgrAcMax_P" /begin REF_CHARACTERISTIC BCTE_ICpbyOfChrgrAcMax_P /end REF_CHARACTERISTIC /end GROUP
/begin GROUP S183_BCTE_ICpbyOfChrgrDcMax_P "swc_BatChCtl/BCC_10ms_sys/BCC_10ms_sys/BatChTiEstimn/BatChTiEstimn/remaining_charge_time_prediction/BCTE_ICpbyOfChrgrDcMax_P" /begin REF_CHARACTERISTIC BCTE_ICpbyOfChrgrDcMax_P /end REF_CHARACTERISTIC /end GROUP
/begin GROUP S183_BCTE_SocChFnshd_P1 "swc_BatChCtl/BCC_10ms_sys/BCC_10ms_sys/BatChTiEstimn/BatChTiEstimn/remaining_charge_time_prediction/BCTE_SocChFnshd_P1" /begin REF_CHARACTERISTIC BCTE_SocChFnshd_P /end REF_CHARACTERISTIC /end GROUP
/begin GROUP S183_BCTE_TiBatChMax_P "swc_BatChCtl/BCC_10ms_sys/BCC_10ms_sys/BatChTiEstimn/BatChTiEstimn/remaining_charge_time_prediction/BCTE_TiBatChMax_P" /begin REF_CHARACTERISTIC BCTE_TiBatChMax_P /end REF_CHARACTERISTIC /end GROUP
/begin GROUP S183_Calculate_Soc_Reference "swc_BatCoreFct/BCF_100ms_sys/BatCoreFct/PackObs/PackObsLoop/MdulObs/MdulCObs/Calculate Soc Reference" /begin SUB_GROUP S279_BCF_CCellNom_M S279_BCF_Td_P /end SUB_GROUP /end GROUP
/begin GROUP S183_CMdulAgiFac_Estimation_in_CTestMode "swc_BatCoreFct/BCF_100ms_sys/BatCoreFct/PackObs/PackObsLoop/MdulObs/MdulCObs/CMdulAgiFac Estimation in CTestMode"
 /begin SUB_GROUP S277_BCF_CCellNom_M S277_BCF_SocLowrLimForSohVeri_P S277_BCF_SocUpprLimForSohVeri_P S277_BCF_Td_P S277_BCF_TTsForSohVeri_P /end SUB_GROUP
/end GROUP
/begin GROUP S183_CMdulDeltaTrip_Evaluation "swc_BatCoreFct/BCF_100ms_sys/BatCoreFct/PackObs/PackObsLoop/MdulObs/MdulCObs/CMdulDeltaTrip Evaluation" /begin SUB_GROUP S278_BCF_CMdulDeltaUpprLimOfTrip_P /end SUB_GROUP /end GROUP
/begin GROUP S183_DC_charging "swc_BatChCtl/BCC_10ms_sys/BCC_10ms_sys/BatChTiEstimn/BatChTiEstimn/remaining_charge_time_prediction/DC charging"
 /begin REF_CHARACTERISTIC BCTE_ICpbyOfChrgrDcMax_A BCTE_SocCellMaxForDcTiPred_A BCTE_TCooltAvgForDcTiPred_A BCTE_TMdulAvgForDcTiPred_A BCTE_TiBatChMax_P BCTE_TiDcTiPred_M /end REF_CHARACTERISTIC
/end GROUP
/begin GROUP S183_Sensitivity_Of_Estimation "swc_BatCoreFct/BCF_100ms_sys/BatCoreFct/PackObs/PackObsLoop/MdulObs/MdulCObs/Sensitivity Of Estimation"
 /begin SUB_GROUP S281_BCF_CMdulTripLamWithBaln_P S281_BCF_CMdulTripLamWoutBaln_P S281_BCF_CSysMtrxCdngNrLimHi_P S281_BCF_RMdulWtngWithBaln_P /end SUB_GROUP
/end GROUP
/begin GROUP S183_Update_CMdulAgiFac "swc_BatCoreFct/BCF_100ms_sys/BatCoreFct/PackObs/PackObsLoop/MdulObs/MdulCObs/Update CMdulAgiFac"
 /begin SUB_GROUP S282_Calculate_update_of_aging_factor S282_Diagnostic_of_module_degradation S282_Update_new_aging_factor /end SUB_GROUP
/end GROUP
/begin GROUP S184_1st_order_low_pass_filter "swc_BatCoreFct/BCF_100ms_sys/BatCoreFct/PackObs/PackObsLoop/MdulObs/MdulRObs/1st order low pass filter" /begin SUB_GROUP S335_BCF_Td_P S335_BCF_UMdulMeasdToMdlFilTcFac_P /end SUB_GROUP /end GROUP
/begin GROUP S184_BPP_bInhCtctrRelsDchaIThd_P "swc_BatProtnPack/PackVDiagAndExecutionControl/10ms/SignalArbitrator/CtctrRelsInh/BPP_bInhCtctrRelsDchaIThd_P" /end GROUP
/begin GROUP S184_BPP_bInhCtctrRelsIChThd_P1 "swc_BatProtnPack/PackVDiagAndExecutionControl/10ms/SignalArbitrator/CtctrRelsInh/BPP_bInhCtctrRelsIChThd_P1" /end GROUP
/begin GROUP S184_BPP_bInhCtctrRelsTiLim_P1 "swc_BatProtnPack/PackVDiagAndExecutionControl/10ms/SignalArbitrator/CtctrRelsInh/BPP_bInhCtctrRelsTiLim_P1" /end GROUP
/begin GROUP S184_BPP_FacFuseClr_M1 "swc_BatProtnPack/PackVDiagAndExecutionControl/10ms/SignalArbitrator/CtctrRelsInh/BPP_FacFuseClr_M1" /end GROUP
/begin GROUP S184_BPP_TiSample1_P "swc_BatProtnPack/PackVDiagAndExecutionControl/10ms/SignalArbitrator/CtctrRelsInh/BPP_TiSample1_P" /end GROUP
/begin GROUP S184_RMdulDeltaTripSatn "swc_BatCoreFct/BCF_100ms_sys/BatCoreFct/PackObs/PackObsLoop/MdulObs/MdulRObs/RMdulDeltaTripSatn" /begin SUB_GROUP S339_BCF_RMdulDeltaUpprLimOfTrip_P /end SUB_GROUP /end GROUP
/begin GROUP S184_Sensitivity_of_Estimation "swc_BatCoreFct/BCF_100ms_sys/BatCoreFct/PackObs/PackObsLoop/MdulObs/MdulRObs/Sensitivity of Estimation"
 /begin SUB_GROUP S340_BCF_RMdulDeltaShoUpprLim_P S340_BCF_RMdulLamWithBaln_P S340_BCF_RMdulLamWoutBaln_P S340_BCF_RMdulTripLamWithBaln_P S340_BCF_RMdulTripLamWoutBaln_P S340_BCF_RMdulWtngWithBaln_P S340_BCF_RSysMtrxCdngNrShoLimHi_P S340_BCF_RSysMtrxCdngNrTripLimHi_P /end SUB_GROUP
/end GROUP
/begin GROUP S184_Timer "swc_BatProtnPack/PackVDiagAndExecutionControl/10ms/SignalArbitrator/CtctrRelsInh/Timer" /begin SUB_GROUP S199_BPP_TiFuseClrdDetd_P1 S199_BPP_TiSample1_P /end SUB_GROUP /end GROUP
/begin GROUP S184_UMdulOffSho_Diagnosis "swc_BatCoreFct/BCF_100ms_sys/BatCoreFct/PackObs/PackObsLoop/MdulObs/MdulRObs/UMdulOffSho Diagnosis" /begin SUB_GROUP S341_Diagnostic_of_UMdulOffSho /end SUB_GROUP /end GROUP
/begin GROUP S184_Update_RMdulAgiFac "swc_BatCoreFct/BCF_100ms_sys/BatCoreFct/PackObs/PackObsLoop/MdulObs/MdulRObs/Update RMdulAgiFac"
 /begin SUB_GROUP S342_Calculate_update_of_aging_factor S342_Diagnostic_of_module_degradation S342_Update_new_aging_factor /end SUB_GROUP
/end GROUP
/begin GROUP S185_BPP_TiIActCutoff_P "swc_BatProtnPack/PackVDiagAndExecutionControl/10ms/SignalArbitrator/IActFilter/BPP_TiIActCutoff_P" /end GROUP
/begin GROUP S185_BPP_TiSample1_P "swc_BatProtnPack/PackVDiagAndExecutionControl/10ms/SignalArbitrator/IActFilter/BPP_TiSample1_P" /end GROUP
/begin GROUP S185_Evaluate_Estimate "swc_BatCoreFct/BCF_100ms_sys/BatCoreFct/PackObs/PackObsLoop/MdulObs/MdulSocObsr/Evaluate Estimate"
 /begin SUB_GROUP S415_BCF_SocLowrLimForAgiFacUpd_P S415_BCF_SocUpprLimForAgiFacUpd_P S415_BCF_TLowrLimForAgiFacUpd_P S415_BCF_UChOc_M S415_BCF_UDchaOc_M /end SUB_GROUP
/end GROUP
/begin GROUP S185_MdulStateObs "swc_BatCoreFct/BCF_100ms_sys/BatCoreFct/PackObs/PackObsLoop/MdulObs/MdulSocObsr/MdulStateObs"
 /begin SUB_GROUP S417_Correction_of_State_Estimation S417_Determine_Observer_Gain S417_MdulModel /end SUB_GROUP
/end GROUP
/begin GROUP S185_MdulTObs "swc_BatCoreFct/BCF_100ms_sys/BatCoreFct/PackObs/PackObsLoop/MdulObs/MdulSocObsr/MdulTObs" /begin SUB_GROUP S418_Evaluation_of_Estimation S418_T_Estimation /end SUB_GROUP /end GROUP
/begin GROUP S185_Temperature_Source_Switch "swc_BatCoreFct/BCF_100ms_sys/BatCoreFct/PackObs/PackObsLoop/MdulObs/MdulSocObsr/Temperature Source Switch" /begin SUB_GROUP S421_BCF_bAcvTEstimnForSoc_P /end SUB_GROUP /end GROUP
/begin GROUP S186_BPP_IFilActNoiseLim_P1 "swc_BatProtnPack/PackVDiagAndExecutionControl/10ms/SignalArbitrator/IActNoiseReduction/BPP_IFilActNoiseLim_P1" /end GROUP
/begin GROUP S187_BPP_CHSIGN_P "swc_BatProtnPack/PackVDiagAndExecutionControl/10ms/SignalArbitrator/IActSplitter/BPP_CHSIGN_P" /end GROUP
/begin GROUP S188_BCF_bAcvTEstimnForSoc_P "swc_BatCoreFct/BCF_100ms_sys/BatCoreFct/PackObs/PackObsLoop/MdulObs/CellObsr/Balancing Charge/BCF_bAcvTEstimnForSoc_P" /begin REF_CHARACTERISTIC BCF_bAcvTEstimnForSoc_P /end REF_CHARACTERISTIC /end GROUP
/begin GROUP S188_BCF_CCellNom_M "swc_BatCoreFct/BCF_100ms_sys/BatCoreFct/PackObs/PackObsLoop/MdulObs/CellObsr/Balancing Charge/BCF_CCellNom_M" /begin REF_CHARACTERISTIC BCF_CCellNom_M /end REF_CHARACTERISTIC /end GROUP
/begin GROUP S188_BCF_Td_P "swc_BatCoreFct/BCF_100ms_sys/BatCoreFct/PackObs/PackObsLoop/MdulObs/CellObsr/Balancing Charge/BCF_Td_P" /begin REF_CHARACTERISTIC BCF_Td_P /end REF_CHARACTERISTIC /end GROUP
/begin GROUP S188_BitSelect "swc_EltlLnkHzrdProtnNet/ELHPN_10ms_sys/ELHPN_10ms_sys/StateIsolation/StIsln/VehicleIsolationError/InitialCheck/BitSelect" /begin REF_CHARACTERISTIC ELHPN_Csw_P /end REF_CHARACTERISTIC /end GROUP
/begin GROUP S188_BitSelect1 "swc_BatProtnPack/PackVDiagAndExecutionControl/10ms/SignalArbitrator/PackVoltageDiagnosis/BitSelect1" /end GROUP
/begin GROUP S188_BPP_TCellUMinThd1_P "swc_BatProtnPack/PackVDiagAndExecutionControl/10ms/SignalArbitrator/PackVoltageDiagnosis/BPP_TCellUMinThd1_P" /end GROUP
/begin GROUP S188_BPP_TCellUMinThd2_P "swc_BatProtnPack/PackVDiagAndExecutionControl/10ms/SignalArbitrator/PackVoltageDiagnosis/BPP_TCellUMinThd2_P" /end GROUP
/begin GROUP S188_BPP_TiOffDig86_P "swc_BatProtnPack/PackVDiagAndExecutionControl/10ms/SignalArbitrator/PackVoltageDiagnosis/BPP_TiOffDig86_P" /end GROUP
/begin GROUP S188_BPP_TiOffDig87_P "swc_BatProtnPack/PackVDiagAndExecutionControl/10ms/SignalArbitrator/PackVoltageDiagnosis/BPP_TiOffDig87_P" /end GROUP
/begin GROUP S188_BPP_TiOnDig86_P "swc_BatProtnPack/PackVDiagAndExecutionControl/10ms/SignalArbitrator/PackVoltageDiagnosis/BPP_TiOnDig86_P" /end GROUP
/begin GROUP S188_BPP_TiOnDig87_P "swc_BatProtnPack/PackVDiagAndExecutionControl/10ms/SignalArbitrator/PackVoltageDiagnosis/BPP_TiOnDig87_P" /end GROUP
/begin GROUP S188_BPP_TiSample1_P "swc_BatProtnPack/PackVDiagAndExecutionControl/10ms/SignalArbitrator/PackVoltageDiagnosis/BPP_TiSample1_P" /end GROUP
/begin GROUP S188_BPP_TiSample1_P1 "swc_BatProtnPack/PackVDiagAndExecutionControl/10ms/SignalArbitrator/PackVoltageDiagnosis/BPP_TiSample1_P1" /end GROUP
/begin GROUP S188_BPP_UCellMax_P "swc_BatProtnPack/PackVDiagAndExecutionControl/10ms/SignalArbitrator/PackVoltageDiagnosis/BPP_UCellMax_P" /end GROUP
/begin GROUP S188_BPP_UPackMin_P1 "swc_BatProtnPack/PackVDiagAndExecutionControl/10ms/SignalArbitrator/PackVoltageDiagnosis/BPP_UPackMin_P1" /end GROUP
/begin GROUP S188_BPP_UPackMinOff_P "swc_BatProtnPack/PackVDiagAndExecutionControl/10ms/SignalArbitrator/PackVoltageDiagnosis/BPP_UPackMinOff_P" /end GROUP
/begin GROUP S188_BPP_UPackTBlwLoMin_P1 "swc_BatProtnPack/PackVDiagAndExecutionControl/10ms/SignalArbitrator/PackVoltageDiagnosis/BPP_UPackTBlwLoMin_P1" /end GROUP
/begin GROUP S188_BPP_UPackTBlwLoMinOff_P "swc_BatProtnPack/PackVDiagAndExecutionControl/10ms/SignalArbitrator/PackVoltageDiagnosis/BPP_UPackTBlwLoMinOff_P" /end GROUP
/begin GROUP S188_BPP_UPackTLoMin_P1 "swc_BatProtnPack/PackVDiagAndExecutionControl/10ms/SignalArbitrator/PackVoltageDiagnosis/BPP_UPackTLoMin_P1" /end GROUP
/begin GROUP S188_BPP_UPackTLoMinOff_P "swc_BatProtnPack/PackVDiagAndExecutionControl/10ms/SignalArbitrator/PackVoltageDiagnosis/BPP_UPackTLoMinOff_P" /end GROUP
/begin GROUP S188_ELHPN_TiDiagDebIniOff18_P "swc_EltlLnkHzrdProtnNet/ELHPN_10ms_sys/ELHPN_10ms_sys/StateIsolation/StIsln/VehicleIsolationError/InitialCheck/ELHPN_TiDiagDebIniOff18_P" /begin REF_CHARACTERISTIC ELHPN_TiDiagDebIniOff18_P /end REF_CHARACTERISTIC /end GROUP
/begin GROUP S188_ELHPN_TiDiagDebIniOn18_P "swc_EltlLnkHzrdProtnNet/ELHPN_10ms_sys/ELHPN_10ms_sys/StateIsolation/StIsln/VehicleIsolationError/InitialCheck/ELHPN_TiDiagDebIniOn18_P" /begin REF_CHARACTERISTIC ELHPN_TiDiagDebIniOn18_P /end REF_CHARACTERISTIC /end GROUP
/begin GROUP S188_ELHPN_TiSample1 "swc_EltlLnkHzrdProtnNet/ELHPN_10ms_sys/ELHPN_10ms_sys/StateIsolation/StIsln/VehicleIsolationError/InitialCheck/ELHPN_TiSample1" /begin REF_CHARACTERISTIC ELHPN_TiSample1 /end REF_CHARACTERISTIC /end GROUP
/begin GROUP S189_BPP_TiIActCutoff_P "swc_BatProtnPack/PackVDiagAndExecutionControl/10ms/SignalArbitrator/PwrActFilter/BPP_TiIActCutoff_P" /end GROUP
/begin GROUP S189_BPP_TiSample1_P "swc_BatProtnPack/PackVDiagAndExecutionControl/10ms/SignalArbitrator/PwrActFilter/BPP_TiSample1_P" /end GROUP
/begin GROUP S18_BitSelect "swc_BatProtnPack/PackSocAndSohDiag/1000ms/CellTemperatureDiagnosis/CellTemperatureMinLimitCore/BitSelect" /end GROUP
/begin GROUP S18_BPP_TCellWarnMin_P1 "swc_BatProtnPack/PackSocAndSohDiag/1000ms/CellTemperatureDiagnosis/CellTemperatureMinLimitCore/BPP_TCellWarnMin_P1" /end GROUP
/begin GROUP S18_BPP_TCellWarnMinOff_P "swc_BatProtnPack/PackSocAndSohDiag/1000ms/CellTemperatureDiagnosis/CellTemperatureMinLimitCore/BPP_TCellWarnMinOff_P" /end GROUP
/begin GROUP S18_BPP_TiOffDig176_P "swc_BatProtnPack/PackSocAndSohDiag/1000ms/CellTemperatureDiagnosis/CellTemperatureMinLimitCore/BPP_TiOffDig176_P" /end GROUP
/begin GROUP S18_BPP_TiOnDig176_P "swc_BatProtnPack/PackSocAndSohDiag/1000ms/CellTemperatureDiagnosis/CellTemperatureMinLimitCore/BPP_TiOnDig176_P" /end GROUP
/begin GROUP S18_BPP_TiSample2_P "swc_BatProtnPack/PackSocAndSohDiag/1000ms/CellTemperatureDiagnosis/CellTemperatureMinLimitCore/BPP_TiSample2_P" /end GROUP
/begin GROUP S18_BPP_TMdulSnsrSeln_P "swc_BatProtnPack/PackSocAndSohDiag/1000ms/CellTemperatureDiagnosis/CellTemperatureMinLimitCore/BPP_TMdulSnsrSeln_P" /end GROUP
/begin GROUP S190_BCTE_FacFil3ChTiEstimn_P "swc_BatChCtl/BCC_10ms_sys/BCC_10ms_sys/BatChTiEstimn/BatChTiEstimn/SecToHourAndMinu/Filter/BCTE_FacFil3ChTiEstimn_P" /begin REF_CHARACTERISTIC BCTE_FacFil3ChTiEstimn_P /end REF_CHARACTERISTIC /end GROUP
/begin GROUP S190_BCTE_TiBatChMax_P1 "swc_BatChCtl/BCC_10ms_sys/BCC_10ms_sys/BatChTiEstimn/BatChTiEstimn/SecToHourAndMinu/Filter/BCTE_TiBatChMax_P1" /begin REF_CHARACTERISTIC BCTE_TiBatChMax_P /end REF_CHARACTERISTIC /end GROUP
/begin GROUP S190_BPP_bAcvCTest_P "swc_BatProtnPack/PackVDiagAndExecutionControl/10ms/SignalArbitrator/ServiceModes1/BPP_bAcvCTest_P" /end GROUP
/begin GROUP S190_BPP_bAcvCTestMan_P "swc_BatProtnPack/PackVDiagAndExecutionControl/10ms/SignalArbitrator/ServiceModes1/BPP_bAcvCTestMan_P" /end GROUP
/begin GROUP S190_R_Cell_Delta_Wear_Detection "swc_BatCoreFct/BCF_100ms_sys/BatCoreFct/PackObs/PackObsLoop/MdulObs/CellObsr/Cell Wear Detection/R Cell Delta Wear Detection"
 /begin SUB_GROUP S207_BCF_ErrLimOfRDelta_P S207_BCF_ErrLimOfRDeltaCdn_P S207_BCF_Td_P S207_BCF_TdOffDig1002_P S207_BCF_TdOnDig1002_P S207_BCF_ValHealLimOfRDelta_P S207_BCF_ValHealLimOfRDeltaCdn_P S207_BitSelect3 /end SUB_GROUP
/end GROUP
/begin GROUP S190_Soc_Cell_Delta_Wear_Detection "swc_BatCoreFct/BCF_100ms_sys/BatCoreFct/PackObs/PackObsLoop/MdulObs/CellObsr/Cell Wear Detection/Soc Cell Delta Wear Detection"
 /begin SUB_GROUP S208_BCF_ErrLimOfSocDelta_P S208_BCF_ErrLimOfSocDeltaCdn_P S208_BCF_Td_P S208_BCF_TdOffDig1001_P S208_BCF_TdOnDig1001_P S208_BCF_ValHealLimOfSocDelta_P S208_BCF_ValHealLimOfSocDeltaCdn_P S208_BitSelect3 /end SUB_GROUP
/end GROUP
/begin GROUP S192_BCF_SocLnrznDelta_P "swc_BatCoreFct/BCF_100ms_sys/BatCoreFct/PackObs/PackObsLoop/MdulObs/CellObsr/MdulModelLin/BCF_SocLnrznDelta_P" /begin REF_CHARACTERISTIC BCF_SocLnrznDelta_P /end REF_CHARACTERISTIC /end GROUP
/begin GROUP S19_BitSelect "swc_EltlLnkHzrdProtnNet/ELHPN_10ms_sys/ELHPN_10ms_sys/CrashErr/BitSelect" /begin REF_CHARACTERISTIC BPIU_bAcvSwtDtc_P ELHPN_Csw_P /end REF_CHARACTERISTIC /end GROUP
/begin GROUP S19_BitSelect1 "swc_EltlLnkHzrdProtnNet/ELHPN_10ms_sys/ELHPN_10ms_sys/CrashErr/BitSelect1" /begin REF_CHARACTERISTIC ELHPN_Csw_P /end REF_CHARACTERISTIC /end GROUP
/begin GROUP S19_BitSelect2 "swc_EltlLnkHzrdProtnNet/ELHPN_10ms_sys/ELHPN_10ms_sys/CrashErr/BitSelect2" /begin REF_CHARACTERISTIC ELHPN_Csw_P /end REF_CHARACTERISTIC /end GROUP
/begin GROUP S19_BPIU_TiSample2_P1 "swc_BatProtnIU/CellUDiag/100ms/TotalVoltageFault/BPIU_TiSample2_P1" /begin REF_CHARACTERISTIC BPIU_TiSample2_P /end REF_CHARACTERISTIC /end GROUP
/begin GROUP S1_BcuStTranCtl "swc_BcuStTranCtl/BcuStTranCtl_sys/BcuStTranCtl" /begin REF_CHARACTERISTIC BSTC_TiProc_P /end REF_CHARACTERISTIC /end GROUP
/begin GROUP S203_BCTE_TiBatChMax_P "swc_BatChCtl/BCC_10ms_sys/BCC_10ms_sys/BatChTiEstimn/BatChTiEstimn/remaining_charge_time_calculation/Filter/BCTE_TiBatChMax_P" /begin REF_CHARACTERISTIC BCTE_TiBatChMax_P /end REF_CHARACTERISTIC /end GROUP
/begin GROUP S207_BCF_Td_P "swc_BatCoreFct/BCF_100ms_sys/BatCoreFct/PackObs/PackObsLoop/MdulObs/CellObsr/Cell Wear Detection/R Cell Delta Wear Detection/BCF_Td_P" /begin REF_CHARACTERISTIC BCF_Td_P /end REF_CHARACTERISTIC /end GROUP
/begin GROUP S207_BitSelect3 "swc_CtctrTranCtl/CtcrtTranCtl_sys/CtcrtTranCtl/Error/PostiveRelayError/BitSelect3" /begin REF_CHARACTERISTIC BCF_EnaDiag_P /end REF_CHARACTERISTIC /end GROUP
/begin GROUP S208_BCF_Td_P "swc_BatCoreFct/BCF_100ms_sys/BatCoreFct/PackObs/PackObsLoop/MdulObs/CellObsr/Cell Wear Detection/Soc Cell Delta Wear Detection/BCF_Td_P" /begin REF_CHARACTERISTIC BCF_Td_P /end REF_CHARACTERISTIC /end GROUP
/begin GROUP S208_BitSelect3 "swc_BatCoreFct/BCF_100ms_sys/BatCoreFct/PackObs/PackObsLoop/MdulObs/CellObsr/Cell Wear Detection/Soc Cell Delta Wear Detection/BitSelect3" /begin REF_CHARACTERISTIC BCF_EnaDiag_P /end REF_CHARACTERISTIC /end GROUP
/begin GROUP S20_BitSelect "swc_BatProtnIU/CellUDiag/100ms/UPackCollectionDiagnosis/BitSelect" /begin REF_CHARACTERISTIC BPIU_bAcvSwtDtc_P /end REF_CHARACTERISTIC /end GROUP
/begin GROUP S20_BPIU_TiSample2_P1 "swc_BatProtnIU/CellUDiag/100ms/UPackCollectionDiagnosis/BPIU_TiSample2_P1" /begin REF_CHARACTERISTIC BPIU_TiSample2_P /end REF_CHARACTERISTIC /end GROUP
/begin GROUP S21_BitSelect "swc_EltlLnkHzrdProtnNet/ELHPN_10ms_sys/ELHPN_10ms_sys/HighVoltageInterlock /BitSelect" /begin REF_CHARACTERISTIC ELHPN_Csw_P /end REF_CHARACTERISTIC /end GROUP
/begin GROUP S21_ELHPN_TiSample11 "swc_EltlLnkHzrdProtnNet/ELHPN_10ms_sys/ELHPN_10ms_sys/HighVoltageInterlock /ELHPN_TiSample11" /begin REF_CHARACTERISTIC ELHPN_TiSample1 /end REF_CHARACTERISTIC /end GROUP
/begin GROUP S23_BitSelect "swc_BatProtnIU/CellUDiag/100ms/CellVoltageDiagnosis/CellVoltageLimitCore/BitSelect" /begin REF_CHARACTERISTIC BPIU_bAcvSwtDtc_P /end REF_CHARACTERISTIC /end GROUP
/begin GROUP S23_BitSelect1 "swc_BatProtnIU/CellUDiag/100ms/CellVoltageDiagnosis/CellVoltageLimitCore/BitSelect1" /begin REF_CHARACTERISTIC BPIU_bAcvSwtDtc_P /end REF_CHARACTERISTIC /end GROUP
/begin GROUP S23_BitSelect2 "swc_BatProtnIU/CellUDiag/100ms/CellVoltageDiagnosis/CellVoltageLimitCore/BitSelect2" /begin REF_CHARACTERISTIC BPIU_bAcvSwtDtc_P /end REF_CHARACTERISTIC /end GROUP
/begin GROUP S23_BitSelect3 "swc_BatProtnIU/CellUDiag/100ms/CellVoltageDiagnosis/CellVoltageLimitCore/BitSelect3" /begin REF_CHARACTERISTIC BPIU_bAcvSwtDtc_P /end REF_CHARACTERISTIC /end GROUP
/begin GROUP S23_BPIU_TiSample2_P1 "swc_BatProtnIU/CellUDiag/100ms/CellVoltageDiagnosis/CellVoltageLimitCore/BPIU_TiSample2_P1" /begin REF_CHARACTERISTIC BPIU_TiSample2_P /end REF_CHARACTERISTIC /end GROUP
/begin GROUP S23_BPIU_TiSample2_P2 "swc_BatProtnIU/CellUDiag/100ms/CellVoltageDiagnosis/CellVoltageLimitCore/BPIU_TiSample2_P2" /begin REF_CHARACTERISTIC BPIU_TiSample2_P /end REF_CHARACTERISTIC /end GROUP
/begin GROUP S23_BPIU_TiSample2_P3 "swc_BatProtnIU/CellUDiag/100ms/CellVoltageDiagnosis/CellVoltageLimitCore/BPIU_TiSample2_P3" /begin REF_CHARACTERISTIC BPIU_TiSample2_P /end REF_CHARACTERISTIC /end GROUP
/begin GROUP S23_BPIU_TiSample2_P4 "swc_BatProtnIU/CellUDiag/100ms/CellVoltageDiagnosis/CellVoltageLimitCore/BPIU_TiSample2_P4" /begin REF_CHARACTERISTIC BPIU_TiSample2_P /end REF_CHARACTERISTIC /end GROUP
/begin GROUP S243_BitSelect "swc_BatProtnIU/PackIDiag/Subsystem/ChargeCurrentDiagnosis/BitSelect" /begin REF_CHARACTERISTIC BPIU_bAcvSwtDtc_P /end REF_CHARACTERISTIC /end GROUP
/begin GROUP S243_BitSelect1 "swc_BatProtnIU/PackIDiag/Subsystem/ChargeCurrentDiagnosis/BitSelect1" /begin REF_CHARACTERISTIC BPIU_bAcvSwtDtc_P /end REF_CHARACTERISTIC /end GROUP
/begin GROUP S243_BitSelect2 "swc_BatProtnIU/PackIDiag/Subsystem/ChargeCurrentDiagnosis/BitSelect2" /begin REF_CHARACTERISTIC BPIU_bAcvSwtDtc_P /end REF_CHARACTERISTIC /end GROUP
/begin GROUP S244_BitSelect "swc_BatProtnIU/PackIDiag/Subsystem/DischargeCurrentDiagnosis/BitSelect" /begin REF_CHARACTERISTIC BPIU_bAcvSwtDtc_P /end REF_CHARACTERISTIC /end GROUP
/begin GROUP S244_BitSelect1 "swc_BatProtnIU/PackIDiag/Subsystem/DischargeCurrentDiagnosis/BitSelect1" /begin REF_CHARACTERISTIC BPIU_bAcvSwtDtc_P /end REF_CHARACTERISTIC /end GROUP
/begin GROUP S245_BitSelect "swc_BatProtnIU/PackIDiag/Subsystem/ISnsrLimDiagnosis/BitSelect" /begin REF_CHARACTERISTIC BPIU_bAcvSwtDtc_P /end REF_CHARACTERISTIC /end GROUP
/begin GROUP S247_BitSelect "swc_BatProtnIU/PackIDiag/Subsystem/SupplyVoltageDiagnosis/BitSelect" /begin REF_CHARACTERISTIC BPIU_bAcvSwtDtc_P /end REF_CHARACTERISTIC /end GROUP
/begin GROUP S247_BitSelect1 "swc_BatProtnIU/PackIDiag/Subsystem/SupplyVoltageDiagnosis/BitSelect1" /begin REF_CHARACTERISTIC BPIU_bAcvSwtDtc_P /end REF_CHARACTERISTIC /end GROUP
/begin GROUP S255_BTHM_TiTask100Ms_P5 "swc_BatThermHndlgMngt/BTHM_100ms_sys/100ms/DataPrep/Diagnosis/IntialCheck/BTHM_TiTask100Ms_P5" /begin REF_CHARACTERISTIC BTHM_TiTask100Ms_P /end REF_CHARACTERISTIC /end GROUP
/begin GROUP S25_BitSelect "swc_BatProtnIU/CellUDiag/100ms/CellVoltageDiagnosis/CellVoltageOutOfRange/BitSelect" /begin REF_CHARACTERISTIC BPIU_bAcvSwtDtc_P /end REF_CHARACTERISTIC /end GROUP
/begin GROUP S25_BPIU_TiSample2_P "swc_BatProtnIU/CellUDiag/100ms/CellVoltageDiagnosis/CellVoltageOutOfRange/BPIU_TiSample2_P" /begin REF_CHARACTERISTIC BPIU_TiSample2_P /end REF_CHARACTERISTIC /end GROUP
/begin GROUP S26_BitSelect "swc_BatProtnIU/CellUDiag/100ms/CellVoltageDiagnosis/ModulelVoltageOutOfRange/BitSelect" /begin REF_CHARACTERISTIC BPIU_bAcvSwtDtc_P /end REF_CHARACTERISTIC /end GROUP
/begin GROUP S26_BPIU_TiSample2_P "swc_BatProtnIU/CellUDiag/100ms/CellVoltageDiagnosis/ModulelVoltageOutOfRange/BPIU_TiSample2_P" /begin REF_CHARACTERISTIC BPIU_TiSample2_P /end REF_CHARACTERISTIC /end GROUP
/begin GROUP S277_BCF_CCellNom_M "swc_BatCoreFct/BCF_100ms_sys/BatCoreFct/PackObs/PackObsLoop/MdulObs/MdulCObs/CMdulAgiFac Estimation in CTestMode/BCF_CCellNom_M" /begin REF_CHARACTERISTIC BCF_CCellNom_M /end REF_CHARACTERISTIC /end GROUP
/begin GROUP S277_BCF_Td_P "swc_BatCoreFct/BCF_100ms_sys/BatCoreFct/PackObs/PackObsLoop/MdulObs/MdulCObs/CMdulAgiFac Estimation in CTestMode/BCF_Td_P" /begin REF_CHARACTERISTIC BCF_Td_P /end REF_CHARACTERISTIC /end GROUP
/begin GROUP S279_BCF_CCellNom_M "swc_BatCoreFct/BCF_100ms_sys/BatCoreFct/PackObs/PackObsLoop/MdulObs/MdulCObs/Calculate Soc Reference/BCF_CCellNom_M" /begin REF_CHARACTERISTIC BCF_CCellNom_M /end REF_CHARACTERISTIC /end GROUP
/begin GROUP S279_BCF_Td_P "swc_BatCoreFct/BCF_100ms_sys/BatCoreFct/PackObs/PackObsLoop/MdulObs/MdulCObs/Calculate Soc Reference/BCF_Td_P" /begin REF_CHARACTERISTIC BCF_Td_P /end REF_CHARACTERISTIC /end GROUP
/begin GROUP S27_BitSelect "swc_BatProtnIU/CellUDiag/100ms/CellVoltageDiagnosis/UCellCollectionDiagnosis/BitSelect" /begin REF_CHARACTERISTIC BPIU_bAcvSwtDtc_P /end REF_CHARACTERISTIC /end GROUP
/begin GROUP S27_BPIU_TiSample2_P "swc_BatProtnIU/CellUDiag/100ms/CellVoltageDiagnosis/UCellCollectionDiagnosis/BPIU_TiSample2_P" /begin REF_CHARACTERISTIC BPIU_TiSample2_P /end REF_CHARACTERISTIC /end GROUP
/begin GROUP S28_BitSelect1 "swc_BatProtnIU/CellUDiag/100ms/CellVoltageDiagnosis/UCellDiffDiag/BitSelect1" /begin REF_CHARACTERISTIC BPIU_bAcvSwtDtc_P /end REF_CHARACTERISTIC /end GROUP
/begin GROUP S28_BPIU_TiSample2_P1 "swc_BatProtnIU/CellUDiag/100ms/CellVoltageDiagnosis/UCellDiffDiag/BPIU_TiSample2_P1" /begin REF_CHARACTERISTIC BPIU_TiSample2_P /end REF_CHARACTERISTIC /end GROUP
/begin GROUP S29_BitSelect "swc_BatProtnIU/CellUDiag/100ms/CellVoltageDiagnosis/UCellMaxDiagnosis/BitSelect" /begin REF_CHARACTERISTIC BPIU_bAcvSwtDtc_P /end REF_CHARACTERISTIC /end GROUP
/begin GROUP S29_BitSelect1 "swc_BatProtnIU/CellUDiag/100ms/CellVoltageDiagnosis/UCellMaxDiagnosis/BitSelect1" /begin REF_CHARACTERISTIC BPIU_bAcvSwtDtc_P /end REF_CHARACTERISTIC /end GROUP
/begin GROUP S29_BitSelect2 "swc_BatProtnIU/CellUDiag/100ms/CellVoltageDiagnosis/UCellMaxDiagnosis/BitSelect2" /begin REF_CHARACTERISTIC BPIU_bAcvSwtDtc_P /end REF_CHARACTERISTIC /end GROUP
/begin GROUP S29_BitSelect3 "swc_BatProtnIU/CellUDiag/100ms/CellVoltageDiagnosis/UCellMaxDiagnosis/BitSelect3" /begin REF_CHARACTERISTIC BPIU_bAcvSwtDtc_P /end REF_CHARACTERISTIC /end GROUP
/begin GROUP S29_BPIU_TiSample2_P "swc_BatProtnIU/CellUDiag/100ms/CellVoltageDiagnosis/UCellMaxDiagnosis/BPIU_TiSample2_P" /begin REF_CHARACTERISTIC BPIU_TiSample2_P /end REF_CHARACTERISTIC /end GROUP
/begin GROUP S29_BPIU_TiSample2_P1 "swc_BatProtnIU/CellUDiag/100ms/CellVoltageDiagnosis/UCellMaxDiagnosis/BPIU_TiSample2_P1" /begin REF_CHARACTERISTIC BPIU_TiSample2_P /end REF_CHARACTERISTIC /end GROUP
/begin GROUP S29_BPIU_TiSample2_P2 "swc_BatProtnIU/CellUDiag/100ms/CellVoltageDiagnosis/UCellMaxDiagnosis/BPIU_TiSample2_P2" /begin REF_CHARACTERISTIC BPIU_TiSample2_P /end REF_CHARACTERISTIC /end GROUP
/begin GROUP S29_BPIU_TiSample2_P3 "swc_BatProtnIU/CellUDiag/100ms/CellVoltageDiagnosis/UCellMaxDiagnosis/BPIU_TiSample2_P3" /begin REF_CHARACTERISTIC BPIU_TiSample2_P /end REF_CHARACTERISTIC /end GROUP
/begin GROUP S308_BCC_EffDcdc_P "swc_BatChCtl/DC_10ms_sys/ElecVehChegnStHdlr_Sys/ElecVehChegnStHdlr/BCL/BCC_EffDcdc_P" /begin REF_CHARACTERISTIC BCC_EffDcdc_P /end REF_CHARACTERISTIC /end GROUP
/begin GROUP S308_BCC_IThermReq_P "swc_BatChCtl/DC_10ms_sys/ElecVehChegnStHdlr_Sys/ElecVehChegnStHdlr/BCL/BCC_IThermReq_P" /begin REF_CHARACTERISTIC BCC_IThermReq_P /end REF_CHARACTERISTIC /end GROUP
/begin GROUP S308_BCC_PwrPtcTherm_P "swc_BatChCtl/DC_10ms_sys/ElecVehChegnStHdlr_Sys/ElecVehChegnStHdlr/BCL/BCC_PwrPtcTherm_P" /begin REF_CHARACTERISTIC BCC_PwrPtcTherm_P /end REF_CHARACTERISTIC /end GROUP
/begin GROUP S308_BCC_UOfsThermReq_P "swc_BatChCtl/DC_10ms_sys/ElecVehChegnStHdlr_Sys/ElecVehChegnStHdlr/BCL/BCC_UOfsThermReq_P" /begin REF_CHARACTERISTIC BCC_UOfsThermReq_P /end REF_CHARACTERISTIC /end GROUP
/begin GROUP S308_BCF_Td_P "swc_BatCoreFct/BCF_100ms_sys/BatCoreFct/PackObs/PackObsLoop/MdulObs/MdulCObs/Update CMdulAgiFac/Diagnostic of module degradation/BCF_Td_P" /begin REF_CHARACTERISTIC BCF_Td_P /end REF_CHARACTERISTIC /end GROUP
/begin GROUP S308_BitSelect3 "swc_BatCoreFct/BCF_100ms_sys/BatCoreFct/PackObs/PackObsLoop/MdulObs/MdulCObs/Update CMdulAgiFac/Diagnostic of module degradation/BitSelect3" /begin REF_CHARACTERISTIC BCF_EnaDiag_P /end REF_CHARACTERISTIC /end GROUP
/begin GROUP S30_BitSelect "swc_BatProtnIU/CellUDiag/100ms/CellVoltageDiagnosis/UCellRateDiagnosis/BitSelect" /begin REF_CHARACTERISTIC BPIU_bAcvSwtDtc_P /end REF_CHARACTERISTIC /end GROUP
/begin GROUP S30_BPIU_TiSample2_P1 "swc_BatProtnIU/CellUDiag/100ms/CellVoltageDiagnosis/UCellRateDiagnosis/BPIU_TiSample2_P1" /begin REF_CHARACTERISTIC BPIU_TiSample2_P /end REF_CHARACTERISTIC /end GROUP
/begin GROUP S310_CompareToCalibrationPara1 "swc_BatChCtl/DC_10ms_sys/ElecVehChegnStHdlr_Sys/ElecVehChegnStHdlr/BSM/CompareToCalibrationPara1" /begin REF_CHARACTERISTIC SMObc_TMdulSnsrMax_P /end REF_CHARACTERISTIC /end GROUP
/begin GROUP S310_CompareToCalibrationPara23 "swc_BatChCtl/DC_10ms_sys/ElecVehChegnStHdlr_Sys/ElecVehChegnStHdlr/BSM/CompareToCalibrationPara23" /begin REF_CHARACTERISTIC SMObc_TMdulSnsrMin_P /end REF_CHARACTERISTIC /end GROUP
/begin GROUP S313_BitSelect "swc_BatChCtl/DC_10ms_sys/ElecVehChegnStHdlr_Sys/ElecVehChegnStHdlr/Diagnosis/BitSelect" /begin REF_CHARACTERISTIC BCC_bAcvSwtDtc_P /end REF_CHARACTERISTIC /end GROUP
/begin GROUP S313_BitSelect1 "swc_BatChCtl/DC_10ms_sys/ElecVehChegnStHdlr_Sys/ElecVehChegnStHdlr/Diagnosis/BitSelect1" /begin REF_CHARACTERISTIC BCC_bAcvSwtDtc_P /end REF_CHARACTERISTIC /end GROUP
/begin GROUP S313_BitSelect10 "swc_BatChCtl/DC_10ms_sys/ElecVehChegnStHdlr_Sys/ElecVehChegnStHdlr/Diagnosis/BitSelect10" /begin REF_CHARACTERISTIC BCC_ValReplDig_P /end REF_CHARACTERISTIC /end GROUP
/begin GROUP S313_BitSelect11 "swc_BatChCtl/DC_10ms_sys/ElecVehChegnStHdlr_Sys/ElecVehChegnStHdlr/Diagnosis/BitSelect11" /begin REF_CHARACTERISTIC BCC_ValReplDig_P /end REF_CHARACTERISTIC /end GROUP
/begin GROUP S313_BitSelect12 "swc_BatChCtl/DC_10ms_sys/ElecVehChegnStHdlr_Sys/ElecVehChegnStHdlr/Diagnosis/BitSelect12" /begin REF_CHARACTERISTIC BCC_CswReplDig_P /end REF_CHARACTERISTIC /end GROUP
/begin GROUP S313_BitSelect13 "swc_BatChCtl/DC_10ms_sys/ElecVehChegnStHdlr_Sys/ElecVehChegnStHdlr/Diagnosis/BitSelect13" /begin REF_CHARACTERISTIC BCC_CswReplDig_P /end REF_CHARACTERISTIC /end GROUP
/begin GROUP S313_BitSelect14 "swc_BatChCtl/DC_10ms_sys/ElecVehChegnStHdlr_Sys/ElecVehChegnStHdlr/Diagnosis/BitSelect14" /begin REF_CHARACTERISTIC BCC_ValReplDig_P /end REF_CHARACTERISTIC /end GROUP
/begin GROUP S313_BitSelect15 "swc_BatChCtl/DC_10ms_sys/ElecVehChegnStHdlr_Sys/ElecVehChegnStHdlr/Diagnosis/BitSelect15" /begin REF_CHARACTERISTIC BCC_CswReplDig_P /end REF_CHARACTERISTIC /end GROUP
/begin GROUP S313_BitSelect16 "swc_BatChCtl/DC_10ms_sys/ElecVehChegnStHdlr_Sys/ElecVehChegnStHdlr/Diagnosis/BitSelect16" /begin REF_CHARACTERISTIC BCC_ValReplDig_P /end REF_CHARACTERISTIC /end GROUP
/begin GROUP S313_BitSelect17 "swc_BatChCtl/DC_10ms_sys/ElecVehChegnStHdlr_Sys/ElecVehChegnStHdlr/Diagnosis/BitSelect17" /begin REF_CHARACTERISTIC BCC_CswReplDig_P /end REF_CHARACTERISTIC /end GROUP
/begin GROUP S313_BitSelect18 "swc_BatChCtl/DC_10ms_sys/ElecVehChegnStHdlr_Sys/ElecVehChegnStHdlr/Diagnosis/BitSelect18" /begin REF_CHARACTERISTIC BCC_ValReplDig_P /end REF_CHARACTERISTIC /end GROUP
/begin GROUP S313_BitSelect2 "swc_BatChCtl/DC_10ms_sys/ElecVehChegnStHdlr_Sys/ElecVehChegnStHdlr/Diagnosis/BitSelect2" /begin REF_CHARACTERISTIC BCC_bAcvSwtDtc_P /end REF_CHARACTERISTIC /end GROUP
/begin GROUP S313_BitSelect22 "swc_BatChCtl/DC_10ms_sys/ElecVehChegnStHdlr_Sys/ElecVehChegnStHdlr/Diagnosis/BitSelect22" /begin REF_CHARACTERISTIC BCC_CswReplDig_P /end REF_CHARACTERISTIC /end GROUP
/begin GROUP S313_BitSelect23 "swc_BatChCtl/DC_10ms_sys/ElecVehChegnStHdlr_Sys/ElecVehChegnStHdlr/Diagnosis/BitSelect23" /begin REF_CHARACTERISTIC BCC_ValReplDig_P /end REF_CHARACTERISTIC /end GROUP
/begin GROUP S313_BitSelect3 "swc_BatChCtl/DC_10ms_sys/ElecVehChegnStHdlr_Sys/ElecVehChegnStHdlr/Diagnosis/BitSelect3" /begin REF_CHARACTERISTIC BCC_bAcvSwtDtc_P /end REF_CHARACTERISTIC /end GROUP
/begin GROUP S313_BitSelect4 "swc_BatChCtl/DC_10ms_sys/ElecVehChegnStHdlr_Sys/ElecVehChegnStHdlr/Diagnosis/BitSelect4" /begin REF_CHARACTERISTIC BCC_bAcvSwtDtc_P /end REF_CHARACTERISTIC /end GROUP
/begin GROUP S313_BitSelect5 "swc_BatChCtl/DC_10ms_sys/ElecVehChegnStHdlr_Sys/ElecVehChegnStHdlr/Diagnosis/BitSelect5" /begin REF_CHARACTERISTIC BCC_bAcvSwtDtc_P /end REF_CHARACTERISTIC /end GROUP
/begin GROUP S313_BitSelect6 "swc_BatChCtl/DC_10ms_sys/ElecVehChegnStHdlr_Sys/ElecVehChegnStHdlr/Diagnosis/BitSelect6" /begin REF_CHARACTERISTIC BCC_bAcvSwtDtc_P /end REF_CHARACTERISTIC /end GROUP
/begin GROUP S313_BitSelect7 "swc_BatChCtl/DC_10ms_sys/ElecVehChegnStHdlr_Sys/ElecVehChegnStHdlr/Diagnosis/BitSelect7" /begin REF_CHARACTERISTIC BCC_CswReplDig_P /end REF_CHARACTERISTIC /end GROUP
/begin GROUP S313_BitSelect8 "swc_BatChCtl/DC_10ms_sys/ElecVehChegnStHdlr_Sys/ElecVehChegnStHdlr/Diagnosis/BitSelect8" /begin REF_CHARACTERISTIC BCC_ValReplDig_P /end REF_CHARACTERISTIC /end GROUP
/begin GROUP S313_BitSelect9 "swc_BatChCtl/DC_10ms_sys/ElecVehChegnStHdlr_Sys/ElecVehChegnStHdlr/Diagnosis/BitSelect9" /begin REF_CHARACTERISTIC BCC_CswReplDig_P /end REF_CHARACTERISTIC /end GROUP
/begin GROUP S32_BSTC_TiProc_P "swc_BcuStTranCtl/BcuStTranCtl_sys/BcuStTranCtl/BatteryTimeCalculation/BSTC_TiProc_P" /begin REF_CHARACTERISTIC BSTC_TiProc_P /end REF_CHARACTERISTIC /end GROUP
/begin GROUP S32_BSTC_TiProc_P1 "swc_BcuStTranCtl/BcuStTranCtl_sys/BcuStTranCtl/BatteryTimeCalculation/BSTC_TiProc_P1" /begin REF_CHARACTERISTIC BSTC_TiProc_P /end REF_CHARACTERISTIC /end GROUP
/begin GROUP S335_BCF_Td_P "swc_BatCoreFct/BCF_100ms_sys/BatCoreFct/PackObs/PackObsLoop/MdulObs/MdulRObs/1st order low pass filter/BCF_Td_P" /begin REF_CHARACTERISTIC BCF_Td_P /end REF_CHARACTERISTIC /end GROUP
/begin GROUP S335_BitSelect "swc_BatProtnIU/PackIDiag/Subsystem/SupplyVoltageDiagnosis/SelfCheck/BitSelect" /begin REF_CHARACTERISTIC BPIU_bAcvSwtDtc_P /end REF_CHARACTERISTIC /end GROUP
/begin GROUP S336_BitSelect "swc_BatProtnIU/PackIDiag/Subsystem/SupplyVoltageDiagnosis/SelfCheck1/BitSelect" /begin REF_CHARACTERISTIC BPIU_bAcvSwtDtc_P /end REF_CHARACTERISTIC /end GROUP
/begin GROUP S35_BitSelect "swc_EltlLnkHzrdProtnNet/ELHPN_10ms_sys/ELHPN_10ms_sys/CrashErr/InitialCheck/BitSelect" /begin REF_CHARACTERISTIC ELHPN_Csw_P /end REF_CHARACTERISTIC /end GROUP
/begin GROUP S35_ELHPN_TiSample1 "swc_EltlLnkHzrdProtnNet/ELHPN_10ms_sys/ELHPN_10ms_sys/CrashErr/InitialCheck/ELHPN_TiSample1" /begin REF_CHARACTERISTIC ELHPN_TiSample1 /end REF_CHARACTERISTIC /end GROUP
/begin GROUP S368_BCF_Td_P "swc_BatCoreFct/BCF_100ms_sys/BatCoreFct/PackObs/PackObsLoop/MdulObs/MdulRObs/UMdulOffSho Diagnosis/Diagnostic of UMdulOffSho/BCF_Td_P" /begin REF_CHARACTERISTIC BCF_Td_P /end REF_CHARACTERISTIC /end GROUP
/begin GROUP S368_BitSelect3 "swc_BatCoreFct/BCF_100ms_sys/BatCoreFct/PackObs/PackObsLoop/MdulObs/MdulRObs/UMdulOffSho Diagnosis/Diagnostic of UMdulOffSho/BitSelect3" /begin REF_CHARACTERISTIC BCF_EnaDiag_P /end REF_CHARACTERISTIC /end GROUP
/begin GROUP S369_BTHM_TiTask100Ms_P "swc_BatThermHndlgMngt/BTHM_100ms_sys/100ms/ThermManage/LiquidThermalCondition/BTHM_TiTask100Ms_P" /begin REF_CHARACTERISTIC BTHM_TiTask100Ms_P /end REF_CHARACTERISTIC /end GROUP
/begin GROUP S37_BBC_EnaTestBaln_P "swc_BatBalnCtl/BBC_100ms_sys/BBC_100ms_sys/BatBalnCtl/Battery Balancing Decision/BatBalnCtl/BBC_EnaTestBaln_P" /begin REF_CHARACTERISTIC BBC_EnaTestBaln_P /end REF_CHARACTERISTIC /end GROUP
/begin GROUP S37_BBC_NrMdulTest_P "swc_BatBalnCtl/BBC_100ms_sys/BBC_100ms_sys/BatBalnCtl/Battery Balancing Decision/BatBalnCtl/BBC_NrMdulTest_P" /begin REF_CHARACTERISTIC BBC_NrMdulTest_P /end REF_CHARACTERISTIC /end GROUP
/begin GROUP S37_BSTC_TiProc_P "swc_BcuStTranCtl/BcuStTranCtl_sys/BcuStTranCtl/ConditionConfirm/BSTC_TiProc_P" /begin REF_CHARACTERISTIC BSTC_TiProc_P /end REF_CHARACTERISTIC /end GROUP
/begin GROUP S37_BSTC_TiProc_P1 "swc_BcuStTranCtl/BcuStTranCtl_sys/BcuStTranCtl/ConditionConfirm/BSTC_TiProc_P1" /begin REF_CHARACTERISTIC BSTC_TiProc_P /end REF_CHARACTERISTIC /end GROUP
/begin GROUP S37_BTHM_TiTask100Ms_P "swc_BatThermHndlgMngt/BTHM_100ms_sys/100ms/ThermManage/BTHM_TiTask100Ms_P" /begin REF_CHARACTERISTIC BTHM_TiTask100Ms_P /end REF_CHARACTERISTIC /end GROUP
/begin GROUP S37_BTHM_TiTask100Ms_P1 "swc_BatThermHndlgMngt/BTHM_100ms_sys/100ms/ThermManage/BTHM_TiTask100Ms_P1" /begin REF_CHARACTERISTIC BTHM_TiTask100Ms_P /end REF_CHARACTERISTIC /end GROUP
/begin GROUP S385_BCF_Td_P "swc_BatCoreFct/BCF_100ms_sys/BatCoreFct/PackObs/PackObsLoop/MdulObs/MdulRObs/Update RMdulAgiFac/Diagnostic of module degradation/BCF_Td_P" /begin REF_CHARACTERISTIC BCF_Td_P /end REF_CHARACTERISTIC /end GROUP
/begin GROUP S385_BitSelect3 "swc_BatCoreFct/BCF_100ms_sys/BatCoreFct/PackObs/PackObsLoop/MdulObs/MdulRObs/Update RMdulAgiFac/Diagnostic of module degradation/BitSelect3" /begin REF_CHARACTERISTIC BCF_EnaDiag_P /end REF_CHARACTERISTIC /end GROUP
/begin GROUP S38_BSTC_TiProc_P "swc_BcuStTranCtl/BcuStTranCtl_sys/BcuStTranCtl/DTC/BSTC_TiProc_P" /begin REF_CHARACTERISTIC BSTC_TiProc_P /end REF_CHARACTERISTIC /end GROUP
/begin GROUP S38_BSTC_TiProc_P1 "swc_BcuStTranCtl/BcuStTranCtl_sys/BcuStTranCtl/DTC/BSTC_TiProc_P1" /begin REF_CHARACTERISTIC BSTC_TiProc_P /end REF_CHARACTERISTIC /end GROUP
/begin GROUP S38_BSTC_TiProc_P2 "swc_BcuStTranCtl/BcuStTranCtl_sys/BcuStTranCtl/DTC/BSTC_TiProc_P2" /begin REF_CHARACTERISTIC BSTC_TiProc_P /end REF_CHARACTERISTIC /end GROUP
/begin GROUP S38_BSTC_TiProc_P3 "swc_BcuStTranCtl/BcuStTranCtl_sys/BcuStTranCtl/DTC/BSTC_TiProc_P3" /begin REF_CHARACTERISTIC BSTC_TiProc_P /end REF_CHARACTERISTIC /end GROUP
/begin GROUP S38_BSTC_TiProc_P4 "swc_BcuStTranCtl/BcuStTranCtl_sys/BcuStTranCtl/DTC/BSTC_TiProc_P4" /begin REF_CHARACTERISTIC BSTC_TiProc_P /end REF_CHARACTERISTIC /end GROUP
/begin GROUP S39_BSTC_TiProc_P "swc_BcuStTranCtl/BcuStTranCtl_sys/BcuStTranCtl/ExternalResetCalculation/BSTC_TiProc_P" /begin REF_CHARACTERISTIC BSTC_TiProc_P /end REF_CHARACTERISTIC /end GROUP
/begin GROUP S421_BCF_bAcvTEstimnForSoc_P "swc_BatCoreFct/BCF_100ms_sys/BatCoreFct/PackObs/PackObsLoop/MdulObs/MdulSocObsr/Temperature Source Switch/BCF_bAcvTEstimnForSoc_P" /begin REF_CHARACTERISTIC BCF_bAcvTEstimnForSoc_P /end REF_CHARACTERISTIC /end GROUP
/begin GROUP S42_BSTC_TiProc_P "swc_BcuStTranCtl/BcuStTranCtl_sys/BcuStTranCtl/Time/BSTC_TiProc_P" /begin REF_CHARACTERISTIC BSTC_TiProc_P /end REF_CHARACTERISTIC /end GROUP
/begin GROUP S42_BTHM_TiTask100Ms_P "swc_BatThermHndlgMngt/BTHM_100ms_sys/100ms/DataPrep/Diagnosis/BTHM_TiTask100Ms_P" /begin REF_CHARACTERISTIC BTHM_TiTask100Ms_P /end REF_CHARACTERISTIC /end GROUP
/begin GROUP S42_BTHM_TiTask100Ms_P1 "swc_BatThermHndlgMngt/BTHM_100ms_sys/100ms/DataPrep/Diagnosis/BTHM_TiTask100Ms_P1" /begin REF_CHARACTERISTIC BTHM_TiTask100Ms_P /end REF_CHARACTERISTIC /end GROUP
/begin GROUP S42_BTHM_TiTask100Ms_P10 "swc_BatThermHndlgMngt/BTHM_100ms_sys/100ms/DataPrep/Diagnosis/BTHM_TiTask100Ms_P10" /begin REF_CHARACTERISTIC BTHM_TiTask100Ms_P /end REF_CHARACTERISTIC /end GROUP
/begin GROUP S42_BTHM_TiTask100Ms_P11 "swc_BatThermHndlgMngt/BTHM_100ms_sys/100ms/DataPrep/Diagnosis/BTHM_TiTask100Ms_P11" /begin REF_CHARACTERISTIC BTHM_TiTask100Ms_P /end REF_CHARACTERISTIC /end GROUP
/begin GROUP S42_BTHM_TiTask100Ms_P12 "swc_BatThermHndlgMngt/BTHM_100ms_sys/100ms/DataPrep/Diagnosis/BTHM_TiTask100Ms_P12" /begin REF_CHARACTERISTIC BTHM_TiTask100Ms_P /end REF_CHARACTERISTIC /end GROUP
/begin GROUP S42_BTHM_TiTask100Ms_P13 "swc_BatThermHndlgMngt/BTHM_100ms_sys/100ms/DataPrep/Diagnosis/BTHM_TiTask100Ms_P13" /begin REF_CHARACTERISTIC BTHM_TiTask100Ms_P /end REF_CHARACTERISTIC /end GROUP
/begin GROUP S42_BTHM_TiTask100Ms_P14 "swc_BatThermHndlgMngt/BTHM_100ms_sys/100ms/DataPrep/Diagnosis/BTHM_TiTask100Ms_P14" /begin REF_CHARACTERISTIC BTHM_TiTask100Ms_P /end REF_CHARACTERISTIC /end GROUP
/begin GROUP S42_BTHM_TiTask100Ms_P15 "swc_BatThermHndlgMngt/BTHM_100ms_sys/100ms/DataPrep/Diagnosis/BTHM_TiTask100Ms_P15" /begin REF_CHARACTERISTIC BTHM_TiTask100Ms_P /end REF_CHARACTERISTIC /end GROUP
/begin GROUP S42_BTHM_TiTask100Ms_P2 "swc_BatThermHndlgMngt/BTHM_100ms_sys/100ms/DataPrep/Diagnosis/BTHM_TiTask100Ms_P2" /begin REF_CHARACTERISTIC BTHM_TiTask100Ms_P /end REF_CHARACTERISTIC /end GROUP
/begin GROUP S42_BTHM_TiTask100Ms_P3 "swc_BatThermHndlgMngt/BTHM_100ms_sys/100ms/DataPrep/Diagnosis/BTHM_TiTask100Ms_P3" /begin REF_CHARACTERISTIC BTHM_TiTask100Ms_P /end REF_CHARACTERISTIC /end GROUP
/begin GROUP S42_BTHM_TiTask100Ms_P4 "swc_BatThermHndlgMngt/BTHM_100ms_sys/100ms/DataPrep/Diagnosis/BTHM_TiTask100Ms_P4" /begin REF_CHARACTERISTIC BTHM_TiTask100Ms_P /end REF_CHARACTERISTIC /end GROUP
/begin GROUP S42_BTHM_TiTask100Ms_P5 "swc_BatThermHndlgMngt/BTHM_100ms_sys/100ms/DataPrep/Diagnosis/BTHM_TiTask100Ms_P5" /begin REF_CHARACTERISTIC BTHM_TiTask100Ms_P /end REF_CHARACTERISTIC /end GROUP
/begin GROUP S42_BTHM_TiTask100Ms_P6 "swc_BatThermHndlgMngt/BTHM_100ms_sys/100ms/DataPrep/Diagnosis/BTHM_TiTask100Ms_P6" /begin REF_CHARACTERISTIC BTHM_TiTask100Ms_P /end REF_CHARACTERISTIC /end GROUP
/begin GROUP S42_BTHM_TiTask100Ms_P7 "swc_BatThermHndlgMngt/BTHM_100ms_sys/100ms/DataPrep/Diagnosis/BTHM_TiTask100Ms_P7" /begin REF_CHARACTERISTIC BTHM_TiTask100Ms_P /end REF_CHARACTERISTIC /end GROUP
/begin GROUP S42_BTHM_TiTask100Ms_P8 "swc_BatThermHndlgMngt/BTHM_100ms_sys/100ms/DataPrep/Diagnosis/BTHM_TiTask100Ms_P8" /begin REF_CHARACTERISTIC BTHM_TiTask100Ms_P /end REF_CHARACTERISTIC /end GROUP
/begin GROUP S42_BTHM_TiTask100Ms_P9 "swc_BatThermHndlgMngt/BTHM_100ms_sys/100ms/DataPrep/Diagnosis/BTHM_TiTask100Ms_P9" /begin REF_CHARACTERISTIC BTHM_TiTask100Ms_P /end REF_CHARACTERISTIC /end GROUP
/begin GROUP S448_BCF_CCellNom_M "swc_BatCoreFct/BCF_100ms_sys/BatCoreFct/PackObs/PackObsLoop/MdulObs/MdulSocObsr/MdulStateObs/MdulModel/ Process Equation, ffun/BCF_CCellNom_M" /begin REF_CHARACTERISTIC BCF_CCellNom_M /end REF_CHARACTERISTIC /end GROUP
/begin GROUP S448_BCF_Td_P "swc_BatCoreFct/BCF_100ms_sys/BatCoreFct/PackObs/PackObsLoop/MdulObs/MdulSocObsr/MdulStateObs/MdulModel/ Process Equation, ffun/BCF_Td_P" /begin REF_CHARACTERISTIC BCF_Td_P /end REF_CHARACTERISTIC /end GROUP
/begin GROUP S456_BCF_Td_P "swc_BatCoreFct/BCF_100ms_sys/BatCoreFct/PackObs/PackObsLoop/MdulObs/MdulSocObsr/MdulStateObs/MdulModel/ Process Equation, ffun/SimpleFilterState1/BCF_Td_P" /begin REF_CHARACTERISTIC BCF_Td_P /end REF_CHARACTERISTIC /end GROUP
/begin GROUP S457_BCF_Td_P "swc_BatCoreFct/BCF_100ms_sys/BatCoreFct/PackObs/PackObsLoop/MdulObs/MdulSocObsr/MdulStateObs/MdulModel/ Process Equation, ffun/SimpleFilterState2/BCF_Td_P" /begin REF_CHARACTERISTIC BCF_Td_P /end REF_CHARACTERISTIC /end GROUP
/begin GROUP S458_BCF_Td_P "swc_BatCoreFct/BCF_100ms_sys/BatCoreFct/PackObs/PackObsLoop/MdulObs/MdulSocObsr/MdulStateObs/MdulModel/ Process Equation, ffun/SimpleFilterState3/BCF_Td_P" /begin REF_CHARACTERISTIC BCF_Td_P /end REF_CHARACTERISTIC /end GROUP
/begin GROUP S479_BCF_Td_P "swc_BatCoreFct/BCF_100ms_sys/BatCoreFct/PackObs/PackObsLoop/MdulObs/MdulSocObsr/MdulTObs/T Estimation/TCoolt Estimation/BCF_Td_P" /begin REF_CHARACTERISTIC BCF_Td_P /end REF_CHARACTERISTIC /end GROUP
/begin GROUP S480_BCF_Td_P "swc_BatCoreFct/BCF_100ms_sys/BatCoreFct/PackObs/PackObsLoop/MdulObs/MdulSocObsr/MdulTObs/T Estimation/TMdul Estimation/BCF_Td_P" /begin REF_CHARACTERISTIC BCF_Td_P /end REF_CHARACTERISTIC /end GROUP
/begin GROUP S4_SMObc_TiProc_P "swc_BatChCtl/AC_10ms_sys/AC_10ms_sys/SMObc_TiProc_P" /begin REF_CHARACTERISTIC SMObc_TiProc_P /end REF_CHARACTERISTIC /end GROUP
/begin GROUP S542_BCF_RCellCnct_P "swc_BatCoreFct/BCF_100ms_sys/BatCoreFct/PackStateClcn/PackSofClcn/RPack Calculation/BCF_RCellCnct_P" /begin REF_CHARACTERISTIC BCF_RCellCnct_P /end REF_CHARACTERISTIC /end GROUP
/begin GROUP S566_BCF_Td_P "swc_BatCoreFct/BCF_100ms_sys/BatCoreFct/PackStateClcn/PackSofClcn/Pack Min Max Current Calculation (PwrLoss & U)/Find Max Current within the Temperature Limitations/Calc Power Loss Buffer/Simple Filter/BCF_Td_P" /begin REF_CHARACTERISTIC BCF_Td_P /end REF_CHARACTERISTIC /end GROUP
/begin GROUP S566_BCF_Td_P1 "swc_BatCoreFct/BCF_100ms_sys/BatCoreFct/PackStateClcn/PackSofClcn/Pack Min Max Current Calculation (PwrLoss & U)/Find Max Current within the Temperature Limitations/Calc Power Loss Buffer/Simple Filter/BCF_Td_P1" /begin REF_CHARACTERISTIC BCF_Td_P /end REF_CHARACTERISTIC /end GROUP
/begin GROUP S621_BCF_CCellNom_M "swc_BatCoreFct/BCF_100ms_sys/BatCoreFct/PackStateClcn/PackSofClcn/Pack Min Max Current Calculation (PwrLoss & U)/Pred Worst Cell Voltages and Power Losses/Predict average cell voltages/Predict Average Cell Voltages/ Process Equation, ffun/BCF_CCellNom_M" /begin REF_CHARACTERISTIC BCF_CCellNom_M /end REF_CHARACTERISTIC /end GROUP
/begin GROUP S622_BCF_SocLnrznDelta_P "swc_BatCoreFct/BCF_100ms_sys/BatCoreFct/PackStateClcn/PackSofClcn/Pack Min Max Current Calculation (PwrLoss & U)/Pred Worst Cell Voltages and Power Losses/Predict average cell voltages/Predict Average Cell Voltages/Measurement Equation hfun/BCF_SocLnrznDe" /begin REF_CHARACTERISTIC BCF_SocLnrznDelta_P /end REF_CHARACTERISTIC /end GROUP
/begin GROUP S65_BitSelect "swc_EltlLnkHzrdProtnNet/ELHPN_10ms_sys/ELHPN_10ms_sys/HighVoltageInterlock /InitialCheck/BitSelect" /begin REF_CHARACTERISTIC ELHPN_Csw_P /end REF_CHARACTERISTIC /end GROUP
/begin GROUP S65_ELHPN_TiSample1 "swc_EltlLnkHzrdProtnNet/ELHPN_10ms_sys/ELHPN_10ms_sys/HighVoltageInterlock /InitialCheck/ELHPN_TiSample1" /begin REF_CHARACTERISTIC ELHPN_TiSample1 /end REF_CHARACTERISTIC /end GROUP
/begin GROUP S67_BCF_Td_P "swc_BatCoreFct/BCF_100ms_sys/BatCoreFct/SensorDelayForISD/BCF_Td_P" /begin REF_CHARACTERISTIC BCF_Td_P /end REF_CHARACTERISTIC /end GROUP
/begin GROUP S67_BCF_TiDlyForThrwyT_P "swc_BatCoreFct/BCF_100ms_sys/BatCoreFct/SensorDelayForISD/BCF_TiDlyForThrwyT_P" /begin REF_CHARACTERISTIC BCF_TiDlyForThrwyT_P /end REF_CHARACTERISTIC /end GROUP
/begin GROUP S700_BCF_CCellNom_M "swc_BatCoreFct/BCF_100ms_sys/BatCoreFct/PackStateClcn/PackSofClcn/Pack Min Max Voltage Prediction/Module Min Max Voltage Prediction/SOF Actual/ Process Equation, ffun/BCF_CCellNom_M" /begin REF_CHARACTERISTIC BCF_CCellNom_M /end REF_CHARACTERISTIC /end GROUP
/begin GROUP S717_BCF_CCellNom_M "swc_BatCoreFct/BCF_100ms_sys/BatCoreFct/PackStateClcn/PackSofClcn/Pack Min Max Voltage Prediction/Module Min Max Voltage Prediction/SOF Pred/ Process Equation, ffun/BCF_CCellNom_M" /begin REF_CHARACTERISTIC BCF_CCellNom_M /end REF_CHARACTERISTIC /end GROUP
/begin GROUP S72_BitSelect "swc_BatProtnIU/CellUDiag/100ms/CellVoltageDiagnosis/CellVoltageLimitCore/SelfCheck/BitSelect" /begin REF_CHARACTERISTIC BPIU_bAcvSwtDtc_P /end REF_CHARACTERISTIC /end GROUP
/begin GROUP S72_BPIU_TiChkOnDig63_P "swc_BatProtnIU/CellUDiag/100ms/CellVoltageDiagnosis/CellVoltageLimitCore/SelfCheck/BPIU_TiChkOnDig63_P" /begin REF_CHARACTERISTIC BPIU_TiChkOnDig63_P /end REF_CHARACTERISTIC /end GROUP
/begin GROUP S72_BPIU_TiSample2_P4 "swc_BatProtnIU/CellUDiag/100ms/CellVoltageDiagnosis/CellVoltageLimitCore/SelfCheck/BPIU_TiSample2_P4" /begin REF_CHARACTERISTIC BPIU_TiSample2_P /end REF_CHARACTERISTIC /end GROUP
/begin GROUP S73_BCF_SocInin_M "swc_BatCoreFct/BCF_100ms_sys/BatCoreFct/BatCoreInit/OCVInitializationServiceMode/BCF_SocInin_M" /begin REF_CHARACTERISTIC BCF_SocInin_M /end REF_CHARACTERISTIC /end GROUP
/begin GROUP S74_BTHM_TiTask100Ms_P "swc_BatThermHndlgMngt/BTHM_100ms_sys/100ms/DataPrep/DataClcn/TPackDif/BTHM_TiTask100Ms_P" /begin REF_CHARACTERISTIC BTHM_TiTask100Ms_P /end REF_CHARACTERISTIC /end GROUP
/begin GROUP S86_BitSelect "swc_EltlLnkHzrdProtnNet/ELHPN_10ms_sys/ELHPN_10ms_sys/StateIsolation/StIsln/VehicleIsolationError/BitSelect" /begin REF_CHARACTERISTIC ELHPN_Csw_P /end REF_CHARACTERISTIC /end GROUP
/begin GROUP S86_ELHPN_TiSample1 "swc_EltlLnkHzrdProtnNet/ELHPN_10ms_sys/ELHPN_10ms_sys/StateIsolation/StIsln/VehicleIsolationError/ELHPN_TiSample1" /begin REF_CHARACTERISTIC ELHPN_TiSample1 /end REF_CHARACTERISTIC /end GROUP
/begin GROUP S87_ELHPN_TiSample1 "swc_EltlLnkHzrdProtnNet/ELHPN_10ms_sys/ELHPN_10ms_sys/StateIsolation/StIsln/VehicleIsolationState/ELHPN_TiSample1" /begin REF_CHARACTERISTIC ELHPN_TiSample1 /end REF_CHARACTERISTIC /end GROUP
/begin GROUP S87_ELHPN_TiSample11 "swc_EltlLnkHzrdProtnNet/ELHPN_10ms_sys/ELHPN_10ms_sys/StateIsolation/StIsln/VehicleIsolationState/ELHPN_TiSample11" /begin REF_CHARACTERISTIC ELHPN_TiSample1 /end REF_CHARACTERISTIC /end GROUP
/begin GROUP S88_BitSelect "swc_EltlLnkHzrdProtnNet/ELHPN_10ms_sys/ELHPN_10ms_sys/StateIsolation/StIsln/ElectrodesErrorLevel/Debounce1/BitSelect" /begin REF_CHARACTERISTIC ELHPN_Csw_P /end REF_CHARACTERISTIC /end GROUP
/begin GROUP S88_BitSelect1 "swc_EltlLnkHzrdProtnNet/ELHPN_10ms_sys/ELHPN_10ms_sys/StateIsolation/StIsln/ElectrodesErrorLevel/Debounce1/BitSelect1" /begin REF_CHARACTERISTIC ELHPN_Csw_P /end REF_CHARACTERISTIC /end GROUP
/begin GROUP S88_ELHPN_TiSample1 "swc_EltlLnkHzrdProtnNet/ELHPN_10ms_sys/ELHPN_10ms_sys/StateIsolation/StIsln/ElectrodesErrorLevel/Debounce1/ELHPN_TiSample1" /begin REF_CHARACTERISTIC ELHPN_TiSample1 /end REF_CHARACTERISTIC /end GROUP
/begin GROUP S88_ELHPN_TiSample11 "swc_EltlLnkHzrdProtnNet/ELHPN_10ms_sys/ELHPN_10ms_sys/StateIsolation/StIsln/ElectrodesErrorLevel/Debounce1/ELHPN_TiSample11" /begin REF_CHARACTERISTIC ELHPN_TiSample1 /end REF_CHARACTERISTIC /end GROUP
/begin GROUP S89_BitSelect "swc_EltlLnkHzrdProtnNet/ELHPN_10ms_sys/ELHPN_10ms_sys/StateIsolation/StIsln/ElectrodesErrorLevel/Debounce2/BitSelect" /begin REF_CHARACTERISTIC ELHPN_Csw_P /end REF_CHARACTERISTIC /end GROUP
/begin GROUP S89_BitSelect1 "swc_EltlLnkHzrdProtnNet/ELHPN_10ms_sys/ELHPN_10ms_sys/StateIsolation/StIsln/ElectrodesErrorLevel/Debounce2/BitSelect1" /begin REF_CHARACTERISTIC ELHPN_Csw_P /end REF_CHARACTERISTIC /end GROUP
/begin GROUP S89_ELHPN_TiSample1 "swc_EltlLnkHzrdProtnNet/ELHPN_10ms_sys/ELHPN_10ms_sys/StateIsolation/StIsln/ElectrodesErrorLevel/Debounce2/ELHPN_TiSample1" /begin REF_CHARACTERISTIC ELHPN_TiSample1 /end REF_CHARACTERISTIC /end GROUP
/begin GROUP S89_ELHPN_TiSample11 "swc_EltlLnkHzrdProtnNet/ELHPN_10ms_sys/ELHPN_10ms_sys/StateIsolation/StIsln/ElectrodesErrorLevel/Debounce2/ELHPN_TiSample11" /begin REF_CHARACTERISTIC ELHPN_TiSample1 /end REF_CHARACTERISTIC /end GROUP
/begin GROUP S92_BSTC_TiProc_P "swc_BcuStTranCtl/BcuStTranCtl_sys/BcuStTranCtl/ConditionConfirm/ShutdownDetection/BSTC_TiProc_P" /begin REF_CHARACTERISTIC BSTC_TiProc_P /end REF_CHARACTERISTIC /end GROUP
/begin GROUP S92_BSTC_TiProc_P1 "swc_BcuStTranCtl/BcuStTranCtl_sys/BcuStTranCtl/ConditionConfirm/ShutdownDetection/BSTC_TiProc_P1" /begin REF_CHARACTERISTIC BSTC_TiProc_P /end REF_CHARACTERISTIC /end GROUP
/begin GROUP S92_BSTC_TiProc_P2 "swc_BcuStTranCtl/BcuStTranCtl_sys/BcuStTranCtl/ConditionConfirm/ShutdownDetection/BSTC_TiProc_P2" /begin REF_CHARACTERISTIC BSTC_TiProc_P /end REF_CHARACTERISTIC /end GROUP
/begin GROUP S96_BBC_RCellBaln_P "swc_BatBalnCtl/BBC_100ms_sys/BBC_100ms_sys/BatBalnCtl_BalnIClcn/Subsystem/Balancing Current Calculation Loop/Balancing Current Calculation and Compensation Loop/BBC_RCellBaln_P" /begin REF_CHARACTERISTIC BBC_RCellBaln_P /end REF_CHARACTERISTIC /end GROUP
/begin RECORD_LAYOUT Lookup1D_BOOLEAN FNC_VALUES 1 UBYTE COLUMN_DIR DIRECT /end RECORD_LAYOUT
/begin RECORD_LAYOUT Lookup1D_BYTE FNC_VALUES 1 SBYTE COLUMN_DIR DIRECT /end RECORD_LAYOUT
/begin RECORD_LAYOUT Lookup1D_FLOAT32_IEEE FNC_VALUES 1 FLOAT32_IEEE COLUMN_DIR DIRECT /end RECORD_LAYOUT
/begin RECORD_LAYOUT Lookup1D_FLOAT64_IEEE FNC_VALUES 1 FLOAT64_IEEE COLUMN_DIR DIRECT /end RECORD_LAYOUT
/begin RECORD_LAYOUT Lookup1D_SLONG FNC_VALUES 1 SLONG COLUMN_DIR DIRECT /end RECORD_LAYOUT
/begin RECORD_LAYOUT Lookup1D_UBYTE FNC_VALUES 1 UBYTE COLUMN_DIR DIRECT /end RECORD_LAYOUT
/begin RECORD_LAYOUT Lookup1D_ULONG FNC_VALUES 1 ULONG COLUMN_DIR DIRECT /end RECORD_LAYOUT
/begin RECORD_LAYOUT Lookup1D_UWORD FNC_VALUES 1 UWORD COLUMN_DIR DIRECT /end RECORD_LAYOUT
/begin RECORD_LAYOUT Lookup1D_WORD FNC_VALUES 1 SWORD COLUMN_DIR DIRECT /end RECORD_LAYOUT
/begin RECORD_LAYOUT Lookup1D_X_BOOLEAN AXIS_PTS_X 1 UBYTE INDEX_INCR DIRECT /end RECORD_LAYOUT
/begin RECORD_LAYOUT Lookup1D_X_BYTE AXIS_PTS_X 1 SBYTE INDEX_INCR DIRECT /end RECORD_LAYOUT
/begin RECORD_LAYOUT Lookup1D_X_FLOAT32_IEEE AXIS_PTS_X 1 FLOAT32_IEEE INDEX_INCR DIRECT /end RECORD_LAYOUT
/begin RECORD_LAYOUT Lookup1D_X_UBYTE AXIS_PTS_X 1 UBYTE INDEX_INCR DIRECT /end RECORD_LAYOUT
/begin RECORD_LAYOUT Lookup1D_X_ULONG AXIS_PTS_X 1 ULONG INDEX_INCR DIRECT /end RECORD_LAYOUT
/begin RECORD_LAYOUT Lookup2D_FLOAT32_IEEE FNC_VALUES 1 FLOAT32_IEEE COLUMN_DIR DIRECT /end RECORD_LAYOUT
/begin RECORD_LAYOUT Lookup2D_X_BYTE AXIS_PTS_X 1 SBYTE INDEX_INCR DIRECT /end RECORD_LAYOUT
/begin RECORD_LAYOUT Lookup2D_X_FLOAT32_IEEE AXIS_PTS_X 1 FLOAT32_IEEE INDEX_INCR DIRECT /end RECORD_LAYOUT
/begin RECORD_LAYOUT Scalar_BOOLEAN FNC_VALUES 1 UBYTE COLUMN_DIR DIRECT /end RECORD_LAYOUT
/begin RECORD_LAYOUT Scalar_BYTE FNC_VALUES 1 SBYTE COLUMN_DIR DIRECT /end RECORD_LAYOUT
/begin RECORD_LAYOUT Scalar_FLOAT32_IEEE FNC_VALUES 1 FLOAT32_IEEE COLUMN_DIR DIRECT /end RECORD_LAYOUT
/begin RECORD_LAYOUT Scalar_UBYTE FNC_VALUES 1 UBYTE COLUMN_DIR DIRECT /end RECORD_LAYOUT
/begin RECORD_LAYOUT Scalar_ULONG FNC_VALUES 1 ULONG COLUMN_DIR DIRECT /end RECORD_LAYOUT
/begin RECORD_LAYOUT Scalar_UWORD FNC_VALUES 1 UWORD COLUMN_DIR DIRECT /end RECORD_LAYOUT
/end MODULE
/end PROJECT
