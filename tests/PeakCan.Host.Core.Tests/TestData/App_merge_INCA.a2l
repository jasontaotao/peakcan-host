ASAP2_VERSION 1 40
/begin PROJECT ProjectName "Project Comment Goes Here"
/begin HEADER "Header Comments go here" /end HEADER
/begin MODULE ModuleName "Module Comment Goes Here"
/begin MOD_COMMON "Mod Common Comment Here" BYTE_ORDER MSB_LAST ALIGNMENT_BYTE 1 ALIGNMENT_WORD 1 ALIGNMENT_LONG 1 ALIGNMENT_FLOAT32_IEEE 1 ALIGNMENT_FLOAT64_IEEE 1 /end MOD_COMMON
/begin COMPU_METHOD swc_BatBalnCtl_CM_single_dash_ "Q = V" RAT_FUNC "%8.6" "-" COEFFS 0 1 0 0 0 1 /end COMPU_METHOD
/begin COMPU_METHOD swc_BatChCtl_CM_single__ "Q = V" RAT_FUNC "%8.6" "癈" COEFFS 0 1 0 0 0 1 /end COMPU_METHOD
/begin COMPU_METHOD swc_BatChCtl_CM_single_A "Q = V" RAT_FUNC "%8.6" "A" COEFFS 0 1 0 0 0 1 /end COMPU_METHOD
/begin COMPU_METHOD swc_BatChCtl_CM_single_dash_ "Q = V" RAT_FUNC "%8.6" "-" COEFFS 0 1 0 0 0 1 /end COMPU_METHOD
/begin COMPU_METHOD swc_BatChCtl_CM_single_percent_ "Q = V" RAT_FUNC "%8.6" "%" COEFFS 0 1 0 0 0 1 /end COMPU_METHOD
/begin COMPU_METHOD swc_BatCoreFct_CM_boolean_dash_ "Q = V" RAT_FUNC "%1.0" "-" COEFFS 0 1 0 0 0 1 /end COMPU_METHOD
/begin COMPU_METHOD swc_BatCoreFct_CM_int16_dash_ "Q = V" RAT_FUNC "%5.0" "-" COEFFS 0 1 0 0 0 1 /end COMPU_METHOD
/begin COMPU_METHOD swc_BatCoreFct_CM_single__ "Q = V" RAT_FUNC "%8.6" "癈" COEFFS 0 1 0 0 0 1 /end COMPU_METHOD
/begin COMPU_METHOD swc_BatCoreFct_CM_single_dash_ "Q = V" RAT_FUNC "%8.6" "-" COEFFS 0 1 0 0 0 1 /end COMPU_METHOD
/begin COMPU_METHOD swc_BatCoreFct_CM_single_s "Q = V" RAT_FUNC "%8.6" "s" COEFFS 0 1 0 0 0 1 /end COMPU_METHOD
/begin COMPU_METHOD swc_BatCoreFct_CM_single_V "Q = V" RAT_FUNC "%8.6" "V" COEFFS 0 1 0 0 0 1 /end COMPU_METHOD
/begin COMPU_METHOD swc_BatCoreFct_CM_single_W "Q = V" RAT_FUNC "%8.6" "W" COEFFS 0 1 0 0 0 1 /end COMPU_METHOD
/begin COMPU_METHOD swc_BatCoreFct_CM_uint16_dash_ "Q = V" RAT_FUNC "%5.0" "-" COEFFS 0 1 0 0 0 1 /end COMPU_METHOD
/begin COMPU_METHOD swc_BatCoreFct_CM_uint32_s "Q = V" RAT_FUNC "%10.0" "s" COEFFS 0 1 0 0 0 1 /end COMPU_METHOD
/begin COMPU_METHOD swc_BatCoreFct_CM_uint8_dash_ "Q = V" RAT_FUNC "%3.0" "-" COEFFS 0 1 0 0 0 1 /end COMPU_METHOD
/begin COMPU_METHOD swc_BatProtnIU_CM_single_A "Q = V" RAT_FUNC "%8.6" "A" COEFFS 0 1 0 0 0 1 /end COMPU_METHOD
/begin COMPU_METHOD swc_BatProtnIU_CM_single_dash_ "Q = V" RAT_FUNC "%8.6" "-" COEFFS 0 1 0 0 0 1 /end COMPU_METHOD
/begin COMPU_METHOD swc_BatProtnIU_CM_single_s "Q = V" RAT_FUNC "%8.6" "s" COEFFS 0 1 0 0 0 1 /end COMPU_METHOD
/begin COMPU_METHOD swc_BatProtnIU_CM_single_V "Q = V" RAT_FUNC "%8.6" "V" COEFFS 0 1 0 0 0 1 /end COMPU_METHOD
/begin COMPU_METHOD swc_BatProtnIU_CM_uint8_dash_ "Q = V" RAT_FUNC "%3.0" "-" COEFFS 0 1 0 0 0 1 /end COMPU_METHOD
/begin COMPU_METHOD swc_CIL_CM_single__ "Q = V" RAT_FUNC "%8.6" "癈" COEFFS 0 1 0 0 0 1 /end COMPU_METHOD
/begin COMPU_METHOD swc_CIL_CM_single_V "Q = V" RAT_FUNC "%8.6" "V" COEFFS 0 1 0 0 0 1 /end COMPU_METHOD
/begin COMPU_METHOD swc_CIL_CM_uint16_dash_ "Q = V" RAT_FUNC "%5.0" "-" COEFFS 0 1 0 0 0 1 /end COMPU_METHOD
/begin COMPU_METHOD swc_CIL_CM_uint8_A "Q = V" RAT_FUNC "%3.0" "A" COEFFS 0 1 0 0 0 1 /end COMPU_METHOD
/begin COMPU_METHOD swc_CIL_CM_uint8_dash_ "Q = V" RAT_FUNC "%3.0" "-" COEFFS 0 1 0 0 0 1 /end COMPU_METHOD
/begin COMPU_METHOD swc_COL_CM_single___C "Q = V" RAT_FUNC "%8.6" "??C" COEFFS 0 1 0 0 0 1 /end COMPU_METHOD
/begin COMPU_METHOD swc_COL_CM_single_A "Q = V" RAT_FUNC "%8.6" "A" COEFFS 0 1 0 0 0 1 /end COMPU_METHOD
/begin COMPU_METHOD swc_COL_CM_single_dash_ "Q = V" RAT_FUNC "%8.6" "-" COEFFS 0 1 0 0 0 1 /end COMPU_METHOD
/begin COMPU_METHOD swc_COL_CM_single_km "Q = V" RAT_FUNC "%8.6" "km" COEFFS 0 1 0 0 0 1 /end COMPU_METHOD
/begin COMPU_METHOD swc_COL_CM_single_percent_ "Q = V" RAT_FUNC "%8.6" "%" COEFFS 0 1 0 0 0 1 /end COMPU_METHOD
/begin COMPU_METHOD swc_COL_CM_single_V "Q = V" RAT_FUNC "%8.6" "V" COEFFS 0 1 0 0 0 1 /end COMPU_METHOD
/begin COMPU_METHOD swc_COL_CM_uint16_Ah "Q = V" RAT_FUNC "%5.0" "Ah" COEFFS 0 1 0 0 0 1 /end COMPU_METHOD
/begin COMPU_METHOD swc_COL_CM_uint16_dash_ "Q = V" RAT_FUNC "%5.0" "-" COEFFS 0 1 0 0 0 1 /end COMPU_METHOD
/begin COMPU_METHOD swc_COL_CM_uint16_km "Q = V" RAT_FUNC "%5.0" "km" COEFFS 0 1 0 0 0 1 /end COMPU_METHOD
/begin COMPU_METHOD swc_COL_CM_uint16_kWh "Q = V" RAT_FUNC "%5.0" "kWh" COEFFS 0 1 0 0 0 1 /end COMPU_METHOD
/begin COMPU_METHOD swc_COL_CM_uint16_min "Q = V" RAT_FUNC "%5.0" "min" COEFFS 0 1 0 0 0 1 /end COMPU_METHOD
/begin COMPU_METHOD swc_COL_CM_uint16_V "Q = V" RAT_FUNC "%5.0" "V" COEFFS 0 1 0 0 0 1 /end COMPU_METHOD
/begin COMPU_METHOD swc_COL_CM_uint8___C "Q = V" RAT_FUNC "%3.0" "??C" COEFFS 0 1 0 0 0 1 /end COMPU_METHOD
/begin COMPU_METHOD swc_COL_CM_uint8_A "Q = V" RAT_FUNC "%3.0" "A" COEFFS 0 1 0 0 0 1 /end COMPU_METHOD
/begin COMPU_METHOD swc_COL_CM_uint8_dash_ "Q = V" RAT_FUNC "%3.0" "-" COEFFS 0 1 0 0 0 1 /end COMPU_METHOD
/begin COMPU_METHOD swc_COL_CM_uint8_percent_ "Q = V" RAT_FUNC "%3.0" "%" COEFFS 0 1 0 0 0 1 /end COMPU_METHOD
/begin COMPU_METHOD swc_CtctrTranCtl_CM_boolean_dash_ "Q = V" RAT_FUNC "%1.0" "-" COEFFS 0 1 0 0 0 1 /end COMPU_METHOD
/begin COMPU_METHOD swc_CtctrTranCtl_CM_single_A "Q = V" RAT_FUNC "%8.6" "A" COEFFS 0 1 0 0 0 1 /end COMPU_METHOD
/begin COMPU_METHOD swc_CtctrTranCtl_CM_single_dash_ "Q = V" RAT_FUNC "%8.6" "-" COEFFS 0 1 0 0 0 1 /end COMPU_METHOD
/begin COMPU_METHOD swc_CtctrTranCtl_CM_single_s "Q = V" RAT_FUNC "%8.6" "s" COEFFS 0 1 0 0 0 1 /end COMPU_METHOD
/begin COMPU_METHOD swc_CtctrTranCtl_CM_single_V "Q = V" RAT_FUNC "%8.6" "V" COEFFS 0 1 0 0 0 1 /end COMPU_METHOD
/begin COMPU_METHOD swc_CtctrTranCtl_CM_single_V_per_s "Q = V" RAT_FUNC "%8.6" "V/s" COEFFS 0 1 0 0 0 1 /end COMPU_METHOD
/begin COMPU_METHOD swc_CtctrTranCtl_CM_uint32_dash_ "Q = V" RAT_FUNC "%10.0" "-" COEFFS 0 1 0 0 0 1 /end COMPU_METHOD
/begin COMPU_METHOD swc_CtctrTranCtl_CM_uint8_dash_ "Q = V" RAT_FUNC "%3.0" "-" COEFFS 0 1 0 0 0 1 /end COMPU_METHOD
/begin COMPU_METHOD swc_EltlLnkHzrdProtnNet_CM_boolean_dash_ "Q = V" RAT_FUNC "%1.0" "-" COEFFS 0 1 0 0 0 1 /end COMPU_METHOD
/begin COMPU_METHOD swc_EltlLnkHzrdProtnNet_CM_single_Hz "Q = V" RAT_FUNC "%8.6" "Hz" COEFFS 0 1 0 0 0 1 /end COMPU_METHOD
/begin COMPU_METHOD swc_EltlLnkHzrdProtnNet_CM_single_percent_ "Q = V" RAT_FUNC "%8.6" "%" COEFFS 0 1 0 0 0 1 /end COMPU_METHOD
/begin COMPU_METHOD swc_EltlLnkHzrdProtnNet_CM_single_s "Q = V" RAT_FUNC "%8.6" "s" COEFFS 0 1 0 0 0 1 /end COMPU_METHOD
/begin COMPU_METHOD swc_EltlLnkHzrdProtnNet_CM_uint32_dash_ "Q = V" RAT_FUNC "%10.0" "-" COEFFS 0 1 0 0 0 1 /end COMPU_METHOD
/begin COMPU_METHOD swc_EltlLnkHzrdProtnNet_CM_uint32_Hz "Q = V" RAT_FUNC "%10.0" "Hz" COEFFS 0 1 0 0 0 1 /end COMPU_METHOD
/begin COMPU_METHOD swc_EltlLnkHzrdProtnNet_CM_uint32_percent_ "Q = V" RAT_FUNC "%10.0" "%" COEFFS 0 1 0 0 0 1 /end COMPU_METHOD
/begin COMPU_METHOD swc_EltlLnkHzrdProtnNet_CM_uint8_dash_ "Q = V" RAT_FUNC "%3.0" "-" COEFFS 0 1 0 0 0 1 /end COMPU_METHOD
/begin CHARACTERISTIC B2V_ST1_ChgMode_P "Charging mode (0x0: Reserved\n      0x1: DC charging\n      0x2: AC charging\n      0x3: Other charging)" VALUE 0x20019CB2 Scalar_UBYTE 0 swc_COL_CM_uint8_dash_ 0 255 /end CHARACTERISTIC
/begin MEASUREMENT BBC_TBalnRAvg "Balancing Resistor Temperatures Average Per Module" FLOAT32_IEEE swc_BatBalnCtl_CM_single_dash_ 0 0 -3.40282346639e+038 3.40282346639e+038 ECU_ADDRESS 0x1FFE3C20 MATRIX_DIM 24 1 1 /end MEASUREMENT
/begin MEASUREMENT BBC_TBalnRPas "Balancing Resistor Temperatures" FLOAT32_IEEE swc_BatBalnCtl_CM_single_dash_ 0 0 -3.40282346639e+038 3.40282346639e+038 ECU_ADDRESS 0x1FFE3C80 MATRIX_DIM 255 1 1 /end MEASUREMENT
/begin MEASUREMENT BCF_CMdulAgiFacErrCt "C Module Ageing Factor Error Counter" SWORD swc_BatCoreFct_CM_int16_dash_ 0 0 -32768 32767 ECU_ADDRESS 0x20001134 MATRIX_DIM 24 1 1 /end MEASUREMENT
/begin MEASUREMENT BCF_CMdulAgiFacFls "Modules capacity ageing factor stored" FLOAT32_IEEE swc_BatCoreFct_CM_single_dash_ 0 0 -3.40282346639e+038 3.40282346639e+038 ECU_ADDRESS 0x20001224 MATRIX_DIM 24 1 1 /end MEASUREMENT
/begin MEASUREMENT BCF_CMdulAgiFacTrip "Modules capacity ageing factor used online" FLOAT32_IEEE swc_BatCoreFct_CM_single_dash_ 0 0 -3.40282346639e+038 3.40282346639e+038 ECU_ADDRESS 0x200012E4 MATRIX_DIM 24 1 1 /end MEASUREMENT
/begin MEASUREMENT BCF_ChMdulIntgl "Integrated charge to use as reference Soc for MdulCObs" FLOAT32_IEEE swc_BatCoreFct_CM_single_dash_ 0 0 -3.40282346639e+038 3.40282346639e+038 ECU_ADDRESS 0x200013A4 MATRIX_DIM 24 1 1 /end MEASUREMENT
/begin CHARACTERISTIC BCF_ErrLimOfRDeltaCdn_P "Error Limit for R Cell Delta Signal (invalid model operating region)" VALUE 0x1FFE802C Scalar_FLOAT32_IEEE 0 swc_BatCoreFct_CM_single_dash_ -3.40282346639e+038 3.40282346639e+038 /end CHARACTERISTIC
/begin CHARACTERISTIC BCF_ErrLimOfRDelta_P "Error Limit for R Cell Delta Signal (valid model operating region)" VALUE 0x1FFE8030 Scalar_FLOAT32_IEEE 0 swc_BatCoreFct_CM_single_dash_ -3.40282346639e+038 3.40282346639e+038 /end CHARACTERISTIC
/begin CHARACTERISTIC BCF_ErrLimOfSocDeltaCdn_P "Error Limit for Soc Cell Delta Signal (invalid operating region of the model)" VALUE 0x1FFE8034 Scalar_FLOAT32_IEEE 0 swc_BatCoreFct_CM_single_dash_ -3.40282346639e+038 3.40282346639e+038 /end CHARACTERISTIC
/begin CHARACTERISTIC BCF_ErrLimOfSocDelta_P "Error Limit for Soc Cell Delta Signal (valid operating region of the model)" VALUE 0x1FFE8038 Scalar_FLOAT32_IEEE 0 swc_BatCoreFct_CM_single_dash_ -3.40282346639e+038 3.40282346639e+038 /end CHARACTERISTIC
/begin CHARACTERISTIC BCF_FacRCellDelta_P "Scaling parameter for weighting the deltaR estimation as part of the cell observer" VALUE 0x1FFE8068 Scalar_FLOAT32_IEEE 0 swc_BatCoreFct_CM_single_dash_ -3.40282346639e+038 3.40282346639e+038 /end CHARACTERISTIC
/begin CHARACTERISTIC BCF_RCellDeltaHiLim_P "DeltaRCell higher limit" VALUE 0x1FFE9E40 Scalar_FLOAT32_IEEE 0 swc_BatCoreFct_CM_single_dash_ -3.40282346639e+038 3.40282346639e+038 /end CHARACTERISTIC
/begin CHARACTERISTIC BCF_RCellDeltaLoLim_P "DeltaRCell lower limit" VALUE 0x1FFE9E44 Scalar_FLOAT32_IEEE 0 swc_BatCoreFct_CM_single_dash_ -3.40282346639e+038 3.40282346639e+038 /end CHARACTERISTIC
/begin MEASUREMENT BCF_RMdulAgiFacErrCt "R Module Ageing Factor Error Counter" SWORD swc_BatCoreFct_CM_int16_dash_ 0 0 -32768 32767 ECU_ADDRESS 0x20001164 MATRIX_DIM 24 1 1 /end MEASUREMENT
/begin MEASUREMENT BCF_RMdulAgiFacFls "Module resistance ageing factors stored" FLOAT32_IEEE swc_BatCoreFct_CM_single_dash_ 0 0 -3.40282346639e+038 3.40282346639e+038 ECU_ADDRESS 0x20001934 MATRIX_DIM 24 1 1 /end MEASUREMENT
/begin MEASUREMENT BCF_RMdulAgiFacTrip "Module resistance ageing factors used online" FLOAT32_IEEE swc_BatCoreFct_CM_single_dash_ 0 0 -3.40282346639e+038 3.40282346639e+038 ECU_ADDRESS 0x200019F4 MATRIX_DIM 24 1 1 /end MEASUREMENT
/begin CHARACTERISTIC BCF_RMdulLamWithBaln_P "Forgetting factor for Recursive Regression in the Cell Observer and the Module Resistance observer with Balancing" VALUE 0x1FFE9F50 Scalar_FLOAT32_IEEE 0 swc_BatCoreFct_CM_single_dash_ -3.40282346639e+038 3.40282346639e+038 /end CHARACTERISTIC
/begin CHARACTERISTIC BCF_RMdulLamWoutBaln_P "Forgetting factor for Recursive Regression in the Cell Observer and the Module Resistance observer without Balancing " VALUE 0x1FFE9F54 Scalar_FLOAT32_IEEE 0 swc_BatCoreFct_CM_single_dash_ -3.40282346639e+038 3.40282346639e+038 /end CHARACTERISTIC
/begin CHARACTERISTIC BCF_RMdulWtngWithBaln_P "Weight for RLS data with Balancing" VALUE 0x1FFE9F60 Scalar_FLOAT32_IEEE 0 swc_BatCoreFct_CM_single_dash_ -3.40282346639e+038 3.40282346639e+038 /end CHARACTERISTIC
/begin CHARACTERISTIC BCF_SocCellDeltaHiLim_P "DeltaSOCCell higher limit" VALUE 0x1FFEA190 Scalar_FLOAT32_IEEE 0 swc_BatCoreFct_CM_single_dash_ -3.40282346639e+038 3.40282346639e+038 /end CHARACTERISTIC
/begin CHARACTERISTIC BCF_SocCellDeltaLoLim_P "DeltaSOCCell lower limit" VALUE 0x1FFEA194 Scalar_FLOAT32_IEEE 0 swc_BatCoreFct_CM_single_dash_ -3.40282346639e+038 3.40282346639e+038 /end CHARACTERISTIC
/begin MEASUREMENT BCF_SocMdulInvldFlsRaw "Soc Estimation Error Flag per Module Raw" UBYTE swc_BatCoreFct_CM_uint8_dash_ 0 0 0 255 ECU_ADDRESS 0x20003B64 MATRIX_DIM 24 1 1 /end MEASUREMENT
/begin MEASUREMENT BCF_SofCellPwrLoss "Memory Block for SOF Power Loss Filter" FLOAT32_IEEE swc_BatCoreFct_CM_single_W 0 0 -3.40282346639e+038 3.40282346639e+038 ECU_ADDRESS 0x20002388 /end MEASUREMENT
/begin MEASUREMENT BCF_SohPackMinFls "Minimum of all Soh Pack Values stored in flash" FLOAT32_IEEE swc_BatCoreFct_CM_single_dash_ 0 0 -3.40282346639e+038 3.40282346639e+038 ECU_ADDRESS 0x20002390 /end MEASUREMENT
/begin MEASUREMENT BCF_SohRDeltaFls "Delta R based SOH value in flash" FLOAT32_IEEE swc_BatCoreFct_CM_single_dash_ 0 0 -3.40282346639e+038 3.40282346639e+038 ECU_ADDRESS 0x20002394 MATRIX_DIM 24 1 1 /end MEASUREMENT
/begin MEASUREMENT BCF_SohRDeltaOfTrip "Delta R based SOH during the trip" FLOAT32_IEEE swc_BatCoreFct_CM_single_dash_ 0 0 -3.40282346639e+038 3.40282346639e+038 ECU_ADDRESS 0x20002454 MATRIX_DIM 24 1 1 /end MEASUREMENT
/begin MEASUREMENT BCF_SohRDeltaOfTripRef "R Cell Delta based SOH reference value (initialized from flash value each trip)" FLOAT32_IEEE swc_BatCoreFct_CM_single_dash_ 0 0 -3.40282346639e+038 3.40282346639e+038 ECU_ADDRESS 0x200024B4 MATRIX_DIM 24 1 1 /end MEASUREMENT
/begin MEASUREMENT BCF_SohSocDeltaFls "DeltaSOC based SOH value in flash" FLOAT32_IEEE swc_BatCoreFct_CM_single_dash_ 0 0 -3.40282346639e+038 3.40282346639e+038 ECU_ADDRESS 0x20002574 MATRIX_DIM 24 1 1 /end MEASUREMENT
/begin MEASUREMENT BCF_SohSocDeltaOfTrip "DeltaSOC based SOH during the trip" FLOAT32_IEEE swc_BatCoreFct_CM_single_dash_ 0 0 -3.40282346639e+038 3.40282346639e+038 ECU_ADDRESS 0x20002634 MATRIX_DIM 24 1 1 /end MEASUREMENT
/begin MEASUREMENT BCF_SohSocDeltaOfTripRef "Soc Cell Delta based SOH reference value (initialized from flash value each trip)" FLOAT32_IEEE swc_BatCoreFct_CM_single_dash_ 0 0 -3.40282346639e+038 3.40282346639e+038 ECU_ADDRESS 0x20002694 MATRIX_DIM 24 1 1 /end MEASUREMENT
/begin MEASUREMENT BCF_StAryFls "Module model states of electrical and thermal model" FLOAT32_IEEE swc_BatCoreFct_CM_single_dash_ 0 0 -3.40282346639e+038 3.40282346639e+038 ECU_ADDRESS 0x200026F4 MATRIX_DIM 144 1 1 /end MEASUREMENT
/begin AXIS_PTS BCF_TRngVld_A "Valid Temperature range of of the model" 0x1FFEA590 NO_INPUT_QUANTITY Lookup2D_X_FLOAT32_IEEE 0 swc_BatCoreFct_CM_single__ 9 -3.40282346639e+038 3.40282346639e+038 DEPOSIT ABSOLUTE /end AXIS_PTS
/begin CHARACTERISTIC BCF_TdOffDig1001_P "Battery Core Function TimeDelay Off Digital _Parameter" VALUE 0x1FFEA5B8 Scalar_FLOAT32_IEEE 0 swc_BatCoreFct_CM_single_s -3.40282346639e+038 3.40282346639e+038 /end CHARACTERISTIC
/begin CHARACTERISTIC BCF_TdOffDig1002_P "Battery Core Function TimeDelay Off Digital _Parameter" VALUE 0x1FFEA5BC Scalar_FLOAT32_IEEE 0 swc_BatCoreFct_CM_single_s -3.40282346639e+038 3.40282346639e+038 /end CHARACTERISTIC
/begin CHARACTERISTIC BCF_TdOnDig1001_P "Battery Core Function TimeDelay On Digital _Parameter" VALUE 0x1FFEA5D0 Scalar_FLOAT32_IEEE 0 swc_BatCoreFct_CM_single_s -3.40282346639e+038 3.40282346639e+038 /end CHARACTERISTIC
/begin CHARACTERISTIC BCF_TdOnDig1002_P "Battery Core Function TimeDelay On Digital _Parameter" VALUE 0x1FFEA5D4 Scalar_FLOAT32_IEEE 0 swc_BatCoreFct_CM_single_s -3.40282346639e+038 3.40282346639e+038 /end CHARACTERISTIC
/begin CHARACTERISTIC BCF_TiBalnAcvDdecrt_P "Balancing Active Time Decrement for Cell Observer Validity Debouncing" VALUE 0x1FFEB516 Scalar_SWORD 0 swc_BatCoreFct_CM_int16_dash_ -32768 32767 /end CHARACTERISTIC
/begin CHARACTERISTIC BCF_TiBalnAcvDincrt_P "Balancing Active Time Increment for Cell Observer Validity Debouncing" VALUE 0x1FFEB518 Scalar_SWORD 0 swc_BatCoreFct_CM_int16_dash_ -32768 32767 /end CHARACTERISTIC
/begin CHARACTERISTIC BCF_TiBalnAcvUpprLim_P "Balancing Active Time Upper Limit for Cell Observer Validity Debouncing" VALUE 0x1FFEB51A Scalar_SWORD 0 swc_BatCoreFct_CM_int16_dash_ -32768 32767 /end CHARACTERISTIC
/begin CHARACTERISTIC BCF_TiBalnOffLowrLim_P "Balancing Off Time Limit for Cell Observer Validity Debouncing" VALUE 0x1FFEB51C Scalar_SWORD 0 swc_BatCoreFct_CM_int16_dash_ -32768 32767 /end CHARACTERISTIC
/begin MEASUREMENT BCF_TiBatOffForMdulCFls "TiBatOff stored in flash for Mdul C Observer" ULONG swc_BatCoreFct_CM_uint32_s 0 0 0 4294967295 ECU_ADDRESS 0x20002C98 MATRIX_DIM 24 1 1 /end MEASUREMENT
/begin MEASUREMENT BCF_TiBatOffForMdulCTrip "TiBatOff trip for Mdul C Observer" ULONG swc_BatCoreFct_CM_uint32_s 0 0 0 4294967295 ECU_ADDRESS 0x20002D58 MATRIX_DIM 24 1 1 /end MEASUREMENT
/begin MEASUREMENT BCF_TiBatOffForMdulRFls "TiBatOff stored in flash for Mdul R Observer" ULONG swc_BatCoreFct_CM_uint32_s 0 0 0 4294967295 ECU_ADDRESS 0x20002DB8 MATRIX_DIM 24 1 1 /end MEASUREMENT
/begin MEASUREMENT BCF_TiBatOffForMdulRTrip "TiBatOff trip for Mdul R Observer" ULONG swc_BatCoreFct_CM_uint32_s 0 0 0 4294967295 ECU_ADDRESS 0x20002E78 MATRIX_DIM 24 1 1 /end MEASUREMENT
/begin MEASUREMENT BCF_TiTmrBalnAcv "Timer keeping track of Balancing activity" FLOAT32_IEEE swc_BatCoreFct_CM_single_dash_ 0 0 -3.40282346639e+038 3.40282346639e+038 ECU_ADDRESS 0x20002ED8 MATRIX_DIM 24 1 1 /end MEASUREMENT
/begin MEASUREMENT BCF_TsCtrCMdulObsr "Counter for running MdulCObsr with another sample time than 100ms" UWORD swc_BatCoreFct_CM_uint16_dash_ 0 0 0 65535 ECU_ADDRESS 0x2000878E /end MEASUREMENT
/begin CHARACTERISTIC BCF_UChOc_M "Charge OCV axis of the OCV-SOC curve of the Measurement Model" MAP 0x1FFEA64C Lookup2D_FLOAT32_IEEE 0 swc_BatCoreFct_CM_single_dash_ -3.40282346639e+038 3.40282346639e+038
 /begin AXIS_DESCR COM_AXIS NO_INPUT_QUANTITY swc_BatCoreFct_CM_single_dash_ 31 -3.40282346639e+038 3.40282346639e+038 DEPOSIT ABSOLUTE AXIS_PTS_REF BCF_UOc_A /end AXIS_DESCR
 /begin AXIS_DESCR COM_AXIS NO_INPUT_QUANTITY swc_BatCoreFct_CM_single__ 9 -3.40282346639e+038 3.40282346639e+038 DEPOSIT ABSOLUTE AXIS_PTS_REF BCF_TRngVld_A /end AXIS_DESCR
/end CHARACTERISTIC
/begin CHARACTERISTIC BCF_UDchaOc_M "Discharge OCV axis of the OCV-SOC curve of the Measurement Model" MAP 0x1FFEAC80 Lookup2D_FLOAT32_IEEE 0 swc_BatCoreFct_CM_single_dash_ -3.40282346639e+038 3.40282346639e+038
 /begin AXIS_DESCR COM_AXIS NO_INPUT_QUANTITY swc_BatCoreFct_CM_single_dash_ 31 -3.40282346639e+038 3.40282346639e+038 DEPOSIT ABSOLUTE AXIS_PTS_REF BCF_UOc_A /end AXIS_DESCR
 /begin AXIS_DESCR COM_AXIS NO_INPUT_QUANTITY swc_BatCoreFct_CM_single__ 9 -3.40282346639e+038 3.40282346639e+038 DEPOSIT ABSOLUTE AXIS_PTS_REF BCF_TRngVld_A /end AXIS_DESCR
/end CHARACTERISTIC
/begin MEASUREMENT BCF_UMapSelnFls "Flash memory for keeping voltage curve selection hysteresis output." UBYTE swc_BatCoreFct_CM_boolean_dash_ 0 0 0 1 ECU_ADDRESS 0x20008A85 /end MEASUREMENT
/begin MEASUREMENT BCF_UMdulToMdlFil "Memory for module voltage measurement to model voltage prediction deviation filtering" FLOAT32_IEEE swc_BatCoreFct_CM_single_V 0 0 -3.40282346639e+038 3.40282346639e+038 ECU_ADDRESS 0x20003430 MATRIX_DIM 24 1 1 /end MEASUREMENT
/begin AXIS_PTS BCF_UOc_A "SOC axis of the OCV-SOC curve of the Measurement Model" 0x1FFEB14C NO_INPUT_QUANTITY Lookup2D_X_FLOAT32_IEEE 0 swc_BatCoreFct_CM_single_dash_ 31 -3.40282346639e+038 3.40282346639e+038 DEPOSIT ABSOLUTE /end AXIS_PTS
/begin CHARACTERISTIC BCF_ValHealLimOfRDeltaCdn_P "Heal Limit for R Cell Delta Signal (invalid model operating region)" VALUE 0x1FFEB1C8 Scalar_FLOAT32_IEEE 0 swc_BatCoreFct_CM_single_dash_ -3.40282346639e+038 3.40282346639e+038 /end CHARACTERISTIC
/begin CHARACTERISTIC BCF_ValHealLimOfRDelta_P "Heal Limit for R Cell Delta Signal (valid model operating region)" VALUE 0x1FFEB1CC Scalar_FLOAT32_IEEE 0 swc_BatCoreFct_CM_single_dash_ -3.40282346639e+038 3.40282346639e+038 /end CHARACTERISTIC
/begin CHARACTERISTIC BCF_ValHealLimOfSocDeltaCdn_P "Heal Limit for Soc Cell Delta Signal (invalid operating region of the model)" VALUE 0x1FFEB1D0 Scalar_FLOAT32_IEEE 0 swc_BatCoreFct_CM_single_dash_ -3.40282346639e+038 3.40282346639e+038 /end CHARACTERISTIC
/begin CHARACTERISTIC BCF_ValHealLimOfSocDelta_P "Heal Limit for Soc Cell Delta Signal (valid operating region of the model)" VALUE 0x1FFEB1D4 Scalar_FLOAT32_IEEE 0 swc_BatCoreFct_CM_single_dash_ -3.40282346639e+038 3.40282346639e+038 /end CHARACTERISTIC
/begin CHARACTERISTIC BCF_ValSysMtrxCdngNrLoLim_P "Lower limit of the reciprocal conditioning numer of the system matrix for the cell observer" VALUE 0x1FFEB1D8 Scalar_FLOAT32_IEEE 0 swc_BatCoreFct_CM_single_dash_ -3.40282346639e+038 3.40282346639e+038 /end CHARACTERISTIC
/begin MEASUREMENT BCF_ValSysUpdMtrx3 "A transpose A (short term) of Module Resistance Deviation Observer" FLOAT32_IEEE swc_BatCoreFct_CM_single_dash_ 0 0 -3.40282346639e+038 3.40282346639e+038 ECU_ADDRESS 0x20003498 MATRIX_DIM 96 1 1 /end MEASUREMENT
/begin MEASUREMENT BCF_ValSysUpdMtrx4 "A transpose b (short term) of Module Resistance Deviation Observer  " FLOAT32_IEEE swc_BatCoreFct_CM_single_dash_ 0 0 -3.40282346639e+038 3.40282346639e+038 ECU_ADDRESS 0x20003618 MATRIX_DIM 48 1 1 /end MEASUREMENT
/begin MEASUREMENT BCF_ValSysUpdMtrx5 "A transpose A (trip) of Module Resistance Deviation Observer  " FLOAT32_IEEE swc_BatCoreFct_CM_single_dash_ 0 0 -3.40282346639e+038 3.40282346639e+038 ECU_ADDRESS 0x200036D8 MATRIX_DIM 96 1 1 /end MEASUREMENT
/begin MEASUREMENT BCF_ValSysUpdMtrx6 "A transpose b (short term) of Module Resistance Deviation Observer  " FLOAT32_IEEE swc_BatCoreFct_CM_single_dash_ 0 0 -3.40282346639e+038 3.40282346639e+038 ECU_ADDRESS 0x20003858 MATRIX_DIM 48 1 1 /end MEASUREMENT
/begin MEASUREMENT BCF_ValSysUpdMtrx7 "AtA of Capacity Estimation  " FLOAT32_IEEE swc_BatCoreFct_CM_single_dash_ 0 0 -3.40282346639e+038 3.40282346639e+038 ECU_ADDRESS 0x20003918 MATRIX_DIM 96 1 1 /end MEASUREMENT
/begin MEASUREMENT BCF_ValSysUpdMtrx8 "Atb of Capacity Estimation" FLOAT32_IEEE swc_BatCoreFct_CM_single_dash_ 0 0 -3.40282346639e+038 3.40282346639e+038 ECU_ADDRESS 0x20003A98 MATRIX_DIM 48 1 1 /end MEASUREMENT
/begin MEASUREMENT BCF_bVldCellObsrEstimn "Cell Observer Estimation Valid Flags" UBYTE swc_BatCoreFct_CM_boolean_dash_ 0 0 0 1 ECU_ADDRESS 0x20003BC8 MATRIX_DIM 24 1 1 /end MEASUREMENT
/begin CHARACTERISTIC BCPP_Max_Allow_DCCur_P "Maximum permissible discharge current" VALUE 0x2001960C Scalar_FLOAT32_IEEE 0 swc_COL_CM_single_A 0 65535 /end CHARACTERISTIC
/begin CHARACTERISTIC BCPP_Max_Allow_DCV_P "Minimum allowable total discharge voltage" VALUE 0x20019BFC Scalar_UWORD 0 swc_COL_CM_uint16_V 0 65535 /end CHARACTERISTIC
/begin CHARACTERISTIC BCPP_Min_Allow_CellV_P "Minimum allowable cell voltage" VALUE 0x20019BFE Scalar_UWORD 0 swc_COL_CM_uint16_V 0 65535 /end CHARACTERISTIC
/begin CHARACTERISTIC BCPP_Min_Allow_Soc_P "Minimum allowable state of charge for power batteries" VALUE 0x20019CB3 Scalar_UBYTE 0 swc_COL_CM_uint8_percent_ 0 255 /end CHARACTERISTIC
/begin CHARACTERISTIC BCSP_Remaining_discharge_time_P "Estimate the remaining discharge time" VALUE 0x20019C00 Scalar_UWORD 0 swc_COL_CM_uint16_min 0 65535 /end CHARACTERISTIC
/begin CHARACTERISTIC BCSP_Remaining_range_P "Remaining range" VALUE 0x20019610 Scalar_FLOAT32_IEEE 0 swc_COL_CM_single_km 0 65535 /end CHARACTERISTIC
/begin CHARACTERISTIC BCTE_FacFil2ChTiEstimn_P "Filter coefficient for calculated charge time" VALUE 0x200167D4 Scalar_FLOAT32_IEEE 0 swc_BatChCtl_CM_single_dash_ -3.40282346639e+038 3.40282346639e+038 /end CHARACTERISTIC
/begin CHARACTERISTIC BCTE_FacFilIMeasd_P "Filter coefficient for fluctuations in measured current" VALUE 0x200167E0 Scalar_FLOAT32_IEEE 0 swc_BatChCtl_CM_single_dash_ -3.40282346639e+038 3.40282346639e+038 /end CHARACTERISTIC
/begin CHARACTERISTIC BCTE_IAcLimnFromTSoc_M "lookup-table for AC charge current limits based on temperature and SOC." MAP 0x20016AD4 Lookup2D_FLOAT32_IEEE 0 swc_BatChCtl_CM_single_A -3.40282346639e+038 3.40282346639e+038
 /begin AXIS_DESCR COM_AXIS NO_INPUT_QUANTITY swc_BatChCtl_CM_single_percent_ 11 -3.40282346639e+038 3.40282346639e+038 DEPOSIT ABSOLUTE AXIS_PTS_REF BCTE_LvlSocForAcILimn_A /end AXIS_DESCR
 /begin AXIS_DESCR COM_AXIS NO_INPUT_QUANTITY swc_BatChCtl_CM_single__ 5 -3.40282346639e+038 3.40282346639e+038 DEPOSIT ABSOLUTE AXIS_PTS_REF BCTE_TForAcILimn_A /end AXIS_DESCR
/end CHARACTERISTIC
/begin CHARACTERISTIC BCTE_IDcLimnFromTSoc_M "lookup-table for DC charge current limits based on temperature and SOC." MAP 0x20016BCC Lookup2D_FLOAT32_IEEE 0 swc_BatChCtl_CM_single_A -3.40282346639e+038 3.40282346639e+038
 /begin AXIS_DESCR COM_AXIS NO_INPUT_QUANTITY swc_BatChCtl_CM_single_percent_ 11 -3.40282346639e+038 3.40282346639e+038 DEPOSIT ABSOLUTE AXIS_PTS_REF BCTE_LvlSocForDcILimn_A /end AXIS_DESCR
 /begin AXIS_DESCR COM_AXIS NO_INPUT_QUANTITY swc_BatChCtl_CM_single__ 5 -3.40282346639e+038 3.40282346639e+038 DEPOSIT ABSOLUTE AXIS_PTS_REF BCTE_TForDcILimn_A /end AXIS_DESCR
/end CHARACTERISTIC
/begin AXIS_PTS BCTE_LvlSocForAcILimn_A "SOC axis for AC current limit" 0x20016CA8 NO_INPUT_QUANTITY Lookup2D_X_FLOAT32_IEEE 0 swc_BatChCtl_CM_single_percent_ 11 -3.40282346639e+038 3.40282346639e+038 DEPOSIT ABSOLUTE /end AXIS_PTS
/begin AXIS_PTS BCTE_LvlSocForDcILimn_A "SOC axis for DC current limit" 0x20016CD4 NO_INPUT_QUANTITY Lookup2D_X_FLOAT32_IEEE 0 swc_BatChCtl_CM_single_percent_ 11 -3.40282346639e+038 3.40282346639e+038 DEPOSIT ABSOLUTE /end AXIS_PTS
/begin AXIS_PTS BCTE_TForAcILimn_A "Temperature axis for AC charging current limits." 0x20016E10 NO_INPUT_QUANTITY Lookup2D_X_FLOAT32_IEEE 0 swc_BatChCtl_CM_single__ 5 -3.40282346639e+038 3.40282346639e+038 DEPOSIT ABSOLUTE /end AXIS_PTS
/begin AXIS_PTS BCTE_TForDcILimn_A "Temperature axis for DC charging current limits." 0x20016E50 NO_INPUT_QUANTITY Lookup2D_X_FLOAT32_IEEE 0 swc_BatChCtl_CM_single__ 5 -3.40282346639e+038 3.40282346639e+038 DEPOSIT ABSOLUTE /end AXIS_PTS
/begin CHARACTERISTIC BCTE_ThdFlucInIMeasd_P "Threshold value for fluctuations in measured current" VALUE 0x20016E8C Scalar_FLOAT32_IEEE 0 swc_BatChCtl_CM_single_dash_ -3.40282346639e+038 3.40282346639e+038 /end CHARACTERISTIC
/begin CHARACTERISTIC BDC_Battery_capacity_P "The total capacity of the current power battery system of the whole vehicle" VALUE 0x20019C02 Scalar_UWORD 0 swc_COL_CM_uint16_Ah 0 65535 /end CHARACTERISTIC
/begin CHARACTERISTIC BDC_Battery_energy_P "The total energy of the current power battery system of the whole vehicle" VALUE 0x20019C04 Scalar_UWORD 0 swc_COL_CM_uint16_kWh 0 65535 /end CHARACTERISTIC
/begin CHARACTERISTIC BDC_Current_V2GCirculate_P "Number of cycles to participate in V2G" VALUE 0x20019C06 Scalar_UWORD 0 swc_COL_CM_uint16_dash_ 0 65535 /end CHARACTERISTIC
/begin CHARACTERISTIC BDC_Remainder_CruisingRange_P "Remaining range" VALUE 0x20019C08 Scalar_UWORD 0 swc_COL_CM_uint16_km 0 65535 /end CHARACTERISTIC
/begin CHARACTERISTIC BDC_Remainder_V2GCirculate_P "The number of cycles remaining for V2G" VALUE 0x20019C0A Scalar_UWORD 0 swc_COL_CM_uint16_dash_ 0 65535 /end CHARACTERISTIC
/begin CHARACTERISTIC BDC_Soc_P "The current state of charge of the power battery of the whole vehicle" VALUE 0x20019614 Scalar_FLOAT32_IEEE 0 swc_COL_CM_single_dash_ 0 255 /end CHARACTERISTIC
/begin CHARACTERISTIC BDC_Vin1_Copy_10_P "Required, missing" VALUE 0x20019CB4 Scalar_UBYTE 0 swc_COL_CM_uint8_dash_ 0 255 /end CHARACTERISTIC
/begin CHARACTERISTIC BDC_Vin1_Copy_11_P "Required, missing" VALUE 0x20019CB5 Scalar_UBYTE 0 swc_COL_CM_uint8_dash_ 0 255 /end CHARACTERISTIC
/begin CHARACTERISTIC BDC_Vin1_Copy_12_P "Required, missing" VALUE 0x20019CB6 Scalar_UBYTE 0 swc_COL_CM_uint8_dash_ 0 255 /end CHARACTERISTIC
/begin CHARACTERISTIC BDC_Vin1_Copy_13_P "Required, missing" VALUE 0x20019CB7 Scalar_UBYTE 0 swc_COL_CM_uint8_dash_ 0 255 /end CHARACTERISTIC
/begin CHARACTERISTIC BDC_Vin1_Copy_14_P "Required, missing" VALUE 0x20019CB8 Scalar_UBYTE 0 swc_COL_CM_uint8_dash_ 0 255 /end CHARACTERISTIC
/begin CHARACTERISTIC BDC_Vin1_Copy_15_P "Required, missing" VALUE 0x20019CB9 Scalar_UBYTE 0 swc_COL_CM_uint8_dash_ 0 255 /end CHARACTERISTIC
/begin CHARACTERISTIC BDC_Vin1_Copy_16_P "Required, missing" VALUE 0x20019CBA Scalar_UBYTE 0 swc_COL_CM_uint8_dash_ 0 255 /end CHARACTERISTIC
/begin CHARACTERISTIC BDC_Vin1_Copy_17_P "Required, missing" VALUE 0x20019CBB Scalar_UBYTE 0 swc_COL_CM_uint8_dash_ 0 255 /end CHARACTERISTIC
/begin CHARACTERISTIC BDC_Vin1_Copy_1_P "Required, missing" VALUE 0x20019CBC Scalar_UBYTE 0 swc_COL_CM_uint8_dash_ 0 255 /end CHARACTERISTIC
/begin CHARACTERISTIC BDC_Vin1_Copy_2_P "Required, missing" VALUE 0x20019CBD Scalar_UBYTE 0 swc_COL_CM_uint8_dash_ 0 255 /end CHARACTERISTIC
/begin CHARACTERISTIC BDC_Vin1_Copy_3_P "Required, missing" VALUE 0x20019CBE Scalar_UBYTE 0 swc_COL_CM_uint8_dash_ 0 255 /end CHARACTERISTIC
/begin CHARACTERISTIC BDC_Vin1_Copy_4_P "Required, missing" VALUE 0x20019CBF Scalar_UBYTE 0 swc_COL_CM_uint8_dash_ 0 255 /end CHARACTERISTIC
/begin CHARACTERISTIC BDC_Vin1_Copy_5_P "Required, missing" VALUE 0x20019CC0 Scalar_UBYTE 0 swc_COL_CM_uint8_dash_ 0 255 /end CHARACTERISTIC
/begin CHARACTERISTIC BDC_Vin1_Copy_6_P "Required, missing" VALUE 0x20019CC1 Scalar_UBYTE 0 swc_COL_CM_uint8_dash_ 0 255 /end CHARACTERISTIC
/begin CHARACTERISTIC BDC_Vin1_Copy_7_P "Required, missing" VALUE 0x20019CC2 Scalar_UBYTE 0 swc_COL_CM_uint8_dash_ 0 255 /end CHARACTERISTIC
/begin CHARACTERISTIC BDC_Vin1_Copy_8_P "Required, missing" VALUE 0x20019CC3 Scalar_UBYTE 0 swc_COL_CM_uint8_dash_ 0 255 /end CHARACTERISTIC
/begin CHARACTERISTIC BDC_Vin1_Copy_9_P "Required, missing" VALUE 0x20019CC4 Scalar_UBYTE 0 swc_COL_CM_uint8_dash_ 0 255 /end CHARACTERISTIC
/begin CHARACTERISTIC BMC_UCell_P "Cell Voltages of Battery Pack " VAL_BLK 0x20018EE0 Scalar_FLOAT32_IEEE 0 swc_CIL_CM_single_V 0 5 MATRIX_DIM 255 1 1 /end CHARACTERISTIC
/begin CHARACTERISTIC BMS_ActWorkSts_P "The actual working status of the BMS (0x0: Reserved\n      0x1: Initial\n      0x2: Standby\n      0x3: Discharging\n      0x4: Charging\n      0x5: Shutdown_HV\n      0x6: After run \n      0xF: Invalid )" VALUE 0x20019CC5 Scalar_UBYTE 0 swc_COL_CM_uint8_dash_ 0 255 /end CHARACTERISTIC
/begin CHARACTERISTIC BMS_BBMSensorCurr_P "bodywork sensor current,Send default values (0xFF: Invalid)" VALUE 0x20019CC6 Scalar_UBYTE 0 swc_COL_CM_uint8_dash_ 0 255 /end CHARACTERISTIC
/begin CHARACTERISTIC BMS_BattCellVolFault_P "Battery cell voltage failure (0x0: No error\n      0x1: Cell Voltage too low\n      0x2: Cell Voltage too high\n      0x3: Reserved)" VALUE 0x20019CC7 Scalar_UBYTE 0 swc_COL_CM_uint8_dash_ 0 255 /end CHARACTERISTIC
/begin CHARACTERISTIC BMS_BattCellsNum_P "Total number of cell cells" VALUE 0x20019C0C Scalar_UWORD 0 swc_COL_CM_uint16_dash_ 0 65535 /end CHARACTERISTIC
/begin CHARACTERISTIC BMS_BattCurr_P "Power battery pack current (0xFFFF: Invalid)" VALUE 0x20019618 Scalar_FLOAT32_IEEE 0 swc_COL_CM_single_A 0 65535 /end CHARACTERISTIC
/begin CHARACTERISTIC BMS_BattEqualizationSts_P "BMS battery equalization status (0x0: Inactive\n      0x1: Active\n      0x2: Reserved\n      0x3: Invalid)" VALUE 0x20019CC8 Scalar_UBYTE 0 swc_COL_CM_uint8_dash_ 0 255 /end CHARACTERISTIC
/begin CHARACTERISTIC BMS_BattIsolationSts_P "Vehicle insulation status (0x0: Isolation is ok\n      0x1: Isolation fault\n      0x2: Reserved\n      0x3: Invalid)" VALUE 0x20019CC9 Scalar_UBYTE 0 swc_COL_CM_uint8_dash_ 0 255 /end CHARACTERISTIC
/begin CHARACTERISTIC BMS_BattPackInCoolTemp_P "Battery pack inlet temperature" VALUE 0x20019628 Scalar_FLOAT32_IEEE 0 swc_COL_CM_single___C 0 255 /end CHARACTERISTIC
/begin CHARACTERISTIC BMS_BattPackNum_P "Total number of battery boxes" VALUE 0x20019CCB Scalar_UBYTE 0 swc_COL_CM_uint8_dash_ 0 255 /end CHARACTERISTIC
/begin CHARACTERISTIC BMS_BattPackOutCoolTemp_P "Battery pack outlet temperature" VALUE 0x2001962C Scalar_FLOAT32_IEEE 0 swc_COL_CM_single___C 0 255 /end CHARACTERISTIC
/begin CHARACTERISTIC BMS_BattPackVolFault_P "Total battery voltage failure (0x0: No error\n      0x1: Voltage too low\n      0x2: Voltage too high\n      0x3: Invalid)" VALUE 0x20019CCC Scalar_UBYTE 0 swc_COL_CM_uint8_dash_ 0 255 /end CHARACTERISTIC
/begin CHARACTERISTIC BMS_BattSOCFault_P "Battery SOC abnormality (0x0: No error\n      0x1: SOC too low\n      0x2: SOC too high\n      0x3:  Reserved)" VALUE 0x20019CCD Scalar_UBYTE 0 swc_COL_CM_uint8_dash_ 0 255 /end CHARACTERISTIC
/begin CHARACTERISTIC BMS_BattSOC_P "Battery pack SOC (0xFF: Signal Invalid)" VALUE 0x20019630 Scalar_FLOAT32_IEEE 0 swc_COL_CM_single_percent_ 0 255 /end CHARACTERISTIC
/begin CHARACTERISTIC BMS_BattSOH_P "Battery pack SOH (0xFF: Signal Invalid)" VALUE 0x20019634 Scalar_FLOAT32_IEEE 0 swc_COL_CM_single_percent_ 0 255 /end CHARACTERISTIC
/begin CHARACTERISTIC BMS_BattVol_P "Power battery pack voltage (0xFFFF: Invalid)" VALUE 0x20019640 Scalar_FLOAT32_IEEE 0 swc_COL_CM_single_V 0 65535 /end CHARACTERISTIC
/begin CHARACTERISTIC BMS_Batty_ThermalMangeReq_P "Battery thermal management requests (0x0: No Request \n      0x1: Heat Request \n      0x2: Cool Request\n      0x3: Self Loop\n      0x4-0xE: Reserved\n      0xF: Invalid)" VALUE 0x20019CCE Scalar_UBYTE 0 swc_COL_CM_uint8_dash_ 0 255 /end CHARACTERISTIC
/begin CHARACTERISTIC BMS_CellVolDiffFault_P "Excessive pressure difference between the monomers alarms (0x0: No error\n      0x1: Error\n      0x2: Reserved\n      0x3: Invalid)" VALUE 0x20019CCF Scalar_UBYTE 0 swc_COL_CM_uint8_dash_ 0 255 /end CHARACTERISTIC
/begin CHARACTERISTIC BMS_ChgStatus_P "Charging status (0x0: Default\n      0x1: Charging \n      0x2: Charge end\n      0x3: Error Charge Stop\n      0x4: Heating\n      0x5: Cooling\n      0x6: Charge Pause\n      0x7: Other Charge Stop\n      0x8-0xF: Reserved)" VALUE 0x20019CD0 Scalar_UBYTE 0 swc_COL_CM_uint8_dash_ 0 255 /end CHARACTERISTIC
/begin CHARACTERISTIC BMS_CutOffLVFbToOBC_P "Whether the slow-charging BMS allows low-voltage electrical feedback (0x0: Not allow\n      0x1: Allow\n      0x2: Reserved\n      0x3: Invalid)" VALUE 0x20019CD3 Scalar_UBYTE 0 swc_COL_CM_uint8_dash_ 0 255 /end CHARACTERISTIC
/begin CHARACTERISTIC BMS_DCChargRelayCtrl_P "Boomers DeChagel Lecktel (0x0: Disconnect\n      0x1: Connect\n      0x2: Reserved\n      0x3: Invalid)" VALUE 0x20019CD4 Scalar_UBYTE 0 swc_COL_CM_uint8_dash_ 0 255 /end CHARACTERISTIC
/begin CHARACTERISTIC BMS_DCChgPlugSts_P "Whether the DC charging plug is connected (0x0: Disconnected\n      0x1: Connected\n      0x2: Reserved\n      0x3: Invalid)" VALUE 0x20019CD5 Scalar_UBYTE 0 swc_COL_CM_uint8_dash_ 0 255 /end CHARACTERISTIC
/begin CHARACTERISTIC BMS_DCChgReady_P "Whether the BMS is ready (0x0: BMS is not ready\n      0x1: The BMS is ready for charging)" VALUE 0x20019CD6 Scalar_UBYTE 0 swc_COL_CM_uint8_dash_ 0 255 /end CHARACTERISTIC
/begin CHARACTERISTIC BMS_DCChgStage_P "Fast charging stage (0x0:  default\n      0x1: Charging handshake initiation phase\n      0x2: Charging handshake identification phase\n      0x3: Charging parameter configuration phase\n      0x4: Charging phase\n      0x5: End of charging phase)" VALUE 0x20019CD7 Scalar_UBYTE 0 swc_COL_CM_uint8_dash_ 0 255 /end CHARACTERISTIC
/begin CHARACTERISTIC BMS_ElectroniclockSts_P "Slow charging sublock status (0x0: No lock\n      0x1: Lock\n      0x2: Error\n      0x3: Invalid)" VALUE 0x20019CD8 Scalar_UBYTE 0 swc_COL_CM_uint8_dash_ 0 255 /end CHARACTERISTIC
/begin CHARACTERISTIC BMS_EmergCutoffHVReq_P "BMS makes an emergency high-voltage power request (0x0: No request\n      0x1: Request\n      0x2: Reserved\n      0x3: Invalid)" VALUE 0x20019CD9 Scalar_UBYTE 0 swc_COL_CM_uint8_dash_ 0 255 /end CHARACTERISTIC
/begin CHARACTERISTIC BMS_FastChgConnStsFb_P "Fast charging contactor status feedback (0x0: Open \n      0x1: Close \n      0x2: Reserved\n      0x3: Invalid )" VALUE 0x20019CDA Scalar_UBYTE 0 swc_COL_CM_uint8_dash_ 0 255 /end CHARACTERISTIC
/begin CHARACTERISTIC BMS_FastChgRelayFlt_P "Fast charge contactor failure (0x0: No fault\n      0x1: Driver Fault\n      0x2: Welded\n      0x3: Invalid)" VALUE 0x20019CDB Scalar_UBYTE 0 swc_COL_CM_uint8_dash_ 0 255 /end CHARACTERISTIC
/begin CHARACTERISTIC BMS_FaultLevel_P "BMS failure level (0x0: No error\n      0x1: Level1\n      0x2: Level2\n      0x3: Level3)" VALUE 0x20019CDC Scalar_UBYTE 0 swc_COL_CM_uint8_dash_ 0 255 /end CHARACTERISTIC
/begin CHARACTERISTIC BMS_HeatNegRelayFault_Reserved_P "Heating negative relay failure (0x0: No error\n      0x1: Drive Error\n      0x2: Welded\n      0x3: Invalid)" VALUE 0x20019CE0 Scalar_UBYTE 0 swc_COL_CM_uint8_dash_ 0 255 /end CHARACTERISTIC
/begin CHARACTERISTIC BMS_HeatingSatus_P "Battery heating film heating state (0x0: No heating\n      0x1: Heating\n      0x2: Reserved\n      0x3: Invalid)" VALUE 0x20019CE4 Scalar_UBYTE 0 swc_COL_CM_uint8_dash_ 0 255 /end CHARACTERISTIC
/begin CHARACTERISTIC BMS_NegRelayFault_P "BMS negative pole relay failure (0x0: No fault 0x1: Driver Fault 0x2: Welded 0x3: Invalid)" VALUE 0x20019CF1 Scalar_UBYTE 0 swc_COL_CM_uint8_dash_ 0 255 /end CHARACTERISTIC
/begin CHARACTERISTIC BMS_NegRelaySts_P "BMS negative contactor status (0x0: Open \n      0x1: Close \n      0x2: Reserved\n      0x3: Invalid )" VALUE 0x20019CF2 Scalar_UBYTE 0 swc_COL_CM_uint8_dash_ 0 255 /end CHARACTERISTIC
/begin CHARACTERISTIC BMS_PmtCutoffLVFb_P "BMS allows low voltage electricity (0x0: Not Allow\n      0x1: Allow\n      0x2: Reserved\n      0x3: Invalid)" VALUE 0x20019CF5 Scalar_UBYTE 0 swc_COL_CM_uint8_dash_ 0 255 /end CHARACTERISTIC
/begin CHARACTERISTIC BMS_PosRelayFault_P "BMS positive pole relay failure (0x0: No fault 0x1: Driver Fault 0x2: Welded 0x3: Invalid)" VALUE 0x20019CF6 Scalar_UBYTE 0 swc_COL_CM_uint8_dash_ 0 255 /end CHARACTERISTIC
/begin CHARACTERISTIC BMS_SelfChkState_P "BMS self-test status (0x0: No error\n      0x1: Error\n      0x2: Reserved\n      0x3: Invalid)" VALUE 0x20019CFB Scalar_UBYTE 0 swc_COL_CM_uint8_dash_ 0 255 /end CHARACTERISTIC
/begin CHARACTERISTIC BPIU_IChMaxLim1_P "Current Charge Maximum Limit" VALUE 0x200188D0 Scalar_FLOAT32_IEEE 0 swc_BatProtnIU_CM_single_dash_ -3.40282346639e+038 3.40282346639e+038 /end CHARACTERISTIC
/begin CHARACTERISTIC BPIU_IChMaxLim2_P "Current Charge Maximum Limit 2" VALUE 0x200188D4 Scalar_FLOAT32_IEEE 0 swc_BatProtnIU_CM_single_dash_ -3.40282346639e+038 3.40282346639e+038 /end CHARACTERISTIC
/begin CHARACTERISTIC BPIU_IChMaxLim3_P "Current Charge Maximum Limit 3" VALUE 0x200188D8 Scalar_FLOAT32_IEEE 0 swc_BatProtnIU_CM_single_dash_ -3.40282346639e+038 3.40282346639e+038 /end CHARACTERISTIC
/begin CHARACTERISTIC BPIU_ICh_P " Current Charge normal" VALUE 0x200188DC Scalar_FLOAT32_IEEE 0 swc_BatProtnIU_CM_single_dash_ -3.40282346639e+038 3.40282346639e+038 /end CHARACTERISTIC
/begin CHARACTERISTIC BPIU_IDchaMaxLim2_P "Current Discharge Maximum Limit" VALUE 0x200188E0 Scalar_FLOAT32_IEEE 0 swc_BatProtnIU_CM_single_dash_ -3.40282346639e+038 3.40282346639e+038 /end CHARACTERISTIC
/begin CHARACTERISTIC BPIU_IDchaMaxLim3_P "Current Discharge Maximum Limit" VALUE 0x200188E4 Scalar_FLOAT32_IEEE 0 swc_BatProtnIU_CM_single_dash_ -3.40282346639e+038 3.40282346639e+038 /end CHARACTERISTIC
/begin CHARACTERISTIC BPIU_IDcha_P "Current Discharge normal" VALUE 0x200188E8 Scalar_FLOAT32_IEEE 0 swc_BatProtnIU_CM_single_dash_ -3.40282346639e+038 3.40282346639e+038 /end CHARACTERISTIC
/begin CHARACTERISTIC BPIU_IDlyLim_P "The current limit used for current limit exceedance diagnosis will be delayed by this amount of calculation cycles. This is useful to compensate control delays of the powertrain system." VALUE 0x20019C49 Scalar_UBYTE 0 swc_BatProtnIU_CM_uint8_dash_ 0 255 /end CHARACTERISTIC
/begin CHARACTERISTIC BPIU_TiOffDig111_P "Time delay off for DTC111." VALUE 0x200188FC Scalar_FLOAT32_IEEE 0 swc_BatProtnIU_CM_single_s -3.40282346639e+038 3.40282346639e+038 /end CHARACTERISTIC
/begin CHARACTERISTIC BPIU_TiOffDig112_P "Time delay off for DTC112." VALUE 0x20018900 Scalar_FLOAT32_IEEE 0 swc_BatProtnIU_CM_single_s -3.40282346639e+038 3.40282346639e+038 /end CHARACTERISTIC
/begin CHARACTERISTIC BPIU_TiOffDig11_P "Time delay off for DTC11." VALUE 0x20018908 Scalar_FLOAT32_IEEE 0 swc_BatProtnIU_CM_single_s -3.40282346639e+038 3.40282346639e+038 /end CHARACTERISTIC
/begin CHARACTERISTIC BPIU_TiOffDig133_P "Time delay off for DTC133." VALUE 0x2001890C Scalar_FLOAT32_IEEE 0 swc_BatProtnIU_CM_single_s -3.40282346639e+038 3.40282346639e+038 /end CHARACTERISTIC
/begin CHARACTERISTIC BPIU_TiOffDig140_P "Time delay off for DTC140." VALUE 0x20018910 Scalar_FLOAT32_IEEE 0 swc_BatProtnIU_CM_single_s -3.40282346639e+038 3.40282346639e+038 /end CHARACTERISTIC
/begin CHARACTERISTIC BPIU_TiOffDig141_P "Time delay off for DTC141." VALUE 0x20018914 Scalar_FLOAT32_IEEE 0 swc_BatProtnIU_CM_single_s -3.40282346639e+038 3.40282346639e+038 /end CHARACTERISTIC
/begin CHARACTERISTIC BPIU_TiOffDig174_P "Time delay off for DTC174." VALUE 0x2001891C Scalar_FLOAT32_IEEE 0 swc_BatProtnIU_CM_single_s -3.40282346639e+038 3.40282346639e+038 /end CHARACTERISTIC
/begin CHARACTERISTIC BPIU_TiOffDig181_P "Time delay off for DTC181." VALUE 0x20018920 Scalar_FLOAT32_IEEE 0 swc_BatProtnIU_CM_single_dash_ -3.40282346639e+038 3.40282346639e+038 /end CHARACTERISTIC
/begin CHARACTERISTIC BPIU_TiOffDig4_P "Time delay off for DTC4." VALUE 0x20018934 Scalar_FLOAT32_IEEE 0 swc_BatProtnIU_CM_single_s -3.40282346639e+038 3.40282346639e+038 /end CHARACTERISTIC
/begin CHARACTERISTIC BPIU_TiOffDig63_P "Time delay off for DTC63." VALUE 0x20018940 Scalar_FLOAT32_IEEE 0 swc_BatProtnIU_CM_single_s -3.40282346639e+038 3.40282346639e+038 /end CHARACTERISTIC
/begin CHARACTERISTIC BPIU_TiOffDig89_P "Time delay off for DTC89." VALUE 0x2001894C Scalar_FLOAT32_IEEE 0 swc_BatProtnIU_CM_single_dash_ -3.40282346639e+038 3.40282346639e+038 /end CHARACTERISTIC
/begin CHARACTERISTIC BPIU_TiOffDig94_P "Time delay off for DTC94." VALUE 0x20018950 Scalar_FLOAT32_IEEE 0 swc_BatProtnIU_CM_single_s -3.40282346639e+038 3.40282346639e+038 /end CHARACTERISTIC
/begin CHARACTERISTIC BPIU_TiOffDig96_P "Time delay off for DTC96." VALUE 0x20018954 Scalar_FLOAT32_IEEE 0 swc_BatProtnIU_CM_single_s -3.40282346639e+038 3.40282346639e+038 /end CHARACTERISTIC
/begin CHARACTERISTIC BPIU_TiOffDig9_P "Time delay off for DTC9." VALUE 0x20018958 Scalar_FLOAT32_IEEE 0 swc_BatProtnIU_CM_single_s -3.40282346639e+038 3.40282346639e+038 /end CHARACTERISTIC
/begin CHARACTERISTIC BPIU_TiOnDig111_P "Time delay on for DTC111." VALUE 0x2001895C Scalar_FLOAT32_IEEE 0 swc_BatProtnIU_CM_single_s -3.40282346639e+038 3.40282346639e+038 /end CHARACTERISTIC
/begin CHARACTERISTIC BPIU_TiOnDig112_P "Time delay on for DTC112." VALUE 0x20018960 Scalar_FLOAT32_IEEE 0 swc_BatProtnIU_CM_single_s -3.40282346639e+038 3.40282346639e+038 /end CHARACTERISTIC
/begin CHARACTERISTIC BPIU_TiOnDig11_P "Time delay on for DTC11." VALUE 0x20018968 Scalar_FLOAT32_IEEE 0 swc_BatProtnIU_CM_single_s -3.40282346639e+038 3.40282346639e+038 /end CHARACTERISTIC
/begin CHARACTERISTIC BPIU_TiOnDig133_P "Time delay on for DTC133." VALUE 0x2001896C Scalar_FLOAT32_IEEE 0 swc_BatProtnIU_CM_single_s -3.40282346639e+038 3.40282346639e+038 /end CHARACTERISTIC
/begin CHARACTERISTIC BPIU_TiOnDig140_P "Time delay on for DTC140." VALUE 0x20018970 Scalar_FLOAT32_IEEE 0 swc_BatProtnIU_CM_single_s -3.40282346639e+038 3.40282346639e+038 /end CHARACTERISTIC
/begin CHARACTERISTIC BPIU_TiOnDig141_P "Time delay on for DTC141." VALUE 0x20018974 Scalar_FLOAT32_IEEE 0 swc_BatProtnIU_CM_single_s -3.40282346639e+038 3.40282346639e+038 /end CHARACTERISTIC
/begin CHARACTERISTIC BPIU_TiOnDig174_P "Time delay on for DTC174." VALUE 0x2001897C Scalar_FLOAT32_IEEE 0 swc_BatProtnIU_CM_single_s -3.40282346639e+038 3.40282346639e+038 /end CHARACTERISTIC
/begin CHARACTERISTIC BPIU_TiOnDig181_P "Time delay on for DTC181." VALUE 0x20018980 Scalar_FLOAT32_IEEE 0 swc_BatProtnIU_CM_single_s -3.40282346639e+038 3.40282346639e+038 /end CHARACTERISTIC
/begin CHARACTERISTIC BPIU_TiOnDig4_P "Time delay on for DTC4." VALUE 0x20018994 Scalar_FLOAT32_IEEE 0 swc_BatProtnIU_CM_single_dash_ -3.40282346639e+038 3.40282346639e+038 /end CHARACTERISTIC
/begin CHARACTERISTIC BPIU_TiOnDig63_P "Time delay on for DTC63." VALUE 0x200189A0 Scalar_FLOAT32_IEEE 0 swc_BatProtnIU_CM_single_s -3.40282346639e+038 3.40282346639e+038 /end CHARACTERISTIC
/begin CHARACTERISTIC BPIU_TiOnDig89_P "Time delay on for DTC89." VALUE 0x200189AC Scalar_FLOAT32_IEEE 0 swc_BatProtnIU_CM_single_s -3.40282346639e+038 3.40282346639e+038 /end CHARACTERISTIC
/begin CHARACTERISTIC BPIU_TiOnDig94_P "Time delay on for DTC94." VALUE 0x200189B0 Scalar_FLOAT32_IEEE 0 swc_BatProtnIU_CM_single_s -3.40282346639e+038 3.40282346639e+038 /end CHARACTERISTIC
/begin CHARACTERISTIC BPIU_TiOnDig96_P "Time delay on for DTC96." VALUE 0x200189B4 Scalar_FLOAT32_IEEE 0 swc_BatProtnIU_CM_single_s -3.40282346639e+038 3.40282346639e+038 /end CHARACTERISTIC
/begin CHARACTERISTIC BPIU_TiOnDig9_P "Time delay on for DTC9." VALUE 0x200189B8 Scalar_FLOAT32_IEEE 0 swc_BatProtnIU_CM_single_s -3.40282346639e+038 3.40282346639e+038 /end CHARACTERISTIC
/begin CHARACTERISTIC BPIU_TiSample1_P "10ms" VALUE 0x200189BC Scalar_FLOAT32_IEEE 0 swc_BatProtnIU_CM_single_s -3.40282346639e+038 3.40282346639e+038 /end CHARACTERISTIC
/begin CHARACTERISTIC BPIU_UCellMaxLim_P "5V" VALUE 0x200189DC Scalar_FLOAT32_IEEE 0 swc_BatProtnIU_CM_single_V -3.40282346639e+038 3.40282346639e+038 /end CHARACTERISTIC
/begin CHARACTERISTIC BPIU_UCellOverMin1_P "Voltage Cell Over Minimum 1" VALUE 0x200189F0 Scalar_FLOAT32_IEEE 0 swc_BatProtnIU_CM_single_V -3.40282346639e+038 3.40282346639e+038 /end CHARACTERISTIC
/begin CHARACTERISTIC BPIU_UCellOverMin2_P "Voltage Cell Over Minimum 2" VALUE 0x200189F4 Scalar_FLOAT32_IEEE 0 swc_BatProtnIU_CM_single_V -3.40282346639e+038 3.40282346639e+038 /end CHARACTERISTIC
/begin CHARACTERISTIC BPIU_UCellWarnMin2_P "Voltage Cell Warning Minimum 2" VALUE 0x20018A00 Scalar_FLOAT32_IEEE 0 swc_BatProtnIU_CM_single_V -3.40282346639e+038 3.40282346639e+038 /end CHARACTERISTIC
/begin CHARACTERISTIC BPIU_UCellWarnMin3_P "Voltage Cell Warning Minimum 3" VALUE 0x20018A04 Scalar_FLOAT32_IEEE 0 swc_BatProtnIU_CM_single_V -3.40282346639e+038 3.40282346639e+038 /end CHARACTERISTIC
/begin CHARACTERISTIC BPIU_UCellWarnMinOff2_P "Voltage Voltage Cell Warning Minimum Off " VALUE 0x20018A08 Scalar_FLOAT32_IEEE 0 swc_BatProtnIU_CM_single_V -3.40282346639e+038 3.40282346639e+038 /end CHARACTERISTIC
/begin CHARACTERISTIC BPIU_UCellWarnMinOff_P "Voltage Cell Warning Minimum Off" VALUE 0x20018A0C Scalar_FLOAT32_IEEE 0 swc_BatProtnIU_CM_single_V -3.40282346639e+038 3.40282346639e+038 /end CHARACTERISTIC
/begin CHARACTERISTIC BPIU_UCellWarnMin_P "Minimum recommended cell voltage" VALUE 0x20018A10 Scalar_FLOAT32_IEEE 0 swc_BatProtnIU_CM_single_V 0 100 /end CHARACTERISTIC
/begin CHARACTERISTIC BPIU_UCellWarnTBlwLoMin2_P "Cell Warning Temperature Below Low Minimum 2" VALUE 0x20018A14 Scalar_FLOAT32_IEEE 0 swc_BatProtnIU_CM_single_V -3.40282346639e+038 3.40282346639e+038 /end CHARACTERISTIC
/begin CHARACTERISTIC BPIU_UCellWarnTBlwLoMin3_P "Voltage Cell Warning Temperature Below Low Minimum 3" VALUE 0x20018A18 Scalar_FLOAT32_IEEE 0 swc_BatProtnIU_CM_single_V -3.40282346639e+038 3.40282346639e+038 /end CHARACTERISTIC
/begin CHARACTERISTIC BPIU_UCellWarnTBlwLoMinOff2_P "Voltage Cell Warning Temperature Below Low Minimum Off 2" VALUE 0x20018A1C Scalar_FLOAT32_IEEE 0 swc_BatProtnIU_CM_single_V -3.40282346639e+038 3.40282346639e+038 /end CHARACTERISTIC
/begin CHARACTERISTIC BPIU_UCellWarnTBlwLoMinOff_P "Cell Warning Temperature Below Low Minimum Off" VALUE 0x20018A20 Scalar_FLOAT32_IEEE 0 swc_BatProtnIU_CM_single_V -3.40282346639e+038 3.40282346639e+038 /end CHARACTERISTIC
/begin CHARACTERISTIC BPIU_UCellWarnTBlwLoMin_P "Minimum recommended cell voltage at deeply low temperature" VALUE 0x20018A24 Scalar_FLOAT32_IEEE 0 swc_BatProtnIU_CM_single_dash_ -3.40282346639e+038 3.40282346639e+038 /end CHARACTERISTIC
/begin CHARACTERISTIC BPIU_UCellWarnTLoMin2_P "UCell Warning Temperature Low Minimum2" VALUE 0x20018A28 Scalar_FLOAT32_IEEE 0 swc_BatProtnIU_CM_single_V -3.40282346639e+038 3.40282346639e+038 /end CHARACTERISTIC
/begin CHARACTERISTIC BPIU_UCellWarnTLoMin3_P "Voltage Cell Warning Temperature Low Minimum" VALUE 0x20018A2C Scalar_FLOAT32_IEEE 0 swc_BatProtnIU_CM_single_V -3.40282346639e+038 3.40282346639e+038 /end CHARACTERISTIC
/begin CHARACTERISTIC BPIU_UCellWarnTLoMinOff2_P "Voltage Cell Warning Temperature Low Minimum Off 2" VALUE 0x20018A30 Scalar_FLOAT32_IEEE 0 swc_BatProtnIU_CM_single_V -3.40282346639e+038 3.40282346639e+038 /end CHARACTERISTIC
/begin CHARACTERISTIC BPIU_UCellWarnTLoMinOff_P "Cell Warning Temperature Low Minimum Off" VALUE 0x20018A34 Scalar_FLOAT32_IEEE 0 swc_BatProtnIU_CM_single_V -3.40282346639e+038 3.40282346639e+038 /end CHARACTERISTIC
/begin CHARACTERISTIC BPIU_UCellWarnTLoMin_P "Minimum recommended cell voltage at low temperature" VALUE 0x20018A38 Scalar_FLOAT32_IEEE 0 swc_BatProtnIU_CM_single_V 0 100 /end CHARACTERISTIC
/begin CHARACTERISTIC BPIU_UPackLimOff_P "Voltage Pack Limit Off" VALUE 0x20018A44 Scalar_FLOAT32_IEEE 0 swc_BatProtnIU_CM_single_V -3.40282346639e+038 3.40282346639e+038 /end CHARACTERISTIC
/begin CHARACTERISTIC BPIU_UPackLimOn_P "Voltage Pack Limit On" VALUE 0x20018A48 Scalar_FLOAT32_IEEE 0 swc_BatProtnIU_CM_single_V -3.40282346639e+038 3.40282346639e+038 /end CHARACTERISTIC
/begin CHARACTERISTIC BPIU_USptMaxLim_P "Voltage Sport Maximum Limit" VALUE 0x20018A4C Scalar_FLOAT32_IEEE 0 swc_BatProtnIU_CM_single_V -3.40282346639e+038 3.40282346639e+038 /end CHARACTERISTIC
/begin CHARACTERISTIC BPIU_USptMinLim_P "Voltage Sport Minimum Limit" VALUE 0x20018A50 Scalar_FLOAT32_IEEE 0 swc_BatProtnIU_CM_single_V -3.40282346639e+038 3.40282346639e+038 /end CHARACTERISTIC
/begin CHARACTERISTIC BPIU_USptOffLim_P "Voltage Sport Off Limit" VALUE 0x20018A54 Scalar_FLOAT32_IEEE 0 swc_BatProtnIU_CM_single_V -3.40282346639e+038 3.40282346639e+038 /end CHARACTERISTIC
/begin CHARACTERISTIC BPIU_USptOnLim_P "Voltage Sport On Limit" VALUE 0x20018A58 Scalar_FLOAT32_IEEE 0 swc_BatProtnIU_CM_single_V -3.40282346639e+038 3.40282346639e+038 /end CHARACTERISTIC
/begin CHARACTERISTIC BPP_ISnsrLim_P "Current Sensor Limit" VALUE 0x20018A60 Scalar_FLOAT32_IEEE 0 swc_BatProtnIU_CM_single_A -3.40282346639e+038 3.40282346639e+038 /end CHARACTERISTIC
/begin CHARACTERISTIC BatteryChargingOvercurrent_P "BSM: Power battery charging (discharging) overcurrent" VALUE 0x20019D11 Scalar_UBYTE 0 swc_COL_CM_uint8_A 0 255 /end CHARACTERISTIC
/begin CHARACTERISTIC BatteryExcessTemperature_P "BSM: The power battery temperature is too high" VALUE 0x20019D12 Scalar_UBYTE 0 swc_COL_CM_uint8_dash_ 0 255 /end CHARACTERISTIC
/begin CHARACTERISTIC BatteryHighestTempSerNo_P "BSM: Maximum Temperature Detection Point Number" VALUE 0x20019D13 Scalar_UBYTE 0 swc_COL_CM_uint8_dash_ 0 255 /end CHARACTERISTIC
/begin CHARACTERISTIC BatteryHighestTemp_P "BatteryHighestTemp" VALUE 0x20019D14 Scalar_UBYTE 0 swc_COL_CM_uint8___C 0 255 /end CHARACTERISTIC
/begin CHARACTERISTIC BatteryInsulationState_P "BSM: Power battery insulation state" VALUE 0x20019D15 Scalar_UBYTE 0 swc_COL_CM_uint8_dash_ 0 255 /end CHARACTERISTIC
/begin CHARACTERISTIC BatteryLowestTempSerNo_P "BSM: Minimum power battery temperature detection point number" VALUE 0x20019D16 Scalar_UBYTE 0 swc_COL_CM_uint8_dash_ 0 255 /end CHARACTERISTIC
/begin CHARACTERISTIC BatteryLowestTemp_P "BSM: Minimum power battery temperature" VALUE 0x20019684 Scalar_FLOAT32_IEEE 0 swc_COL_CM_single_dash_ 0 255 /end CHARACTERISTIC
/begin CHARACTERISTIC BatteryOutputConnectorState_P "BSM: Power battery pack output connector connection status" VALUE 0x20019D17 Scalar_UBYTE 0 swc_COL_CM_uint8_dash_ 0 255 /end CHARACTERISTIC
/begin CHARACTERISTIC BatterySystemCapacity_P "BRM rated capacity" VALUE 0x20019C18 Scalar_UWORD 0 swc_COL_CM_uint16_Ah 0 65535 /end CHARACTERISTIC
/begin CHARACTERISTIC BatterySystemVoltage_P "BRM rated total pressure" VALUE 0x20019C1A Scalar_UWORD 0 swc_COL_CM_uint16_V 0 65535 /end CHARACTERISTIC
/begin CHARACTERISTIC BatteryType_P "BRM battery type: Send 03H: lithium iron phosphate battery" VALUE 0x20019D18 Scalar_UBYTE 0 swc_COL_CM_uint8_dash_ 0 255 /end CHARACTERISTIC
/begin CHARACTERISTIC CIL_Csw6_P "configuration switch for BSW (100ms)" VALUE 0x20019BEA Scalar_UWORD 0 swc_CIL_CM_uint16_dash_ 0 65535 /end CHARACTERISTIC
/begin CHARACTERISTIC CIL_IDcdcLvAct_P "Current at the low voltage side of DCDC" VALUE 0x20019C83 Scalar_UBYTE 0 swc_CIL_CM_uint8_A 0 255 /end CHARACTERISTIC
/begin CHARACTERISTIC CIL_StCellT_P "Cell temperature state\n      1: open circuit\n      2: short circuit" VAL_BLK 0x200195AC Scalar_UBYTE 0 swc_CIL_CM_uint8_dash_ 0 255 MATRIX_DIM 18 1 1 /end CHARACTERISTIC
/begin CHARACTERISTIC CIL_TBdSnsr_P "Temperature of the BCU board" VAL_BLK 0x200193DC Scalar_FLOAT32_IEEE 0 swc_CIL_CM_single__ -3.40282346639e+038 3.40282346639e+038 MATRIX_DIM 9 1 1 /end CHARACTERISTIC
/begin CHARACTERISTIC CIL_TMdulCtlr_P "Temperature of the module controllers" VAL_BLK 0x20019408 Scalar_FLOAT32_IEEE 0 swc_CIL_CM_single__ -3.40282346639e+038 3.40282346639e+038 MATRIX_DIM 32 1 1 /end CHARACTERISTIC
/begin CHARACTERISTIC CIL_TMdul_P "Temperature of the modules" VAL_BLK 0x20019488 Scalar_FLOAT32_IEEE 0 swc_CIL_CM_single__ -3.40282346639e+038 3.40282346639e+038 MATRIX_DIM 54 1 1 /end CHARACTERISTIC
/begin CHARACTERISTIC CIL_UDcdcLvAct_P "Voltage at the low voltage side of DCDC" VALUE 0x2001956C Scalar_FLOAT32_IEEE 0 swc_CIL_CM_single_V -3.40282346639e+038 3.40282346639e+038 /end CHARACTERISTIC
/begin CHARACTERISTIC CTC_Csw2_P "Configuration swtich for CTC outputs" VALUE 0x20019710 Scalar_ULONG 0 swc_CtctrTranCtl_CM_uint32_dash_ 0 4294967295 /end CHARACTERISTIC
/begin CHARACTERISTIC CTC_CswDiag_P "Configuration swtich for CTC diagnosis" VALUE 0x20019714 Scalar_ULONG 0 swc_CtctrTranCtl_CM_uint32_dash_ 0 4294967295 /end CHARACTERISTIC
/begin CHARACTERISTIC CTC_DecrtUPrechAccumd_P "If not in precharge mode, the accumulated precharge voltage (used for precharge resistor protection) decreases over time to simulate the resistor cooldown. This parameter sets the derement per second." VALUE 0x2001980C Scalar_FLOAT32_IEEE 0 swc_CtctrTranCtl_CM_single_V_per_s 0 10000 /end CHARACTERISTIC
/begin CHARACTERISTIC CTC_GainUPrechAccumd_P "The accumulated precharged voltage can be altered using this parameter." VALUE 0x20019814 Scalar_FLOAT32_IEEE 0 swc_CtctrTranCtl_CM_single_dash_ 0 100 /end CHARACTERISTIC
/begin CHARACTERISTIC CTC_IDriftZeroLim_P "Limit current for zero-drift faults" VALUE 0x200198F8 Scalar_FLOAT32_IEEE 0 swc_CtctrTranCtl_CM_single_A -3.40282346639e+038 3.40282346639e+038 /end CHARACTERISTIC
/begin CHARACTERISTIC CTC_StsTProtnRPrech_P "Fault status of the diagnosis: Temperature protection of precharge resistor" VALUE 0x20019D4B Scalar_UBYTE 0 swc_CtctrTranCtl_CM_uint8_dash_ 0 255 /end CHARACTERISTIC
/begin CHARACTERISTIC CTC_TiOffDig119ForSc_P "Turn off delay for diganosis 119" VALUE 0x20019964 Scalar_FLOAT32_IEEE 0 swc_CtctrTranCtl_CM_single_s -3.40282346639e+038 3.40282346639e+038 /end CHARACTERISTIC
/begin CHARACTERISTIC CTC_TiOffDig119_P "Turn off delay for diganosis 119 (High side drive shorted to ground)" VALUE 0x20019968 Scalar_FLOAT32_IEEE 0 swc_CtctrTranCtl_CM_single_s -3.40282346639e+038 3.40282346639e+038 /end CHARACTERISTIC
/begin CHARACTERISTIC CTC_TiOffDig120AftChk_P "Turn off delay for diganosis 120 (after self-checkc)" VALUE 0x2001996C Scalar_FLOAT32_IEEE 0 swc_CtctrTranCtl_CM_single_s -3.40282346639e+038 3.40282346639e+038 /end CHARACTERISTIC
/begin CHARACTERISTIC CTC_TiOffDig120AtChk_P "Turn off delay for diganosis 120 (During self-checkc)" VALUE 0x20019970 Scalar_FLOAT32_IEEE 0 swc_CtctrTranCtl_CM_single_s -3.40282346639e+038 3.40282346639e+038 /end CHARACTERISTIC
/begin CHARACTERISTIC CTC_TiOffDig120ForSc_P "Turn off delay for diganosis 120" VALUE 0x20019974 Scalar_FLOAT32_IEEE 0 swc_CtctrTranCtl_CM_single_s -3.40282346639e+038 3.40282346639e+038 /end CHARACTERISTIC
/begin CHARACTERISTIC CTC_TiOffDig121ForSc_P "Turn off delay for diganosis 121 (High side drive shorted to ground)" VALUE 0x20019978 Scalar_FLOAT32_IEEE 0 swc_CtctrTranCtl_CM_single_dash_ -3.40282346639e+038 3.40282346639e+038 /end CHARACTERISTIC
/begin CHARACTERISTIC CTC_TiOffDig121_P "Turn off delay for diganosis 121" VALUE 0x2001997C Scalar_FLOAT32_IEEE 0 swc_CtctrTranCtl_CM_single_dash_ -3.40282346639e+038 3.40282346639e+038 /end CHARACTERISTIC
/begin CHARACTERISTIC CTC_TiOffDig122ForSc_P "Turn off delay for diganosis 122 (High side drive shorted to power source)" VALUE 0x20019980 Scalar_FLOAT32_IEEE 0 swc_CtctrTranCtl_CM_single_dash_ -3.40282346639e+038 3.40282346639e+038 /end CHARACTERISTIC
/begin CHARACTERISTIC CTC_TiOffDig122_P "Turn off delay for diganosis 122" VALUE 0x20019984 Scalar_FLOAT32_IEEE 0 swc_CtctrTranCtl_CM_single_dash_ -3.40282346639e+038 3.40282346639e+038 /end CHARACTERISTIC
/begin CHARACTERISTIC CTC_TiOffDig123ForSc_P "Turn off delay for diganosis 123 (High side drive shorted to ground)" VALUE 0x20019988 Scalar_FLOAT32_IEEE 0 swc_CtctrTranCtl_CM_single_dash_ -3.40282346639e+038 3.40282346639e+038 /end CHARACTERISTIC
/begin CHARACTERISTIC CTC_TiOffDig123_P "Turn off delay for diganosis 123" VALUE 0x2001998C Scalar_FLOAT32_IEEE 0 swc_CtctrTranCtl_CM_single_dash_ -3.40282346639e+038 3.40282346639e+038 /end CHARACTERISTIC
/begin CHARACTERISTIC CTC_TiOffDig124AftChk_P "Turn off delay for diganosis 124 (after self-check)" VALUE 0x20019990 Scalar_FLOAT32_IEEE 0 swc_CtctrTranCtl_CM_single_dash_ -3.40282346639e+038 3.40282346639e+038 /end CHARACTERISTIC
/begin CHARACTERISTIC CTC_TiOffDig124AtChk_P "Turn off delay for diganosis 124 (During self-check)" VALUE 0x20019994 Scalar_FLOAT32_IEEE 0 swc_CtctrTranCtl_CM_single_dash_ -3.40282346639e+038 3.40282346639e+038 /end CHARACTERISTIC
/begin CHARACTERISTIC CTC_TiOffDig124ForSc_P "Turn off delay for diganosis 124 (High side drive shorted to power source)" VALUE 0x20019998 Scalar_FLOAT32_IEEE 0 swc_CtctrTranCtl_CM_single_dash_ -3.40282346639e+038 3.40282346639e+038 /end CHARACTERISTIC
/begin CHARACTERISTIC CTC_TiOffDig135ForSc_P "Turn off delay for diganosis 135 (High side drive shorted to ground)" VALUE 0x2001999C Scalar_FLOAT32_IEEE 0 swc_CtctrTranCtl_CM_single_dash_ -3.40282346639e+038 3.40282346639e+038 /end CHARACTERISTIC
/begin CHARACTERISTIC CTC_TiOffDig135_P "Turn off delay for diganosis 135" VALUE 0x200199A0 Scalar_FLOAT32_IEEE 0 swc_CtctrTranCtl_CM_single_dash_ -3.40282346639e+038 3.40282346639e+038 /end CHARACTERISTIC
/begin CHARACTERISTIC CTC_TiOffDig136AftChk_P "Turn off delay for diganosis 136 (after self-check)" VALUE 0x200199A4 Scalar_FLOAT32_IEEE 0 swc_CtctrTranCtl_CM_single_dash_ -3.40282346639e+038 3.40282346639e+038 /end CHARACTERISTIC
/begin CHARACTERISTIC CTC_TiOffDig136AtChk_P "Turn off delay for diganosis 136 (During self-check)" VALUE 0x200199A8 Scalar_FLOAT32_IEEE 0 swc_CtctrTranCtl_CM_single_dash_ -3.40282346639e+038 3.40282346639e+038 /end CHARACTERISTIC
/begin CHARACTERISTIC CTC_TiOffDig136ForSc_P "Turn off delay for diganosis 136 (High side drive shorted to power source)" VALUE 0x200199AC Scalar_FLOAT32_IEEE 0 swc_CtctrTranCtl_CM_single_dash_ -3.40282346639e+038 3.40282346639e+038 /end CHARACTERISTIC
/begin CHARACTERISTIC CTC_TiOffDig225_P "Turn off delay for diganosis 225" VALUE 0x200199B0 Scalar_FLOAT32_IEEE 0 swc_CtctrTranCtl_CM_single_dash_ -3.40282346639e+038 3.40282346639e+038 /end CHARACTERISTIC
/begin CHARACTERISTIC CTC_TiOffDig226_P "Turn off delay for diganosis 226" VALUE 0x200199B4 Scalar_FLOAT32_IEEE 0 swc_CtctrTranCtl_CM_single_dash_ -3.40282346639e+038 3.40282346639e+038 /end CHARACTERISTIC
/begin CHARACTERISTIC CTC_TiOffDig239_P "Turn on delay for diganosis 239" VALUE 0x200199B8 Scalar_FLOAT32_IEEE 0 swc_CtctrTranCtl_CM_single_dash_ -3.40282346639e+038 3.40282346639e+038 /end CHARACTERISTIC
/begin CHARACTERISTIC CTC_TiOffDig84ForScToGnd_P "Turn off delay for diganosis 84 (High side drive shorted to ground)" VALUE 0x200199BC Scalar_FLOAT32_IEEE 0 swc_CtctrTranCtl_CM_single_dash_ -3.40282346639e+038 3.40282346639e+038 /end CHARACTERISTIC
/begin CHARACTERISTIC CTC_TiOffDig84ForScToPwr_P "Turn off delay for diganosis 84 (High side drive shorted to power source)" VALUE 0x200199C0 Scalar_FLOAT32_IEEE 0 swc_CtctrTranCtl_CM_single_dash_ -3.40282346639e+038 3.40282346639e+038 /end CHARACTERISTIC
/begin CHARACTERISTIC CTC_TiOffDig84_P "Turn off delay for diganosis 84" VALUE 0x200199C4 Scalar_FLOAT32_IEEE 0 swc_CtctrTranCtl_CM_single_dash_ -3.40282346639e+038 3.40282346639e+038 /end CHARACTERISTIC
/begin CHARACTERISTIC CTC_TiOffForStsTProtnRPrech_P "Turn off delay for diganosis :Temperature protection of precharge resistor" VALUE 0x200199C8 Scalar_FLOAT32_IEEE 0 swc_CtctrTranCtl_CM_single_dash_ -3.40282346639e+038 3.40282346639e+038 /end CHARACTERISTIC
/begin CHARACTERISTIC CTC_TiOnDig119ForSc_P "Turn on delay for diganosis 119 (High side drive shorted to ground)" VALUE 0x200199CC Scalar_FLOAT32_IEEE 0 swc_CtctrTranCtl_CM_single_s -3.40282346639e+038 3.40282346639e+038 /end CHARACTERISTIC
/begin CHARACTERISTIC CTC_TiOnDig119_P "Turn on delay for diganosis 119" VALUE 0x200199D0 Scalar_FLOAT32_IEEE 0 swc_CtctrTranCtl_CM_single_s -3.40282346639e+038 3.40282346639e+038 /end CHARACTERISTIC
/begin CHARACTERISTIC CTC_TiOnDig120AftChk_P "Turn on delay for diganosis 120 (after self-check)" VALUE 0x200199D4 Scalar_FLOAT32_IEEE 0 swc_CtctrTranCtl_CM_single_s -3.40282346639e+038 3.40282346639e+038 /end CHARACTERISTIC
/begin CHARACTERISTIC CTC_TiOnDig120AtChk_P "Turn on delay for diganosis 120 (During self-checkc)" VALUE 0x200199D8 Scalar_FLOAT32_IEEE 0 swc_CtctrTranCtl_CM_single_s -3.40282346639e+038 3.40282346639e+038 /end CHARACTERISTIC
/begin CHARACTERISTIC CTC_TiOnDig120ForSc_P "Turn on delay for diganosis 120 (High side drive shorted to ground)" VALUE 0x200199DC Scalar_FLOAT32_IEEE 0 swc_CtctrTranCtl_CM_single_s -3.40282346639e+038 3.40282346639e+038 /end CHARACTERISTIC
/begin CHARACTERISTIC CTC_TiOnDig121ForSc_P "Turn on delay for diganosis 121 (High side drive shorted to ground)" VALUE 0x200199E0 Scalar_FLOAT32_IEEE 0 swc_CtctrTranCtl_CM_single_dash_ -3.40282346639e+038 3.40282346639e+038 /end CHARACTERISTIC
/begin CHARACTERISTIC CTC_TiOnDig121_P "Turn on delay for diganosis 121" VALUE 0x200199E4 Scalar_FLOAT32_IEEE 0 swc_CtctrTranCtl_CM_single_dash_ -3.40282346639e+038 3.40282346639e+038 /end CHARACTERISTIC
/begin CHARACTERISTIC CTC_TiOnDig122ForSc_P "Turn on delay for diganosis 122 (High side drive shorted to power source)" VALUE 0x200199E8 Scalar_FLOAT32_IEEE 0 swc_CtctrTranCtl_CM_single_dash_ -3.40282346639e+038 3.40282346639e+038 /end CHARACTERISTIC
/begin CHARACTERISTIC CTC_TiOnDig122_P "Turn on delay for diganosis 122" VALUE 0x200199EC Scalar_FLOAT32_IEEE 0 swc_CtctrTranCtl_CM_single_dash_ -3.40282346639e+038 3.40282346639e+038 /end CHARACTERISTIC
/begin CHARACTERISTIC CTC_TiOnDig123ForSc_P "Turn on delay for diganosis 123 (High side drive shorted to ground)" VALUE 0x200199F0 Scalar_FLOAT32_IEEE 0 swc_CtctrTranCtl_CM_single_dash_ -3.40282346639e+038 3.40282346639e+038 /end CHARACTERISTIC
/begin CHARACTERISTIC CTC_TiOnDig123_P "Turn on delay for diganosis 123" VALUE 0x200199F4 Scalar_FLOAT32_IEEE 0 swc_CtctrTranCtl_CM_single_dash_ -3.40282346639e+038 3.40282346639e+038 /end CHARACTERISTIC
/begin CHARACTERISTIC CTC_TiOnDig124AftChk_P "Turn on delay for diganosis 124 (after self-check)" VALUE 0x200199F8 Scalar_FLOAT32_IEEE 0 swc_CtctrTranCtl_CM_single_dash_ -3.40282346639e+038 3.40282346639e+038 /end CHARACTERISTIC
/begin CHARACTERISTIC CTC_TiOnDig124AtChk_P "Turn on delay for diganosis 124 (During self-check)" VALUE 0x200199FC Scalar_FLOAT32_IEEE 0 swc_CtctrTranCtl_CM_single_dash_ -3.40282346639e+038 3.40282346639e+038 /end CHARACTERISTIC
/begin CHARACTERISTIC CTC_TiOnDig124ForSc_P "Turn on delay for diganosis 124 (High side drive shorted to power source)" VALUE 0x20019A00 Scalar_FLOAT32_IEEE 0 swc_CtctrTranCtl_CM_single_dash_ -3.40282346639e+038 3.40282346639e+038 /end CHARACTERISTIC
/begin CHARACTERISTIC CTC_TiOnDig135ForSc_P "Turn on delay for diganosis 135 (High side drive shorted to ground)" VALUE 0x20019A04 Scalar_FLOAT32_IEEE 0 swc_CtctrTranCtl_CM_single_dash_ -3.40282346639e+038 3.40282346639e+038 /end CHARACTERISTIC
/begin CHARACTERISTIC CTC_TiOnDig135_P "Turn on delay for diganosis 135" VALUE 0x20019A08 Scalar_FLOAT32_IEEE 0 swc_CtctrTranCtl_CM_single_dash_ -3.40282346639e+038 3.40282346639e+038 /end CHARACTERISTIC
/begin CHARACTERISTIC CTC_TiOnDig136AftChk_P "Turn on delay for diganosis 136 (after self-check)" VALUE 0x20019A0C Scalar_FLOAT32_IEEE 0 swc_CtctrTranCtl_CM_single_dash_ -3.40282346639e+038 3.40282346639e+038 /end CHARACTERISTIC
/begin CHARACTERISTIC CTC_TiOnDig136AtChk_P "Turn on delay for diganosis 136 (During self-check)" VALUE 0x20019A10 Scalar_FLOAT32_IEEE 0 swc_CtctrTranCtl_CM_single_dash_ -3.40282346639e+038 3.40282346639e+038 /end CHARACTERISTIC
/begin CHARACTERISTIC CTC_TiOnDig136ForSc_P "Turn on delay for diganosis 136 (High side drive shorted to power source)" VALUE 0x20019A14 Scalar_FLOAT32_IEEE 0 swc_CtctrTranCtl_CM_single_dash_ -3.40282346639e+038 3.40282346639e+038 /end CHARACTERISTIC
/begin CHARACTERISTIC CTC_TiOnDig225_P "Turn on delay for diganosis 225" VALUE 0x20019A18 Scalar_FLOAT32_IEEE 0 swc_CtctrTranCtl_CM_single_dash_ -3.40282346639e+038 3.40282346639e+038 /end CHARACTERISTIC
/begin CHARACTERISTIC CTC_TiOnDig226_P "Turn on delay for diganosis 226" VALUE 0x20019A1C Scalar_FLOAT32_IEEE 0 swc_CtctrTranCtl_CM_single_dash_ -3.40282346639e+038 3.40282346639e+038 /end CHARACTERISTIC
/begin CHARACTERISTIC CTC_TiOnDig239_P "Turn on delay for diganosis 239" VALUE 0x20019A20 Scalar_FLOAT32_IEEE 0 swc_CtctrTranCtl_CM_single_dash_ -3.40282346639e+038 3.40282346639e+038 /end CHARACTERISTIC
/begin CHARACTERISTIC CTC_TiOnDig84ForErrI_P "Turn on delay for diganosis 84 (For excessive precharge current)" VALUE 0x20019A24 Scalar_FLOAT32_IEEE 0 swc_CtctrTranCtl_CM_single_dash_ -3.40282346639e+038 3.40282346639e+038 /end CHARACTERISTIC
/begin CHARACTERISTIC CTC_TiOnDig84ForScToGnd_P "Turn on delay for diganosis 84 (High side drive shorted to ground)" VALUE 0x20019A28 Scalar_FLOAT32_IEEE 0 swc_CtctrTranCtl_CM_single_dash_ -3.40282346639e+038 3.40282346639e+038 /end CHARACTERISTIC
/begin CHARACTERISTIC CTC_TiOnDig84ForScToPwr_P "Turn on delay for diganosis 84 (High side drive shorted to power source)" VALUE 0x20019A2C Scalar_FLOAT32_IEEE 0 swc_CtctrTranCtl_CM_single_dash_ -3.40282346639e+038 3.40282346639e+038 /end CHARACTERISTIC
/begin CHARACTERISTIC CTC_TiOnDig84_P "Turn on delay for diganosis 84" VALUE 0x20019A30 Scalar_FLOAT32_IEEE 0 swc_CtctrTranCtl_CM_single_dash_ -3.40282346639e+038 3.40282346639e+038 /end CHARACTERISTIC
/begin CHARACTERISTIC CTC_TiOnForStsTProtnRPrech_P "Turn on delay for diganosis :Temperature protection of precharge resistor" VALUE 0x20019A34 Scalar_FLOAT32_IEEE 0 swc_CtctrTranCtl_CM_single_dash_ -3.40282346639e+038 3.40282346639e+038 /end CHARACTERISTIC
/begin CHARACTERISTIC CTC_TiProc_P "Calculation time of CTC" VALUE 0x20019A3C Scalar_FLOAT32_IEEE 0 swc_CtctrTranCtl_CM_single_s -3.40282346639e+038 3.40282346639e+038 /end CHARACTERISTIC
/begin CHARACTERISTIC CTC_UPrechAccumdUpprLim_P "The function accumulates the precharged voltage during each precharge procedure to be able to monitor the precharge resistor stress and avoid damage. If the accumulated precharged voltage would exceed this limit after precharging, the diagnosis is reporti" VALUE 0x20019AA4 Scalar_FLOAT32_IEEE 0 swc_CtctrTranCtl_CM_single_V 0 10000 /end CHARACTERISTIC
/begin CHARACTERISTIC CTC_bAcvTProtnRPrech_P "Active flag for precharge resistance temperature protection" VALUE 0x20019D4D Scalar_BOOLEAN 0 swc_CtctrTranCtl_CM_boolean_dash_ 0 1 /end CHARACTERISTIC
/begin CHARACTERISTIC CTC_bErrIDriftZero_P "Excessive zero drift fault in current sensor" VALUE 0x20019D50 Scalar_BOOLEAN 0 swc_CtctrTranCtl_CM_boolean_dash_ 0 1 /end CHARACTERISTIC
/begin CHARACTERISTIC CTC_bErrPrech_P "Precharge failure" VALUE 0x20019D51 Scalar_BOOLEAN 0 swc_CtctrTranCtl_CM_boolean_dash_ 0 1 /end CHARACTERISTIC
/begin CHARACTERISTIC CTC_bErrRlyChHiDrvShoToGnd_P "Fast charging relay high side drive circuit shorted to ground" VALUE 0x20019D52 Scalar_BOOLEAN 0 swc_CtctrTranCtl_CM_boolean_dash_ 0 1 /end CHARACTERISTIC
/begin CHARACTERISTIC CTC_bErrRlyChHiDrvShoToPwr_P "Fast charging relay high side drive circuit shorted to power source" VALUE 0x20019D53 Scalar_BOOLEAN 0 swc_CtctrTranCtl_CM_boolean_dash_ 0 1 /end CHARACTERISTIC
/begin CHARACTERISTIC CTC_bErrRlyChHiSideDrv_P "Fast charging relay high side drive error" VALUE 0x20019D54 Scalar_BOOLEAN 0 swc_CtctrTranCtl_CM_boolean_dash_ 0 1 /end CHARACTERISTIC
/begin CHARACTERISTIC CTC_bErrRlyChWldd_P "Fast charging relay weld error" VALUE 0x20019D55 Scalar_BOOLEAN 0 swc_CtctrTranCtl_CM_boolean_dash_ 0 1 /end CHARACTERISTIC
/begin CHARACTERISTIC CTC_bErrRlyHeatHiDrvShoToGnd_P "Heat relay high side drive circuit shorted to ground" VALUE 0x20019D56 Scalar_BOOLEAN 0 swc_CtctrTranCtl_CM_boolean_dash_ 0 1 /end CHARACTERISTIC
/begin CHARACTERISTIC CTC_bErrRlyHeatHiDrvShoToPwr_P "Heat relay high side drive circuit shorted to power source" VALUE 0x20019D57 Scalar_BOOLEAN 0 swc_CtctrTranCtl_CM_boolean_dash_ 0 1 /end CHARACTERISTIC
/begin CHARACTERISTIC CTC_bErrRlyHeatHiSideDrv_P "Heat relay high side drive error" VALUE 0x20019D58 Scalar_BOOLEAN 0 swc_CtctrTranCtl_CM_boolean_dash_ 0 1 /end CHARACTERISTIC
/begin CHARACTERISTIC CTC_bErrRlyHeatWldd_P "Heat relay weld error" VALUE 0x20019D59 Scalar_BOOLEAN 0 swc_CtctrTranCtl_CM_boolean_dash_ 0 1 /end CHARACTERISTIC
/begin CHARACTERISTIC CTC_bErrRlyNegHiDrvShoToGnd_P "Main negative relay high side drive circuit shorted to ground" VALUE 0x20019D5A Scalar_BOOLEAN 0 swc_CtctrTranCtl_CM_boolean_dash_ 0 1 /end CHARACTERISTIC
/begin CHARACTERISTIC CTC_bErrRlyNegHiDrvShoToPwr_P "Main negative relay high side drive circuit shorted to power source" VALUE 0x20019D5B Scalar_BOOLEAN 0 swc_CtctrTranCtl_CM_boolean_dash_ 0 1 /end CHARACTERISTIC
/begin CHARACTERISTIC CTC_bErrRlyNegHiSideDrv_P "Main negative relay high side drive error" VALUE 0x20019D5C Scalar_BOOLEAN 0 swc_CtctrTranCtl_CM_boolean_dash_ 0 1 /end CHARACTERISTIC
/begin CHARACTERISTIC CTC_bErrRlyNegWldd_P "Main negative relay weld error" VALUE 0x20019D5D Scalar_BOOLEAN 0 swc_CtctrTranCtl_CM_boolean_dash_ 0 1 /end CHARACTERISTIC
/begin CHARACTERISTIC CTC_bErrRlyPosHiDrvShoToGnd_P "Main positive relay high side drive circuit shorted to ground" VALUE 0x20019D5E Scalar_BOOLEAN 0 swc_CtctrTranCtl_CM_boolean_dash_ 0 1 /end CHARACTERISTIC
/begin CHARACTERISTIC CTC_bErrRlyPosHiDrvShoToPwr_P "Main positive relay high side drive circuit shorted to power source" VALUE 0x20019D5F Scalar_BOOLEAN 0 swc_CtctrTranCtl_CM_boolean_dash_ 0 1 /end CHARACTERISTIC
/begin CHARACTERISTIC CTC_bErrRlyPosHiSideDrv_P "Main positive relay high side drive error" VALUE 0x20019D60 Scalar_BOOLEAN 0 swc_CtctrTranCtl_CM_boolean_dash_ 0 1 /end CHARACTERISTIC
/begin CHARACTERISTIC CTC_bErrRlyPosWldd_P "Main positive relay weld error" VALUE 0x20019D61 Scalar_BOOLEAN 0 swc_CtctrTranCtl_CM_boolean_dash_ 0 1 /end CHARACTERISTIC
/begin CHARACTERISTIC CTC_bErrRlyPrechHiDrvShoToGnd_P "Precharge relay high side drive circuit shorted to ground" VALUE 0x20019D62 Scalar_BOOLEAN 0 swc_CtctrTranCtl_CM_boolean_dash_ 0 1 /end CHARACTERISTIC
/begin CHARACTERISTIC CTC_bErrRlyPrechHiDrvShoToPwr_P "Precharge relay high side drive circuit shorted to power source" VALUE 0x20019D63 Scalar_BOOLEAN 0 swc_CtctrTranCtl_CM_boolean_dash_ 0 1 /end CHARACTERISTIC
/begin CHARACTERISTIC CTC_bErrSigChWupLost_P "Charging wake-up signal loss fault" VALUE 0x20019D64 Scalar_BOOLEAN 0 swc_CtctrTranCtl_CM_boolean_dash_ 0 1 /end CHARACTERISTIC
/begin CHARACTERISTIC CTC_bErrToutForMotDchaToDiag_P "Motor discharge time out" VALUE 0x20019D65 Scalar_BOOLEAN 0 swc_CtctrTranCtl_CM_boolean_dash_ 0 1 /end CHARACTERISTIC
/begin CHARACTERISTIC ELHPN_CfgHvil2_P "Configuration of non-power high voltage interlock loop state." VALUE 0x20019D83 Scalar_UBYTE 0 swc_EltlLnkHzrdProtnNet_CM_uint8_dash_ 0 255 /end CHARACTERISTIC
/begin CHARACTERISTIC ELHPN_DucycCrashTolr_P "HW crash is deCrash is detected if crash duty cycle exceeds this tolerance." VALUE 0x20019AEC Scalar_FLOAT32_IEEE 0 swc_EltlLnkHzrdProtnNet_CM_single_percent_ 0 100 /end CHARACTERISTIC
/begin CHARACTERISTIC ELHPN_DucycHvilReq_P "Ducy parameter to call SetPwmValue function to get CIL_FrqHvil and CIL_DucycHvil." VALUE 0x20019AF0 Scalar_ULONG 0 swc_EltlLnkHzrdProtnNet_CM_uint32_percent_ 0 4294967295 /end CHARACTERISTIC
/begin CHARACTERISTIC ELHPN_DucycHvilTolr_P "An HVIL fault is detected if the dutycycle return value is outside the range of HVIL source value +/- this tolerance." VALUE 0x20019AF4 Scalar_FLOAT32_IEEE 0 swc_EltlLnkHzrdProtnNet_CM_single_percent_ 0 100 /end CHARACTERISTIC
/begin CHARACTERISTIC ELHPN_FrqCrashTolr_P "Crash is detected if crash frequency exceeds this tolerance." VALUE 0x20019AF8 Scalar_FLOAT32_IEEE 0 swc_EltlLnkHzrdProtnNet_CM_single_Hz 0 100 /end CHARACTERISTIC
/begin CHARACTERISTIC ELHPN_FrqHvilReq_P "Period parameter to call SetPwmValue function to get CIL_FrqHvil and CIL_DucycHvil." VALUE 0x20019AFC Scalar_ULONG 0 swc_EltlLnkHzrdProtnNet_CM_uint32_Hz 0 4294967295 /end CHARACTERISTIC
/begin CHARACTERISTIC ELHPN_FrqHvilTolr_P "An HVIL fault is detected if the frequency return value is outside the range of HVIL source value +/- this tolerance." VALUE 0x20019B00 Scalar_FLOAT32_IEEE 0 swc_EltlLnkHzrdProtnNet_CM_single_Hz 0 100 /end CHARACTERISTIC
/begin CHARACTERISTIC ELHPN_IdxHvilReq_P "NumId parameter to call SetPwmValue function to get CIL_FrqHvil and CIL_DucycHvil." VALUE 0x20019B04 Scalar_ULONG 0 swc_EltlLnkHzrdProtnNet_CM_uint32_dash_ 0 4294967295 /end CHARACTERISTIC
/begin AXIS_PTS ELHPN_StBatHv_A "Axis for look up table of isolation measurement disable flag." 0x20019B84 NO_INPUT_QUANTITY Lookup1D_X_UBYTE 0 swc_EltlLnkHzrdProtnNet_CM_uint8_dash_ 16 0 255 DEPOSIT ABSOLUTE /end AXIS_PTS
/begin CHARACTERISTIC ELHPN_StCrashCfg_P "Directly config output ELHPN_StCrash. (Only when corresponding configure switch bit is valid)." VALUE 0x0 Scalar_BOOLEAN 0 swc_EltlLnkHzrdProtnNet_CM_boolean_dash_ 0 1 /end CHARACTERISTIC
/begin CHARACTERISTIC ELHPN_TiCrashDebOff_P "Time delay off for debounce of crash state." VALUE 0x20019B34 Scalar_FLOAT32_IEEE 0 swc_EltlLnkHzrdProtnNet_CM_single_s 0 4294967296 /end CHARACTERISTIC
/begin CHARACTERISTIC ELHPN_TiCrashDebOn_P "Time delay on for debounce of crash state." VALUE 0x20019B38 Scalar_FLOAT32_IEEE 0 swc_EltlLnkHzrdProtnNet_CM_single_s 0 4294967296 /end CHARACTERISTIC
/begin CHARACTERISTIC ELHPN_TiDebOffHvIntlc_P "Time delay off for debounce of high voltege interlock error state." VALUE 0x20019B44 Scalar_FLOAT32_IEEE 0 swc_EltlLnkHzrdProtnNet_CM_single_s 0 4294967296 /end CHARACTERISTIC
/begin CHARACTERISTIC ELHPN_TiDebOnHvIntlc_P "Time delay on for debounce of high voltege interlock error state." VALUE 0x20019B48 Scalar_FLOAT32_IEEE 0 swc_EltlLnkHzrdProtnNet_CM_single_s 0 4294967296 /end CHARACTERISTIC
/begin CHARACTERISTIC ELHPN_TiIslnIninChk_P "Time limit for isolation state check during initialization." VALUE 0x20019B7C Scalar_FLOAT32_IEEE 0 swc_EltlLnkHzrdProtnNet_CM_single_s -3.40282346639e+038 3.40282346639e+038 /end CHARACTERISTIC
/begin CHARACTERISTIC ELHPN_bDisaIslnMeas_M "Look up table of isolation measurement disable flag." CURVE 0x20019BA4 Lookup1D_UBYTE 0 swc_EltlLnkHzrdProtnNet_CM_uint8_dash_ 0 255
 /begin AXIS_DESCR COM_AXIS NO_INPUT_QUANTITY swc_EltlLnkHzrdProtnNet_CM_uint8_dash_ 16 0 255 DEPOSIT ABSOLUTE AXIS_PTS_REF ELHPN_StBatHv_A /end AXIS_DESCR
/end CHARACTERISTIC
/begin GROUP S192_BCF_UChOc_M "swc_BatCoreFct/BCF_100ms_sys/BatCoreFct/PackObs/PackObsLoop/MdulObs/CellObsr/MdulModelLin/BCF_UChOc_M" /begin REF_CHARACTERISTIC BCF_UChOc_M /end REF_CHARACTERISTIC /end GROUP
/begin GROUP S192_BCF_UDchaOc_M "swc_BatCoreFct/BCF_100ms_sys/BatCoreFct/PackObs/PackObsLoop/MdulObs/CellObsr/MdulModelLin/BCF_UDchaOc_M" /begin REF_CHARACTERISTIC BCF_UDchaOc_M /end REF_CHARACTERISTIC /end GROUP
/begin GROUP S194_BCF_FacRCellDelta_P "swc_BatCoreFct/BCF_100ms_sys/BatCoreFct/PackObs/PackObsLoop/MdulObs/CellObsr/Sensitivity of Estimation/BCF_FacRCellDelta_P" /begin REF_CHARACTERISTIC BCF_FacRCellDelta_P /end REF_CHARACTERISTIC /end GROUP
/begin GROUP S194_BCF_RMdulLamWithBaln_P "swc_BatCoreFct/BCF_100ms_sys/BatCoreFct/PackObs/PackObsLoop/MdulObs/CellObsr/Sensitivity of Estimation/BCF_RMdulLamWithBaln_P" /begin REF_CHARACTERISTIC BCF_RMdulLamWithBaln_P /end REF_CHARACTERISTIC /end GROUP
/begin GROUP S194_BCF_RMdulLamWoutBaln_P "swc_BatCoreFct/BCF_100ms_sys/BatCoreFct/PackObs/PackObsLoop/MdulObs/CellObsr/Sensitivity of Estimation/BCF_RMdulLamWoutBaln_P" /begin REF_CHARACTERISTIC BCF_RMdulLamWoutBaln_P /end REF_CHARACTERISTIC /end GROUP
/begin GROUP S194_BCF_RMdulWtngWithBaln_P "swc_BatCoreFct/BCF_100ms_sys/BatCoreFct/PackObs/PackObsLoop/MdulObs/CellObsr/Sensitivity of Estimation/BCF_RMdulWtngWithBaln_P" /begin REF_CHARACTERISTIC BCF_RMdulWtngWithBaln_P /end REF_CHARACTERISTIC /end GROUP
/begin GROUP S194_BCF_ValSysMtrxCdngNrLoLim_P "swc_BatCoreFct/BCF_100ms_sys/BatCoreFct/PackObs/PackObsLoop/MdulObs/CellObsr/Sensitivity of Estimation/BCF_ValSysMtrxCdngNrLoLim_P" /begin REF_CHARACTERISTIC BCF_ValSysMtrxCdngNrLoLim_P /end REF_CHARACTERISTIC /end GROUP
/begin GROUP S196_Cell_Delta_Assignment "swc_BatCoreFct/BCF_100ms_sys/BatCoreFct/PackObs/PackObsLoop/MdulObs/CellObsr/Validation of Estimation/Cell Delta Assignment"
 /begin SUB_GROUP S243_BCF_RCellDeltaHiLim_P S243_BCF_RCellDeltaLoLim_P S243_BCF_SocCellDeltaHiLim_P S243_BCF_SocCellDeltaLoLim_P /end SUB_GROUP
/end GROUP
/begin GROUP S196_Monitor_Balancing_Activity "swc_BatCoreFct/BCF_100ms_sys/BatCoreFct/PackObs/PackObsLoop/MdulObs/CellObsr/Validation of Estimation/Monitor Balancing Activity"
 /begin SUB_GROUP S244_BCF_TiBalnAcvDdecrt_P S244_BCF_TiBalnAcvDincrt_P S244_BCF_TiBalnAcvUpprLim_P S244_BCF_TiBalnOffLowrLim_P /end SUB_GROUP
/end GROUP
/begin GROUP S199_BPP_TiFuseClrdDetd_P1 "swc_BatProtnPack/PackVDiagAndExecutionControl/10ms/SignalArbitrator/CtctrRelsInh/Timer/BPP_TiFuseClrdDetd_P1" /end GROUP
/begin GROUP S199_BPP_TiSample1_P "swc_BatProtnPack/PackVDiagAndExecutionControl/10ms/SignalArbitrator/CtctrRelsInh/Timer/BPP_TiSample1_P" /end GROUP
/begin GROUP S19_BPIU_TiOffDig112_P "swc_BatProtnIU/CellUDiag/100ms/TotalVoltageFault/BPIU_TiOffDig112_P" /begin REF_CHARACTERISTIC BPIU_TiOffDig112_P /end REF_CHARACTERISTIC /end GROUP
/begin GROUP S19_BPIU_TiOnDig112_P "swc_BatProtnIU/CellUDiag/100ms/TotalVoltageFault/BPIU_TiOnDig112_P" /begin REF_CHARACTERISTIC BPIU_TiOnDig112_P /end REF_CHARACTERISTIC /end GROUP
/begin GROUP S19_BPIU_UPackLimOff_P "swc_BatProtnIU/CellUDiag/100ms/TotalVoltageFault/BPIU_UPackLimOff_P" /begin REF_CHARACTERISTIC BPIU_UPackLimOff_P /end REF_CHARACTERISTIC /end GROUP
/begin GROUP S19_BPIU_UPackLimOn_P "swc_BatProtnIU/CellUDiag/100ms/TotalVoltageFault/BPIU_UPackLimOn_P" /begin REF_CHARACTERISTIC BPIU_UPackLimOn_P /end REF_CHARACTERISTIC /end GROUP
/begin GROUP S19_ELHPN_DucycCrashTolr_P1 "swc_EltlLnkHzrdProtnNet/ELHPN_10ms_sys/ELHPN_10ms_sys/CrashErr/ELHPN_DucycCrashTolr_P1" /begin REF_CHARACTERISTIC ELHPN_DucycCrashTolr_P /end REF_CHARACTERISTIC /end GROUP
/begin GROUP S19_ELHPN_FrqCrashTolr_P1 "swc_EltlLnkHzrdProtnNet/ELHPN_10ms_sys/ELHPN_10ms_sys/CrashErr/ELHPN_FrqCrashTolr_P1" /begin REF_CHARACTERISTIC ELHPN_FrqCrashTolr_P /end REF_CHARACTERISTIC /end GROUP
/begin GROUP S19_ELHPN_StCrashCfg_P1 "swc_EltlLnkHzrdProtnNet/ELHPN_10ms_sys/ELHPN_10ms_sys/CrashErr/ELHPN_StCrashCfg_P1" /begin REF_CHARACTERISTIC ELHPN_StCrashCfg_P /end REF_CHARACTERISTIC /end GROUP
/begin GROUP S19_ELHPN_TiCrashDebOff_P "swc_EltlLnkHzrdProtnNet/ELHPN_10ms_sys/ELHPN_10ms_sys/CrashErr/ELHPN_TiCrashDebOff_P" /begin REF_CHARACTERISTIC ELHPN_TiCrashDebOff_P /end REF_CHARACTERISTIC /end GROUP
/begin GROUP S19_ELHPN_TiCrashDebOn_P "swc_EltlLnkHzrdProtnNet/ELHPN_10ms_sys/ELHPN_10ms_sys/CrashErr/ELHPN_TiCrashDebOn_P" /begin REF_CHARACTERISTIC ELHPN_TiCrashDebOn_P /end REF_CHARACTERISTIC /end GROUP
/begin GROUP S19_InitialCheck "swc_EltlLnkHzrdProtnNet/ELHPN_10ms_sys/ELHPN_10ms_sys/CrashErr/InitialCheck"
 /begin SUB_GROUP S35_BitSelect S35_ELHPN_TiCrashDebIniOff_P S35_ELHPN_TiCrashDebIniOn_P S35_ELHPN_TiSample1 /end SUB_GROUP
/end GROUP
/begin GROUP S1_1000ms "swc_BatProtnPack/PackSocAndSohDiag/1000ms"
 /begin SUB_GROUP S3_CellTemperatureDiagnosis S3_PackSocDiagnosisAndLimit S3_PackSohDiagnosis /end SUB_GROUP
/end GROUP
/begin GROUP S1_100ms "swc_BatThermHndlgMngt/BTHM_100ms_sys/100ms"
 /begin SUB_GROUP S2_BTHM_ModeTherm_P1 S2_BTHM_ModeTherm_P2 S2_BTHM_ModeTherm_P3 S2_BTHM_TMaxOptmLim_P S2_BTHM_TMinOptmLim_P S2_DataPrep S2_ThermManage S3_CellVoltageDiagnosis S3_HighVoltageDiagnosis S3_TotalVoltageFault S3_UPackCollectionDiagnosis /end SUB_GROUP
/end GROUP
/begin GROUP S1_AC_10ms_sys "swc_BatChCtl/AC_10ms_sys/AC_10ms_sys"
 /begin SUB_GROUP S4_AC_Condition S4_Current_and_Voltage_Calculated S4_Diagnosis S4_SMObc_TiProc_P S4_SMObc_TiWaitForTout1_P S4_SMObc_TiWaitForTout2_P S4_SMObc_TiWaitForTout_P /end SUB_GROUP
/end GROUP
/begin GROUP S1_BatCoreFct "swc_BatCoreFct/BCF_100ms_sys/BatCoreFct"
 /begin SUB_GROUP S51_BatCoreInit S51_BCF_NrCellPack_P S51_NrMdulMax S51_PackObs S51_PackStateClcn S51_SensorDelayForISD S51_Signal_Mapping /end SUB_GROUP
 /begin REF_MEASUREMENT BCF_CMdulAgiFacErrCt BCF_CMdulAgiFacFls BCF_CMdulAgiFacTrip BCF_ChMdulIntgl BCF_RMdulAgiFacErrCt BCF_RMdulAgiFacFls BCF_RMdulAgiFacTrip BCF_SocMdulInvldFlsRaw BCF_SofCellPwrLoss BCF_SohPackMinFls BCF_SohRDeltaFls BCF_SohRDeltaOfTrip BCF_SohRDeltaOfTripRef BCF_SohSocDeltaFls BCF_SohSocDeltaOfTrip BCF_SohSocDeltaOfTripRef BCF_StAryFls BCF_TiBatOffForMdulCFls BCF_TiBatOffForMdulCTrip BCF_TiBatOffForMdulRFls BCF_TiBatOffForMdulRTrip BCF_TiTmrBalnAcv BCF_TsCtrCMdulObsr BCF_UMapSelnFls BCF_UMdulToMdlFil BCF_ValSysUpdMtrx3 BCF_ValSysUpdMtrx4 BCF_ValSysUpdMtrx5 BCF_ValSysUpdMtrx6 BCF_ValSysUpdMtrx7 BCF_ValSysUpdMtrx8 BCF_bVldCellObsrEstimn /end REF_MEASUREMENT
/end GROUP
/begin GROUP S1_BBC_100ms_sys "swc_BatBalnCtl/BBC_100ms_sys/BBC_100ms_sys"
 /begin SUB_GROUP S2_BatBalnCtl S2_BatBalnCtl_BalnIClcn S2_BBC_IdxMdulInCfg_P1 /end SUB_GROUP
 /begin REF_MEASUREMENT BBC_TBalnRAvg BBC_TBalnRPas /end REF_MEASUREMENT
/end GROUP
/begin GROUP S1_BcuStTranCtl "swc_BcuStTranCtl/BcuStTranCtl_sys/BcuStTranCtl"
 /begin SUB_GROUP S29_BatteryTimeCalculation S29_ConditionConfirm S29_DTC S29_ExternalResetCalculation S29_SetWakeUpTime S29_Time /end SUB_GROUP
/end GROUP
/begin GROUP S1_BMS_customer_config "swc_CIL/CIL_100ms_sys/BMS customer config"
 /begin SUB_GROUP S5_MCC_NrCellByMdul_P S5_MCC_NrCellTot_P S5_MCC_NrCtlrSnsrTByMdul_P S5_MCC_NrMdulCtlrSnsrTTot_P S5_MCC_NrMdulTot_P S5_MCC_NrSnsrTByMdul_P S5_MCC_NrSnsrTTot_P /end SUB_GROUP
/end GROUP
/begin GROUP S1_BSW "swc_CIL/CIL_100ms_sys/BSW"
 /begin SUB_GROUP S22_BMC_UCell_P S22_CIL_IDcdcLvAct_P S22_CIL_StCellT_P S22_CIL_TBdSnsr_P S22_CIL_TMdul_P S22_CIL_TMdulCtlr_P S22_CIL_UDcdcLvAct_P S22_DTRC_Csw_P_1 S22_DTRC_Csw_P_10 S22_DTRC_Csw_P_11 S22_DTRC_Csw_P_12 S22_DTRC_Csw_P_16 S22_DTRC_Csw_P_8 S22_DTRC_Csw_P_9 /end SUB_GROUP
/end GROUP
/begin GROUP S1_COL_1000ms_sys "swc_COL/COL_1000ms_sys/COL_1000ms_sys"
 /begin SUB_GROUP S41_B2V_SingleChgEnergy_P S41_BMS_BattMaxTemp1_P S41_BMS_BattMaxWorkTemp_P S41_BMS_BattMinTemp1_P S41_BMS_BattMinWorkTemp_P S41_BMS_BattTotalChgEny_P S41_BMS_BattTotalDischgEny_P S41_BMS_Cell_Avg_Temp_P S41_BMS_ChgCount_P S41_BMS_ChgTimeRemain_P S41_BMS_DCChgNegTemp_P S41_BMS_DCChgPosTemp_P S41_BMS_IC_Temp_P S41_BMS_MaxCellVolt_P S41_BMS_MaxPmtDischgCurr_P S41_BMS_MaxPmtEnyRecoCurr_P S41_BMS_MaxPmtEnyRecoVol_P S41_BMS_MaxTemp1PackNum_P S41_BMS_MaxTemp1SnsNum_P S41_BMS_MaxVoltCellNum_P S41_BMS_MaxVoltCellPackNum_P S41_BMS_MinCellVolt_P S41_BMS_MinPmtSOC_P S41_BMS_MinTemp1PackNum_P S41_BMS_MinTemp1SnsNum_P S41_BMS_MinVoltCellNum_P S41_BMS_MinVoltCellPackNum_P S41_BMS_SingleDisChgEny_P S41_DTRC_Csw_P_1 S41_DTRC_Csw_P_103 S41_DTRC_Csw_P_110 S41_DTRC_Csw_P_14 S41_DTRC_Csw_P_15 S41_DTRC_Csw_P_16 S41_DTRC_Csw_P_17 S41_DTRC_Csw_P_18 S41_DTRC_Csw_P_19 S41_DTRC_Csw_P_2 S41_DTRC_Csw_P_20 S41_DTRC_Csw_P_21 S41_DTRC_Csw_P_22 S41_DTRC_Csw_P_24 S41_DTRC_Csw_P_25 S41_DTRC_Csw_P_26 S41_DTRC_Csw_P_27 S41_DTRC_Csw_P_29 S41_DTRC_Csw_P_30 S41_DTRC_Csw_P_31 S41_DTRC_Csw_P_34 S41_DTRC_Csw_P_46 S41_DTRC_Csw_P_47 S41_DTRC_Csw_P_48 S41_DTRC_Csw_P_57 S41_DTRC_Csw_P_58 S41_DTRC_Csw_P_77 S41_DTRC_Csw_P_98 /end SUB_GROUP
/end GROUP
/begin GROUP S1_CtcrtTranCtl "swc_CtctrTranCtl/CtcrtTranCtl_sys/CtcrtTranCtl"
 /begin SUB_GROUP S47_BitSelect1 S47_BitSelect22 S47_ContactorAgingObserver S47_CTC_bDisaUDecr_P S47_CTC_bDisaUDecr_P1 S47_CTC_bDisaUDecr_P2 S47_CTC_StHvbat_P S47_CTC_StLoopHv_P S47_Enabled_Subsystem1 S47_Enabled_Subsystem2 S47_Enabled_Subsystem3 S47_Enabled_Subsystem4 S47_Enabled_Subsystem5 S47_Error S47_Subsystem S47_TiLoop S47_Time S47_TransitionCondition /end SUB_GROUP
/end GROUP
/begin GROUP S1_DEH_10ms_sys "swc_DiagcEveHndlg/DEH_10ms_sys/DEH_10ms_sys" /begin SUB_GROUP S7_FIM S7_General_Diagnosis_Signals /end SUB_GROUP /end GROUP
/begin GROUP S1_ELHPN_10ms_sys "swc_EltlLnkHzrdProtnNet/ELHPN_10ms_sys/ELHPN_10ms_sys"
 /begin SUB_GROUP S2_CrashErr S2_ELHPN_CfgDiag191_P S2_HighVoltageInterlock_ S2_InhibitionIsolationMeasurement S2_StateIsolation /end SUB_GROUP
/end GROUP
/begin GROUP S1_GB_CAN "swc_CIL/CIL_100ms_sys/GB_CAN"
 /begin SUB_GROUP S47_BSOF_DirChAndDcha_P S47_BSOF_EChSng_P S47_BSOF_ErrMsgTout1_P S47_BSOF_ErrMsgTout2_P S47_BSOF_ErrMsgTout3_P S47_BSOF_ErrMsgTout4_P S47_BSOF_ErrMsgTout5_P S47_BSOF_ErrMsgTout6_P S47_BSOF_ErrMsgTout7_P S47_BSOF_IChrgrMax_P S47_BSOF_IChrgrMin_P S47_BSOF_IDchaMax_P S47_BSOF_IDchaMin_P S47_BSOF_MsgChrgrRcgtn_P S47_BSOF_MsgChrgrRdy_P S47_BSOF_NrChrgrComVers_P S47_BSOF_SocDchaMax_P S47_BSOF_SocDchaMin_P S47_BSOF_UChrgrMax_P S47_BSOF_UChrgrMin_P S47_BSOF_UDchaMax_P S47_BSOF_UDchaMin_P S47_DTRC_Csw_P_1 S47_DTRC_Csw_P_2 S47_DTRC_Csw_P_3 S47_DTRC_Csw_P_32 S47_DTRC_Csw_P_33 S47_DTRC_Csw_P_34 S47_DTRC_Csw_P_35 S47_DTRC_Csw_P_38 S47_DTRC_Csw_P_39 S47_DTRC_Csw_P_4 S47_DTRC_Csw_P_5 S47_DTRC_Csw_P_57 S47_DTRC_Csw_P_58 S47_DTRC_Csw_P_59 S47_DTRC_Csw_P_6 S47_DTRC_Csw_P_60 S47_DTRC_Csw_P_61 S47_DTRC_Csw_P_62 S47_DTRC_Csw_P_63 S47_DTRC_Csw_P_64 S47_DTRC_Csw_P_7 S47_DTRC_Csw_P_70 /end SUB_GROUP
/end GROUP
/begin GROUP S1_Veh_CAN "swc_CIL/CIL_100ms_sys/Veh_CAN"
 /begin SUB_GROUP S55_CIL_DucycCtlPilot_P S55_CIL_IEACAct_P S55_CIL_IObcChOutp_P S55_CIL_PwrEACAct_P S55_CIL_PwrPtcAct_P S55_CIL_RAcChCnctn_P S55_CIL_StAcChCnct_P S55_CIL_StBatHvReq_P S55_CIL_StBatLvCutoffReq_P S55_CIL_StChAllwd_P S55_CIL_StObc_P S55_CIL_StPtcW_P S55_CIL_StPtIndcr_P S55_CIL_TCooltPackInSnsr_P S55_CIL_TCooltPackOutSnsr_P S55_CIL_UEACAct_P S55_CIL_UObcChInp_P S55_CIL_UObcChOutp_P S55_DTRC_Csw_P_1 S55_DTRC_Csw_P_10 S55_DTRC_Csw_P_13 S55_DTRC_Csw_P_14 S55_DTRC_Csw_P_2 S55_DTRC_Csw_P_3 S55_DTRC_Csw_P_4 S55_DTRC_Csw_P_40 S55_DTRC_Csw_P_41 S55_DTRC_Csw_P_5 S55_DTRC_Csw_P_6 S55_DTRC_Csw_P_7 S55_DTRC_Csw_P_71 S55_DTRC_Csw_P_72 S55_DTRC_Csw_P_8 S55_DTRC_Csw_P_82 S55_DTRC_Csw_P_83 S55_DTRC_Csw_P_9 /end SUB_GROUP
/end GROUP
/begin GROUP S200_BitSelect "swc_CtctrTranCtl/CtcrtTranCtl_sys/CtcrtTranCtl/Error/ChargeSignalLost/BitSelect" /begin REF_CHARACTERISTIC CTC_CswDiag_P /end REF_CHARACTERISTIC /end GROUP
/begin GROUP S200_BitSelect20 "swc_CtctrTranCtl/CtcrtTranCtl_sys/CtcrtTranCtl/Error/ChargeSignalLost/BitSelect20" /begin REF_CHARACTERISTIC CTC_Csw2_P /end REF_CHARACTERISTIC /end GROUP
/begin GROUP S200_CTC_bErrSigChWupLost_P "swc_CtctrTranCtl/CtcrtTranCtl_sys/CtcrtTranCtl/Error/ChargeSignalLost/CTC_bErrSigChWupLost_P" /begin REF_CHARACTERISTIC CTC_bErrSigChWupLost_P /end REF_CHARACTERISTIC /end GROUP
/begin GROUP S200_CTC_TiOffDig225_P "swc_CtctrTranCtl/CtcrtTranCtl_sys/CtcrtTranCtl/Error/ChargeSignalLost/CTC_TiOffDig225_P" /begin REF_CHARACTERISTIC CTC_TiOffDig225_P /end REF_CHARACTERISTIC /end GROUP
/begin GROUP S200_CTC_TiOnDig225_P "swc_CtctrTranCtl/CtcrtTranCtl_sys/CtcrtTranCtl/Error/ChargeSignalLost/CTC_TiOnDig225_P" /begin REF_CHARACTERISTIC CTC_TiOnDig225_P /end REF_CHARACTERISTIC /end GROUP
/begin GROUP S200_CTC_TiProc_P19 "swc_CtctrTranCtl/CtcrtTranCtl_sys/CtcrtTranCtl/Error/ChargeSignalLost/CTC_TiProc_P19" /begin REF_CHARACTERISTIC CTC_TiProc_P /end REF_CHARACTERISTIC /end GROUP
/begin GROUP S201_BitSelect "swc_CtctrTranCtl/CtcrtTranCtl_sys/CtcrtTranCtl/Error/CurrentZeroDriftError/BitSelect" /begin REF_CHARACTERISTIC CTC_CswDiag_P /end REF_CHARACTERISTIC /end GROUP
/begin GROUP S201_BitSelect20 "swc_CtctrTranCtl/CtcrtTranCtl_sys/CtcrtTranCtl/Error/CurrentZeroDriftError/BitSelect20" /begin REF_CHARACTERISTIC CTC_Csw2_P /end REF_CHARACTERISTIC /end GROUP
/begin GROUP S201_CompareToCalibrationPara "swc_CtctrTranCtl/CtcrtTranCtl_sys/CtcrtTranCtl/Error/CurrentZeroDriftError/CompareToCalibrationPara" /begin REF_CHARACTERISTIC CTC_IDriftZeroLim_P /end REF_CHARACTERISTIC /end GROUP
/begin GROUP S201_CTC_bErrIDriftZero_P "swc_CtctrTranCtl/CtcrtTranCtl_sys/CtcrtTranCtl/Error/CurrentZeroDriftError/CTC_bErrIDriftZero_P" /begin REF_CHARACTERISTIC CTC_bErrIDriftZero_P /end REF_CHARACTERISTIC /end GROUP
/begin GROUP S201_CTC_TiOffDig239_P "swc_CtctrTranCtl/CtcrtTranCtl_sys/CtcrtTranCtl/Error/CurrentZeroDriftError/CTC_TiOffDig239_P" /begin REF_CHARACTERISTIC CTC_TiOffDig239_P /end REF_CHARACTERISTIC /end GROUP
/begin GROUP S201_CTC_TiOnDig239_P "swc_CtctrTranCtl/CtcrtTranCtl_sys/CtcrtTranCtl/Error/CurrentZeroDriftError/CTC_TiOnDig239_P" /begin REF_CHARACTERISTIC CTC_TiOnDig239_P /end REF_CHARACTERISTIC /end GROUP
/begin GROUP S201_CTC_TiProc_P "swc_CtctrTranCtl/CtcrtTranCtl_sys/CtcrtTranCtl/Error/CurrentZeroDriftError/CTC_TiProc_P" /begin REF_CHARACTERISTIC CTC_TiProc_P /end REF_CHARACTERISTIC /end GROUP
/begin GROUP S202_BCTE_FacFilIMeasd_P "swc_BatChCtl/BCC_10ms_sys/BCC_10ms_sys/BatChTiEstimn/BatChTiEstimn/remaining_charge_time_calculation/ConterCalculate/BCTE_FacFilIMeasd_P" /begin REF_CHARACTERISTIC BCTE_FacFilIMeasd_P /end REF_CHARACTERISTIC /end GROUP
/begin GROUP S202_BCTE_ThdFlucInIMeasd_P "swc_BatChCtl/BCC_10ms_sys/BCC_10ms_sys/BatChTiEstimn/BatChTiEstimn/remaining_charge_time_calculation/ConterCalculate/BCTE_ThdFlucInIMeasd_P" /begin REF_CHARACTERISTIC BCTE_ThdFlucInIMeasd_P /end REF_CHARACTERISTIC /end GROUP
/begin GROUP S202_BitSelect "swc_CtctrTranCtl/CtcrtTranCtl_sys/CtcrtTranCtl/Error/FastChargeRelayError/BitSelect" /begin REF_CHARACTERISTIC CTC_CswDiag_P /end REF_CHARACTERISTIC /end GROUP
/begin GROUP S202_BitSelect1 "swc_CtctrTranCtl/CtcrtTranCtl_sys/CtcrtTranCtl/Error/FastChargeRelayError/BitSelect1" /begin REF_CHARACTERISTIC CTC_CswDiag_P /end REF_CHARACTERISTIC /end GROUP
/begin GROUP S202_BitSelect10 "swc_CtctrTranCtl/CtcrtTranCtl_sys/CtcrtTranCtl/Error/FastChargeRelayError/BitSelect10" /begin REF_CHARACTERISTIC CTC_Csw2_P /end REF_CHARACTERISTIC /end GROUP
/begin GROUP S202_BitSelect11 "swc_CtctrTranCtl/CtcrtTranCtl_sys/CtcrtTranCtl/Error/FastChargeRelayError/BitSelect11" /begin REF_CHARACTERISTIC CTC_Csw2_P /end REF_CHARACTERISTIC /end GROUP
/begin GROUP S202_BitSelect12 "swc_CtctrTranCtl/CtcrtTranCtl_sys/CtcrtTranCtl/Error/FastChargeRelayError/BitSelect12" /begin REF_CHARACTERISTIC CTC_Csw2_P /end REF_CHARACTERISTIC /end GROUP
/begin GROUP S202_BitSelect13 "swc_CtctrTranCtl/CtcrtTranCtl_sys/CtcrtTranCtl/Error/FastChargeRelayError/BitSelect13" /begin REF_CHARACTERISTIC CTC_Csw2_P /end REF_CHARACTERISTIC /end GROUP
/begin GROUP S202_BitSelect2 "swc_CtctrTranCtl/CtcrtTranCtl_sys/CtcrtTranCtl/Error/FastChargeRelayError/BitSelect2" /begin REF_CHARACTERISTIC CTC_CswDiag_P /end REF_CHARACTERISTIC /end GROUP
/begin GROUP S202_BitSelect6 "swc_CtctrTranCtl/CtcrtTranCtl_sys/CtcrtTranCtl/Error/FastChargeRelayError/BitSelect6" /begin REF_CHARACTERISTIC CTC_CswDiag_P /end REF_CHARACTERISTIC /end GROUP
/begin GROUP S202_CTC_bErrRlyChHiDrvShoToGnd_P "swc_CtctrTranCtl/CtcrtTranCtl_sys/CtcrtTranCtl/Error/FastChargeRelayError/CTC_bErrRlyChHiDrvShoToGnd_P" /begin REF_CHARACTERISTIC CTC_bErrRlyChHiDrvShoToGnd_P /end REF_CHARACTERISTIC /end GROUP
/begin GROUP S202_CTC_bErrRlyChHiDrvShoToPwr_P "swc_CtctrTranCtl/CtcrtTranCtl_sys/CtcrtTranCtl/Error/FastChargeRelayError/CTC_bErrRlyChHiDrvShoToPwr_P" /begin REF_CHARACTERISTIC CTC_bErrRlyChHiDrvShoToPwr_P /end REF_CHARACTERISTIC /end GROUP
/begin GROUP S202_CTC_bErrRlyChHiSideDrv_P "swc_CtctrTranCtl/CtcrtTranCtl_sys/CtcrtTranCtl/Error/FastChargeRelayError/CTC_bErrRlyChHiSideDrv_P" /begin REF_CHARACTERISTIC CTC_bErrRlyChHiSideDrv_P /end REF_CHARACTERISTIC /end GROUP
/begin GROUP S202_CTC_bErrRlyChWldd_P "swc_CtctrTranCtl/CtcrtTranCtl_sys/CtcrtTranCtl/Error/FastChargeRelayError/CTC_bErrRlyChWldd_P" /begin REF_CHARACTERISTIC CTC_bErrRlyChWldd_P /end REF_CHARACTERISTIC /end GROUP
/begin GROUP S202_CTC_TiOffDig123_P "swc_CtctrTranCtl/CtcrtTranCtl_sys/CtcrtTranCtl/Error/FastChargeRelayError/CTC_TiOffDig123_P" /begin REF_CHARACTERISTIC CTC_TiOffDig123_P /end REF_CHARACTERISTIC /end GROUP
/begin GROUP S202_CTC_TiOffDig123ForSc_P "swc_CtctrTranCtl/CtcrtTranCtl_sys/CtcrtTranCtl/Error/FastChargeRelayError/CTC_TiOffDig123ForSc_P" /begin REF_CHARACTERISTIC CTC_TiOffDig123ForSc_P /end REF_CHARACTERISTIC /end GROUP
/begin GROUP S202_CTC_TiOffDig124AftChk_P "swc_CtctrTranCtl/CtcrtTranCtl_sys/CtcrtTranCtl/Error/FastChargeRelayError/CTC_TiOffDig124AftChk_P" /begin REF_CHARACTERISTIC CTC_TiOffDig124AftChk_P /end REF_CHARACTERISTIC /end GROUP
/begin GROUP S202_CTC_TiOffDig124AtChk_P "swc_CtctrTranCtl/CtcrtTranCtl_sys/CtcrtTranCtl/Error/FastChargeRelayError/CTC_TiOffDig124AtChk_P" /begin REF_CHARACTERISTIC CTC_TiOffDig124AtChk_P /end REF_CHARACTERISTIC /end GROUP
/begin GROUP S202_CTC_TiOffDig124ForSc_P "swc_CtctrTranCtl/CtcrtTranCtl_sys/CtcrtTranCtl/Error/FastChargeRelayError/CTC_TiOffDig124ForSc_P" /begin REF_CHARACTERISTIC CTC_TiOffDig124ForSc_P /end REF_CHARACTERISTIC /end GROUP
/begin GROUP S202_CTC_TiOnDig123_P "swc_CtctrTranCtl/CtcrtTranCtl_sys/CtcrtTranCtl/Error/FastChargeRelayError/CTC_TiOnDig123_P" /begin REF_CHARACTERISTIC CTC_TiOnDig123_P /end REF_CHARACTERISTIC /end GROUP
/begin GROUP S202_CTC_TiOnDig123ForSc_P "swc_CtctrTranCtl/CtcrtTranCtl_sys/CtcrtTranCtl/Error/FastChargeRelayError/CTC_TiOnDig123ForSc_P" /begin REF_CHARACTERISTIC CTC_TiOnDig123ForSc_P /end REF_CHARACTERISTIC /end GROUP
/begin GROUP S202_CTC_TiOnDig124AftChk_P "swc_CtctrTranCtl/CtcrtTranCtl_sys/CtcrtTranCtl/Error/FastChargeRelayError/CTC_TiOnDig124AftChk_P" /begin REF_CHARACTERISTIC CTC_TiOnDig124AftChk_P /end REF_CHARACTERISTIC /end GROUP
/begin GROUP S202_CTC_TiOnDig124AtChk_P "swc_CtctrTranCtl/CtcrtTranCtl_sys/CtcrtTranCtl/Error/FastChargeRelayError/CTC_TiOnDig124AtChk_P" /begin REF_CHARACTERISTIC CTC_TiOnDig124AtChk_P /end REF_CHARACTERISTIC /end GROUP
/begin GROUP S202_CTC_TiOnDig124ForSc_P "swc_CtctrTranCtl/CtcrtTranCtl_sys/CtcrtTranCtl/Error/FastChargeRelayError/CTC_TiOnDig124ForSc_P" /begin REF_CHARACTERISTIC CTC_TiOnDig124ForSc_P /end REF_CHARACTERISTIC /end GROUP
/begin GROUP S202_CTC_TiProc_P10 "swc_CtctrTranCtl/CtcrtTranCtl_sys/CtcrtTranCtl/Error/FastChargeRelayError/CTC_TiProc_P10" /begin REF_CHARACTERISTIC CTC_TiProc_P /end REF_CHARACTERISTIC /end GROUP
/begin GROUP S202_CTC_TiProc_P11 "swc_CtctrTranCtl/CtcrtTranCtl_sys/CtcrtTranCtl/Error/FastChargeRelayError/CTC_TiProc_P11" /begin REF_CHARACTERISTIC CTC_TiProc_P /end REF_CHARACTERISTIC /end GROUP
/begin GROUP S202_CTC_TiProc_P12 "swc_CtctrTranCtl/CtcrtTranCtl_sys/CtcrtTranCtl/Error/FastChargeRelayError/CTC_TiProc_P12" /begin REF_CHARACTERISTIC CTC_TiProc_P /end REF_CHARACTERISTIC /end GROUP
/begin GROUP S202_CTC_TiProc_P13 "swc_CtctrTranCtl/CtcrtTranCtl_sys/CtcrtTranCtl/Error/FastChargeRelayError/CTC_TiProc_P13" /begin REF_CHARACTERISTIC CTC_TiProc_P /end REF_CHARACTERISTIC /end GROUP
/begin GROUP S203_BCTE_FacFil2ChTiEstimn_P "swc_BatChCtl/BCC_10ms_sys/BCC_10ms_sys/BatChTiEstimn/BatChTiEstimn/remaining_charge_time_calculation/Filter/BCTE_FacFil2ChTiEstimn_P" /begin REF_CHARACTERISTIC BCTE_FacFil2ChTiEstimn_P /end REF_CHARACTERISTIC /end GROUP
/begin GROUP S203_BitSelect "swc_CtctrTranCtl/CtcrtTranCtl_sys/CtcrtTranCtl/Error/HeatRelayError/BitSelect" /begin REF_CHARACTERISTIC CTC_CswDiag_P /end REF_CHARACTERISTIC /end GROUP
/begin GROUP S203_BitSelect1 "swc_CtctrTranCtl/CtcrtTranCtl_sys/CtcrtTranCtl/Error/HeatRelayError/BitSelect1" /begin REF_CHARACTERISTIC CTC_CswDiag_P /end REF_CHARACTERISTIC /end GROUP
/begin GROUP S203_BitSelect14 "swc_CtctrTranCtl/CtcrtTranCtl_sys/CtcrtTranCtl/Error/HeatRelayError/BitSelect14" /begin REF_CHARACTERISTIC CTC_Csw2_P /end REF_CHARACTERISTIC /end GROUP
/begin GROUP S203_BitSelect15 "swc_CtctrTranCtl/CtcrtTranCtl_sys/CtcrtTranCtl/Error/HeatRelayError/BitSelect15" /begin REF_CHARACTERISTIC CTC_Csw2_P /end REF_CHARACTERISTIC /end GROUP
/begin GROUP S203_BitSelect16 "swc_CtctrTranCtl/CtcrtTranCtl_sys/CtcrtTranCtl/Error/HeatRelayError/BitSelect16" /begin REF_CHARACTERISTIC CTC_Csw2_P /end REF_CHARACTERISTIC /end GROUP
/begin GROUP S203_BitSelect18 "swc_CtctrTranCtl/CtcrtTranCtl_sys/CtcrtTranCtl/Error/HeatRelayError/BitSelect18" /begin REF_CHARACTERISTIC CTC_Csw2_P /end REF_CHARACTERISTIC /end GROUP
/begin GROUP S203_BitSelect2 "swc_CtctrTranCtl/CtcrtTranCtl_sys/CtcrtTranCtl/Error/HeatRelayError/BitSelect2" /begin REF_CHARACTERISTIC CTC_CswDiag_P /end REF_CHARACTERISTIC /end GROUP
/begin GROUP S203_BitSelect6 "swc_CtctrTranCtl/CtcrtTranCtl_sys/CtcrtTranCtl/Error/HeatRelayError/BitSelect6" /begin REF_CHARACTERISTIC CTC_CswDiag_P /end REF_CHARACTERISTIC /end GROUP
/begin GROUP S203_CTC_bErrRlyHeatHiDrvShoToGnd_P "swc_CtctrTranCtl/CtcrtTranCtl_sys/CtcrtTranCtl/Error/HeatRelayError/CTC_bErrRlyHeatHiDrvShoToGnd_P" /begin REF_CHARACTERISTIC CTC_bErrRlyHeatHiDrvShoToGnd_P /end REF_CHARACTERISTIC /end GROUP
/begin GROUP S203_CTC_bErrRlyHeatHiDrvShoToPwr_P "swc_CtctrTranCtl/CtcrtTranCtl_sys/CtcrtTranCtl/Error/HeatRelayError/CTC_bErrRlyHeatHiDrvShoToPwr_P" /begin REF_CHARACTERISTIC CTC_bErrRlyHeatHiDrvShoToPwr_P /end REF_CHARACTERISTIC /end GROUP
/begin GROUP S203_CTC_bErrRlyHeatHiSideDrv_P "swc_CtctrTranCtl/CtcrtTranCtl_sys/CtcrtTranCtl/Error/HeatRelayError/CTC_bErrRlyHeatHiSideDrv_P" /begin REF_CHARACTERISTIC CTC_bErrRlyHeatHiSideDrv_P /end REF_CHARACTERISTIC /end GROUP
/begin GROUP S203_CTC_bErrRlyHeatWldd_P "swc_CtctrTranCtl/CtcrtTranCtl_sys/CtcrtTranCtl/Error/HeatRelayError/CTC_bErrRlyHeatWldd_P" /begin REF_CHARACTERISTIC CTC_bErrRlyHeatWldd_P /end REF_CHARACTERISTIC /end GROUP
/begin GROUP S203_CTC_TiOffDig135_P "swc_CtctrTranCtl/CtcrtTranCtl_sys/CtcrtTranCtl/Error/HeatRelayError/CTC_TiOffDig135_P" /begin REF_CHARACTERISTIC CTC_TiOffDig135_P /end REF_CHARACTERISTIC /end GROUP
/begin GROUP S203_CTC_TiOffDig135ForSc_P "swc_CtctrTranCtl/CtcrtTranCtl_sys/CtcrtTranCtl/Error/HeatRelayError/CTC_TiOffDig135ForSc_P" /begin REF_CHARACTERISTIC CTC_TiOffDig135ForSc_P /end REF_CHARACTERISTIC /end GROUP
/begin GROUP S203_CTC_TiOffDig136AftChk_P "swc_CtctrTranCtl/CtcrtTranCtl_sys/CtcrtTranCtl/Error/HeatRelayError/CTC_TiOffDig136AftChk_P" /begin REF_CHARACTERISTIC CTC_TiOffDig136AftChk_P /end REF_CHARACTERISTIC /end GROUP
/begin GROUP S203_CTC_TiOffDig136AtChk_P "swc_CtctrTranCtl/CtcrtTranCtl_sys/CtcrtTranCtl/Error/HeatRelayError/CTC_TiOffDig136AtChk_P" /begin REF_CHARACTERISTIC CTC_TiOffDig136AtChk_P /end REF_CHARACTERISTIC /end GROUP
/begin GROUP S203_CTC_TiOffDig136ForSc_P "swc_CtctrTranCtl/CtcrtTranCtl_sys/CtcrtTranCtl/Error/HeatRelayError/CTC_TiOffDig136ForSc_P" /begin REF_CHARACTERISTIC CTC_TiOffDig136ForSc_P /end REF_CHARACTERISTIC /end GROUP
/begin GROUP S203_CTC_TiOnDig135_P "swc_CtctrTranCtl/CtcrtTranCtl_sys/CtcrtTranCtl/Error/HeatRelayError/CTC_TiOnDig135_P" /begin REF_CHARACTERISTIC CTC_TiOnDig135_P /end REF_CHARACTERISTIC /end GROUP
/begin GROUP S203_CTC_TiOnDig135ForSc_P "swc_CtctrTranCtl/CtcrtTranCtl_sys/CtcrtTranCtl/Error/HeatRelayError/CTC_TiOnDig135ForSc_P" /begin REF_CHARACTERISTIC CTC_TiOnDig135ForSc_P /end REF_CHARACTERISTIC /end GROUP
/begin GROUP S203_CTC_TiOnDig136AftChk_P "swc_CtctrTranCtl/CtcrtTranCtl_sys/CtcrtTranCtl/Error/HeatRelayError/CTC_TiOnDig136AftChk_P" /begin REF_CHARACTERISTIC CTC_TiOnDig136AftChk_P /end REF_CHARACTERISTIC /end GROUP
/begin GROUP S203_CTC_TiOnDig136AtChk_P "swc_CtctrTranCtl/CtcrtTranCtl_sys/CtcrtTranCtl/Error/HeatRelayError/CTC_TiOnDig136AtChk_P" /begin REF_CHARACTERISTIC CTC_TiOnDig136AtChk_P /end REF_CHARACTERISTIC /end GROUP
/begin GROUP S203_CTC_TiOnDig136ForSc_P "swc_CtctrTranCtl/CtcrtTranCtl_sys/CtcrtTranCtl/Error/HeatRelayError/CTC_TiOnDig136ForSc_P" /begin REF_CHARACTERISTIC CTC_TiOnDig136ForSc_P /end REF_CHARACTERISTIC /end GROUP
/begin GROUP S203_CTC_TiProc_P14 "swc_CtctrTranCtl/CtcrtTranCtl_sys/CtcrtTranCtl/Error/HeatRelayError/CTC_TiProc_P14" /begin REF_CHARACTERISTIC CTC_TiProc_P /end REF_CHARACTERISTIC /end GROUP
/begin GROUP S203_CTC_TiProc_P15 "swc_CtctrTranCtl/CtcrtTranCtl_sys/CtcrtTranCtl/Error/HeatRelayError/CTC_TiProc_P15" /begin REF_CHARACTERISTIC CTC_TiProc_P /end REF_CHARACTERISTIC /end GROUP
/begin GROUP S203_CTC_TiProc_P16 "swc_CtctrTranCtl/CtcrtTranCtl_sys/CtcrtTranCtl/Error/HeatRelayError/CTC_TiProc_P16" /begin REF_CHARACTERISTIC CTC_TiProc_P /end REF_CHARACTERISTIC /end GROUP
/begin GROUP S203_CTC_TiProc_P17 "swc_CtctrTranCtl/CtcrtTranCtl_sys/CtcrtTranCtl/Error/HeatRelayError/CTC_TiProc_P17" /begin REF_CHARACTERISTIC CTC_TiProc_P /end REF_CHARACTERISTIC /end GROUP
/begin GROUP S204_BCTE_IAcLimnFromTSoc_M "swc_BatChCtl/BCC_10ms_sys/BCC_10ms_sys/BatChTiEstimn/BatChTiEstimn/remaining_charge_time_calculation/For Iterator Subsystem/BCTE_IAcLimnFromTSoc_M" /begin REF_CHARACTERISTIC BCTE_IAcLimnFromTSoc_M /end REF_CHARACTERISTIC /end GROUP
/begin GROUP S204_BCTE_IDcLimnFromTSoc_M "swc_BatChCtl/BCC_10ms_sys/BCC_10ms_sys/BatChTiEstimn/BatChTiEstimn/remaining_charge_time_calculation/For Iterator Subsystem/BCTE_IDcLimnFromTSoc_M" /begin REF_CHARACTERISTIC BCTE_IDcLimnFromTSoc_M /end REF_CHARACTERISTIC /end GROUP
/begin GROUP S205_BitSelect "swc_CtctrTranCtl/CtcrtTranCtl_sys/CtcrtTranCtl/Error/MotorDischargeError/BitSelect" /begin REF_CHARACTERISTIC CTC_CswDiag_P /end REF_CHARACTERISTIC /end GROUP
/begin GROUP S205_BitSelect21 "swc_CtctrTranCtl/CtcrtTranCtl_sys/CtcrtTranCtl/Error/MotorDischargeError/BitSelect21" /begin REF_CHARACTERISTIC CTC_Csw2_P /end REF_CHARACTERISTIC /end GROUP
/begin GROUP S205_CTC_bErrToutForMotDchaToDiag_P "swc_CtctrTranCtl/CtcrtTranCtl_sys/CtcrtTranCtl/Error/MotorDischargeError/CTC_bErrToutForMotDchaToDiag_P" /begin REF_CHARACTERISTIC CTC_bErrToutForMotDchaToDiag_P /end REF_CHARACTERISTIC /end GROUP
/begin GROUP S205_CTC_TiOffDig226_P "swc_CtctrTranCtl/CtcrtTranCtl_sys/CtcrtTranCtl/Error/MotorDischargeError/CTC_TiOffDig226_P" /begin REF_CHARACTERISTIC CTC_TiOffDig226_P /end REF_CHARACTERISTIC /end GROUP
/begin GROUP S205_CTC_TiOnDig226_P "swc_CtctrTranCtl/CtcrtTranCtl_sys/CtcrtTranCtl/Error/MotorDischargeError/CTC_TiOnDig226_P" /begin REF_CHARACTERISTIC CTC_TiOnDig226_P /end REF_CHARACTERISTIC /end GROUP
/begin GROUP S205_CTC_TiProc_P20 "swc_CtctrTranCtl/CtcrtTranCtl_sys/CtcrtTranCtl/Error/MotorDischargeError/CTC_TiProc_P20" /begin REF_CHARACTERISTIC CTC_TiProc_P /end REF_CHARACTERISTIC /end GROUP
/begin GROUP S206_BitSelect "swc_CtctrTranCtl/CtcrtTranCtl_sys/CtcrtTranCtl/Error/NegativeRelayError/BitSelect" /begin REF_CHARACTERISTIC CTC_CswDiag_P /end REF_CHARACTERISTIC /end GROUP
/begin GROUP S206_BitSelect1 "swc_CtctrTranCtl/CtcrtTranCtl_sys/CtcrtTranCtl/Error/NegativeRelayError/BitSelect1" /begin REF_CHARACTERISTIC CTC_CswDiag_P /end REF_CHARACTERISTIC /end GROUP
/begin GROUP S206_BitSelect2 "swc_CtctrTranCtl/CtcrtTranCtl_sys/CtcrtTranCtl/Error/NegativeRelayError/BitSelect2" /begin REF_CHARACTERISTIC CTC_CswDiag_P /end REF_CHARACTERISTIC /end GROUP
/begin GROUP S206_BitSelect3 "swc_CtctrTranCtl/CtcrtTranCtl_sys/CtcrtTranCtl/Error/NegativeRelayError/BitSelect3" /begin REF_CHARACTERISTIC CTC_CswDiag_P /end REF_CHARACTERISTIC /end GROUP
/begin GROUP S206_BitSelect4 "swc_CtctrTranCtl/CtcrtTranCtl_sys/CtcrtTranCtl/Error/NegativeRelayError/BitSelect4" /begin REF_CHARACTERISTIC CTC_Csw2_P /end REF_CHARACTERISTIC /end GROUP
/begin GROUP S206_BitSelect5 "swc_CtctrTranCtl/CtcrtTranCtl_sys/CtcrtTranCtl/Error/NegativeRelayError/BitSelect5" /begin REF_CHARACTERISTIC CTC_Csw2_P /end REF_CHARACTERISTIC /end GROUP
/begin GROUP S206_BitSelect6 "swc_CtctrTranCtl/CtcrtTranCtl_sys/CtcrtTranCtl/Error/NegativeRelayError/BitSelect6" /begin REF_CHARACTERISTIC CTC_Csw2_P /end REF_CHARACTERISTIC /end GROUP
/begin GROUP S206_BitSelect7 "swc_CtctrTranCtl/CtcrtTranCtl_sys/CtcrtTranCtl/Error/NegativeRelayError/BitSelect7" /begin REF_CHARACTERISTIC CTC_Csw2_P /end REF_CHARACTERISTIC /end GROUP
/begin GROUP S206_CTC_bErrRlyNegHiDrvShoToGnd_P "swc_CtctrTranCtl/CtcrtTranCtl_sys/CtcrtTranCtl/Error/NegativeRelayError/CTC_bErrRlyNegHiDrvShoToGnd_P" /begin REF_CHARACTERISTIC CTC_bErrRlyNegHiDrvShoToGnd_P /end REF_CHARACTERISTIC /end GROUP
/begin GROUP S206_CTC_bErrRlyNegHiDrvShoToPwr_P "swc_CtctrTranCtl/CtcrtTranCtl_sys/CtcrtTranCtl/Error/NegativeRelayError/CTC_bErrRlyNegHiDrvShoToPwr_P" /begin REF_CHARACTERISTIC CTC_bErrRlyNegHiDrvShoToPwr_P /end REF_CHARACTERISTIC /end GROUP
/begin GROUP S206_CTC_bErrRlyNegHiSideDrv_P "swc_CtctrTranCtl/CtcrtTranCtl_sys/CtcrtTranCtl/Error/NegativeRelayError/CTC_bErrRlyNegHiSideDrv_P" /begin REF_CHARACTERISTIC CTC_bErrRlyNegHiSideDrv_P /end REF_CHARACTERISTIC /end GROUP
/begin GROUP S206_CTC_bErrRlyNegWldd_P "swc_CtctrTranCtl/CtcrtTranCtl_sys/CtcrtTranCtl/Error/NegativeRelayError/CTC_bErrRlyNegWldd_P" /begin REF_CHARACTERISTIC CTC_bErrRlyNegWldd_P /end REF_CHARACTERISTIC /end GROUP
/begin GROUP S206_CTC_TiOffDig121_P "swc_CtctrTranCtl/CtcrtTranCtl_sys/CtcrtTranCtl/Error/NegativeRelayError/CTC_TiOffDig121_P" /begin REF_CHARACTERISTIC CTC_TiOffDig121_P /end REF_CHARACTERISTIC /end GROUP
/begin GROUP S206_CTC_TiOffDig121ForSc_P "swc_CtctrTranCtl/CtcrtTranCtl_sys/CtcrtTranCtl/Error/NegativeRelayError/CTC_TiOffDig121ForSc_P" /begin REF_CHARACTERISTIC CTC_TiOffDig121ForSc_P /end REF_CHARACTERISTIC /end GROUP
/begin GROUP S206_CTC_TiOffDig122_P "swc_CtctrTranCtl/CtcrtTranCtl_sys/CtcrtTranCtl/Error/NegativeRelayError/CTC_TiOffDig122_P" /begin REF_CHARACTERISTIC CTC_TiOffDig122_P /end REF_CHARACTERISTIC /end GROUP
/begin GROUP S206_CTC_TiOffDig122ForSc_P "swc_CtctrTranCtl/CtcrtTranCtl_sys/CtcrtTranCtl/Error/NegativeRelayError/CTC_TiOffDig122ForSc_P" /begin REF_CHARACTERISTIC CTC_TiOffDig122ForSc_P /end REF_CHARACTERISTIC /end GROUP
/begin GROUP S206_CTC_TiOnDig121_P "swc_CtctrTranCtl/CtcrtTranCtl_sys/CtcrtTranCtl/Error/NegativeRelayError/CTC_TiOnDig121_P" /begin REF_CHARACTERISTIC CTC_TiOnDig121_P /end REF_CHARACTERISTIC /end GROUP
/begin GROUP S206_CTC_TiOnDig121ForSc_P "swc_CtctrTranCtl/CtcrtTranCtl_sys/CtcrtTranCtl/Error/NegativeRelayError/CTC_TiOnDig121ForSc_P" /begin REF_CHARACTERISTIC CTC_TiOnDig121ForSc_P /end REF_CHARACTERISTIC /end GROUP
/begin GROUP S206_CTC_TiOnDig122_P "swc_CtctrTranCtl/CtcrtTranCtl_sys/CtcrtTranCtl/Error/NegativeRelayError/CTC_TiOnDig122_P" /begin REF_CHARACTERISTIC CTC_TiOnDig122_P /end REF_CHARACTERISTIC /end GROUP
/begin GROUP S206_CTC_TiOnDig122ForSc_P "swc_CtctrTranCtl/CtcrtTranCtl_sys/CtcrtTranCtl/Error/NegativeRelayError/CTC_TiOnDig122ForSc_P" /begin REF_CHARACTERISTIC CTC_TiOnDig122ForSc_P /end REF_CHARACTERISTIC /end GROUP
/begin GROUP S206_CTC_TiProc_P4 "swc_CtctrTranCtl/CtcrtTranCtl_sys/CtcrtTranCtl/Error/NegativeRelayError/CTC_TiProc_P4" /begin REF_CHARACTERISTIC CTC_TiProc_P /end REF_CHARACTERISTIC /end GROUP
/begin GROUP S206_CTC_TiProc_P5 "swc_CtctrTranCtl/CtcrtTranCtl_sys/CtcrtTranCtl/Error/NegativeRelayError/CTC_TiProc_P5" /begin REF_CHARACTERISTIC CTC_TiProc_P /end REF_CHARACTERISTIC /end GROUP
/begin GROUP S206_CTC_TiProc_P6 "swc_CtctrTranCtl/CtcrtTranCtl_sys/CtcrtTranCtl/Error/NegativeRelayError/CTC_TiProc_P6" /begin REF_CHARACTERISTIC CTC_TiProc_P /end REF_CHARACTERISTIC /end GROUP
/begin GROUP S206_CTC_TiProc_P7 "swc_CtctrTranCtl/CtcrtTranCtl_sys/CtcrtTranCtl/Error/NegativeRelayError/CTC_TiProc_P7" /begin REF_CHARACTERISTIC CTC_TiProc_P /end REF_CHARACTERISTIC /end GROUP
/begin GROUP S207_BCF_ErrLimOfRDelta_P "swc_BatCoreFct/BCF_100ms_sys/BatCoreFct/PackObs/PackObsLoop/MdulObs/CellObsr/Cell Wear Detection/R Cell Delta Wear Detection/BCF_ErrLimOfRDelta_P" /begin REF_CHARACTERISTIC BCF_ErrLimOfRDelta_P /end REF_CHARACTERISTIC /end GROUP
/begin GROUP S207_BCF_ErrLimOfRDeltaCdn_P "swc_BatCoreFct/BCF_100ms_sys/BatCoreFct/PackObs/PackObsLoop/MdulObs/CellObsr/Cell Wear Detection/R Cell Delta Wear Detection/BCF_ErrLimOfRDeltaCdn_P" /begin REF_CHARACTERISTIC BCF_ErrLimOfRDeltaCdn_P /end REF_CHARACTERISTIC /end GROUP
/begin GROUP S207_BCF_TdOffDig1002_P "swc_BatCoreFct/BCF_100ms_sys/BatCoreFct/PackObs/PackObsLoop/MdulObs/CellObsr/Cell Wear Detection/R Cell Delta Wear Detection/BCF_TdOffDig1002_P" /begin REF_CHARACTERISTIC BCF_TdOffDig1002_P /end REF_CHARACTERISTIC /end GROUP
/begin GROUP S207_BCF_TdOnDig1002_P "swc_BatCoreFct/BCF_100ms_sys/BatCoreFct/PackObs/PackObsLoop/MdulObs/CellObsr/Cell Wear Detection/R Cell Delta Wear Detection/BCF_TdOnDig1002_P" /begin REF_CHARACTERISTIC BCF_TdOnDig1002_P /end REF_CHARACTERISTIC /end GROUP
/begin GROUP S207_BCF_ValHealLimOfRDelta_P "swc_BatCoreFct/BCF_100ms_sys/BatCoreFct/PackObs/PackObsLoop/MdulObs/CellObsr/Cell Wear Detection/R Cell Delta Wear Detection/BCF_ValHealLimOfRDelta_P" /begin REF_CHARACTERISTIC BCF_ValHealLimOfRDelta_P /end REF_CHARACTERISTIC /end GROUP
/begin GROUP S207_BCF_ValHealLimOfRDeltaCdn_P "swc_BatCoreFct/BCF_100ms_sys/BatCoreFct/PackObs/PackObsLoop/MdulObs/CellObsr/Cell Wear Detection/R Cell Delta Wear Detection/BCF_ValHealLimOfRDeltaCdn_P" /begin REF_CHARACTERISTIC BCF_ValHealLimOfRDeltaCdn_P /end REF_CHARACTERISTIC /end GROUP
/begin GROUP S207_BitSelect "swc_CtctrTranCtl/CtcrtTranCtl_sys/CtcrtTranCtl/Error/PostiveRelayError/BitSelect" /begin REF_CHARACTERISTIC CTC_CswDiag_P /end REF_CHARACTERISTIC /end GROUP
/begin GROUP S207_BitSelect1 "swc_CtctrTranCtl/CtcrtTranCtl_sys/CtcrtTranCtl/Error/PostiveRelayError/BitSelect1" /begin REF_CHARACTERISTIC CTC_Csw2_P /end REF_CHARACTERISTIC /end GROUP
/begin GROUP S207_BitSelect17 "swc_CtctrTranCtl/CtcrtTranCtl_sys/CtcrtTranCtl/Error/PostiveRelayError/BitSelect17" /begin REF_CHARACTERISTIC CTC_Csw2_P /end REF_CHARACTERISTIC /end GROUP
/begin GROUP S207_BitSelect2 "swc_CtctrTranCtl/CtcrtTranCtl_sys/CtcrtTranCtl/Error/PostiveRelayError/BitSelect2" /begin REF_CHARACTERISTIC CTC_Csw2_P /end REF_CHARACTERISTIC /end GROUP
/begin GROUP S207_BitSelect3 "swc_CtctrTranCtl/CtcrtTranCtl_sys/CtcrtTranCtl/Error/PostiveRelayError/BitSelect3" /begin REF_CHARACTERISTIC CTC_Csw2_P /end REF_CHARACTERISTIC /end GROUP
/begin GROUP S207_BitSelect4 "swc_CtctrTranCtl/CtcrtTranCtl_sys/CtcrtTranCtl/Error/PostiveRelayError/BitSelect4" /begin REF_CHARACTERISTIC CTC_CswDiag_P /end REF_CHARACTERISTIC /end GROUP
/begin GROUP S207_BitSelect5 "swc_CtctrTranCtl/CtcrtTranCtl_sys/CtcrtTranCtl/Error/PostiveRelayError/BitSelect5" /begin REF_CHARACTERISTIC CTC_CswDiag_P /end REF_CHARACTERISTIC /end GROUP
/begin GROUP S207_BitSelect6 "swc_CtctrTranCtl/CtcrtTranCtl_sys/CtcrtTranCtl/Error/PostiveRelayError/BitSelect6" /begin REF_CHARACTERISTIC CTC_CswDiag_P /end REF_CHARACTERISTIC /end GROUP
/begin GROUP S207_CTC_bErrRlyPosHiDrvShoToGnd_P "swc_CtctrTranCtl/CtcrtTranCtl_sys/CtcrtTranCtl/Error/PostiveRelayError/CTC_bErrRlyPosHiDrvShoToGnd_P" /begin REF_CHARACTERISTIC CTC_bErrRlyPosHiDrvShoToGnd_P /end REF_CHARACTERISTIC /end GROUP
/begin GROUP S207_CTC_bErrRlyPosHiDrvShoToPwr_P "swc_CtctrTranCtl/CtcrtTranCtl_sys/CtcrtTranCtl/Error/PostiveRelayError/CTC_bErrRlyPosHiDrvShoToPwr_P" /begin REF_CHARACTERISTIC CTC_bErrRlyPosHiDrvShoToPwr_P /end REF_CHARACTERISTIC /end GROUP
/begin GROUP S207_CTC_bErrRlyPosHiSideDrv_P "swc_CtctrTranCtl/CtcrtTranCtl_sys/CtcrtTranCtl/Error/PostiveRelayError/CTC_bErrRlyPosHiSideDrv_P" /begin REF_CHARACTERISTIC CTC_bErrRlyPosHiSideDrv_P /end REF_CHARACTERISTIC /end GROUP
/begin GROUP S207_CTC_bErrRlyPosWldd_P "swc_CtctrTranCtl/CtcrtTranCtl_sys/CtcrtTranCtl/Error/PostiveRelayError/CTC_bErrRlyPosWldd_P" /begin REF_CHARACTERISTIC CTC_bErrRlyPosWldd_P /end REF_CHARACTERISTIC /end GROUP
/begin GROUP S207_CTC_TiOffDig119_P "swc_CtctrTranCtl/CtcrtTranCtl_sys/CtcrtTranCtl/Error/PostiveRelayError/CTC_TiOffDig119_P" /begin REF_CHARACTERISTIC CTC_TiOffDig119_P /end REF_CHARACTERISTIC /end GROUP
/begin GROUP S207_CTC_TiOffDig119ForSc_P "swc_CtctrTranCtl/CtcrtTranCtl_sys/CtcrtTranCtl/Error/PostiveRelayError/CTC_TiOffDig119ForSc_P" /begin REF_CHARACTERISTIC CTC_TiOffDig119ForSc_P /end REF_CHARACTERISTIC /end GROUP
/begin GROUP S207_CTC_TiOffDig120AftChk_P "swc_CtctrTranCtl/CtcrtTranCtl_sys/CtcrtTranCtl/Error/PostiveRelayError/CTC_TiOffDig120AftChk_P" /begin REF_CHARACTERISTIC CTC_TiOffDig120AftChk_P /end REF_CHARACTERISTIC /end GROUP
/begin GROUP S207_CTC_TiOffDig120AtChk_P "swc_CtctrTranCtl/CtcrtTranCtl_sys/CtcrtTranCtl/Error/PostiveRelayError/CTC_TiOffDig120AtChk_P" /begin REF_CHARACTERISTIC CTC_TiOffDig120AtChk_P /end REF_CHARACTERISTIC /end GROUP
/begin GROUP S207_CTC_TiOffDig120ForSc_P "swc_CtctrTranCtl/CtcrtTranCtl_sys/CtcrtTranCtl/Error/PostiveRelayError/CTC_TiOffDig120ForSc_P" /begin REF_CHARACTERISTIC CTC_TiOffDig120ForSc_P /end REF_CHARACTERISTIC /end GROUP
/begin GROUP S207_CTC_TiOnDig119_P "swc_CtctrTranCtl/CtcrtTranCtl_sys/CtcrtTranCtl/Error/PostiveRelayError/CTC_TiOnDig119_P" /begin REF_CHARACTERISTIC CTC_TiOnDig119_P /end REF_CHARACTERISTIC /end GROUP
/begin GROUP S207_CTC_TiOnDig119ForSc_P "swc_CtctrTranCtl/CtcrtTranCtl_sys/CtcrtTranCtl/Error/PostiveRelayError/CTC_TiOnDig119ForSc_P" /begin REF_CHARACTERISTIC CTC_TiOnDig119ForSc_P /end REF_CHARACTERISTIC /end GROUP
/begin GROUP S207_CTC_TiOnDig120AftChk_P "swc_CtctrTranCtl/CtcrtTranCtl_sys/CtcrtTranCtl/Error/PostiveRelayError/CTC_TiOnDig120AftChk_P" /begin REF_CHARACTERISTIC CTC_TiOnDig120AftChk_P /end REF_CHARACTERISTIC /end GROUP
/begin GROUP S207_CTC_TiOnDig120AtChk_P "swc_CtctrTranCtl/CtcrtTranCtl_sys/CtcrtTranCtl/Error/PostiveRelayError/CTC_TiOnDig120AtChk_P" /begin REF_CHARACTERISTIC CTC_TiOnDig120AtChk_P /end REF_CHARACTERISTIC /end GROUP
/begin GROUP S207_CTC_TiOnDig120ForSc_P "swc_CtctrTranCtl/CtcrtTranCtl_sys/CtcrtTranCtl/Error/PostiveRelayError/CTC_TiOnDig120ForSc_P" /begin REF_CHARACTERISTIC CTC_TiOnDig120ForSc_P /end REF_CHARACTERISTIC /end GROUP
/begin GROUP S207_CTC_TiProc_P "swc_CtctrTranCtl/CtcrtTranCtl_sys/CtcrtTranCtl/Error/PostiveRelayError/CTC_TiProc_P" /begin REF_CHARACTERISTIC CTC_TiProc_P /end REF_CHARACTERISTIC /end GROUP
/begin GROUP S207_CTC_TiProc_P1 "swc_CtctrTranCtl/CtcrtTranCtl_sys/CtcrtTranCtl/Error/PostiveRelayError/CTC_TiProc_P1" /begin REF_CHARACTERISTIC CTC_TiProc_P /end REF_CHARACTERISTIC /end GROUP
/begin GROUP S207_CTC_TiProc_P2 "swc_CtctrTranCtl/CtcrtTranCtl_sys/CtcrtTranCtl/Error/PostiveRelayError/CTC_TiProc_P2" /begin REF_CHARACTERISTIC CTC_TiProc_P /end REF_CHARACTERISTIC /end GROUP
/begin GROUP S207_CTC_TiProc_P3 "swc_CtctrTranCtl/CtcrtTranCtl_sys/CtcrtTranCtl/Error/PostiveRelayError/CTC_TiProc_P3" /begin REF_CHARACTERISTIC CTC_TiProc_P /end REF_CHARACTERISTIC /end GROUP
/begin GROUP S208_BCF_ErrLimOfSocDelta_P "swc_BatCoreFct/BCF_100ms_sys/BatCoreFct/PackObs/PackObsLoop/MdulObs/CellObsr/Cell Wear Detection/Soc Cell Delta Wear Detection/BCF_ErrLimOfSocDelta_P" /begin REF_CHARACTERISTIC BCF_ErrLimOfSocDelta_P /end REF_CHARACTERISTIC /end GROUP
/begin GROUP S208_BCF_ErrLimOfSocDeltaCdn_P "swc_BatCoreFct/BCF_100ms_sys/BatCoreFct/PackObs/PackObsLoop/MdulObs/CellObsr/Cell Wear Detection/Soc Cell Delta Wear Detection/BCF_ErrLimOfSocDeltaCdn_P" /begin REF_CHARACTERISTIC BCF_ErrLimOfSocDeltaCdn_P /end REF_CHARACTERISTIC /end GROUP
/begin GROUP S208_BCF_TdOffDig1001_P "swc_BatCoreFct/BCF_100ms_sys/BatCoreFct/PackObs/PackObsLoop/MdulObs/CellObsr/Cell Wear Detection/Soc Cell Delta Wear Detection/BCF_TdOffDig1001_P" /begin REF_CHARACTERISTIC BCF_TdOffDig1001_P /end REF_CHARACTERISTIC /end GROUP
/begin GROUP S208_BCF_TdOnDig1001_P "swc_BatCoreFct/BCF_100ms_sys/BatCoreFct/PackObs/PackObsLoop/MdulObs/CellObsr/Cell Wear Detection/Soc Cell Delta Wear Detection/BCF_TdOnDig1001_P" /begin REF_CHARACTERISTIC BCF_TdOnDig1001_P /end REF_CHARACTERISTIC /end GROUP
/begin GROUP S208_BCF_ValHealLimOfSocDelta_P "swc_BatCoreFct/BCF_100ms_sys/BatCoreFct/PackObs/PackObsLoop/MdulObs/CellObsr/Cell Wear Detection/Soc Cell Delta Wear Detection/BCF_ValHealLimOfSocDelta_P" /begin REF_CHARACTERISTIC BCF_ValHealLimOfSocDelta_P /end REF_CHARACTERISTIC /end GROUP
/begin GROUP S208_BCF_ValHealLimOfSocDeltaCdn_P "swc_BatCoreFct/BCF_100ms_sys/BatCoreFct/PackObs/PackObsLoop/MdulObs/CellObsr/Cell Wear Detection/Soc Cell Delta Wear Detection/BCF_ValHealLimOfSocDeltaCdn_P" /begin REF_CHARACTERISTIC BCF_ValHealLimOfSocDeltaCdn_P /end REF_CHARACTERISTIC /end GROUP
/begin GROUP S208_BitSelect "swc_CtctrTranCtl/CtcrtTranCtl_sys/CtcrtTranCtl/Error/PrechargeError/BitSelect" /begin REF_CHARACTERISTIC CTC_CswDiag_P /end REF_CHARACTERISTIC /end GROUP
/begin GROUP S208_BitSelect1 "swc_CtctrTranCtl/CtcrtTranCtl_sys/CtcrtTranCtl/Error/PrechargeError/BitSelect1" /begin REF_CHARACTERISTIC CTC_CswDiag_P /end REF_CHARACTERISTIC /end GROUP
/begin GROUP S208_BitSelect19 "swc_CtctrTranCtl/CtcrtTranCtl_sys/CtcrtTranCtl/Error/PrechargeError/BitSelect19" /begin REF_CHARACTERISTIC CTC_Csw2_P /end REF_CHARACTERISTIC /end GROUP
/begin GROUP S208_CTC_bErrPrech_P "swc_CtctrTranCtl/CtcrtTranCtl_sys/CtcrtTranCtl/Error/PrechargeError/CTC_bErrPrech_P" /begin REF_CHARACTERISTIC CTC_bErrPrech_P /end REF_CHARACTERISTIC /end GROUP
/begin GROUP S208_CTC_TiOffDig84_P "swc_CtctrTranCtl/CtcrtTranCtl_sys/CtcrtTranCtl/Error/PrechargeError/CTC_TiOffDig84_P" /begin REF_CHARACTERISTIC CTC_TiOffDig84_P /end REF_CHARACTERISTIC /end GROUP
/begin GROUP S208_CTC_TiOnDig84_P "swc_CtctrTranCtl/CtcrtTranCtl_sys/CtcrtTranCtl/Error/PrechargeError/CTC_TiOnDig84_P" /begin REF_CHARACTERISTIC CTC_TiOnDig84_P /end REF_CHARACTERISTIC /end GROUP
/begin GROUP S208_CTC_TiOnDig84ForErrI_P "swc_CtctrTranCtl/CtcrtTranCtl_sys/CtcrtTranCtl/Error/PrechargeError/CTC_TiOnDig84ForErrI_P" /begin REF_CHARACTERISTIC CTC_TiOnDig84ForErrI_P /end REF_CHARACTERISTIC /end GROUP
/begin GROUP S208_CTC_TiOnDig84ForErrI_P1 "swc_CtctrTranCtl/CtcrtTranCtl_sys/CtcrtTranCtl/Error/PrechargeError/CTC_TiOnDig84ForErrI_P1" /begin REF_CHARACTERISTIC CTC_TiOnDig84ForErrI_P /end REF_CHARACTERISTIC /end GROUP
/begin GROUP S208_CTC_TiProc_P1 "swc_CtctrTranCtl/CtcrtTranCtl_sys/CtcrtTranCtl/Error/PrechargeError/CTC_TiProc_P1" /begin REF_CHARACTERISTIC CTC_TiProc_P /end REF_CHARACTERISTIC /end GROUP
/begin GROUP S208_CTC_TiProc_P18 "swc_CtctrTranCtl/CtcrtTranCtl_sys/CtcrtTranCtl/Error/PrechargeError/CTC_TiProc_P18" /begin REF_CHARACTERISTIC CTC_TiProc_P /end REF_CHARACTERISTIC /end GROUP
/begin GROUP S209_BitSelect "swc_CtctrTranCtl/CtcrtTranCtl_sys/CtcrtTranCtl/Error/PrechargeRelayError/BitSelect" /begin REF_CHARACTERISTIC CTC_CswDiag_P /end REF_CHARACTERISTIC /end GROUP
/begin GROUP S209_BitSelect1 "swc_CtctrTranCtl/CtcrtTranCtl_sys/CtcrtTranCtl/Error/PrechargeRelayError/BitSelect1" /begin REF_CHARACTERISTIC CTC_CswDiag_P /end REF_CHARACTERISTIC /end GROUP
/begin GROUP S209_BitSelect8 "swc_CtctrTranCtl/CtcrtTranCtl_sys/CtcrtTranCtl/Error/PrechargeRelayError/BitSelect8" /begin REF_CHARACTERISTIC CTC_Csw2_P /end REF_CHARACTERISTIC /end GROUP
/begin GROUP S209_BitSelect9 "swc_CtctrTranCtl/CtcrtTranCtl_sys/CtcrtTranCtl/Error/PrechargeRelayError/BitSelect9" /begin REF_CHARACTERISTIC CTC_Csw2_P /end REF_CHARACTERISTIC /end GROUP
/begin GROUP S209_CTC_bErrRlyPrechHiDrvShoToGnd_P "swc_CtctrTranCtl/CtcrtTranCtl_sys/CtcrtTranCtl/Error/PrechargeRelayError/CTC_bErrRlyPrechHiDrvShoToGnd_P" /begin REF_CHARACTERISTIC CTC_bErrRlyPrechHiDrvShoToGnd_P /end REF_CHARACTERISTIC /end GROUP
/begin GROUP S209_CTC_bErrRlyPrechHiDrvShoToPwr_P "swc_CtctrTranCtl/CtcrtTranCtl_sys/CtcrtTranCtl/Error/PrechargeRelayError/CTC_bErrRlyPrechHiDrvShoToPwr_P" /begin REF_CHARACTERISTIC CTC_bErrRlyPrechHiDrvShoToPwr_P /end REF_CHARACTERISTIC /end GROUP
/begin GROUP S209_CTC_TiOffDig84ForScToGnd_P "swc_CtctrTranCtl/CtcrtTranCtl_sys/CtcrtTranCtl/Error/PrechargeRelayError/CTC_TiOffDig84ForScToGnd_P" /begin REF_CHARACTERISTIC CTC_TiOffDig84ForScToGnd_P /end REF_CHARACTERISTIC /end GROUP
/begin GROUP S209_CTC_TiOffDig84ForScToPwr_P "swc_CtctrTranCtl/CtcrtTranCtl_sys/CtcrtTranCtl/Error/PrechargeRelayError/CTC_TiOffDig84ForScToPwr_P" /begin REF_CHARACTERISTIC CTC_TiOffDig84ForScToPwr_P /end REF_CHARACTERISTIC /end GROUP
/begin GROUP S209_CTC_TiOnDig84ForScToGnd_P "swc_CtctrTranCtl/CtcrtTranCtl_sys/CtcrtTranCtl/Error/PrechargeRelayError/CTC_TiOnDig84ForScToGnd_P" /begin REF_CHARACTERISTIC CTC_TiOnDig84ForScToGnd_P /end REF_CHARACTERISTIC /end GROUP
/begin GROUP S209_CTC_TiOnDig84ForScToPwr_P "swc_CtctrTranCtl/CtcrtTranCtl_sys/CtcrtTranCtl/Error/PrechargeRelayError/CTC_TiOnDig84ForScToPwr_P" /begin REF_CHARACTERISTIC CTC_TiOnDig84ForScToPwr_P /end REF_CHARACTERISTIC /end GROUP
/begin GROUP S209_CTC_TiProc_P8 "swc_CtctrTranCtl/CtcrtTranCtl_sys/CtcrtTranCtl/Error/PrechargeRelayError/CTC_TiProc_P8" /begin REF_CHARACTERISTIC CTC_TiProc_P /end REF_CHARACTERISTIC /end GROUP
/begin GROUP S209_CTC_TiProc_P9 "swc_CtctrTranCtl/CtcrtTranCtl_sys/CtcrtTranCtl/Error/PrechargeRelayError/CTC_TiProc_P9" /begin REF_CHARACTERISTIC CTC_TiProc_P /end REF_CHARACTERISTIC /end GROUP
/begin GROUP S20_BPIU_TiOffDig133_P "swc_BatProtnIU/CellUDiag/100ms/UPackCollectionDiagnosis/BPIU_TiOffDig133_P" /begin REF_CHARACTERISTIC BPIU_TiOffDig133_P /end REF_CHARACTERISTIC /end GROUP
/begin GROUP S20_BPIU_TiOnDig133_P "swc_BatProtnIU/CellUDiag/100ms/UPackCollectionDiagnosis/BPIU_TiOnDig133_P" /begin REF_CHARACTERISTIC BPIU_TiOnDig133_P /end REF_CHARACTERISTIC /end GROUP
/begin GROUP S20_BPIU_UCellMaxLim_P "swc_BatProtnIU/CellUDiag/100ms/UPackCollectionDiagnosis/BPIU_UCellMaxLim_P" /begin REF_CHARACTERISTIC BPIU_UCellMaxLim_P /end REF_CHARACTERISTIC /end GROUP
/begin GROUP S210_BitSelect "swc_CtctrTranCtl/CtcrtTranCtl_sys/CtcrtTranCtl/Error/ResistorTemperatureProtect/BitSelect" /begin REF_CHARACTERISTIC CTC_CswDiag_P /end REF_CHARACTERISTIC /end GROUP
/begin GROUP S210_BitSelect20 "swc_CtctrTranCtl/CtcrtTranCtl_sys/CtcrtTranCtl/Error/ResistorTemperatureProtect/BitSelect20" /begin REF_CHARACTERISTIC CTC_Csw2_P /end REF_CHARACTERISTIC /end GROUP
/begin GROUP S210_CTC_bAcvTProtnRPrech_P "swc_CtctrTranCtl/CtcrtTranCtl_sys/CtcrtTranCtl/Error/ResistorTemperatureProtect/CTC_bAcvTProtnRPrech_P" /begin REF_CHARACTERISTIC CTC_bAcvTProtnRPrech_P /end REF_CHARACTERISTIC /end GROUP
/begin GROUP S210_CTC_DecrtUPrechAccumd_P "swc_CtctrTranCtl/CtcrtTranCtl_sys/CtcrtTranCtl/Error/ResistorTemperatureProtect/CTC_DecrtUPrechAccumd_P" /begin REF_CHARACTERISTIC CTC_DecrtUPrechAccumd_P /end REF_CHARACTERISTIC /end GROUP
/begin GROUP S210_CTC_GainUPrechAccumd_P "swc_CtctrTranCtl/CtcrtTranCtl_sys/CtcrtTranCtl/Error/ResistorTemperatureProtect/CTC_GainUPrechAccumd_P" /begin REF_CHARACTERISTIC CTC_GainUPrechAccumd_P /end REF_CHARACTERISTIC /end GROUP
/begin GROUP S210_CTC_StsTProtnRPrech_P "swc_CtctrTranCtl/CtcrtTranCtl_sys/CtcrtTranCtl/Error/ResistorTemperatureProtect/CTC_StsTProtnRPrech_P" /begin REF_CHARACTERISTIC CTC_StsTProtnRPrech_P /end REF_CHARACTERISTIC /end GROUP
/begin GROUP S210_CTC_TiOffForStsTProtnRPrech_P "swc_CtctrTranCtl/CtcrtTranCtl_sys/CtcrtTranCtl/Error/ResistorTemperatureProtect/CTC_TiOffForStsTProtnRPrech_P" /begin REF_CHARACTERISTIC CTC_TiOffForStsTProtnRPrech_P /end REF_CHARACTERISTIC /end GROUP
/begin GROUP S210_CTC_TiOnForStsTProtnRPrech_P "swc_CtctrTranCtl/CtcrtTranCtl_sys/CtcrtTranCtl/Error/ResistorTemperatureProtect/CTC_TiOnForStsTProtnRPrech_P" /begin REF_CHARACTERISTIC CTC_TiOnForStsTProtnRPrech_P /end REF_CHARACTERISTIC /end GROUP
/begin GROUP S210_CTC_TiProc_P "swc_CtctrTranCtl/CtcrtTranCtl_sys/CtcrtTranCtl/Error/ResistorTemperatureProtect/CTC_TiProc_P" /begin REF_CHARACTERISTIC CTC_TiProc_P /end REF_CHARACTERISTIC /end GROUP
/begin GROUP S210_CTC_TiProc_P1 "swc_CtctrTranCtl/CtcrtTranCtl_sys/CtcrtTranCtl/Error/ResistorTemperatureProtect/CTC_TiProc_P1" /begin REF_CHARACTERISTIC CTC_TiProc_P /end REF_CHARACTERISTIC /end GROUP
/begin GROUP S210_CTC_UPrechAccumdUpprLim_P "swc_CtctrTranCtl/CtcrtTranCtl_sys/CtcrtTranCtl/Error/ResistorTemperatureProtect/CTC_UPrechAccumdUpprLim_P" /begin REF_CHARACTERISTIC CTC_UPrechAccumdUpprLim_P /end REF_CHARACTERISTIC /end GROUP
/begin GROUP S21_ELHPN_CfgHvil2_P "swc_EltlLnkHzrdProtnNet/ELHPN_10ms_sys/ELHPN_10ms_sys/HighVoltageInterlock /ELHPN_CfgHvil2_P" /begin REF_CHARACTERISTIC ELHPN_CfgHvil2_P /end REF_CHARACTERISTIC /end GROUP
/begin GROUP S21_ELHPN_DucycHvilReq_P1 "swc_EltlLnkHzrdProtnNet/ELHPN_10ms_sys/ELHPN_10ms_sys/HighVoltageInterlock /ELHPN_DucycHvilReq_P1" /begin REF_CHARACTERISTIC ELHPN_DucycHvilReq_P /end REF_CHARACTERISTIC /end GROUP
/begin GROUP S21_ELHPN_DucycHvilTolr_P1 "swc_EltlLnkHzrdProtnNet/ELHPN_10ms_sys/ELHPN_10ms_sys/HighVoltageInterlock /ELHPN_DucycHvilTolr_P1" /begin REF_CHARACTERISTIC ELHPN_DucycHvilTolr_P /end REF_CHARACTERISTIC /end GROUP
/begin GROUP S21_ELHPN_FrqHvilReq_P1 "swc_EltlLnkHzrdProtnNet/ELHPN_10ms_sys/ELHPN_10ms_sys/HighVoltageInterlock /ELHPN_FrqHvilReq_P1" /begin REF_CHARACTERISTIC ELHPN_FrqHvilReq_P /end REF_CHARACTERISTIC /end GROUP
/begin GROUP S21_ELHPN_FrqHvilTolr_P1 "swc_EltlLnkHzrdProtnNet/ELHPN_10ms_sys/ELHPN_10ms_sys/HighVoltageInterlock /ELHPN_FrqHvilTolr_P1" /begin REF_CHARACTERISTIC ELHPN_FrqHvilTolr_P /end REF_CHARACTERISTIC /end GROUP
/begin GROUP S21_ELHPN_IdxHvilReq_P1 "swc_EltlLnkHzrdProtnNet/ELHPN_10ms_sys/ELHPN_10ms_sys/HighVoltageInterlock /ELHPN_IdxHvilReq_P1" /begin REF_CHARACTERISTIC ELHPN_IdxHvilReq_P /end REF_CHARACTERISTIC /end GROUP
/begin GROUP S21_ELHPN_TiDebOffHvIntlc_P "swc_EltlLnkHzrdProtnNet/ELHPN_10ms_sys/ELHPN_10ms_sys/HighVoltageInterlock /ELHPN_TiDebOffHvIntlc_P" /begin REF_CHARACTERISTIC ELHPN_TiDebOffHvIntlc_P /end REF_CHARACTERISTIC /end GROUP
/begin GROUP S21_ELHPN_TiDebOnHvIntlc_P "swc_EltlLnkHzrdProtnNet/ELHPN_10ms_sys/ELHPN_10ms_sys/HighVoltageInterlock /ELHPN_TiDebOnHvIntlc_P" /begin REF_CHARACTERISTIC ELHPN_TiDebOnHvIntlc_P /end REF_CHARACTERISTIC /end GROUP
/begin GROUP S21_InitialCheck "swc_EltlLnkHzrdProtnNet/ELHPN_10ms_sys/ELHPN_10ms_sys/HighVoltageInterlock /InitialCheck"
 /begin SUB_GROUP S65_BitSelect S65_ELHPN_TiDebIniOffHvIntlc_P S65_ELHPN_TiDebIniOnHvIntlc_P1 S65_ELHPN_TiSample1 /end SUB_GROUP
/end GROUP
/begin GROUP S22_BMC_UCell_P "swc_CIL/CIL_100ms_sys/BSW/BMC_UCell_P" /begin REF_CHARACTERISTIC BMC_UCell_P /end REF_CHARACTERISTIC /end GROUP
/begin GROUP S22_CIL_IDcdcLvAct_P "swc_CIL/CIL_100ms_sys/BSW/CIL_IDcdcLvAct_P" /begin REF_CHARACTERISTIC CIL_IDcdcLvAct_P /end REF_CHARACTERISTIC /end GROUP
/begin GROUP S22_CIL_StCellT_P "swc_CIL/CIL_100ms_sys/BSW/CIL_StCellT_P" /begin REF_CHARACTERISTIC CIL_StCellT_P /end REF_CHARACTERISTIC /end GROUP
/begin GROUP S22_CIL_TBdSnsr_P "swc_CIL/CIL_100ms_sys/BSW/CIL_TBdSnsr_P" /begin REF_CHARACTERISTIC CIL_TBdSnsr_P /end REF_CHARACTERISTIC /end GROUP
/begin GROUP S22_CIL_TMdul_P "swc_CIL/CIL_100ms_sys/BSW/CIL_TMdul_P" /begin REF_CHARACTERISTIC CIL_TMdul_P /end REF_CHARACTERISTIC /end GROUP
/begin GROUP S22_CIL_TMdulCtlr_P "swc_CIL/CIL_100ms_sys/BSW/CIL_TMdulCtlr_P" /begin REF_CHARACTERISTIC CIL_TMdulCtlr_P /end REF_CHARACTERISTIC /end GROUP
/begin GROUP S22_CIL_UDcdcLvAct_P "swc_CIL/CIL_100ms_sys/BSW/CIL_UDcdcLvAct_P" /begin REF_CHARACTERISTIC CIL_UDcdcLvAct_P /end REF_CHARACTERISTIC /end GROUP
/begin GROUP S22_DTRC_Csw_P_1 "swc_CIL/CIL_100ms_sys/BSW/DTRC_Csw_P.1" /begin REF_CHARACTERISTIC CIL_Csw6_P /end REF_CHARACTERISTIC /end GROUP
/begin GROUP S22_DTRC_Csw_P_10 "swc_CIL/CIL_100ms_sys/BSW/DTRC_Csw_P.10" /begin REF_CHARACTERISTIC CIL_Csw6_P /end REF_CHARACTERISTIC /end GROUP
/begin GROUP S22_DTRC_Csw_P_11 "swc_CIL/CIL_100ms_sys/BSW/DTRC_Csw_P.11" /begin REF_CHARACTERISTIC CIL_Csw6_P /end REF_CHARACTERISTIC /end GROUP
/begin GROUP S22_DTRC_Csw_P_12 "swc_CIL/CIL_100ms_sys/BSW/DTRC_Csw_P.12" /begin REF_CHARACTERISTIC CIL_Csw6_P /end REF_CHARACTERISTIC /end GROUP
/begin GROUP S22_DTRC_Csw_P_16 "swc_CIL/CIL_100ms_sys/BSW/DTRC_Csw_P.16" /begin REF_CHARACTERISTIC CIL_Csw6_P /end REF_CHARACTERISTIC /end GROUP
/begin GROUP S22_DTRC_Csw_P_8 "swc_CIL/CIL_100ms_sys/BSW/DTRC_Csw_P.8" /begin REF_CHARACTERISTIC CIL_Csw6_P /end REF_CHARACTERISTIC /end GROUP
/begin GROUP S22_DTRC_Csw_P_9 "swc_CIL/CIL_100ms_sys/BSW/DTRC_Csw_P.9" /begin REF_CHARACTERISTIC CIL_Csw6_P /end REF_CHARACTERISTIC /end GROUP
/begin GROUP S22_ELHPN_bDisaIslnMeas_M "swc_EltlLnkHzrdProtnNet/ELHPN_10ms_sys/ELHPN_10ms_sys/InhibitionIsolationMeasurement/ELHPN_bDisaIslnMeas_M" /begin REF_CHARACTERISTIC ELHPN_bDisaIslnMeas_M /end REF_CHARACTERISTIC /end GROUP
/begin GROUP S23_BPIU_TiOffDig174_P "swc_BatProtnIU/CellUDiag/100ms/CellVoltageDiagnosis/CellVoltageLimitCore/BPIU_TiOffDig174_P" /begin REF_CHARACTERISTIC BPIU_TiOffDig174_P /end REF_CHARACTERISTIC /end GROUP
/begin GROUP S23_BPIU_TiOffDig4_P "swc_BatProtnIU/CellUDiag/100ms/CellVoltageDiagnosis/CellVoltageLimitCore/BPIU_TiOffDig4_P" /begin REF_CHARACTERISTIC BPIU_TiOffDig4_P /end REF_CHARACTERISTIC /end GROUP
/begin GROUP S23_BPIU_TiOffDig63_P "swc_BatProtnIU/CellUDiag/100ms/CellVoltageDiagnosis/CellVoltageLimitCore/BPIU_TiOffDig63_P" /begin REF_CHARACTERISTIC BPIU_TiOffDig63_P /end REF_CHARACTERISTIC /end GROUP
/begin GROUP S23_BPIU_TiOffDig89_P "swc_BatProtnIU/CellUDiag/100ms/CellVoltageDiagnosis/CellVoltageLimitCore/BPIU_TiOffDig89_P" /begin REF_CHARACTERISTIC BPIU_TiOffDig89_P /end REF_CHARACTERISTIC /end GROUP
/begin GROUP S23_BPIU_TiOnDig174_P "swc_BatProtnIU/CellUDiag/100ms/CellVoltageDiagnosis/CellVoltageLimitCore/BPIU_TiOnDig174_P" /begin REF_CHARACTERISTIC BPIU_TiOnDig174_P /end REF_CHARACTERISTIC /end GROUP
/begin GROUP S23_BPIU_TiOnDig4_P "swc_BatProtnIU/CellUDiag/100ms/CellVoltageDiagnosis/CellVoltageLimitCore/BPIU_TiOnDig4_P" /begin REF_CHARACTERISTIC BPIU_TiOnDig4_P /end REF_CHARACTERISTIC /end GROUP
/begin GROUP S23_BPIU_TiOnDig63_P "swc_BatProtnIU/CellUDiag/100ms/CellVoltageDiagnosis/CellVoltageLimitCore/BPIU_TiOnDig63_P" /begin REF_CHARACTERISTIC BPIU_TiOnDig63_P /end REF_CHARACTERISTIC /end GROUP
/begin GROUP S23_BPIU_TiOnDig89_P "swc_BatProtnIU/CellUDiag/100ms/CellVoltageDiagnosis/CellVoltageLimitCore/BPIU_TiOnDig89_P" /begin REF_CHARACTERISTIC BPIU_TiOnDig89_P /end REF_CHARACTERISTIC /end GROUP
/begin GROUP S23_BPIU_UCellOverMin1_P "swc_BatProtnIU/CellUDiag/100ms/CellVoltageDiagnosis/CellVoltageLimitCore/BPIU_UCellOverMin1_P" /begin REF_CHARACTERISTIC BPIU_UCellOverMin1_P /end REF_CHARACTERISTIC /end GROUP
/begin GROUP S23_BPIU_UCellOverMin2_P "swc_BatProtnIU/CellUDiag/100ms/CellVoltageDiagnosis/CellVoltageLimitCore/BPIU_UCellOverMin2_P" /begin REF_CHARACTERISTIC BPIU_UCellOverMin2_P /end REF_CHARACTERISTIC /end GROUP
/begin GROUP S23_BPIU_UCellWarnMin2_P "swc_BatProtnIU/CellUDiag/100ms/CellVoltageDiagnosis/CellVoltageLimitCore/BPIU_UCellWarnMin2_P" /begin REF_CHARACTERISTIC BPIU_UCellWarnMin2_P /end REF_CHARACTERISTIC /end GROUP
/begin GROUP S23_BPIU_UCellWarnMin3_P "swc_BatProtnIU/CellUDiag/100ms/CellVoltageDiagnosis/CellVoltageLimitCore/BPIU_UCellWarnMin3_P" /begin REF_CHARACTERISTIC BPIU_UCellWarnMin3_P /end REF_CHARACTERISTIC /end GROUP
/begin GROUP S23_BPIU_UCellWarnMin_P "swc_BatProtnIU/CellUDiag/100ms/CellVoltageDiagnosis/CellVoltageLimitCore/BPIU_UCellWarnMin_P" /begin REF_CHARACTERISTIC BPIU_UCellWarnMin_P /end REF_CHARACTERISTIC /end GROUP
/begin GROUP S23_BPIU_UCellWarnMinOff2_P "swc_BatProtnIU/CellUDiag/100ms/CellVoltageDiagnosis/CellVoltageLimitCore/BPIU_UCellWarnMinOff2_P" /begin REF_CHARACTERISTIC BPIU_UCellWarnMinOff2_P /end REF_CHARACTERISTIC /end GROUP
/begin GROUP S23_BPIU_UCellWarnMinOff_P "swc_BatProtnIU/CellUDiag/100ms/CellVoltageDiagnosis/CellVoltageLimitCore/BPIU_UCellWarnMinOff_P" /begin REF_CHARACTERISTIC BPIU_UCellWarnMinOff_P /end REF_CHARACTERISTIC /end GROUP
/begin GROUP S23_BPIU_UCellWarnTBlwLoMin2_P "swc_BatProtnIU/CellUDiag/100ms/CellVoltageDiagnosis/CellVoltageLimitCore/BPIU_UCellWarnTBlwLoMin2_P" /begin REF_CHARACTERISTIC BPIU_UCellWarnTBlwLoMin2_P /end REF_CHARACTERISTIC /end GROUP
/begin GROUP S23_BPIU_UCellWarnTBlwLoMin3_P "swc_BatProtnIU/CellUDiag/100ms/CellVoltageDiagnosis/CellVoltageLimitCore/BPIU_UCellWarnTBlwLoMin3_P" /begin REF_CHARACTERISTIC BPIU_UCellWarnTBlwLoMin3_P /end REF_CHARACTERISTIC /end GROUP
/begin GROUP S23_BPIU_UCellWarnTBlwLoMin_P "swc_BatProtnIU/CellUDiag/100ms/CellVoltageDiagnosis/CellVoltageLimitCore/BPIU_UCellWarnTBlwLoMin_P" /begin REF_CHARACTERISTIC BPIU_UCellWarnTBlwLoMin_P /end REF_CHARACTERISTIC /end GROUP
/begin GROUP S23_BPIU_UCellWarnTBlwLoMinOff2_P "swc_BatProtnIU/CellUDiag/100ms/CellVoltageDiagnosis/CellVoltageLimitCore/BPIU_UCellWarnTBlwLoMinOff2_P" /begin REF_CHARACTERISTIC BPIU_UCellWarnTBlwLoMinOff2_P /end REF_CHARACTERISTIC /end GROUP
/begin GROUP S23_BPIU_UCellWarnTBlwLoMinOff_P "swc_BatProtnIU/CellUDiag/100ms/CellVoltageDiagnosis/CellVoltageLimitCore/BPIU_UCellWarnTBlwLoMinOff_P" /begin REF_CHARACTERISTIC BPIU_UCellWarnTBlwLoMinOff_P /end REF_CHARACTERISTIC /end GROUP
/begin GROUP S23_BPIU_UCellWarnTLoMin2_P "swc_BatProtnIU/CellUDiag/100ms/CellVoltageDiagnosis/CellVoltageLimitCore/BPIU_UCellWarnTLoMin2_P" /begin REF_CHARACTERISTIC BPIU_UCellWarnTLoMin2_P /end REF_CHARACTERISTIC /end GROUP
/begin GROUP S23_BPIU_UCellWarnTLoMin3_P "swc_BatProtnIU/CellUDiag/100ms/CellVoltageDiagnosis/CellVoltageLimitCore/BPIU_UCellWarnTLoMin3_P" /begin REF_CHARACTERISTIC BPIU_UCellWarnTLoMin3_P /end REF_CHARACTERISTIC /end GROUP
/begin GROUP S23_BPIU_UCellWarnTLoMin_P "swc_BatProtnIU/CellUDiag/100ms/CellVoltageDiagnosis/CellVoltageLimitCore/BPIU_UCellWarnTLoMin_P" /begin REF_CHARACTERISTIC BPIU_UCellWarnTLoMin_P /end REF_CHARACTERISTIC /end GROUP
/begin GROUP S23_BPIU_UCellWarnTLoMinOff2_P "swc_BatProtnIU/CellUDiag/100ms/CellVoltageDiagnosis/CellVoltageLimitCore/BPIU_UCellWarnTLoMinOff2_P" /begin REF_CHARACTERISTIC BPIU_UCellWarnTLoMinOff2_P /end REF_CHARACTERISTIC /end GROUP
/begin GROUP S23_BPIU_UCellWarnTLoMinOff_P "swc_BatProtnIU/CellUDiag/100ms/CellVoltageDiagnosis/CellVoltageLimitCore/BPIU_UCellWarnTLoMinOff_P" /begin REF_CHARACTERISTIC BPIU_UCellWarnTLoMinOff_P /end REF_CHARACTERISTIC /end GROUP
/begin GROUP S23_ELHPN_TiIslnIninChk_P1 "swc_EltlLnkHzrdProtnNet/ELHPN_10ms_sys/ELHPN_10ms_sys/StateIsolation/ELHPN_TiIslnIninChk_P1" /begin REF_CHARACTERISTIC ELHPN_TiIslnIninChk_P /end REF_CHARACTERISTIC /end GROUP
/begin GROUP S23_SelfCheck "swc_BatProtnIU/CellUDiag/100ms/CellVoltageDiagnosis/CellVoltageLimitCore/SelfCheck"
 /begin SUB_GROUP S72_BitSelect S72_BPIU_TiChkOnDig63_P S72_BPIU_TiSample2_P4 /end SUB_GROUP
/end GROUP
/begin GROUP S23_StIsln "swc_EltlLnkHzrdProtnNet/ELHPN_10ms_sys/ELHPN_10ms_sys/StateIsolation/StIsln"
 /begin SUB_GROUP S81_ElectrodesErrorLevel S81_ELHPN_bAcvLoopHv_M S81_IsolationLevel S81_VehicleIsolationError S81_VehicleIsolationState /end SUB_GROUP
/end GROUP
/begin GROUP S23_Subsystem "swc_BatProtnIU/CellUDiag/100ms/CellVoltageDiagnosis/CellVoltageLimitCore/Subsystem" /begin SUB_GROUP S73_BPIU_TCellUMinThd1_P S73_BPIU_TCellUMinThd2_P /end SUB_GROUP /end GROUP
/begin GROUP S241_ChargeCurrentDiagnosis "swc_BatProtnIU/PackIDiag/Subsystem/ChargeCurrentDiagnosis"
 /begin SUB_GROUP S243_BitSelect S243_BitSelect1 S243_BitSelect2 S243_BPIU_ICh_P S243_BPIU_ICh_P1 S243_BPIU_ICh_P2 S243_BPIU_IChMaxLim1_P S243_BPIU_IChMaxLim2_P S243_BPIU_IChMaxLim3_P S243_BPIU_IDlyLim_P1 S243_BPIU_TiOffDig11_P S243_BPIU_TiOffDig181_P2 S243_BPIU_TiOffDig96_P S243_BPIU_TiOnDig11_P S243_BPIU_TiOnDig181_P S243_BPIU_TiOnDig96_P S243_BPIU_TiSample1_P /end SUB_GROUP
/end GROUP
/begin GROUP S241_DischargeCurrentDiagnosis "swc_BatProtnIU/PackIDiag/Subsystem/DischargeCurrentDiagnosis"
 /begin SUB_GROUP S244_BitSelect S244_BitSelect1 S244_BPIU_IDcha_P S244_BPIU_IDcha_P1 S244_BPIU_IDchaMaxLim2_P S244_BPIU_IDchaMaxLim3_P S244_BPIU_IDlyLim_P1 S244_BPIU_TiOffDig94_P S244_BPIU_TiOffDig9_P S244_BPIU_TiOnDig94_P S244_BPIU_TiOnDig9_P S244_BPIU_TiSample1_P S244_BPIU_TiSample1_P1 /end SUB_GROUP
/end GROUP
/begin GROUP S241_ISnsrLimDiagnosis "swc_BatProtnIU/PackIDiag/Subsystem/ISnsrLimDiagnosis"
 /begin SUB_GROUP S245_BitSelect S245_BPIU_TiOffDig111_P S245_BPIU_TiOnDig111_P S245_BPIU_TiSample1_P S245_BPP_ISnsrLim_P /end SUB_GROUP
/end GROUP
/begin GROUP S241_SupplyVoltageDiagnosis "swc_BatProtnIU/PackIDiag/Subsystem/SupplyVoltageDiagnosis"
 /begin SUB_GROUP S247_BitSelect S247_BitSelect1 S247_BPIU_TiOffDig140_P S247_BPIU_TiOffDig141_P S247_BPIU_TiOnDig140_P S247_BPIU_TiOnDig141_P S247_BPIU_TiSample1_P S247_BPIU_TiSample1_P1 S247_BPIU_USptMaxLim_P S247_BPIU_USptMinLim_P S247_BPIU_USptOffLim_P S247_BPIU_USptOffLim_P1 S247_BPIU_USptOnLim_P S247_BPIU_USptOnLim_P1 S247_SelfCheck S247_SelfCheck1 /end SUB_GROUP
/end GROUP
/begin GROUP S243_BCF_RCellDeltaHiLim_P "swc_BatCoreFct/BCF_100ms_sys/BatCoreFct/PackObs/PackObsLoop/MdulObs/CellObsr/Validation of Estimation/Cell Delta Assignment/BCF_RCellDeltaHiLim_P" /begin REF_CHARACTERISTIC BCF_RCellDeltaHiLim_P /end REF_CHARACTERISTIC /end GROUP
/begin GROUP S243_BCF_RCellDeltaLoLim_P "swc_BatCoreFct/BCF_100ms_sys/BatCoreFct/PackObs/PackObsLoop/MdulObs/CellObsr/Validation of Estimation/Cell Delta Assignment/BCF_RCellDeltaLoLim_P" /begin REF_CHARACTERISTIC BCF_RCellDeltaLoLim_P /end REF_CHARACTERISTIC /end GROUP
/begin GROUP S243_BCF_SocCellDeltaHiLim_P "swc_BatCoreFct/BCF_100ms_sys/BatCoreFct/PackObs/PackObsLoop/MdulObs/CellObsr/Validation of Estimation/Cell Delta Assignment/BCF_SocCellDeltaHiLim_P" /begin REF_CHARACTERISTIC BCF_SocCellDeltaHiLim_P /end REF_CHARACTERISTIC /end GROUP
/begin GROUP S243_BCF_SocCellDeltaLoLim_P "swc_BatCoreFct/BCF_100ms_sys/BatCoreFct/PackObs/PackObsLoop/MdulObs/CellObsr/Validation of Estimation/Cell Delta Assignment/BCF_SocCellDeltaLoLim_P" /begin REF_CHARACTERISTIC BCF_SocCellDeltaLoLim_P /end REF_CHARACTERISTIC /end GROUP
/begin GROUP S243_BPIU_ICh_P "swc_BatProtnIU/PackIDiag/Subsystem/ChargeCurrentDiagnosis/BPIU_ICh_P" /begin REF_CHARACTERISTIC BPIU_ICh_P /end REF_CHARACTERISTIC /end GROUP
/begin GROUP S243_BPIU_ICh_P1 "swc_BatProtnIU/PackIDiag/Subsystem/ChargeCurrentDiagnosis/BPIU_ICh_P1" /begin REF_CHARACTERISTIC BPIU_ICh_P /end REF_CHARACTERISTIC /end GROUP
/begin GROUP S243_BPIU_ICh_P2 "swc_BatProtnIU/PackIDiag/Subsystem/ChargeCurrentDiagnosis/BPIU_ICh_P2" /begin REF_CHARACTERISTIC BPIU_ICh_P /end REF_CHARACTERISTIC /end GROUP
/begin GROUP S243_BPIU_IChMaxLim1_P "swc_BatProtnIU/PackIDiag/Subsystem/ChargeCurrentDiagnosis/BPIU_IChMaxLim1_P" /begin REF_CHARACTERISTIC BPIU_IChMaxLim1_P /end REF_CHARACTERISTIC /end GROUP
/begin GROUP S243_BPIU_IChMaxLim2_P "swc_BatProtnIU/PackIDiag/Subsystem/ChargeCurrentDiagnosis/BPIU_IChMaxLim2_P" /begin REF_CHARACTERISTIC BPIU_IChMaxLim2_P /end REF_CHARACTERISTIC /end GROUP
/begin GROUP S243_BPIU_IChMaxLim3_P "swc_BatProtnIU/PackIDiag/Subsystem/ChargeCurrentDiagnosis/BPIU_IChMaxLim3_P" /begin REF_CHARACTERISTIC BPIU_IChMaxLim3_P /end REF_CHARACTERISTIC /end GROUP
/begin GROUP S243_BPIU_IDlyLim_P1 "swc_BatProtnIU/PackIDiag/Subsystem/ChargeCurrentDiagnosis/BPIU_IDlyLim_P1" /begin REF_CHARACTERISTIC BPIU_IDlyLim_P /end REF_CHARACTERISTIC /end GROUP
/begin GROUP S243_BPIU_TiOffDig11_P "swc_BatProtnIU/PackIDiag/Subsystem/ChargeCurrentDiagnosis/BPIU_TiOffDig11_P" /begin REF_CHARACTERISTIC BPIU_TiOffDig11_P /end REF_CHARACTERISTIC /end GROUP
/begin GROUP S243_BPIU_TiOffDig181_P2 "swc_BatProtnIU/PackIDiag/Subsystem/ChargeCurrentDiagnosis/BPIU_TiOffDig181_P2" /begin REF_CHARACTERISTIC BPIU_TiOffDig181_P /end REF_CHARACTERISTIC /end GROUP
/begin GROUP S243_BPIU_TiOffDig96_P "swc_BatProtnIU/PackIDiag/Subsystem/ChargeCurrentDiagnosis/BPIU_TiOffDig96_P" /begin REF_CHARACTERISTIC BPIU_TiOffDig96_P /end REF_CHARACTERISTIC /end GROUP
/begin GROUP S243_BPIU_TiOnDig11_P "swc_BatProtnIU/PackIDiag/Subsystem/ChargeCurrentDiagnosis/BPIU_TiOnDig11_P" /begin REF_CHARACTERISTIC BPIU_TiOnDig11_P /end REF_CHARACTERISTIC /end GROUP
/begin GROUP S243_BPIU_TiOnDig181_P "swc_BatProtnIU/PackIDiag/Subsystem/ChargeCurrentDiagnosis/BPIU_TiOnDig181_P" /begin REF_CHARACTERISTIC BPIU_TiOnDig181_P /end REF_CHARACTERISTIC /end GROUP
/begin GROUP S243_BPIU_TiOnDig96_P "swc_BatProtnIU/PackIDiag/Subsystem/ChargeCurrentDiagnosis/BPIU_TiOnDig96_P" /begin REF_CHARACTERISTIC BPIU_TiOnDig96_P /end REF_CHARACTERISTIC /end GROUP
/begin GROUP S243_BPIU_TiSample1_P "swc_BatProtnIU/PackIDiag/Subsystem/ChargeCurrentDiagnosis/BPIU_TiSample1_P" /begin REF_CHARACTERISTIC BPIU_TiSample1_P /end REF_CHARACTERISTIC /end GROUP
/begin GROUP S244_BCF_TiBalnAcvDdecrt_P "swc_BatCoreFct/BCF_100ms_sys/BatCoreFct/PackObs/PackObsLoop/MdulObs/CellObsr/Validation of Estimation/Monitor Balancing Activity/BCF_TiBalnAcvDdecrt_P" /begin REF_CHARACTERISTIC BCF_TiBalnAcvDdecrt_P /end REF_CHARACTERISTIC /end GROUP
/begin GROUP S244_BCF_TiBalnAcvDincrt_P "swc_BatCoreFct/BCF_100ms_sys/BatCoreFct/PackObs/PackObsLoop/MdulObs/CellObsr/Validation of Estimation/Monitor Balancing Activity/BCF_TiBalnAcvDincrt_P" /begin REF_CHARACTERISTIC BCF_TiBalnAcvDincrt_P /end REF_CHARACTERISTIC /end GROUP
/begin GROUP S244_BCF_TiBalnAcvUpprLim_P "swc_BatCoreFct/BCF_100ms_sys/BatCoreFct/PackObs/PackObsLoop/MdulObs/CellObsr/Validation of Estimation/Monitor Balancing Activity/BCF_TiBalnAcvUpprLim_P" /begin REF_CHARACTERISTIC BCF_TiBalnAcvUpprLim_P /end REF_CHARACTERISTIC /end GROUP
/begin GROUP S244_BCF_TiBalnOffLowrLim_P "swc_BatCoreFct/BCF_100ms_sys/BatCoreFct/PackObs/PackObsLoop/MdulObs/CellObsr/Validation of Estimation/Monitor Balancing Activity/BCF_TiBalnOffLowrLim_P" /begin REF_CHARACTERISTIC BCF_TiBalnOffLowrLim_P /end REF_CHARACTERISTIC /end GROUP
/begin GROUP S244_BPIU_IDcha_P "swc_BatProtnIU/PackIDiag/Subsystem/DischargeCurrentDiagnosis/BPIU_IDcha_P" /begin REF_CHARACTERISTIC BPIU_IDcha_P /end REF_CHARACTERISTIC /end GROUP
/begin GROUP S244_BPIU_IDcha_P1 "swc_BatProtnIU/PackIDiag/Subsystem/DischargeCurrentDiagnosis/BPIU_IDcha_P1" /begin REF_CHARACTERISTIC BPIU_IDcha_P /end REF_CHARACTERISTIC /end GROUP
/begin GROUP S244_BPIU_IDchaMaxLim2_P "swc_BatProtnIU/PackIDiag/Subsystem/DischargeCurrentDiagnosis/BPIU_IDchaMaxLim2_P" /begin REF_CHARACTERISTIC BPIU_IDchaMaxLim2_P /end REF_CHARACTERISTIC /end GROUP
/begin GROUP S244_BPIU_IDchaMaxLim3_P "swc_BatProtnIU/PackIDiag/Subsystem/DischargeCurrentDiagnosis/BPIU_IDchaMaxLim3_P" /begin REF_CHARACTERISTIC BPIU_IDchaMaxLim3_P /end REF_CHARACTERISTIC /end GROUP
/begin GROUP S244_BPIU_IDlyLim_P1 "swc_BatProtnIU/PackIDiag/Subsystem/DischargeCurrentDiagnosis/BPIU_IDlyLim_P1" /begin REF_CHARACTERISTIC BPIU_IDlyLim_P /end REF_CHARACTERISTIC /end GROUP
/begin GROUP S244_BPIU_TiOffDig94_P "swc_BatProtnIU/PackIDiag/Subsystem/DischargeCurrentDiagnosis/BPIU_TiOffDig94_P" /begin REF_CHARACTERISTIC BPIU_TiOffDig94_P /end REF_CHARACTERISTIC /end GROUP
/begin GROUP S244_BPIU_TiOffDig9_P "swc_BatProtnIU/PackIDiag/Subsystem/DischargeCurrentDiagnosis/BPIU_TiOffDig9_P" /begin REF_CHARACTERISTIC BPIU_TiOffDig9_P /end REF_CHARACTERISTIC /end GROUP
/begin GROUP S244_BPIU_TiOnDig94_P "swc_BatProtnIU/PackIDiag/Subsystem/DischargeCurrentDiagnosis/BPIU_TiOnDig94_P" /begin REF_CHARACTERISTIC BPIU_TiOnDig94_P /end REF_CHARACTERISTIC /end GROUP
/begin GROUP S244_BPIU_TiOnDig9_P "swc_BatProtnIU/PackIDiag/Subsystem/DischargeCurrentDiagnosis/BPIU_TiOnDig9_P" /begin REF_CHARACTERISTIC BPIU_TiOnDig9_P /end REF_CHARACTERISTIC /end GROUP
/begin GROUP S244_BPIU_TiSample1_P "swc_BatProtnIU/PackIDiag/Subsystem/DischargeCurrentDiagnosis/BPIU_TiSample1_P" /begin REF_CHARACTERISTIC BPIU_TiSample1_P /end REF_CHARACTERISTIC /end GROUP
/begin GROUP S244_BPIU_TiSample1_P1 "swc_BatProtnIU/PackIDiag/Subsystem/DischargeCurrentDiagnosis/BPIU_TiSample1_P1" /begin REF_CHARACTERISTIC BPIU_TiSample1_P /end REF_CHARACTERISTIC /end GROUP
/begin GROUP S245_BPIU_TiOffDig111_P "swc_BatProtnIU/PackIDiag/Subsystem/ISnsrLimDiagnosis/BPIU_TiOffDig111_P" /begin REF_CHARACTERISTIC BPIU_TiOffDig111_P /end REF_CHARACTERISTIC /end GROUP
/begin GROUP S245_BPIU_TiOnDig111_P "swc_BatProtnIU/PackIDiag/Subsystem/ISnsrLimDiagnosis/BPIU_TiOnDig111_P" /begin REF_CHARACTERISTIC BPIU_TiOnDig111_P /end REF_CHARACTERISTIC /end GROUP
/begin GROUP S245_BPIU_TiSample1_P "swc_BatProtnIU/PackIDiag/Subsystem/ISnsrLimDiagnosis/BPIU_TiSample1_P" /begin REF_CHARACTERISTIC BPIU_TiSample1_P /end REF_CHARACTERISTIC /end GROUP
/begin GROUP S245_BPP_ISnsrLim_P "swc_BatProtnIU/PackIDiag/Subsystem/ISnsrLimDiagnosis/BPP_ISnsrLim_P" /begin REF_CHARACTERISTIC BPP_ISnsrLim_P /end REF_CHARACTERISTIC /end GROUP
/begin GROUP S247_BPIU_TiOffDig140_P "swc_BatProtnIU/PackIDiag/Subsystem/SupplyVoltageDiagnosis/BPIU_TiOffDig140_P" /begin REF_CHARACTERISTIC BPIU_TiOffDig140_P /end REF_CHARACTERISTIC /end GROUP
/begin GROUP S247_BPIU_TiOffDig141_P "swc_BatProtnIU/PackIDiag/Subsystem/SupplyVoltageDiagnosis/BPIU_TiOffDig141_P" /begin REF_CHARACTERISTIC BPIU_TiOffDig141_P /end REF_CHARACTERISTIC /end GROUP
/begin GROUP S247_BPIU_TiOnDig140_P "swc_BatProtnIU/PackIDiag/Subsystem/SupplyVoltageDiagnosis/BPIU_TiOnDig140_P" /begin REF_CHARACTERISTIC BPIU_TiOnDig140_P /end REF_CHARACTERISTIC /end GROUP
/begin GROUP S247_BPIU_TiOnDig141_P "swc_BatProtnIU/PackIDiag/Subsystem/SupplyVoltageDiagnosis/BPIU_TiOnDig141_P" /begin REF_CHARACTERISTIC BPIU_TiOnDig141_P /end REF_CHARACTERISTIC /end GROUP
/begin GROUP S247_BPIU_TiSample1_P "swc_BatProtnIU/PackIDiag/Subsystem/SupplyVoltageDiagnosis/BPIU_TiSample1_P" /begin REF_CHARACTERISTIC BPIU_TiSample1_P /end REF_CHARACTERISTIC /end GROUP
/begin GROUP S247_BPIU_TiSample1_P1 "swc_BatProtnIU/PackIDiag/Subsystem/SupplyVoltageDiagnosis/BPIU_TiSample1_P1" /begin REF_CHARACTERISTIC BPIU_TiSample1_P /end REF_CHARACTERISTIC /end GROUP
/begin GROUP S247_BPIU_USptMaxLim_P "swc_BatProtnIU/PackIDiag/Subsystem/SupplyVoltageDiagnosis/BPIU_USptMaxLim_P" /begin REF_CHARACTERISTIC BPIU_USptMaxLim_P /end REF_CHARACTERISTIC /end GROUP
/begin GROUP S247_BPIU_USptMinLim_P "swc_BatProtnIU/PackIDiag/Subsystem/SupplyVoltageDiagnosis/BPIU_USptMinLim_P" /begin REF_CHARACTERISTIC BPIU_USptMinLim_P /end REF_CHARACTERISTIC /end GROUP
/begin GROUP S247_BPIU_USptOffLim_P "swc_BatProtnIU/PackIDiag/Subsystem/SupplyVoltageDiagnosis/BPIU_USptOffLim_P" /begin REF_CHARACTERISTIC BPIU_USptOffLim_P /end REF_CHARACTERISTIC /end GROUP
/begin GROUP S247_BPIU_USptOffLim_P1 "swc_BatProtnIU/PackIDiag/Subsystem/SupplyVoltageDiagnosis/BPIU_USptOffLim_P1" /begin REF_CHARACTERISTIC BPIU_USptOffLim_P /end REF_CHARACTERISTIC /end GROUP
/begin GROUP S247_BPIU_USptOnLim_P "swc_BatProtnIU/PackIDiag/Subsystem/SupplyVoltageDiagnosis/BPIU_USptOnLim_P" /begin REF_CHARACTERISTIC BPIU_USptOnLim_P /end REF_CHARACTERISTIC /end GROUP
/begin GROUP S247_BPIU_USptOnLim_P1 "swc_BatProtnIU/PackIDiag/Subsystem/SupplyVoltageDiagnosis/BPIU_USptOnLim_P1" /begin REF_CHARACTERISTIC BPIU_USptOnLim_P /end REF_CHARACTERISTIC /end GROUP
/begin GROUP S247_SelfCheck "swc_BatProtnIU/PackIDiag/Subsystem/SupplyVoltageDiagnosis/SelfCheck"
 /begin SUB_GROUP S335_BitSelect S335_BPIU_TiChkOnDig141_P S335_BPIU_TiOffDig140_P S335_BPIU_TiSample1_P S335_BPIU_USptMinLim_P S335_BPIU_USptOffLim_P S335_BPIU_USptOnLim_P /end SUB_GROUP
/end GROUP
/begin GROUP S247_SelfCheck1 "swc_BatProtnIU/PackIDiag/Subsystem/SupplyVoltageDiagnosis/SelfCheck1"
 /begin SUB_GROUP S336_BitSelect S336_BPIU_TiChkOnDig141_P S336_BPIU_TiOffDig141_P S336_BPIU_TiSample1_P S336_BPIU_USptMaxLim_P S336_BPIU_USptOffLim_P S336_BPIU_USptOnLim_P /end SUB_GROUP
/end GROUP
/begin GROUP S250_B2V_ST1_ChgMode_P "swc_COL/COL_100ms_sys/COL_100ms_sys/B2V_ST1_ChgMode_P" /begin REF_CHARACTERISTIC B2V_ST1_ChgMode_P /end REF_CHARACTERISTIC /end GROUP
/begin GROUP S250_BatteryChargingOvercurrent_P "swc_COL/COL_100ms_sys/COL_100ms_sys/BatteryChargingOvercurrent_P" /begin REF_CHARACTERISTIC BatteryChargingOvercurrent_P /end REF_CHARACTERISTIC /end GROUP
/begin GROUP S250_BatteryExcessTemperature_P "swc_COL/COL_100ms_sys/COL_100ms_sys/BatteryExcessTemperature_P" /begin REF_CHARACTERISTIC BatteryExcessTemperature_P /end REF_CHARACTERISTIC /end GROUP
/begin GROUP S250_BatteryHighestTemp_P "swc_COL/COL_100ms_sys/COL_100ms_sys/BatteryHighestTemp_P" /begin REF_CHARACTERISTIC BatteryHighestTemp_P /end REF_CHARACTERISTIC /end GROUP
/begin GROUP S250_BatteryHighestTempSerNo_P "swc_COL/COL_100ms_sys/COL_100ms_sys/BatteryHighestTempSerNo_P" /begin REF_CHARACTERISTIC BatteryHighestTempSerNo_P /end REF_CHARACTERISTIC /end GROUP
/begin GROUP S250_BatteryInsulationState_P "swc_COL/COL_100ms_sys/COL_100ms_sys/BatteryInsulationState_P" /begin REF_CHARACTERISTIC BatteryInsulationState_P /end REF_CHARACTERISTIC /end GROUP
/begin GROUP S250_BatteryLowestTemp_P "swc_COL/COL_100ms_sys/COL_100ms_sys/BatteryLowestTemp_P" /begin REF_CHARACTERISTIC BatteryLowestTemp_P /end REF_CHARACTERISTIC /end GROUP
/begin GROUP S250_BatteryLowestTempSerNo_P "swc_COL/COL_100ms_sys/COL_100ms_sys/BatteryLowestTempSerNo_P" /begin REF_CHARACTERISTIC BatteryLowestTempSerNo_P /end REF_CHARACTERISTIC /end GROUP
/begin GROUP S250_BatteryOutputConnectorState_P "swc_COL/COL_100ms_sys/COL_100ms_sys/BatteryOutputConnectorState_P" /begin REF_CHARACTERISTIC BatteryOutputConnectorState_P /end REF_CHARACTERISTIC /end GROUP
/begin GROUP S250_BatterySystemCapacity_P "swc_COL/COL_100ms_sys/COL_100ms_sys/BatterySystemCapacity_P" /begin REF_CHARACTERISTIC BatterySystemCapacity_P /end REF_CHARACTERISTIC /end GROUP
/begin GROUP S250_BatterySystemVoltage_P "swc_COL/COL_100ms_sys/COL_100ms_sys/BatterySystemVoltage_P" /begin REF_CHARACTERISTIC BatterySystemVoltage_P /end REF_CHARACTERISTIC /end GROUP
/begin GROUP S250_BatteryType_P "swc_COL/COL_100ms_sys/COL_100ms_sys/BatteryType_P" /begin REF_CHARACTERISTIC BatteryType_P /end REF_CHARACTERISTIC /end GROUP
/begin GROUP S250_BCPP_Max_Allow_DCCur_P "swc_COL/COL_100ms_sys/COL_100ms_sys/BCPP_Max_Allow_DCCur_P" /begin REF_CHARACTERISTIC BCPP_Max_Allow_DCCur_P /end REF_CHARACTERISTIC /end GROUP
/begin GROUP S250_BCPP_Max_Allow_DCV_P "swc_COL/COL_100ms_sys/COL_100ms_sys/BCPP_Max_Allow_DCV_P" /begin REF_CHARACTERISTIC BCPP_Max_Allow_DCV_P /end REF_CHARACTERISTIC /end GROUP
/begin GROUP S250_BCPP_Min_Allow_CellV_P "swc_COL/COL_100ms_sys/COL_100ms_sys/BCPP_Min_Allow_CellV_P" /begin REF_CHARACTERISTIC BCPP_Min_Allow_CellV_P /end REF_CHARACTERISTIC /end GROUP
/begin GROUP S250_BCPP_Min_Allow_Soc_P "swc_COL/COL_100ms_sys/COL_100ms_sys/BCPP_Min_Allow_Soc_P" /begin REF_CHARACTERISTIC BCPP_Min_Allow_Soc_P /end REF_CHARACTERISTIC /end GROUP
/begin GROUP S250_BCSP_Remaining_discharge_time_P "swc_COL/COL_100ms_sys/COL_100ms_sys/BCSP_Remaining_discharge_time_P" /begin REF_CHARACTERISTIC BCSP_Remaining_discharge_time_P /end REF_CHARACTERISTIC /end GROUP
/begin GROUP S250_BCSP_Remaining_range_P "swc_COL/COL_100ms_sys/COL_100ms_sys/BCSP_Remaining_range_P" /begin REF_CHARACTERISTIC BCSP_Remaining_range_P /end REF_CHARACTERISTIC /end GROUP
/begin GROUP S250_BDC_Battery_capacity_P "swc_COL/COL_100ms_sys/COL_100ms_sys/BDC_Battery_capacity_P" /begin REF_CHARACTERISTIC BDC_Battery_capacity_P /end REF_CHARACTERISTIC /end GROUP
/begin GROUP S250_BDC_Battery_energy_P "swc_COL/COL_100ms_sys/COL_100ms_sys/BDC_Battery_energy_P" /begin REF_CHARACTERISTIC BDC_Battery_energy_P /end REF_CHARACTERISTIC /end GROUP
/begin GROUP S250_BDC_Current_V2GCirculate_P "swc_COL/COL_100ms_sys/COL_100ms_sys/BDC_Current_V2GCirculate_P" /begin REF_CHARACTERISTIC BDC_Current_V2GCirculate_P /end REF_CHARACTERISTIC /end GROUP
/begin GROUP S250_BDC_Remainder_CruisingRange_P "swc_COL/COL_100ms_sys/COL_100ms_sys/BDC_Remainder_CruisingRange_P" /begin REF_CHARACTERISTIC BDC_Remainder_CruisingRange_P /end REF_CHARACTERISTIC /end GROUP
/begin GROUP S250_BDC_Remainder_V2GCirculate_P "swc_COL/COL_100ms_sys/COL_100ms_sys/BDC_Remainder_V2GCirculate_P" /begin REF_CHARACTERISTIC BDC_Remainder_V2GCirculate_P /end REF_CHARACTERISTIC /end GROUP
/begin GROUP S250_BDC_Soc_P "swc_COL/COL_100ms_sys/COL_100ms_sys/BDC_Soc_P" /begin REF_CHARACTERISTIC BDC_Soc_P /end REF_CHARACTERISTIC /end GROUP
/begin GROUP S250_BDC_Vin1_Copy_10_P "swc_COL/COL_100ms_sys/COL_100ms_sys/BDC_Vin1_Copy_10_P" /begin REF_CHARACTERISTIC BDC_Vin1_Copy_10_P /end REF_CHARACTERISTIC /end GROUP
/begin GROUP S250_BDC_Vin1_Copy_11_P "swc_COL/COL_100ms_sys/COL_100ms_sys/BDC_Vin1_Copy_11_P" /begin REF_CHARACTERISTIC BDC_Vin1_Copy_11_P /end REF_CHARACTERISTIC /end GROUP
/begin GROUP S250_BDC_Vin1_Copy_12_P "swc_COL/COL_100ms_sys/COL_100ms_sys/BDC_Vin1_Copy_12_P" /begin REF_CHARACTERISTIC BDC_Vin1_Copy_12_P /end REF_CHARACTERISTIC /end GROUP
/begin GROUP S250_BDC_Vin1_Copy_13_P "swc_COL/COL_100ms_sys/COL_100ms_sys/BDC_Vin1_Copy_13_P" /begin REF_CHARACTERISTIC BDC_Vin1_Copy_13_P /end REF_CHARACTERISTIC /end GROUP
/begin GROUP S250_BDC_Vin1_Copy_14_P "swc_COL/COL_100ms_sys/COL_100ms_sys/BDC_Vin1_Copy_14_P" /begin REF_CHARACTERISTIC BDC_Vin1_Copy_14_P /end REF_CHARACTERISTIC /end GROUP
/begin GROUP S250_BDC_Vin1_Copy_15_P "swc_COL/COL_100ms_sys/COL_100ms_sys/BDC_Vin1_Copy_15_P" /begin REF_CHARACTERISTIC BDC_Vin1_Copy_15_P /end REF_CHARACTERISTIC /end GROUP
/begin GROUP S250_BDC_Vin1_Copy_16_P "swc_COL/COL_100ms_sys/COL_100ms_sys/BDC_Vin1_Copy_16_P" /begin REF_CHARACTERISTIC BDC_Vin1_Copy_16_P /end REF_CHARACTERISTIC /end GROUP
/begin GROUP S250_BDC_Vin1_Copy_17_P "swc_COL/COL_100ms_sys/COL_100ms_sys/BDC_Vin1_Copy_17_P" /begin REF_CHARACTERISTIC BDC_Vin1_Copy_17_P /end REF_CHARACTERISTIC /end GROUP
/begin GROUP S250_BDC_Vin1_Copy_1_P "swc_COL/COL_100ms_sys/COL_100ms_sys/BDC_Vin1_Copy_1_P" /begin REF_CHARACTERISTIC BDC_Vin1_Copy_1_P /end REF_CHARACTERISTIC /end GROUP
/begin GROUP S250_BDC_Vin1_Copy_2_P "swc_COL/COL_100ms_sys/COL_100ms_sys/BDC_Vin1_Copy_2_P" /begin REF_CHARACTERISTIC BDC_Vin1_Copy_2_P /end REF_CHARACTERISTIC /end GROUP
/begin GROUP S250_BDC_Vin1_Copy_3_P "swc_COL/COL_100ms_sys/COL_100ms_sys/BDC_Vin1_Copy_3_P" /begin REF_CHARACTERISTIC BDC_Vin1_Copy_3_P /end REF_CHARACTERISTIC /end GROUP
/begin GROUP S250_BDC_Vin1_Copy_4_P "swc_COL/COL_100ms_sys/COL_100ms_sys/BDC_Vin1_Copy_4_P" /begin REF_CHARACTERISTIC BDC_Vin1_Copy_4_P /end REF_CHARACTERISTIC /end GROUP
/begin GROUP S250_BDC_Vin1_Copy_5_P "swc_COL/COL_100ms_sys/COL_100ms_sys/BDC_Vin1_Copy_5_P" /begin REF_CHARACTERISTIC BDC_Vin1_Copy_5_P /end REF_CHARACTERISTIC /end GROUP
/begin GROUP S250_BDC_Vin1_Copy_6_P "swc_COL/COL_100ms_sys/COL_100ms_sys/BDC_Vin1_Copy_6_P" /begin REF_CHARACTERISTIC BDC_Vin1_Copy_6_P /end REF_CHARACTERISTIC /end GROUP
/begin GROUP S250_BDC_Vin1_Copy_7_P "swc_COL/COL_100ms_sys/COL_100ms_sys/BDC_Vin1_Copy_7_P" /begin REF_CHARACTERISTIC BDC_Vin1_Copy_7_P /end REF_CHARACTERISTIC /end GROUP
/begin GROUP S250_BDC_Vin1_Copy_8_P "swc_COL/COL_100ms_sys/COL_100ms_sys/BDC_Vin1_Copy_8_P" /begin REF_CHARACTERISTIC BDC_Vin1_Copy_8_P /end REF_CHARACTERISTIC /end GROUP
/begin GROUP S250_BDC_Vin1_Copy_9_P "swc_COL/COL_100ms_sys/COL_100ms_sys/BDC_Vin1_Copy_9_P" /begin REF_CHARACTERISTIC BDC_Vin1_Copy_9_P /end REF_CHARACTERISTIC /end GROUP
/begin GROUP S250_BMS_BattaryFltInfo_BMS_NegRelayFault_P "swc_COL/COL_100ms_sys/COL_100ms_sys/BMS_BattaryFltInfo_BMS_NegRelayFault_P" /begin REF_CHARACTERISTIC BMS_NegRelayFault_P /end REF_CHARACTERISTIC /end GROUP
/begin GROUP S250_BMS_BattaryFltInfo_BMS_PosRelayFault_P "swc_COL/COL_100ms_sys/COL_100ms_sys/BMS_BattaryFltInfo_BMS_PosRelayFault_P" /begin REF_CHARACTERISTIC BMS_PosRelayFault_P /end REF_CHARACTERISTIC /end GROUP
/begin GROUP S250_BMS_BattCellsNum_P "swc_COL/COL_100ms_sys/COL_100ms_sys/BMS_BattCellsNum_P" /begin REF_CHARACTERISTIC BMS_BattCellsNum_P /end REF_CHARACTERISTIC /end GROUP
/begin GROUP S250_BMS_BattCellVolFault_P "swc_COL/COL_100ms_sys/COL_100ms_sys/BMS_BattCellVolFault_P" /begin REF_CHARACTERISTIC BMS_BattCellVolFault_P /end REF_CHARACTERISTIC /end GROUP
/begin GROUP S250_BMS_BattCurr_P "swc_COL/COL_100ms_sys/COL_100ms_sys/BMS_BattCurr_P" /begin REF_CHARACTERISTIC BMS_BattCurr_P /end REF_CHARACTERISTIC /end GROUP
/begin GROUP S250_BMS_BattEqualizationSts_P "swc_COL/COL_100ms_sys/COL_100ms_sys/BMS_BattEqualizationSts_P" /begin REF_CHARACTERISTIC BMS_BattEqualizationSts_P /end REF_CHARACTERISTIC /end GROUP
/begin GROUP S250_BMS_BatteryInfo_BMS_ActWorkSts_P "swc_COL/COL_100ms_sys/COL_100ms_sys/BMS_BatteryInfo_BMS_ActWorkSts_P" /begin REF_CHARACTERISTIC BMS_ActWorkSts_P /end REF_CHARACTERISTIC /end GROUP
/begin GROUP S250_BMS_BatteryInfo_BMS_EmergCutoffHVReq_P "swc_COL/COL_100ms_sys/COL_100ms_sys/BMS_BatteryInfo_BMS_EmergCutoffHVReq_P" /begin REF_CHARACTERISTIC BMS_EmergCutoffHVReq_P /end REF_CHARACTERISTIC /end GROUP
/begin GROUP S250_BMS_BatteryInfo_BMS_NegRelaySts_P "swc_COL/COL_100ms_sys/COL_100ms_sys/BMS_BatteryInfo_BMS_NegRelaySts_P" /begin REF_CHARACTERISTIC BMS_NegRelaySts_P /end REF_CHARACTERISTIC /end GROUP
/begin GROUP S250_BMS_BatteryInfo_BMS_PmtCutoffLVFb_P "swc_COL/COL_100ms_sys/COL_100ms_sys/BMS_BatteryInfo_BMS_PmtCutoffLVFb_P" /begin REF_CHARACTERISTIC BMS_PmtCutoffLVFb_P /end REF_CHARACTERISTIC /end GROUP
/begin GROUP S250_BMS_BatteryInfo_BMS_SelfChkState_P "swc_COL/COL_100ms_sys/COL_100ms_sys/BMS_BatteryInfo_BMS_SelfChkState_P" /begin REF_CHARACTERISTIC BMS_SelfChkState_P /end REF_CHARACTERISTIC /end GROUP
/begin GROUP S250_BMS_BattIsolationSts_P "swc_COL/COL_100ms_sys/COL_100ms_sys/BMS_BattIsolationSts_P" /begin REF_CHARACTERISTIC BMS_BattIsolationSts_P /end REF_CHARACTERISTIC /end GROUP
/begin GROUP S250_BMS_BattPackInCoolTemp_P "swc_COL/COL_100ms_sys/COL_100ms_sys/BMS_BattPackInCoolTemp_P" /begin REF_CHARACTERISTIC BMS_BattPackInCoolTemp_P /end REF_CHARACTERISTIC /end GROUP
/begin GROUP S250_BMS_BattPackNum_P "swc_COL/COL_100ms_sys/COL_100ms_sys/BMS_BattPackNum_P" /begin REF_CHARACTERISTIC BMS_BattPackNum_P /end REF_CHARACTERISTIC /end GROUP
/begin GROUP S250_BMS_BattPackOutCoolTemp_P "swc_COL/COL_100ms_sys/COL_100ms_sys/BMS_BattPackOutCoolTemp_P" /begin REF_CHARACTERISTIC BMS_BattPackOutCoolTemp_P /end REF_CHARACTERISTIC /end GROUP
/begin GROUP S250_BMS_BattPackVolFault_P "swc_COL/COL_100ms_sys/COL_100ms_sys/BMS_BattPackVolFault_P" /begin REF_CHARACTERISTIC BMS_BattPackVolFault_P /end REF_CHARACTERISTIC /end GROUP
/begin GROUP S250_BMS_BattSOC_P "swc_COL/COL_100ms_sys/COL_100ms_sys/BMS_BattSOC_P" /begin REF_CHARACTERISTIC BMS_BattSOC_P /end REF_CHARACTERISTIC /end GROUP
/begin GROUP S250_BMS_BattSOCFault_P "swc_COL/COL_100ms_sys/COL_100ms_sys/BMS_BattSOCFault_P" /begin REF_CHARACTERISTIC BMS_BattSOCFault_P /end REF_CHARACTERISTIC /end GROUP
/begin GROUP S250_BMS_BattSOH_P "swc_COL/COL_100ms_sys/COL_100ms_sys/BMS_BattSOH_P" /begin REF_CHARACTERISTIC BMS_BattSOH_P /end REF_CHARACTERISTIC /end GROUP
/begin GROUP S250_BMS_BattVol_P "swc_COL/COL_100ms_sys/COL_100ms_sys/BMS_BattVol_P" /begin REF_CHARACTERISTIC BMS_BattVol_P /end REF_CHARACTERISTIC /end GROUP
/begin GROUP S250_BMS_Batty_ThermalMangeReq_P "swc_COL/COL_100ms_sys/COL_100ms_sys/BMS_Batty_ThermalMangeReq_P" /begin REF_CHARACTERISTIC BMS_Batty_ThermalMangeReq_P /end REF_CHARACTERISTIC /end GROUP
/begin GROUP S250_BMS_BBMSensorCurr_P "swc_COL/COL_100ms_sys/COL_100ms_sys/BMS_BBMSensorCurr_P" /begin REF_CHARACTERISTIC BMS_BBMSensorCurr_P /end REF_CHARACTERISTIC /end GROUP
/begin GROUP S250_BMS_CellVolDiffFault_P "swc_COL/COL_100ms_sys/COL_100ms_sys/BMS_CellVolDiffFault_P" /begin REF_CHARACTERISTIC BMS_CellVolDiffFault_P /end REF_CHARACTERISTIC /end GROUP
/begin GROUP S250_BMS_ChgStatus_P "swc_COL/COL_100ms_sys/COL_100ms_sys/BMS_ChgStatus_P" /begin REF_CHARACTERISTIC BMS_ChgStatus_P /end REF_CHARACTERISTIC /end GROUP
/begin GROUP S250_BMS_CutOffLVFbToOBC_P "swc_COL/COL_100ms_sys/COL_100ms_sys/BMS_CutOffLVFbToOBC_P" /begin REF_CHARACTERISTIC BMS_CutOffLVFbToOBC_P /end REF_CHARACTERISTIC /end GROUP
/begin GROUP S250_BMS_DCChargRelayCtrl_P "swc_COL/COL_100ms_sys/COL_100ms_sys/BMS_DCChargRelayCtrl_P" /begin REF_CHARACTERISTIC BMS_DCChargRelayCtrl_P /end REF_CHARACTERISTIC /end GROUP
/begin GROUP S250_BMS_DCChgPlugSts_P "swc_COL/COL_100ms_sys/COL_100ms_sys/BMS_DCChgPlugSts_P" /begin REF_CHARACTERISTIC BMS_DCChgPlugSts_P /end REF_CHARACTERISTIC /end GROUP
/begin GROUP S250_BMS_DCChgReady_P "swc_COL/COL_100ms_sys/COL_100ms_sys/BMS_DCChgReady_P" /begin REF_CHARACTERISTIC BMS_DCChgReady_P /end REF_CHARACTERISTIC /end GROUP
/begin GROUP S250_BMS_DCChgStage_P "swc_COL/COL_100ms_sys/COL_100ms_sys/BMS_DCChgStage_P" /begin REF_CHARACTERISTIC BMS_DCChgStage_P /end REF_CHARACTERISTIC /end GROUP
/begin GROUP S250_BMS_ElectroniclockSts_P "swc_COL/COL_100ms_sys/COL_100ms_sys/BMS_ElectroniclockSts_P" /begin REF_CHARACTERISTIC BMS_ElectroniclockSts_P /end REF_CHARACTERISTIC /end GROUP
/begin GROUP S250_BMS_FastChgConnStsFb_P "swc_COL/COL_100ms_sys/COL_100ms_sys/BMS_FastChgConnStsFb_P" /begin REF_CHARACTERISTIC BMS_FastChgConnStsFb_P /end REF_CHARACTERISTIC /end GROUP
/begin GROUP S250_BMS_FastChgRelayFlt_P "swc_COL/COL_100ms_sys/COL_100ms_sys/BMS_FastChgRelayFlt_P" /begin REF_CHARACTERISTIC BMS_FastChgRelayFlt_P /end REF_CHARACTERISTIC /end GROUP
/begin GROUP S250_BMS_FaultLevel_P "swc_COL/COL_100ms_sys/COL_100ms_sys/BMS_FaultLevel_P" /begin REF_CHARACTERISTIC BMS_FaultLevel_P /end REF_CHARACTERISTIC /end GROUP
/begin GROUP S250_BMS_HeatingSatus_P "swc_COL/COL_100ms_sys/COL_100ms_sys/BMS_HeatingSatus_P" /begin REF_CHARACTERISTIC BMS_HeatingSatus_P /end REF_CHARACTERISTIC /end GROUP
/begin GROUP S250_BMS_HeatNegRelayFault_Reserved_P "swc_COL/COL_100ms_sys/COL_100ms_sys/BMS_HeatNegRelayFault_Reserved_P" /begin REF_CHARACTERISTIC BMS_HeatNegRelayFault_Reserved_P /end REF_CHARACTERISTIC /end GROUP
/begin GROUP S25_BPIU_UCellMaxLim_P "swc_BatProtnIU/CellUDiag/100ms/CellVoltageDiagnosis/CellVoltageOutOfRange/BPIU_UCellMaxLim_P" /begin REF_CHARACTERISTIC BPIU_UCellMaxLim_P /end REF_CHARACTERISTIC /end GROUP
/begin GROUP S281_BCF_RMdulWtngWithBaln_P "swc_BatCoreFct/BCF_100ms_sys/BatCoreFct/PackObs/PackObsLoop/MdulObs/MdulCObs/Sensitivity Of Estimation/BCF_RMdulWtngWithBaln_P" /begin REF_CHARACTERISTIC BCF_RMdulWtngWithBaln_P /end REF_CHARACTERISTIC /end GROUP
/begin GROUP S335_BPIU_TiOffDig140_P "swc_BatProtnIU/PackIDiag/Subsystem/SupplyVoltageDiagnosis/SelfCheck/BPIU_TiOffDig140_P" /begin REF_CHARACTERISTIC BPIU_TiOffDig140_P /end REF_CHARACTERISTIC /end GROUP
/begin GROUP S335_BPIU_TiSample1_P "swc_BatProtnIU/PackIDiag/Subsystem/SupplyVoltageDiagnosis/SelfCheck/BPIU_TiSample1_P" /begin REF_CHARACTERISTIC BPIU_TiSample1_P /end REF_CHARACTERISTIC /end GROUP
/begin GROUP S335_BPIU_USptMinLim_P "swc_BatProtnIU/PackIDiag/Subsystem/SupplyVoltageDiagnosis/SelfCheck/BPIU_USptMinLim_P" /begin REF_CHARACTERISTIC BPIU_USptMinLim_P /end REF_CHARACTERISTIC /end GROUP
/begin GROUP S335_BPIU_USptOffLim_P "swc_BatProtnIU/PackIDiag/Subsystem/SupplyVoltageDiagnosis/SelfCheck/BPIU_USptOffLim_P" /begin REF_CHARACTERISTIC BPIU_USptOffLim_P /end REF_CHARACTERISTIC /end GROUP
/begin GROUP S335_BPIU_USptOnLim_P "swc_BatProtnIU/PackIDiag/Subsystem/SupplyVoltageDiagnosis/SelfCheck/BPIU_USptOnLim_P" /begin REF_CHARACTERISTIC BPIU_USptOnLim_P /end REF_CHARACTERISTIC /end GROUP
/begin GROUP S336_BPIU_TiOffDig141_P "swc_BatProtnIU/PackIDiag/Subsystem/SupplyVoltageDiagnosis/SelfCheck1/BPIU_TiOffDig141_P" /begin REF_CHARACTERISTIC BPIU_TiOffDig141_P /end REF_CHARACTERISTIC /end GROUP
/begin GROUP S336_BPIU_TiSample1_P "swc_BatProtnIU/PackIDiag/Subsystem/SupplyVoltageDiagnosis/SelfCheck1/BPIU_TiSample1_P" /begin REF_CHARACTERISTIC BPIU_TiSample1_P /end REF_CHARACTERISTIC /end GROUP
/begin GROUP S336_BPIU_USptMaxLim_P "swc_BatProtnIU/PackIDiag/Subsystem/SupplyVoltageDiagnosis/SelfCheck1/BPIU_USptMaxLim_P" /begin REF_CHARACTERISTIC BPIU_USptMaxLim_P /end REF_CHARACTERISTIC /end GROUP
/begin GROUP S336_BPIU_USptOffLim_P "swc_BatProtnIU/PackIDiag/Subsystem/SupplyVoltageDiagnosis/SelfCheck1/BPIU_USptOffLim_P" /begin REF_CHARACTERISTIC BPIU_USptOffLim_P /end REF_CHARACTERISTIC /end GROUP
/begin GROUP S336_BPIU_USptOnLim_P "swc_BatProtnIU/PackIDiag/Subsystem/SupplyVoltageDiagnosis/SelfCheck1/BPIU_USptOnLim_P" /begin REF_CHARACTERISTIC BPIU_USptOnLim_P /end REF_CHARACTERISTIC /end GROUP
/begin GROUP S340_BCF_RMdulLamWithBaln_P "swc_BatCoreFct/BCF_100ms_sys/BatCoreFct/PackObs/PackObsLoop/MdulObs/MdulRObs/Sensitivity of Estimation/BCF_RMdulLamWithBaln_P" /begin REF_CHARACTERISTIC BCF_RMdulLamWithBaln_P /end REF_CHARACTERISTIC /end GROUP
/begin GROUP S340_BCF_RMdulLamWoutBaln_P "swc_BatCoreFct/BCF_100ms_sys/BatCoreFct/PackObs/PackObsLoop/MdulObs/MdulRObs/Sensitivity of Estimation/BCF_RMdulLamWoutBaln_P" /begin REF_CHARACTERISTIC BCF_RMdulLamWoutBaln_P /end REF_CHARACTERISTIC /end GROUP
/begin GROUP S340_BCF_RMdulWtngWithBaln_P "swc_BatCoreFct/BCF_100ms_sys/BatCoreFct/PackObs/PackObsLoop/MdulObs/MdulRObs/Sensitivity of Estimation/BCF_RMdulWtngWithBaln_P" /begin REF_CHARACTERISTIC BCF_RMdulWtngWithBaln_P /end REF_CHARACTERISTIC /end GROUP
/begin GROUP S415_BCF_UChOc_M "swc_BatCoreFct/BCF_100ms_sys/BatCoreFct/PackObs/PackObsLoop/MdulObs/MdulSocObsr/Evaluate Estimate/BCF_UChOc_M" /begin REF_CHARACTERISTIC BCF_UChOc_M /end REF_CHARACTERISTIC /end GROUP
/begin GROUP S415_BCF_UDchaOc_M "swc_BatCoreFct/BCF_100ms_sys/BatCoreFct/PackObs/PackObsLoop/MdulObs/MdulSocObsr/Evaluate Estimate/BCF_UDchaOc_M" /begin REF_CHARACTERISTIC BCF_UDchaOc_M /end REF_CHARACTERISTIC /end GROUP
/begin GROUP S449_BCF_UChOc_M "swc_BatCoreFct/BCF_100ms_sys/BatCoreFct/PackObs/PackObsLoop/MdulObs/MdulSocObsr/MdulStateObs/MdulModel/Measurement Equation hfun/BCF_UChOc_M" /begin REF_CHARACTERISTIC BCF_UChOc_M /end REF_CHARACTERISTIC /end GROUP
/begin GROUP S449_BCF_UDchaOc_M "swc_BatCoreFct/BCF_100ms_sys/BatCoreFct/PackObs/PackObsLoop/MdulObs/MdulSocObsr/MdulStateObs/MdulModel/Measurement Equation hfun/BCF_UDchaOc_M" /begin REF_CHARACTERISTIC BCF_UDchaOc_M /end REF_CHARACTERISTIC /end GROUP
/begin GROUP S622_BCF_UChOc_M "swc_BatCoreFct/BCF_100ms_sys/BatCoreFct/PackStateClcn/PackSofClcn/Pack Min Max Current Calculation (PwrLoss & U)/Pred Worst Cell Voltages and Power Losses/Predict average cell voltages/Predict Average Cell Voltages/Measurement Equation hfun/BCF_UChOc_M" /begin REF_CHARACTERISTIC BCF_UChOc_M /end REF_CHARACTERISTIC /end GROUP
/begin GROUP S622_BCF_UChOc_M1 "swc_BatCoreFct/BCF_100ms_sys/BatCoreFct/PackStateClcn/PackSofClcn/Pack Min Max Current Calculation (PwrLoss & U)/Pred Worst Cell Voltages and Power Losses/Predict average cell voltages/Predict Average Cell Voltages/Measurement Equation hfun/BCF_UChOc_M1" /begin REF_CHARACTERISTIC BCF_UChOc_M /end REF_CHARACTERISTIC /end GROUP
/begin GROUP S622_BCF_UChOc_M2 "swc_BatCoreFct/BCF_100ms_sys/BatCoreFct/PackStateClcn/PackSofClcn/Pack Min Max Current Calculation (PwrLoss & U)/Pred Worst Cell Voltages and Power Losses/Predict average cell voltages/Predict Average Cell Voltages/Measurement Equation hfun/BCF_UChOc_M2" /begin REF_CHARACTERISTIC BCF_UChOc_M /end REF_CHARACTERISTIC /end GROUP
/begin GROUP S622_BCF_UChOc_M3 "swc_BatCoreFct/BCF_100ms_sys/BatCoreFct/PackStateClcn/PackSofClcn/Pack Min Max Current Calculation (PwrLoss & U)/Pred Worst Cell Voltages and Power Losses/Predict average cell voltages/Predict Average Cell Voltages/Measurement Equation hfun/BCF_UChOc_M3" /begin REF_CHARACTERISTIC BCF_UChOc_M /end REF_CHARACTERISTIC /end GROUP
/begin GROUP S622_BCF_UDchaOc_M "swc_BatCoreFct/BCF_100ms_sys/BatCoreFct/PackStateClcn/PackSofClcn/Pack Min Max Current Calculation (PwrLoss & U)/Pred Worst Cell Voltages and Power Losses/Predict average cell voltages/Predict Average Cell Voltages/Measurement Equation hfun/BCF_UDchaOc_M" /begin REF_CHARACTERISTIC BCF_UDchaOc_M /end REF_CHARACTERISTIC /end GROUP
/begin GROUP S622_BCF_UDchaOc_M1 "swc_BatCoreFct/BCF_100ms_sys/BatCoreFct/PackStateClcn/PackSofClcn/Pack Min Max Current Calculation (PwrLoss & U)/Pred Worst Cell Voltages and Power Losses/Predict average cell voltages/Predict Average Cell Voltages/Measurement Equation hfun/BCF_UDchaOc_M1" /begin REF_CHARACTERISTIC BCF_UDchaOc_M /end REF_CHARACTERISTIC /end GROUP
/begin GROUP S622_BCF_UDchaOc_M2 "swc_BatCoreFct/BCF_100ms_sys/BatCoreFct/PackStateClcn/PackSofClcn/Pack Min Max Current Calculation (PwrLoss & U)/Pred Worst Cell Voltages and Power Losses/Predict average cell voltages/Predict Average Cell Voltages/Measurement Equation hfun/BCF_UDchaOc_M2" /begin REF_CHARACTERISTIC BCF_UDchaOc_M /end REF_CHARACTERISTIC /end GROUP
/begin GROUP S622_BCF_UDchaOc_M3 "swc_BatCoreFct/BCF_100ms_sys/BatCoreFct/PackStateClcn/PackSofClcn/Pack Min Max Current Calculation (PwrLoss & U)/Pred Worst Cell Voltages and Power Losses/Predict average cell voltages/Predict Average Cell Voltages/Measurement Equation hfun/BCF_UDchaOc_M3" /begin REF_CHARACTERISTIC BCF_UDchaOc_M /end REF_CHARACTERISTIC /end GROUP
/begin GROUP S701_BCF_UChOc_M "swc_BatCoreFct/BCF_100ms_sys/BatCoreFct/PackStateClcn/PackSofClcn/Pack Min Max Voltage Prediction/Module Min Max Voltage Prediction/SOF Actual/Measurement Equation hfun/BCF_UChOc_M" /begin REF_CHARACTERISTIC BCF_UChOc_M /end REF_CHARACTERISTIC /end GROUP
/begin GROUP S701_BCF_UDchaOc_M "swc_BatCoreFct/BCF_100ms_sys/BatCoreFct/PackStateClcn/PackSofClcn/Pack Min Max Voltage Prediction/Module Min Max Voltage Prediction/SOF Actual/Measurement Equation hfun/BCF_UDchaOc_M" /begin REF_CHARACTERISTIC BCF_UDchaOc_M /end REF_CHARACTERISTIC /end GROUP
/begin GROUP S718_BCF_UChOc_M "swc_BatCoreFct/BCF_100ms_sys/BatCoreFct/PackStateClcn/PackSofClcn/Pack Min Max Voltage Prediction/Module Min Max Voltage Prediction/SOF Pred/Measurement Equation hfun/BCF_UChOc_M" /begin REF_CHARACTERISTIC BCF_UChOc_M /end REF_CHARACTERISTIC /end GROUP
/begin GROUP S718_BCF_UDchaOc_M "swc_BatCoreFct/BCF_100ms_sys/BatCoreFct/PackStateClcn/PackSofClcn/Pack Min Max Voltage Prediction/Module Min Max Voltage Prediction/SOF Pred/Measurement Equation hfun/BCF_UDchaOc_M" /begin REF_CHARACTERISTIC BCF_UDchaOc_M /end REF_CHARACTERISTIC /end GROUP
/begin GROUP S83_CTC_TiProc_P "swc_CtctrTranCtl/CtcrtTranCtl_sys/CtcrtTranCtl/TiLoop/CTC_TiProc_P" /begin REF_CHARACTERISTIC CTC_TiProc_P /end REF_CHARACTERISTIC /end GROUP
/begin GROUP S84_CTC_TiProc_P "swc_CtctrTranCtl/CtcrtTranCtl_sys/CtcrtTranCtl/Time/CTC_TiProc_P" /begin REF_CHARACTERISTIC CTC_TiProc_P /end REF_CHARACTERISTIC /end GROUP
/begin GROUP S85_CTC_TiProc_P "swc_CtctrTranCtl/CtcrtTranCtl_sys/CtcrtTranCtl/TransitionCondition/CTC_TiProc_P" /begin REF_CHARACTERISTIC CTC_TiProc_P /end REF_CHARACTERISTIC /end GROUP
/begin RECORD_LAYOUT Lookup1D_UBYTE FNC_VALUES 1 UBYTE COLUMN_DIR DIRECT /end RECORD_LAYOUT
/begin RECORD_LAYOUT Lookup1D_X_FLOAT64_IEEE AXIS_PTS_X 1 FLOAT64_IEEE INDEX_INCR DIRECT /end RECORD_LAYOUT
/begin RECORD_LAYOUT Lookup1D_X_LONG AXIS_PTS_X 1 SLONG INDEX_INCR DIRECT /end RECORD_LAYOUT
/begin RECORD_LAYOUT Lookup1D_X_UBYTE AXIS_PTS_X 1 UBYTE INDEX_INCR DIRECT /end RECORD_LAYOUT
/begin RECORD_LAYOUT Lookup1D_X_UWORD AXIS_PTS_X 1 UWORD INDEX_INCR DIRECT /end RECORD_LAYOUT
/begin RECORD_LAYOUT Lookup1D_X_WORD AXIS_PTS_X 1 SWORD INDEX_INCR DIRECT /end RECORD_LAYOUT
/begin RECORD_LAYOUT Lookup2D_BOOLEAN FNC_VALUES 1 UBYTE COLUMN_DIR DIRECT /end RECORD_LAYOUT
/begin RECORD_LAYOUT Lookup2D_BYTE FNC_VALUES 1 SBYTE COLUMN_DIR DIRECT /end RECORD_LAYOUT
/begin RECORD_LAYOUT Lookup2D_FLOAT32_IEEE FNC_VALUES 1 FLOAT32_IEEE COLUMN_DIR DIRECT /end RECORD_LAYOUT
/begin RECORD_LAYOUT Lookup2D_FLOAT64_IEEE FNC_VALUES 1 FLOAT64_IEEE COLUMN_DIR DIRECT /end RECORD_LAYOUT
/begin RECORD_LAYOUT Lookup2D_LONG FNC_VALUES 1 SLONG COLUMN_DIR DIRECT /end RECORD_LAYOUT
/begin RECORD_LAYOUT Lookup2D_UBYTE FNC_VALUES 1 UBYTE COLUMN_DIR DIRECT /end RECORD_LAYOUT
/begin RECORD_LAYOUT Lookup2D_X_FLOAT32_IEEE AXIS_PTS_X 1 FLOAT32_IEEE INDEX_INCR DIRECT /end RECORD_LAYOUT
/begin RECORD_LAYOUT Scalar_BOOLEAN FNC_VALUES 1 UBYTE COLUMN_DIR DIRECT /end RECORD_LAYOUT
/begin RECORD_LAYOUT Scalar_FLOAT32_IEEE FNC_VALUES 1 FLOAT32_IEEE COLUMN_DIR DIRECT /end RECORD_LAYOUT
/begin RECORD_LAYOUT Scalar_SWORD FNC_VALUES 1 SWORD COLUMN_DIR DIRECT /end RECORD_LAYOUT
/begin RECORD_LAYOUT Scalar_UBYTE FNC_VALUES 1 UBYTE COLUMN_DIR DIRECT /end RECORD_LAYOUT
/begin RECORD_LAYOUT Scalar_ULONG FNC_VALUES 1 ULONG COLUMN_DIR DIRECT /end RECORD_LAYOUT
/begin RECORD_LAYOUT Scalar_UWORD FNC_VALUES 1 UWORD COLUMN_DIR DIRECT /end RECORD_LAYOUT
/end MODULE
/end PROJECT
