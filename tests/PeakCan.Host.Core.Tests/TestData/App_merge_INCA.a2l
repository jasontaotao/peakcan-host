ASAP2_VERSION 1 40
/begin PROJECT ProjectName "Project Comment Goes Here"
/begin HEADER "Header Comments go here" /end HEADER
/begin MODULE ModuleName "Module Comment Goes Here"
/begin MOD_COMMON "Mod Common Comment Here" BYTE_ORDER MSB_LAST ALIGNMENT_BYTE 1 ALIGNMENT_WORD 1 ALIGNMENT_LONG 1 ALIGNMENT_FLOAT32_IEEE 1 ALIGNMENT_FLOAT64_IEEE 1 /end MOD_COMMON
/begin COMPU_METHOD swc_BatProtnIU_CM_boolean_dash_ "Q = V" RAT_FUNC "%1.0" "-" COEFFS 0 1 0 0 0 1 /end COMPU_METHOD
/begin COMPU_METHOD swc_BatProtnIU_CM_single_A "Q = V" RAT_FUNC "%8.6" "A" COEFFS 0 1 0 0 0 1 /end COMPU_METHOD
/begin COMPU_METHOD swc_BatProtnIU_CM_single_V "Q = V" RAT_FUNC "%8.6" "V" COEFFS 0 1 0 0 0 1 /end COMPU_METHOD
/begin COMPU_METHOD swc_BatProtnIU_CM_uint16_dash_ "Q = V" RAT_FUNC "%5.0" "-" COEFFS 0 1 0 0 0 1 /end COMPU_METHOD
/begin COMPU_METHOD swc_BatProtnIU_CM_uint32_dash_ "Q = V" RAT_FUNC "%10.0" "-" COEFFS 0 1 0 0 0 1 /end COMPU_METHOD
/begin COMPU_METHOD swc_BatProtnIU_CM_uint8_dash_ "Q = V" RAT_FUNC "%3.0" "-" COEFFS 0 1 0 0 0 1 /end COMPU_METHOD
/begin COMPU_METHOD swc_BatThermHndlgMngt_CM_single__ "Q = V" RAT_FUNC "%8.6" "癈" COEFFS 0 1 0 0 0 1 /end COMPU_METHOD
/begin COMPU_METHOD swc_BatThermHndlgMngt_CM_single_degC "Q = V" RAT_FUNC "%8.6" "degC" COEFFS 0 1 0 0 0 1 /end COMPU_METHOD
/begin COMPU_METHOD swc_BatThermHndlgMngt_CM_single_l_per_min "Q = V" RAT_FUNC "%8.6" "l/min" COEFFS 0 1 0 0 0 1 /end COMPU_METHOD
/begin COMPU_METHOD swc_BatThermHndlgMngt_CM_uint16_dash_ "Q = V" RAT_FUNC "%5.0" "-" COEFFS 0 1 0 0 0 1 /end COMPU_METHOD
/begin COMPU_METHOD swc_BatThermHndlgMngt_CM_uint32_dash_ "Q = V" RAT_FUNC "%10.0" "-" COEFFS 0 1 0 0 0 1 /end COMPU_METHOD
/begin COMPU_METHOD swc_BatThermHndlgMngt_CM_uint8_dash_ "Q = V" RAT_FUNC "%3.0" "-" COEFFS 0 1 0 0 0 1 /end COMPU_METHOD
/begin COMPU_METHOD swc_BatWntyLogtcData_CM_single__ "Q = V" RAT_FUNC "%8.6" "癈" COEFFS 0 1 0 0 0 1 /end COMPU_METHOD
/begin COMPU_METHOD swc_BatWntyLogtcData_CM_single_A "Q = V" RAT_FUNC "%8.6" "A" COEFFS 0 1 0 0 0 1 /end COMPU_METHOD
/begin COMPU_METHOD swc_BatWntyLogtcData_CM_single_C_ "Q = V" RAT_FUNC "%8.6" "C&#xFFFD;" COEFFS 0 1 0 0 0 1 /end COMPU_METHOD
/begin COMPU_METHOD swc_BatWntyLogtcData_CM_single_dash_ "Q = V" RAT_FUNC "%8.6" "-" COEFFS 0 1 0 0 0 1 /end COMPU_METHOD
/begin COMPU_METHOD swc_BatWntyLogtcData_CM_single_kW "Q = V" RAT_FUNC "%8.6" "kW" COEFFS 0 1 0 0 0 1 /end COMPU_METHOD
/begin COMPU_METHOD swc_BatWntyLogtcData_CM_single_kWh "Q = V" RAT_FUNC "%8.6" "kWh" COEFFS 0 1 0 0 0 1 /end COMPU_METHOD
/begin COMPU_METHOD swc_BatWntyLogtcData_CM_single_V "Q = V" RAT_FUNC "%8.6" "V" COEFFS 0 1 0 0 0 1 /end COMPU_METHOD
/begin COMPU_METHOD swc_BatWntyLogtcData_CM_uint16_dash_ "Q = V" RAT_FUNC "%5.0" "-" COEFFS 0 1 0 0 0 1 /end COMPU_METHOD
/begin COMPU_METHOD swc_BatWntyLogtcData_CM_uint32_s "Q = V" RAT_FUNC "%10.0" "s" COEFFS 0 1 0 0 0 1 /end COMPU_METHOD
/begin COMPU_METHOD swc_BatWntyLogtcData_CM_uint8_dash_ "Q = V" RAT_FUNC "%3.0" "-" COEFFS 0 1 0 0 0 1 /end COMPU_METHOD
/begin COMPU_METHOD swc_BcuStTranCtl_CM_boolean_dash_ "Q = V" RAT_FUNC "%1.0" "-" COEFFS 0 1 0 0 0 1 /end COMPU_METHOD
/begin COMPU_METHOD swc_BcuStTranCtl_CM_single_s "Q = V" RAT_FUNC "%8.6" "s" COEFFS 0 1 0 0 0 1 /end COMPU_METHOD
/begin COMPU_METHOD swc_BcuStTranCtl_CM_uint16_year "Q = V" RAT_FUNC "%5.0" "year" COEFFS 0 1 0 0 0 1 /end COMPU_METHOD
/begin COMPU_METHOD swc_BcuStTranCtl_CM_uint32_dash_ "Q = V" RAT_FUNC "%10.0" "-" COEFFS 0 1 0 0 0 1 /end COMPU_METHOD
/begin COMPU_METHOD swc_BcuStTranCtl_CM_uint32_s "Q = V" RAT_FUNC "%10.0" "s" COEFFS 0 1 0 0 0 1 /end COMPU_METHOD
/begin COMPU_METHOD swc_BcuStTranCtl_CM_uint8_dash_ "Q = V" RAT_FUNC "%3.0" "-" COEFFS 0 1 0 0 0 1 /end COMPU_METHOD
/begin COMPU_METHOD swc_BcuStTranCtl_CM_uint8_day "Q = V" RAT_FUNC "%3.0" "day" COEFFS 0 1 0 0 0 1 /end COMPU_METHOD
/begin COMPU_METHOD swc_BcuStTranCtl_CM_uint8_h "Q = V" RAT_FUNC "%3.0" "h" COEFFS 0 1 0 0 0 1 /end COMPU_METHOD
/begin COMPU_METHOD swc_BcuStTranCtl_CM_uint8_min "Q = V" RAT_FUNC "%3.0" "min" COEFFS 0 1 0 0 0 1 /end COMPU_METHOD
/begin COMPU_METHOD swc_BcuStTranCtl_CM_uint8_month "Q = V" RAT_FUNC "%3.0" "month" COEFFS 0 1 0 0 0 1 /end COMPU_METHOD
/begin COMPU_METHOD swc_BcuStTranCtl_CM_uint8_s "Q = V" RAT_FUNC "%3.0" "s" COEFFS 0 1 0 0 0 1 /end COMPU_METHOD
/begin COMPU_METHOD swc_CIL_CM_boolean_dash_ "Q = V" RAT_FUNC "%1.0" "-" COEFFS 0 1 0 0 0 1 /end COMPU_METHOD
/begin COMPU_METHOD swc_CIL_CM_int16__ "Q = V" RAT_FUNC "%5.0" "癈" COEFFS 0 1 0 0 0 1 /end COMPU_METHOD
/begin COMPU_METHOD swc_CIL_CM_int32_kOhm "Q = V" RAT_FUNC "%10.0" "kOhm" COEFFS 0 1 0 0 0 1 /end COMPU_METHOD
/begin COMPU_METHOD swc_CIL_CM_single__ "Q = V" RAT_FUNC "%8.6" "癈" COEFFS 0 1 0 0 0 1 /end COMPU_METHOD
/begin COMPU_METHOD swc_CIL_CM_single_A "Q = V" RAT_FUNC "%8.6" "A" COEFFS 0 1 0 0 0 1 /end COMPU_METHOD
/begin COMPU_METHOD swc_CIL_CM_single_dash_ "Q = V" RAT_FUNC "%8.6" "-" COEFFS 0 1 0 0 0 1 /end COMPU_METHOD
/begin COMPU_METHOD swc_CIL_CM_single_km "Q = V" RAT_FUNC "%8.6" "km" COEFFS 0 1 0 0 0 1 /end COMPU_METHOD
/begin COMPU_METHOD swc_CIL_CM_single_km_per_h "Q = V" RAT_FUNC "%8.6" "km/h" COEFFS 0 1 0 0 0 1 /end COMPU_METHOD
/begin COMPU_METHOD swc_CIL_CM_single_kW "Q = V" RAT_FUNC "%8.6" "kW" COEFFS 0 1 0 0 0 1 /end COMPU_METHOD
/begin COMPU_METHOD swc_CIL_CM_single_kWh "Q = V" RAT_FUNC "%8.6" "kWh" COEFFS 0 1 0 0 0 1 /end COMPU_METHOD
/begin COMPU_METHOD swc_CIL_CM_single_rpm "Q = V" RAT_FUNC "%8.6" "rpm" COEFFS 0 1 0 0 0 1 /end COMPU_METHOD
/begin COMPU_METHOD swc_CIL_CM_single_V "Q = V" RAT_FUNC "%8.6" "V" COEFFS 0 1 0 0 0 1 /end COMPU_METHOD
/begin COMPU_METHOD swc_CIL_CM_uint16_dash_ "Q = V" RAT_FUNC "%5.0" "-" COEFFS 0 1 0 0 0 1 /end COMPU_METHOD
/begin COMPU_METHOD swc_CIL_CM_uint16_min "Q = V" RAT_FUNC "%5.0" "min" COEFFS 0 1 0 0 0 1 /end COMPU_METHOD
/begin COMPU_METHOD swc_CIL_CM_uint16_year "Q = V" RAT_FUNC "%5.0" "year" COEFFS 0 1 0 0 0 1 /end COMPU_METHOD
/begin COMPU_METHOD swc_CIL_CM_uint32_dash_ "Q = V" RAT_FUNC "%10.0" "-" COEFFS 0 1 0 0 0 1 /end COMPU_METHOD
/begin COMPU_METHOD swc_CIL_CM_uint32_Hz "Q = V" RAT_FUNC "%10.0" "Hz" COEFFS 0 1 0 0 0 1 /end COMPU_METHOD
/begin COMPU_METHOD swc_CIL_CM_uint32_ms "Q = V" RAT_FUNC "%10.0" "ms" COEFFS 0 1 0 0 0 1 /end COMPU_METHOD
/begin COMPU_METHOD swc_CIL_CM_uint32_percent_ "Q = V" RAT_FUNC "%10.0" "%" COEFFS 0 1 0 0 0 1 /end COMPU_METHOD
/begin COMPU_METHOD swc_CIL_CM_uint8_A "Q = V" RAT_FUNC "%3.0" "A" COEFFS 0 1 0 0 0 1 /end COMPU_METHOD
/begin COMPU_METHOD swc_CIL_CM_uint8_dash_ "Q = V" RAT_FUNC "%3.0" "-" COEFFS 0 1 0 0 0 1 /end COMPU_METHOD
/begin COMPU_METHOD swc_CIL_CM_uint8_day "Q = V" RAT_FUNC "%3.0" "day" COEFFS 0 1 0 0 0 1 /end COMPU_METHOD
/begin COMPU_METHOD swc_CIL_CM_uint8_h "Q = V" RAT_FUNC "%3.0" "h" COEFFS 0 1 0 0 0 1 /end COMPU_METHOD
/begin COMPU_METHOD swc_CIL_CM_uint8_min "Q = V" RAT_FUNC "%3.0" "min" COEFFS 0 1 0 0 0 1 /end COMPU_METHOD
/begin COMPU_METHOD swc_CIL_CM_uint8_month "Q = V" RAT_FUNC "%3.0" "month" COEFFS 0 1 0 0 0 1 /end COMPU_METHOD
/begin COMPU_METHOD swc_CIL_CM_uint8_percent_ "Q = V" RAT_FUNC "%3.0" "%" COEFFS 0 1 0 0 0 1 /end COMPU_METHOD
/begin COMPU_METHOD swc_CIL_CM_uint8_s "Q = V" RAT_FUNC "%3.0" "s" COEFFS 0 1 0 0 0 1 /end COMPU_METHOD
/begin COMPU_METHOD swc_COL_CM_uint16_A "Q = V" RAT_FUNC "%5.0" "A" COEFFS 0 1 0 0 0 1 /end COMPU_METHOD
/begin COMPU_METHOD swc_COL_CM_uint16_Ah "Q = V" RAT_FUNC "%5.0" "Ah" COEFFS 0 1 0 0 0 1 /end COMPU_METHOD
/begin COMPU_METHOD swc_COL_CM_uint16_dash_ "Q = V" RAT_FUNC "%5.0" "-" COEFFS 0 1 0 0 0 1 /end COMPU_METHOD
/begin COMPU_METHOD swc_COL_CM_uint16_km "Q = V" RAT_FUNC "%5.0" "km" COEFFS 0 1 0 0 0 1 /end COMPU_METHOD
/begin COMPU_METHOD swc_COL_CM_uint16_kOhm "Q = V" RAT_FUNC "%5.0" "kOhm" COEFFS 0 1 0 0 0 1 /end COMPU_METHOD
/begin COMPU_METHOD swc_COL_CM_uint16_kW "Q = V" RAT_FUNC "%5.0" "kW" COEFFS 0 1 0 0 0 1 /end COMPU_METHOD
/begin COMPU_METHOD swc_COL_CM_uint16_kWh "Q = V" RAT_FUNC "%5.0" "kWh" COEFFS 0 1 0 0 0 1 /end COMPU_METHOD
/begin COMPU_METHOD swc_COL_CM_uint16_min "Q = V" RAT_FUNC "%5.0" "min" COEFFS 0 1 0 0 0 1 /end COMPU_METHOD
/begin COMPU_METHOD swc_COL_CM_uint16_percent_ "Q = V" RAT_FUNC "%5.0" "%" COEFFS 0 1 0 0 0 1 /end COMPU_METHOD
/begin COMPU_METHOD swc_COL_CM_uint16_V "Q = V" RAT_FUNC "%5.0" "V" COEFFS 0 1 0 0 0 1 /end COMPU_METHOD
/begin COMPU_METHOD swc_COL_CM_uint32_Ah "Q = V" RAT_FUNC "%10.0" "Ah" COEFFS 0 1 0 0 0 1 /end COMPU_METHOD
/begin COMPU_METHOD swc_COL_CM_uint32_dash_ "Q = V" RAT_FUNC "%10.0" "-" COEFFS 0 1 0 0 0 1 /end COMPU_METHOD
/begin COMPU_METHOD swc_COL_CM_uint32_V "Q = V" RAT_FUNC "%10.0" "V" COEFFS 0 1 0 0 0 1 /end COMPU_METHOD
/begin COMPU_METHOD swc_COL_CM_uint8___C "Q = V" RAT_FUNC "%3.0" "??C" COEFFS 0 1 0 0 0 1 /end COMPU_METHOD
/begin COMPU_METHOD swc_COL_CM_uint8_A "Q = V" RAT_FUNC "%3.0" "A" COEFFS 0 1 0 0 0 1 /end COMPU_METHOD
/begin COMPU_METHOD swc_COL_CM_uint8_dash_ "Q = V" RAT_FUNC "%3.0" "-" COEFFS 0 1 0 0 0 1 /end COMPU_METHOD
/begin COMPU_METHOD swc_COL_CM_uint8_day "Q = V" RAT_FUNC "%3.0" "day" COEFFS 0 1 0 0 0 1 /end COMPU_METHOD
/begin COMPU_METHOD swc_COL_CM_uint8_month "Q = V" RAT_FUNC "%3.0" "month" COEFFS 0 1 0 0 0 1 /end COMPU_METHOD
/begin COMPU_METHOD swc_COL_CM_uint8_percent_ "Q = V" RAT_FUNC "%3.0" "%" COEFFS 0 1 0 0 0 1 /end COMPU_METHOD
/begin COMPU_METHOD swc_COL_CM_uint8_year "Q = V" RAT_FUNC "%3.0" "year" COEFFS 0 1 0 0 0 1 /end COMPU_METHOD
/begin COMPU_METHOD swc_CtctrTranCtl_CM_boolean_dash_ "Q = V" RAT_FUNC "%1.0" "-" COEFFS 0 1 0 0 0 1 /end COMPU_METHOD
/begin COMPU_METHOD swc_CtctrTranCtl_CM_single_A "Q = V" RAT_FUNC "%8.6" "A" COEFFS 0 1 0 0 0 1 /end COMPU_METHOD
/begin COMPU_METHOD swc_CtctrTranCtl_CM_single_dash_ "Q = V" RAT_FUNC "%8.6" "-" COEFFS 0 1 0 0 0 1 /end COMPU_METHOD
/begin COMPU_METHOD swc_CtctrTranCtl_CM_single_V "Q = V" RAT_FUNC "%8.6" "V" COEFFS 0 1 0 0 0 1 /end COMPU_METHOD
/begin COMPU_METHOD swc_CtctrTranCtl_CM_uint16_dash_ "Q = V" RAT_FUNC "%5.0" "-" COEFFS 0 1 0 0 0 1 /end COMPU_METHOD
/begin COMPU_METHOD swc_CtctrTranCtl_CM_uint32_dash_ "Q = V" RAT_FUNC "%10.0" "-" COEFFS 0 1 0 0 0 1 /end COMPU_METHOD
/begin COMPU_METHOD swc_CtctrTranCtl_CM_uint8_dash_ "Q = V" RAT_FUNC "%3.0" "-" COEFFS 0 1 0 0 0 1 /end COMPU_METHOD
/begin COMPU_METHOD swc_DiagcEveHndlg_CM_boolean_dash_ "Q = V" RAT_FUNC "%1.0" "-" COEFFS 0 1 0 0 0 1 /end COMPU_METHOD
/begin COMPU_METHOD swc_DiagcEveHndlg_CM_single__ "Q = V" RAT_FUNC "%8.6" "癈" COEFFS 0 1 0 0 0 1 /end COMPU_METHOD
/begin COMPU_METHOD swc_DiagcEveHndlg_CM_single_A "Q = V" RAT_FUNC "%8.6" "A" COEFFS 0 1 0 0 0 1 /end COMPU_METHOD
/begin COMPU_METHOD swc_DiagcEveHndlg_CM_single_dash_ "Q = V" RAT_FUNC "%8.6" "-" COEFFS 0 1 0 0 0 1 /end COMPU_METHOD
/begin COMPU_METHOD swc_DiagcEveHndlg_CM_single_kOhm "Q = V" RAT_FUNC "%8.6" "kOhm" COEFFS 0 1 0 0 0 1 /end COMPU_METHOD
/begin COMPU_METHOD swc_DiagcEveHndlg_CM_single_kW "Q = V" RAT_FUNC "%8.6" "kW" COEFFS 0 1 0 0 0 1 /end COMPU_METHOD
/begin COMPU_METHOD swc_DiagcEveHndlg_CM_single_kWh "Q = V" RAT_FUNC "%8.6" "kWh" COEFFS 0 1 0 0 0 1 /end COMPU_METHOD
/begin COMPU_METHOD swc_DiagcEveHndlg_CM_single_V "Q = V" RAT_FUNC "%8.6" "V" COEFFS 0 1 0 0 0 1 /end COMPU_METHOD
/begin COMPU_METHOD swc_DiagcEveHndlg_CM_uint16_dash_ "Q = V" RAT_FUNC "%5.0" "-" COEFFS 0 1 0 0 0 1 /end COMPU_METHOD
/begin COMPU_METHOD swc_DiagcEveHndlg_CM_uint16_year "Q = V" RAT_FUNC "%5.0" "year" COEFFS 0 1 0 0 0 1 /end COMPU_METHOD
/begin COMPU_METHOD swc_DiagcEveHndlg_CM_uint32_dash_ "Q = V" RAT_FUNC "%10.0" "-" COEFFS 0 1 0 0 0 1 /end COMPU_METHOD
/begin COMPU_METHOD swc_DiagcEveHndlg_CM_uint32_s "Q = V" RAT_FUNC "%10.0" "s" COEFFS 0 1 0 0 0 1 /end COMPU_METHOD
/begin COMPU_METHOD swc_DiagcEveHndlg_CM_uint8_dash_ "Q = V" RAT_FUNC "%3.0" "-" COEFFS 0 1 0 0 0 1 /end COMPU_METHOD
/begin COMPU_METHOD swc_DiagcEveHndlg_CM_uint8_day "Q = V" RAT_FUNC "%3.0" "day" COEFFS 0 1 0 0 0 1 /end COMPU_METHOD
/begin COMPU_METHOD swc_DiagcEveHndlg_CM_uint8_h "Q = V" RAT_FUNC "%3.0" "h" COEFFS 0 1 0 0 0 1 /end COMPU_METHOD
/begin COMPU_METHOD swc_DiagcEveHndlg_CM_uint8_min "Q = V" RAT_FUNC "%3.0" "min" COEFFS 0 1 0 0 0 1 /end COMPU_METHOD
/begin COMPU_METHOD swc_DiagcEveHndlg_CM_uint8_month "Q = V" RAT_FUNC "%3.0" "month" COEFFS 0 1 0 0 0 1 /end COMPU_METHOD
/begin COMPU_METHOD swc_DiagcEveHndlg_CM_uint8_s "Q = V" RAT_FUNC "%3.0" "s" COEFFS 0 1 0 0 0 1 /end COMPU_METHOD
/begin COMPU_METHOD swc_EltlLnkHzrdProtnNet_CM_boolean_dash_ "Q = V" RAT_FUNC "%1.0" "-" COEFFS 0 1 0 0 0 1 /end COMPU_METHOD
/begin COMPU_METHOD swc_EltlLnkHzrdProtnNet_CM_single_kOhm "Q = V" RAT_FUNC "%8.6" "kOhm" COEFFS 0 1 0 0 0 1 /end COMPU_METHOD
/begin COMPU_METHOD swc_EltlLnkHzrdProtnNet_CM_uint16_dash_ "Q = V" RAT_FUNC "%5.0" "-" COEFFS 0 1 0 0 0 1 /end COMPU_METHOD
/begin COMPU_METHOD swc_EltlLnkHzrdProtnNet_CM_uint8_dash_ "Q = V" RAT_FUNC "%3.0" "-" COEFFS 0 1 0 0 0 1 /end COMPU_METHOD
/begin MEASUREMENT B2V_ST1_ChgMode "Charging mode (0x0: Reserved\n      0x1: DC charging\n      0x2: AC charging\n      0x3: Other charging)" UBYTE swc_COL_CM_uint8_dash_ 0 0 0 255 ECU_ADDRESS 0x1FFE7608 /end MEASUREMENT
/begin MEASUREMENT B2V_SingleChgEnergy "Single charge charge (when the charger is online)" ULONG swc_COL_CM_uint32_dash_ 0 0 0 65535 ECU_ADDRESS 0x1FFE60E8 /end MEASUREMENT
/begin MEASUREMENT BCPP_Max_Allow_DCCur "Maximum permissible discharge current" UWORD swc_COL_CM_uint16_A 0 0 0 65535 ECU_ADDRESS 0x1FFE74B2 /end MEASUREMENT
/begin MEASUREMENT BCPP_Max_Allow_DCV "Minimum allowable total discharge voltage" UWORD swc_COL_CM_uint16_V 0 0 0 65535 ECU_ADDRESS 0x1FFE74B4 /end MEASUREMENT
/begin MEASUREMENT BCPP_Min_Allow_CellV "Minimum allowable cell voltage" UWORD swc_COL_CM_uint16_V 0 0 0 65535 ECU_ADDRESS 0x1FFE74B6 /end MEASUREMENT
/begin MEASUREMENT BCPP_Min_Allow_Soc "Minimum allowable state of charge for power batteries" UBYTE swc_COL_CM_uint8_percent_ 0 0 0 255 ECU_ADDRESS 0x1FFE7609 /end MEASUREMENT
/begin MEASUREMENT BCSP_Remaining_discharge_time "Estimate the remaining discharge time" UWORD swc_COL_CM_uint16_min 0 0 0 65535 ECU_ADDRESS 0x1FFE74B8 /end MEASUREMENT
/begin MEASUREMENT BCSP_Remaining_range "Remaining range" UWORD swc_COL_CM_uint16_km 0 0 0 65535 ECU_ADDRESS 0x1FFE74BA /end MEASUREMENT
/begin MEASUREMENT BCSP_reserved "retain" ULONG swc_COL_CM_uint32_dash_ 0 0 0 4294967295 ECU_ADDRESS 0x1FFE60EC /end MEASUREMENT
/begin MEASUREMENT BDC_Battery_capacity "The total capacity of the current power battery system of the whole vehicle" UWORD swc_COL_CM_uint16_Ah 0 0 0 65535 ECU_ADDRESS 0x1FFE74BC /end MEASUREMENT
/begin MEASUREMENT BDC_Battery_energy "The total energy of the current power battery system of the whole vehicle" UWORD swc_COL_CM_uint16_kW 0 0 0 65535 ECU_ADDRESS 0x1FFE74BE /end MEASUREMENT
/begin MEASUREMENT BDC_Current_V2GCirculate "Number of cycles to participate in V2G" UWORD swc_COL_CM_uint16_dash_ 0 0 0 65535 ECU_ADDRESS 0x1FFE74C0 /end MEASUREMENT
/begin MEASUREMENT BDC_Remainder_CruisingRange "Remaining range" UWORD swc_COL_CM_uint16_km 0 0 0 65535 ECU_ADDRESS 0x1FFE74C2 /end MEASUREMENT
/begin MEASUREMENT BDC_Remainder_V2GCirculate "The number of cycles remaining for V2G" UWORD swc_COL_CM_uint16_dash_ 0 0 0 65535 ECU_ADDRESS 0x1FFE74C4 /end MEASUREMENT
/begin MEASUREMENT BDC_Soc "The current state of charge of the power battery of the whole vehicle" UBYTE swc_COL_CM_uint8_dash_ 0 0 0 255 ECU_ADDRESS 0x1FFE760A /end MEASUREMENT
/begin MEASUREMENT BDC_Vin1_Copy_1 "Required, missing" UBYTE swc_COL_CM_uint8_dash_ 0 0 0 255 ECU_ADDRESS 0x1FFE760B /end MEASUREMENT
/begin MEASUREMENT BDC_Vin1_Copy_10 "Required, missing" UBYTE swc_COL_CM_uint8_dash_ 0 0 0 255 ECU_ADDRESS 0x1FFE760C /end MEASUREMENT
/begin MEASUREMENT BDC_Vin1_Copy_11 "Required, missing" UBYTE swc_COL_CM_uint8_dash_ 0 0 0 255 ECU_ADDRESS 0x1FFE760D /end MEASUREMENT
/begin MEASUREMENT BDC_Vin1_Copy_12 "Required, missing" UBYTE swc_COL_CM_uint8_dash_ 0 0 0 255 ECU_ADDRESS 0x1FFE760E /end MEASUREMENT
/begin MEASUREMENT BDC_Vin1_Copy_13 "Required, missing" UBYTE swc_COL_CM_uint8_dash_ 0 0 0 255 ECU_ADDRESS 0x1FFE760F /end MEASUREMENT
/begin MEASUREMENT BDC_Vin1_Copy_14 "Required, missing" UBYTE swc_COL_CM_uint8_dash_ 0 0 0 255 ECU_ADDRESS 0x1FFE7610 /end MEASUREMENT
/begin MEASUREMENT BDC_Vin1_Copy_15 "Required, missing" UBYTE swc_COL_CM_uint8_dash_ 0 0 0 255 ECU_ADDRESS 0x1FFE7611 /end MEASUREMENT
/begin MEASUREMENT BDC_Vin1_Copy_16 "Required, missing" UBYTE swc_COL_CM_uint8_dash_ 0 0 0 255 ECU_ADDRESS 0x1FFE7612 /end MEASUREMENT
/begin MEASUREMENT BDC_Vin1_Copy_17 "Required, missing" UBYTE swc_COL_CM_uint8_dash_ 0 0 0 255 ECU_ADDRESS 0x1FFE7613 /end MEASUREMENT
/begin MEASUREMENT BDC_Vin1_Copy_2 "Required, missing" UBYTE swc_COL_CM_uint8_dash_ 0 0 0 255 ECU_ADDRESS 0x1FFE7614 /end MEASUREMENT
/begin MEASUREMENT BDC_Vin1_Copy_3 "Required, missing" UBYTE swc_COL_CM_uint8_dash_ 0 0 0 255 ECU_ADDRESS 0x1FFE7615 /end MEASUREMENT
/begin MEASUREMENT BDC_Vin1_Copy_4 "Required, missing" UBYTE swc_COL_CM_uint8_dash_ 0 0 0 255 ECU_ADDRESS 0x1FFE7616 /end MEASUREMENT
/begin MEASUREMENT BDC_Vin1_Copy_5 "Required, missing" UBYTE swc_COL_CM_uint8_dash_ 0 0 0 255 ECU_ADDRESS 0x1FFE7617 /end MEASUREMENT
/begin MEASUREMENT BDC_Vin1_Copy_6 "Required, missing" UBYTE swc_COL_CM_uint8_dash_ 0 0 0 255 ECU_ADDRESS 0x1FFE7618 /end MEASUREMENT
/begin MEASUREMENT BDC_Vin1_Copy_7 "Required, missing" UBYTE swc_COL_CM_uint8_dash_ 0 0 0 255 ECU_ADDRESS 0x1FFE7619 /end MEASUREMENT
/begin MEASUREMENT BDC_Vin1_Copy_8 "Required, missing" UBYTE swc_COL_CM_uint8_dash_ 0 0 0 255 ECU_ADDRESS 0x1FFE761A /end MEASUREMENT
/begin MEASUREMENT BDC_Vin1_Copy_9 "Required, missing" UBYTE swc_COL_CM_uint8_dash_ 0 0 0 255 ECU_ADDRESS 0x1FFE761B /end MEASUREMENT
/begin MEASUREMENT BMC_UCell "Cell Voltages of Battery Pack " FLOAT32_IEEE swc_CIL_CM_single_V 0 0 0 5 ECU_ADDRESS 0x1FFE59A0 MATRIX_DIM 255 1 1 /end MEASUREMENT
/begin MEASUREMENT BMS_ActWorkSts "BMS actual work states (0x0: Reserved 0x1: Initial 0x2: Standby 0x3: Discharging 0x4: Charging 0x5: Shutdown_HV 0x6: After run 0xF: Invalid)" UBYTE swc_COL_CM_uint8_dash_ 0 0 0 255 ECU_ADDRESS 0x1FFE761C /end MEASUREMENT
/begin MEASUREMENT BMS_BBMSensorCurr "bodywork sensor current,Send default values (0xFF: Invalid)" UBYTE swc_COL_CM_uint8_dash_ 0 0 0 255 ECU_ADDRESS 0x1FFE761D /end MEASUREMENT
/begin MEASUREMENT BMS_BMSStopChgErrReason "BMS aborts charging failure cause" UWORD swc_COL_CM_uint16_dash_ 0 0 0 65535 ECU_ADDRESS 0x1FFE74C6 /end MEASUREMENT
/begin MEASUREMENT BMS_BMSStopChgFltReason "BMS abort charging error cause" UBYTE swc_COL_CM_uint8_dash_ 0 0 0 255 ECU_ADDRESS 0x1FFE761E /end MEASUREMENT
/begin MEASUREMENT BMS_BMSStopChgReason "The reason why the BMS stops charging" UBYTE swc_COL_CM_uint8_dash_ 0 0 0 255 ECU_ADDRESS 0x1FFE761F /end MEASUREMENT
/begin MEASUREMENT BMS_BattCellVolFault "Battery cell voltage failure (0x0: No error\n      0x1: Cell Voltage too low\n      0x2: Cell Voltage too high\n      0x3: Reserved)" UBYTE swc_COL_CM_uint8_dash_ 0 0 0 255 ECU_ADDRESS 0x1FFE7620 /end MEASUREMENT
/begin MEASUREMENT BMS_BattCellsNum "Total number of cell cells" UWORD swc_COL_CM_uint16_dash_ 0 0 0 65535 ECU_ADDRESS 0x1FFE74C8 /end MEASUREMENT
/begin MEASUREMENT BMS_BattConsistencyFlt "Cell consistency fault condition (0x0: No error\n      0x1: Error\n      0x2: Reserved\n      0x3: Invalid)" UBYTE swc_COL_CM_uint8_dash_ 0 0 0 255 ECU_ADDRESS 0x1FFE7621 /end MEASUREMENT
/begin MEASUREMENT BMS_BattCurr "Power battery pack current (0xFFFF: Invalid)" UWORD swc_COL_CM_uint16_dash_ 0 0 0 65535 ECU_ADDRESS 0x1FFE74CA /end MEASUREMENT
/begin MEASUREMENT BMS_BattEqualizationSts "BMS battery equalization status (0x0: Inactive\n      0x1: Active\n      0x2: Reserved\n      0x3: Invalid)" UBYTE swc_COL_CM_uint8_dash_ 0 0 0 255 ECU_ADDRESS 0x1FFE7622 /end MEASUREMENT
/begin MEASUREMENT BMS_BattIsolationSts "Vehicle insulation status (0x0: Isolation is ok\n      0x1: Isolation fault\n      0x2: Reserved\n      0x3: Invalid)" UBYTE swc_COL_CM_uint8_dash_ 0 0 0 255 ECU_ADDRESS 0x1FFE7623 /end MEASUREMENT
/begin MEASUREMENT BMS_BattManuCode "Battery manufacturers (0x0: Not send Manafactorer code, 0x1: EVE, 0x2: CATL, 0x3: AVIC Lithium, 0x4: NGV, 0x5: camel, 0x6: Qianjiang lithium battery, 0x7: Suzhou Veri, 0x8:  New Taihang, 0x9: Sunwoda etc.)" UBYTE swc_COL_CM_uint8_dash_ 0 0 0 255 ECU_ADDRESS 0x1FFE7624 /end MEASUREMENT
/begin MEASUREMENT BMS_BattManufDay "Battery pack production date: day" UBYTE swc_COL_CM_uint8_day 0 0 0 255 ECU_ADDRESS 0x1FFE7625 /end MEASUREMENT
/begin MEASUREMENT BMS_BattManufMonth "Battery pack production date: months" UBYTE swc_COL_CM_uint8_month 0 0 0 255 ECU_ADDRESS 0x1FFE7626 /end MEASUREMENT
/begin MEASUREMENT BMS_BattManufYear "Date of manufacture of the battery pack: year " UBYTE swc_COL_CM_uint8_year 0 0 0 255 ECU_ADDRESS 0x1FFE7627 /end MEASUREMENT
/begin MEASUREMENT BMS_BattMaxTemp1 "The maximum temperature of the power battery (0xFF: Invalid)" UBYTE swc_COL_CM_uint8_dash_ 0 0 0 255 ECU_ADDRESS 0x1FFE7628 /end MEASUREMENT
/begin MEASUREMENT BMS_BattMaxWorkTemp "The power battery is allowed to operate at the maximum temperature (0xFF: Invalid)" UBYTE swc_COL_CM_uint8___C 0 0 0 255 ECU_ADDRESS 0x1FFE7629 /end MEASUREMENT
/begin MEASUREMENT BMS_BattMinTemp1 "The minimum temperature of the power battery (0xFF: Invalid)" UBYTE swc_COL_CM_uint8_dash_ 0 0 0 255 ECU_ADDRESS 0x1FFE762A /end MEASUREMENT
/begin MEASUREMENT BMS_BattMinWorkTemp "The power battery is allowed to operate at the lowest temperature (0xFF: Invalid)" UBYTE swc_COL_CM_uint8___C 0 0 0 255 ECU_ADDRESS 0x1FFE762B /end MEASUREMENT
/begin MEASUREMENT BMS_BattPACKSerNum "Battery pack serial number" UWORD swc_COL_CM_uint16_dash_ 0 0 0 65535 ECU_ADDRESS 0x1FFE74CC /end MEASUREMENT
/begin MEASUREMENT BMS_BattPackInCoolTemp "Battery pack inlet temperature " UBYTE swc_COL_CM_uint8___C 0 0 0 255 ECU_ADDRESS 0x1FFE762C /end MEASUREMENT
/begin MEASUREMENT BMS_BattPackMatchFault "The battery pack matches the fault state (0x0: No error\n      0x1: Error\n      0x2: Reserved\n      0x3: Invalid)" UBYTE swc_COL_CM_uint8_dash_ 0 0 0 255 ECU_ADDRESS 0x1FFE762D /end MEASUREMENT
/begin MEASUREMENT BMS_BattPackNum "Total number of battery boxes" UBYTE swc_COL_CM_uint8_dash_ 0 0 0 255 ECU_ADDRESS 0x1FFE762E /end MEASUREMENT
/begin MEASUREMENT BMS_BattPackOutCoolTemp "Battery pack outlet temperature" UBYTE swc_COL_CM_uint8___C 0 0 0 255 ECU_ADDRESS 0x1FFE762F /end MEASUREMENT
/begin MEASUREMENT BMS_BattPackRemainEgy "High voltage battery pack residual energy" UWORD swc_COL_CM_uint16_kWh 0 0 0 65535 ECU_ADDRESS 0x1FFE74CE /end MEASUREMENT
/begin MEASUREMENT BMS_BattPackVolFault "Total battery voltage failure (0x0: No error\n      0x1: Voltage too low\n      0x2: Voltage too high\n      0x3: Invalid)" UBYTE swc_COL_CM_uint8_dash_ 0 0 0 255 ECU_ADDRESS 0x1FFE7630 /end MEASUREMENT
/begin MEASUREMENT BMS_BattRateCapacity "Rated capacity of power battery (0x3FFFF: Invalid)" ULONG swc_COL_CM_uint32_Ah 0 0 0 4294967295 ECU_ADDRESS 0x1FFE60F0 /end MEASUREMENT
/begin MEASUREMENT BMS_BattRateVol "The rated total voltage of the power battery (0x3FFFF: Invalid)" ULONG swc_COL_CM_uint32_V 0 0 0 4294967295 ECU_ADDRESS 0x1FFE60F4 /end MEASUREMENT
/begin MEASUREMENT BMS_BattSOC "Battery pack SOC (0xFF: Signal Invalid)" UBYTE swc_COL_CM_uint8_percent_ 0 0 0 255 ECU_ADDRESS 0x1FFE7631 /end MEASUREMENT
/begin MEASUREMENT BMS_BattSOCFault "Battery SOC abnormality (0x0: No error\n      0x1: SOC too low\n      0x2: SOC too high\n      0x3:  Reserved)" UBYTE swc_COL_CM_uint8_dash_ 0 0 0 255 ECU_ADDRESS 0x1FFE7632 /end MEASUREMENT
/begin MEASUREMENT BMS_BattSOH "Battery pack SOH (0xFF: Signal Invalid)" UBYTE swc_COL_CM_uint8_percent_ 0 0 0 255 ECU_ADDRESS 0x1FFE7633 /end MEASUREMENT
/begin MEASUREMENT BMS_BattSysFltCode "Power battery pack system fault information" UBYTE swc_COL_CM_uint8_dash_ 0 0 0 255 ECU_ADDRESS 0x1FFE7634 /end MEASUREMENT
/begin MEASUREMENT BMS_BattTempFault "The battery temperature is abnormal (0x0: No error\n      0x1: Bat temperature too low\n      0x2: Bat temperature too high\n      0x3: Reserved)" UBYTE swc_COL_CM_uint8_dash_ 0 0 0 255 ECU_ADDRESS 0x1FFE7635 /end MEASUREMENT
/begin MEASUREMENT BMS_BattTotalChgEny "Cumulative energy charged by the power battery (entire life cycle)" ULONG swc_COL_CM_uint32_dash_ 0 0 0 4294967295 ECU_ADDRESS 0x1FFE60F8 /end MEASUREMENT
/begin MEASUREMENT BMS_BattTotalDischgEny "Accumulated energy discharged by the power battery (whole life cycle) " ULONG swc_COL_CM_uint32_dash_ 0 0 0 4294967295 ECU_ADDRESS 0x1FFE60FC /end MEASUREMENT
/begin MEASUREMENT BMS_BattVol "Power battery pack voltage (0xFFFF: Invalid)" UWORD swc_COL_CM_uint16_V 0 0 0 65535 ECU_ADDRESS 0x1FFE74D0 /end MEASUREMENT
/begin MEASUREMENT BMS_BattaryType "Battery production type (0x0: Reserved \n      0x1: Lead acid battery\n      0x2: NI-MH battery\n      0x3: Lithium iron phosphate battery\n      0x4: Lithium manganate battery\n      0x5: Cobalt acid lithium battery \n      0x6: Ternary material battery\n      " UBYTE swc_COL_CM_uint8_dash_ 0 0 0 255 ECU_ADDRESS 0x1FFE7636 /end MEASUREMENT
/begin MEASUREMENT BMS_Batty_ThermalMangeReq "Battery thermal management requests (0x0: No Request \n      0x1: Heat Request \n      0x2: Cool Request\n      0x3: Self Loop\n      0x4-0xE: Reserved\n      0xF: Invalid)" UBYTE swc_COL_CM_uint8_dash_ 0 0 0 255 ECU_ADDRESS 0x1FFE7637 /end MEASUREMENT
/begin MEASUREMENT BMS_CANComFault "BMS internal communication fault status (0x0: No error\n      0x1: Error\n      0x2: Reserved\n      0x3: Invalid)" UBYTE swc_COL_CM_uint8_dash_ 0 0 0 255 ECU_ADDRESS 0x1FFE7638 /end MEASUREMENT
/begin MEASUREMENT BMS_CCUStopChgErrReason "The charger stops charging and the reason for the failure" UWORD swc_COL_CM_uint16_dash_ 0 0 0 65535 ECU_ADDRESS 0x1FFE74D2 /end MEASUREMENT
/begin MEASUREMENT BMS_CCUStopChgFltReason "The reason for the charger aborting the charging error" UBYTE swc_COL_CM_uint8_dash_ 0 0 0 255 ECU_ADDRESS 0x1FFE7639 /end MEASUREMENT
/begin MEASUREMENT BMS_CCUStopChgReason "The reason why the charger stopped charging" UBYTE swc_COL_CM_uint8_dash_ 0 0 0 255 ECU_ADDRESS 0x1FFE763A /end MEASUREMENT
/begin MEASUREMENT BMS_CellTempDiffFault "Differences in monomer temperature are often alarmed (0x0: No error\n      0x1: Error\n      0x2: Reserved\n      0x3: Invalid)" UBYTE swc_COL_CM_uint8_dash_ 0 0 0 255 ECU_ADDRESS 0x1FFE763B /end MEASUREMENT
/begin MEASUREMENT BMS_CellVolDiffFault "Excessive pressure difference between the monomers alarms (0x0: No error\n      0x1: Error\n      0x2: Reserved\n      0x3: Invalid)" UBYTE swc_COL_CM_uint8_dash_ 0 0 0 255 ECU_ADDRESS 0x1FFE763C /end MEASUREMENT
/begin MEASUREMENT BMS_Cell_Avg_Temp "Cell temperature average (0xFE: Abnormal 0xFF: Signal Invalid)" UBYTE swc_COL_CM_uint8___C 0 0 0 255 ECU_ADDRESS 0x1FFE763D /end MEASUREMENT
/begin MEASUREMENT BMS_ChargeCurrFault "The charging current is abnormal (0x0: No error\n      0x1: Current too high\n      0x2: Reserved\n      0x3: Invalid)" UBYTE swc_COL_CM_uint8_dash_ 0 0 0 255 ECU_ADDRESS 0x1FFE763E /end MEASUREMENT
/begin MEASUREMENT BMS_ChgCount "Number of charges" UWORD swc_COL_CM_uint16_dash_ 0 0 0 65535 ECU_ADDRESS 0x1FFE74D4 /end MEASUREMENT
/begin MEASUREMENT BMS_ChgStatus "Charging status (0x0: Default\n      0x1: Charging \n      0x2: Charge end\n      0x3: Error Charge Stop\n      0x4: Heating\n      0x5: Cooling\n      0x6: Charge Pause\n      0x7: Other Charge Stop\n      0x8-0xF: Reserved)" UBYTE swc_COL_CM_uint8_dash_ 0 0 0 255 ECU_ADDRESS 0x1FFE763F /end MEASUREMENT
/begin MEASUREMENT BMS_ChgTimeRemain "Estimated time to fully charge" UWORD swc_COL_CM_uint16_min 0 0 0 65535 ECU_ADDRESS 0x1FFE74D6 /end MEASUREMENT
/begin MEASUREMENT BMS_CoolNegRelayCtrl "Water-cooled negative relay control command (0x0: Open\n      0x1: Close\n      0x2: Reserved\n      0x3: Invalid)" UBYTE swc_COL_CM_uint8_dash_ 0 0 0 255 ECU_ADDRESS 0x1FFE7640 /end MEASUREMENT
/begin MEASUREMENT BMS_CoolPosRelayCtrl "Water-cooled positive relay control command (0x0: Open\n      0x1: Close\n      0x2: Reserved\n      0x3: Invalid)" UBYTE swc_COL_CM_uint8_dash_ 0 0 0 255 ECU_ADDRESS 0x1FFE7641 /end MEASUREMENT
/begin MEASUREMENT BMS_CurrSensorFault "Current sensor fault condition (0x0: No error\n      0x1: Error\n      0x2: Reserved\n      0x3: Invalid)" UBYTE swc_COL_CM_uint8_dash_ 0 0 0 255 ECU_ADDRESS 0x1FFE7642 /end MEASUREMENT
/begin MEASUREMENT BMS_CutOffLVFbToOBC "Whether the slow-charging BMS allows low-voltage electrical feedback (0x0: Not allow\n      0x1: Allow\n      0x2: Reserved\n      0x3: Invalid)" UBYTE swc_COL_CM_uint8_dash_ 0 0 0 255 ECU_ADDRESS 0x1FFE7643 /end MEASUREMENT
/begin MEASUREMENT BMS_DCChargRelayCtrl "Boomers DeChagel Lecktel (0x0: Disconnect\n      0x1: Connect\n      0x2: Reserved\n      0x3: Invalid)" UBYTE swc_COL_CM_uint8_dash_ 0 0 0 255 ECU_ADDRESS 0x1FFE7644 /end MEASUREMENT
/begin MEASUREMENT BMS_DCChgNegTemp "Fast charging port negative contact temperature" UBYTE swc_COL_CM_uint8_dash_ 0 0 0 255 ECU_ADDRESS 0x1FFE7645 /end MEASUREMENT
/begin MEASUREMENT BMS_DCChgPlugSts "Whether the DC charging plug is connected (0x0: Disconnected\n      0x1: Connected\n      0x2: Reserved\n      0x3: Invalid)" UBYTE swc_COL_CM_uint8_dash_ 0 0 0 255 ECU_ADDRESS 0x1FFE7646 /end MEASUREMENT
/begin MEASUREMENT BMS_DCChgPosTemp "Fast charging port positive contact temperature" UBYTE swc_COL_CM_uint8_dash_ 0 0 0 255 ECU_ADDRESS 0x1FFE7647 /end MEASUREMENT
/begin MEASUREMENT BMS_DCChgReady "Whether the BMS is ready (0x0: BMS is not ready\n      0x1: The BMS is ready for charging)" UBYTE swc_COL_CM_uint8_dash_ 0 0 0 255 ECU_ADDRESS 0x1FFE7648 /end MEASUREMENT
/begin MEASUREMENT BMS_DCChgStage "Fast charging stage (0x0:  default\n      0x1: Charging handshake initiation phase\n      0x2: Charging handshake identification phase\n      0x3: Charging parameter configuration phase\n      0x4: Charging phase\n      0x5: End of charging phase)" UBYTE swc_COL_CM_uint8_dash_ 0 0 0 255 ECU_ADDRESS 0x1FFE7649 /end MEASUREMENT
/begin MEASUREMENT BMS_DischargeCurrFault "The discharge current is abnormal (0x0: No error\n      0x1: Current too high\n      0x2: Reserved\n      0x3: Invalid)" UBYTE swc_COL_CM_uint8_dash_ 0 0 0 255 ECU_ADDRESS 0x1FFE764A /end MEASUREMENT
/begin MEASUREMENT BMS_ElectroniclockSts "Slow charging sublock status (0x0: No lock\n      0x1: Lock\n      0x2: Error\n      0x3: Invalid)" UBYTE swc_COL_CM_uint8_dash_ 0 0 0 255 ECU_ADDRESS 0x1FFE764B /end MEASUREMENT
/begin MEASUREMENT BMS_EmergCutoffHVReq "HV battery emergency cutoff high voltage request (0x0: No request 0x1: Request 0x2: Reserved 0x3: Invalid)" UBYTE swc_COL_CM_uint8_dash_ 0 0 0 255 ECU_ADDRESS 0x1FFE764C /end MEASUREMENT
/begin MEASUREMENT BMS_EnyRecoCurrHighFlt "Faults where the energy feedback current is too large (0x0: No error\n      0x1: Error\n      0x2: Reserved\n      0x3: Invalid)" UBYTE swc_COL_CM_uint8_dash_ 0 0 0 255 ECU_ADDRESS 0x1FFE764D /end MEASUREMENT
/begin MEASUREMENT BMS_FastChgConnStsFb "Fast charging contactor status feedback (0x0: Open \n      0x1: Close \n      0x2: Reserved\n      0x3: Invalid )" UBYTE swc_COL_CM_uint8_dash_ 0 0 0 255 ECU_ADDRESS 0x1FFE764E /end MEASUREMENT
/begin MEASUREMENT BMS_FastChgRelayFlt "Fast charge contactor failure (0x0: No fault\n      0x1: Driver Fault\n      0x2: Welded\n      0x3: Invalid)" UBYTE swc_COL_CM_uint8_dash_ 0 0 0 255 ECU_ADDRESS 0x1FFE764F /end MEASUREMENT
/begin MEASUREMENT BMS_FaultLevel "BMS failure level (0x0: No error\n      0x1: Level1\n      0x2: Level2\n      0x3: Level3)" UBYTE swc_COL_CM_uint8_dash_ 0 0 0 255 ECU_ADDRESS 0x1FFE7650 /end MEASUREMENT
/begin MEASUREMENT BMS_HVIsolationSts "High voltage insulation status (0x0: No error\n      0x1: Level1\n      0x2: Level2\n      0x7: Invalid)" UBYTE swc_COL_CM_uint8_dash_ 0 0 0 255 ECU_ADDRESS 0x1FFE7651 /end MEASUREMENT
/begin MEASUREMENT BMS_HVLoopWorkSts "High voltage circuit working state (0x0: Open 0x1: Precharging 0x2: Precharg Finish 0x3: Prechage Fault 0x4: Precharge lock 0x5: Normal drive)" UBYTE swc_COL_CM_uint8_dash_ 0 0 0 255 ECU_ADDRESS 0x1FFE7652 /end MEASUREMENT
/begin MEASUREMENT BMS_HeatNegRelayCtrl_Reserved "Heating negative relay control command (0x0: Open\n      0x1: Close\n      0x2: Reserved\n      0x3: Invalid)" UBYTE swc_COL_CM_uint8_dash_ 0 0 0 255 ECU_ADDRESS 0x1FFE7653 /end MEASUREMENT
/begin MEASUREMENT BMS_HeatNegRelayFault_Reserved "Heating negative relay failure (0x0: No error\n      0x1: Drive Error\n      0x2: Welded\n      0x3: Invalid)" UBYTE swc_COL_CM_uint8_dash_ 0 0 0 255 ECU_ADDRESS 0x1FFE7654 /end MEASUREMENT
/begin MEASUREMENT BMS_HeatPosRelayCtrl_Reserved "Heating positive relay control command (0x0: Open 0x1: Close 0x2: Reserved 0x3: Invalid)" UBYTE swc_COL_CM_uint8_dash_ 0 0 0 255 ECU_ADDRESS 0x1FFE7655 /end MEASUREMENT
/begin MEASUREMENT BMS_HeatPosRelayFault_Reserved "Heating positive relay failure (0x0: No error\n      0x1: Drive Error\n      0x2: Welded\n      0x3: Invalid)" UBYTE swc_COL_CM_uint8_dash_ 0 0 0 255 ECU_ADDRESS 0x1FFE7656 /end MEASUREMENT
/begin MEASUREMENT BMS_HeatRelaySts "BMS heating relay status (0x0: Open \n      0x1: Close \n      0x2: Reserved\n      0x3: Invalid )" UBYTE swc_COL_CM_uint8_dash_ 0 0 0 255 ECU_ADDRESS 0x1FFE7657 /end MEASUREMENT
/begin MEASUREMENT BMS_HeatingSatus "Battery heating film heating state (0x0: No heating\n      0x1: Heating\n      0x2: Reserved\n      0x3: Invalid)" UBYTE swc_COL_CM_uint8_dash_ 0 0 0 255 ECU_ADDRESS 0x1FFE7658 /end MEASUREMENT
/begin MEASUREMENT BMS_IC_Temp "The gauge shows the battery temperature (0xFE: Abnormal 0XFF: Signal Invalid)" UBYTE swc_COL_CM_uint8___C 0 0 0 127 ECU_ADDRESS 0x1FFE7659 /end MEASUREMENT
/begin MEASUREMENT BMS_InsideFltCode "BMS internal fault code" UBYTE swc_COL_CM_uint8_dash_ 0 0 0 255 ECU_ADDRESS 0x1FFE765A /end MEASUREMENT
/begin MEASUREMENT BMS_IsolationFault "Insulation fault alarm (0x0: No error\n      0x1: Positive isolation fault\n      0x2: Negtive isolation fault\n      0x3: Both P and N fault\n      0x4: Isolation test circuit fault\n      0x1F: Invalid)" UBYTE swc_COL_CM_uint8_dash_ 0 0 0 255 ECU_ADDRESS 0x1FFE765B /end MEASUREMENT
/begin MEASUREMENT BMS_MILTelltale "Request MIL lamp status (0x0: Off\n      0x1: ON\n      0x2: Blink)" UBYTE swc_COL_CM_uint8_dash_ 0 0 0 255 ECU_ADDRESS 0x1FFE765C /end MEASUREMENT
/begin MEASUREMENT BMS_MSDFault "The repair switch MSD is abnormal (0x0: No error\n      0x1: Error\n      0x2: Reserved\n      0x3: Invalid)" UBYTE swc_COL_CM_uint8_dash_ 0 0 0 255 ECU_ADDRESS 0x1FFE765D /end MEASUREMENT
/begin MEASUREMENT BMS_MainNegRelay1Ctrl "Main negative pole relay1 control commend (0x0: Open 0x1: Close 0x2: Reserved 0x3: Invalid)" UBYTE swc_COL_CM_uint8_dash_ 0 0 0 255 ECU_ADDRESS 0x1FFE765E /end MEASUREMENT
/begin MEASUREMENT BMS_MainNegRelay2Ctrl "Main positive pole relay control commend (0x0: Open 0x1: Close 0x2: Reserved 0x3: Invalid)" UBYTE swc_COL_CM_uint8_dash_ 0 0 0 255 ECU_ADDRESS 0x1FFE765F /end MEASUREMENT
/begin MEASUREMENT BMS_MainPosConnSts "Positive pole contactor status (0x0: Open 0x1: Close 0x2: Reserved 0x3: Invalid )" UBYTE swc_COL_CM_uint8_dash_ 0 0 0 255 ECU_ADDRESS 0x1FFE7660 /end MEASUREMENT
/begin MEASUREMENT BMS_MaxCellVolt "The maximum voltage of a single cell (0xFFFF: Invalid)" UWORD swc_COL_CM_uint16_V 0 0 0 65535 ECU_ADDRESS 0x1FFE74D8 /end MEASUREMENT
/begin MEASUREMENT BMS_MaxChgCurrent "Maximum allowable charging current (0xFFFF: Invalid)" UWORD swc_COL_CM_uint16_A 0 0 0 65535 ECU_ADDRESS 0x1FFE74DA /end MEASUREMENT
/begin MEASUREMENT BMS_MaxChgVoltage "Maximum allowable charging voltage (0xFFFF: Invalid)" UWORD swc_COL_CM_uint16_V 0 0 0 65535 ECU_ADDRESS 0x1FFE74DC /end MEASUREMENT
/begin MEASUREMENT BMS_MaxPmtDischgCurr "The maximum allowable discharge current of the power battery (0xFFFF: Invalid)" UWORD swc_COL_CM_uint16_A 0 0 0 65535 ECU_ADDRESS 0x1FFE74DE /end MEASUREMENT
/begin MEASUREMENT BMS_MaxPmtEnyRecoCurr "The maximum allowable energy feedback current of the power battery (0xFFFF: Invalid)" UWORD swc_COL_CM_uint16_dash_ 0 0 0 65535 ECU_ADDRESS 0x1FFE74E0 /end MEASUREMENT
/begin MEASUREMENT BMS_MaxPmtEnyRecoVol "The maximum allowable energy feedback voltage of the power battery (0xFF: Invalid)" UBYTE swc_COL_CM_uint8_percent_ 0 0 0 255 ECU_ADDRESS 0x1FFE7661 /end MEASUREMENT
/begin MEASUREMENT BMS_MaxTemp1PackNum "The address of the box where the highest temperature is located ()" UBYTE swc_COL_CM_uint8_dash_ 0 0 0 255 ECU_ADDRESS 0x1FFE7662 /end MEASUREMENT
/begin MEASUREMENT BMS_MaxTemp1SnsNum "The maximum temperature corresponds to the probe serial number ()" UBYTE swc_COL_CM_uint8_dash_ 0 0 0 255 ECU_ADDRESS 0x1FFE7663 /end MEASUREMENT
/begin MEASUREMENT BMS_MaxVoltCellNum "The cell number in the box/CSC where the highest voltage of the single cell is located" UBYTE swc_COL_CM_uint8_dash_ 0 0 0 255 ECU_ADDRESS 0x1FFE7664 /end MEASUREMENT
/begin MEASUREMENT BMS_MaxVoltCellPackNum "The box/CSC address number where the highest voltage of the single battery is located" UBYTE swc_COL_CM_uint8_dash_ 0 0 0 255 ECU_ADDRESS 0x1FFE7665 /end MEASUREMENT
/begin MEASUREMENT BMS_MinCellVolt "The minimum voltage of the single cell (0xFFFF: Invalid)" UWORD swc_COL_CM_uint16_V 0 0 0 65535 ECU_ADDRESS 0x1FFE74E2 /end MEASUREMENT
/begin MEASUREMENT BMS_MinPmtSOC "The battery allows minimal SOC usage (0xFF: Invalid)" UBYTE swc_COL_CM_uint8_percent_ 0 0 0 255 ECU_ADDRESS 0x1FFE7666 /end MEASUREMENT
/begin MEASUREMENT BMS_MinTemp1PackNum "The address of the enclosure where the lowest temperature is located" UBYTE swc_COL_CM_uint8_dash_ 0 0 0 255 ECU_ADDRESS 0x1FFE7667 /end MEASUREMENT
/begin MEASUREMENT BMS_MinTemp1SnsNum "The probe serial number corresponding to the lowest temperature" UBYTE swc_COL_CM_uint8_dash_ 0 0 0 255 ECU_ADDRESS 0x1FFE7668 /end MEASUREMENT
/begin MEASUREMENT BMS_MinVoltCellNum "The cell number in the box/CSC where the minimum voltage of the single battery is located" UBYTE swc_COL_CM_uint8_dash_ 0 0 0 255 ECU_ADDRESS 0x1FFE7669 /end MEASUREMENT
/begin MEASUREMENT BMS_MinVoltCellPackNum "The box/CSC address number where the minimum voltage of the single battery 1 is located " UBYTE swc_COL_CM_uint8_dash_ 0 0 0 255 ECU_ADDRESS 0x1FFE766A /end MEASUREMENT
/begin MEASUREMENT BMS_NegIsolationRes "Insulation resistance between the high-voltage negative electrode and the chassis (0xFFFF: Invalid)" UWORD swc_COL_CM_uint16_kOhm 0 0 0 65535 ECU_ADDRESS 0x1FFE74E4 /end MEASUREMENT
/begin MEASUREMENT BMS_NegRelayFault "BMS negative pole relay failure (0x0: No error 0x1: Error 0x2: Reserved 0x3: Invalid)" UBYTE swc_COL_CM_uint8_dash_ 0 0 0 255 ECU_ADDRESS 0x1FFE766B /end MEASUREMENT
/begin MEASUREMENT BMS_NegRelaySts "Negative pole contactor status (0x0: Open 0x1: Close 0x2: Reserved 0x3: Invalid)" UBYTE swc_COL_CM_uint8_dash_ 0 0 0 255 ECU_ADDRESS 0x1FFE766C /end MEASUREMENT
/begin MEASUREMENT BMS_OBCChgContrlCmd "Slow charge charge control command (0x0: Stop charge\n      0x1:Start charge\n      0x2: Reserved\n      0x3: Invalid)" UBYTE swc_COL_CM_uint8_dash_ 0 0 0 255 ECU_ADDRESS 0x1FFE766D /end MEASUREMENT
/begin MEASUREMENT BMS_OverChgFault "Battery overcharge alarm (0x0: No error\n      0x1: Error\n      0x2: Reserved\n      0x3: Invalid)" UBYTE swc_COL_CM_uint8_dash_ 0 0 0 255 ECU_ADDRESS 0x1FFE766E /end MEASUREMENT
/begin MEASUREMENT BMS_PTCConnStsFb "Defrost PTC contactor status feedback" UBYTE swc_COL_CM_uint8_dash_ 0 0 0 255 ECU_ADDRESS 0x1FFE766F /end MEASUREMENT
/begin MEASUREMENT BMS_PmtCutoffLVFb "HV battery allow to cutoff low voltage (0x0: Not Allow 0x1: Allow 0x2: Reserved 0x3: Invalid)" UBYTE swc_COL_CM_uint8_dash_ 0 0 0 255 ECU_ADDRESS 0x1FFE7670 /end MEASUREMENT
/begin MEASUREMENT BMS_PosIsolationRes "The insulation resistance between the high voltage positive electrode and the chassis (0xFFFF: Invalid)" UWORD swc_COL_CM_uint16_kOhm 0 0 0 65535 ECU_ADDRESS 0x1FFE74E6 /end MEASUREMENT
/begin MEASUREMENT BMS_PosRelayFault "BMS positive pole relay failure (0x0: No error 0x1: Drive Error 0x2: Welded 0x3: Invalid)" UBYTE swc_COL_CM_uint8_dash_ 0 0 0 255 ECU_ADDRESS 0x1FFE7671 /end MEASUREMENT
/begin MEASUREMENT BMS_PowerActiveMode "BMS power activation mode (0x0: No Active\n      0x1: Key On Active\n      0x2: Charging Active\n      0x3: Both Active)" UBYTE swc_COL_CM_uint8_dash_ 0 0 0 255 ECU_ADDRESS 0x1FFE7672 /end MEASUREMENT
/begin MEASUREMENT BMS_PreChgConnSts "Pre charging contactor status feedback (0x0: Open 0x1: Close 0x2: Reserved 0x3: Invalid )" UBYTE swc_COL_CM_uint8_dash_ 0 0 0 255 ECU_ADDRESS 0x1FFE7673 /end MEASUREMENT
/begin MEASUREMENT BMS_PreChgRelayFlt "Pre charging contactor failure (0x0: No fault 0x1: Driver Fault 0x2: Welded 0x3: Invalid)" UBYTE swc_COL_CM_uint8_dash_ 0 0 0 255 ECU_ADDRESS 0x1FFE7674 /end MEASUREMENT
/begin MEASUREMENT BMS_SOCJumpFault "Battery SOC trip alarm (0x0: No error\n      0x1: Error\n      0x2: Reserved\n      0x3: Invalid)" UBYTE swc_COL_CM_uint8_dash_ 0 0 0 255 ECU_ADDRESS 0x1FFE7675 /end MEASUREMENT
/begin MEASUREMENT BMS_SOC_01 "Battery pack SOC" UWORD swc_COL_CM_uint16_percent_ 0 0 0 65535 ECU_ADDRESS 0x1FFE74E8 /end MEASUREMENT
/begin MEASUREMENT BMS_ST1_Flt_HVIL "High voltage interlock alarm (0x0: No error\n      0x1: Error\n      0x2: Reserved\n      0x3: Invalid)" UBYTE swc_COL_CM_uint8_dash_ 0 0 0 255 ECU_ADDRESS 0x1FFE7676 /end MEASUREMENT
/begin MEASUREMENT BMS_ST1_Flt_HW "BMS hardware failure (0x0: No error\n      0x1: Error\n      0x2: Reserved\n      0x3: Invalid)" UBYTE swc_COL_CM_uint8_dash_ 0 0 0 255 ECU_ADDRESS 0x1FFE7677 /end MEASUREMENT
/begin MEASUREMENT BMS_SelfChkState "HV battery selfcheck state (0x0: No error 0x1: Error 0x2: Reserved 0x3: Invalid)" UBYTE swc_COL_CM_uint8_dash_ 0 0 0 255 ECU_ADDRESS 0x1FFE7678 /end MEASUREMENT
/begin MEASUREMENT BMS_SetTgtTemp "The BMS sets the target temperature" UBYTE swc_COL_CM_uint8___C 0 0 0 255 ECU_ADDRESS 0x1FFE7679 /end MEASUREMENT
/begin MEASUREMENT BMS_SingleDisChgEny "Single discharge charge" UWORD swc_COL_CM_uint16_dash_ 0 0 0 65535 ECU_ADDRESS 0x1FFE74EA /end MEASUREMENT
/begin MEASUREMENT BMS_SubFltLevell "Battery sub-failure level (0x0: Invalid\n      0x1: Level 1 subfault\n      0x2: Level 2 subfault\n      0x3: Level 3 subfault)" UBYTE swc_COL_CM_uint8_dash_ 0 0 0 255 ECU_ADDRESS 0x1FFE767A /end MEASUREMENT
/begin MEASUREMENT BMS_TempOutofCtr "Battery thermal runaway alarm (0x0: No error\n      0x1: Error\n      0x2: Reserved\n      0x3: Invalid)" UBYTE swc_COL_CM_uint8_dash_ 0 0 0 255 ECU_ADDRESS 0x1FFE767B /end MEASUREMENT
/begin MEASUREMENT BMS_TempSnsNum "Total number of temperature probes" UBYTE swc_COL_CM_uint8_dash_ 0 0 0 255 ECU_ADDRESS 0x1FFE767C /end MEASUREMENT
/begin MEASUREMENT BMS_TestFrame "Test frame" UBYTE swc_COL_CM_uint8_dash_ 0 0 0 255 ECU_ADDRESS 0x1FFE767D /end MEASUREMENT
/begin MEASUREMENT BPIU_ErrCellU "cell voltage error:\n      0x0: No error\n      0x1: Cell Voltage too low\n      0x2: Cell Voltage too high\n      0x3: Reserved" UBYTE swc_BatProtnIU_CM_uint8_dash_ 0 0 0 255 ECU_ADDRESS 0x1FFE7552 /end MEASUREMENT
/begin MEASUREMENT BPIU_ErrCellUColctIRV "Error Cell Voltage Collect" UBYTE swc_BatProtnIU_CM_boolean_dash_ 0 0 0 1 ECU_ADDRESS 0x1FFE755F /end MEASUREMENT
/begin MEASUREMENT BPIU_ErrCellUDif "Error of cell voltage difference error (logging)" UBYTE swc_BatProtnIU_CM_uint8_dash_ 0 0 0 1 ECU_ADDRESS 0x1FFE7553 /end MEASUREMENT
/begin MEASUREMENT BPIU_ErrCellUDifIRV "Cell voltage deviation exceeding limit fault" UBYTE swc_BatProtnIU_CM_boolean_dash_ 0 0 0 1 ECU_ADDRESS 0x1FFE7560 /end MEASUREMENT
/begin MEASUREMENT BPIU_ErrCellUMax1IRV "Error Cell Voltage Maximum 1" UBYTE swc_BatProtnIU_CM_boolean_dash_ 0 0 0 1 ECU_ADDRESS 0x1FFE7561 /end MEASUREMENT
/begin MEASUREMENT BPIU_ErrCellUMax2IRV "Error Cell Voltage Maximum 2" UBYTE swc_BatProtnIU_CM_boolean_dash_ 0 0 0 1 ECU_ADDRESS 0x1FFE7562 /end MEASUREMENT
/begin MEASUREMENT BPIU_ErrCellUMax3IRV "Error Cell Voltage Maximum" UBYTE swc_BatProtnIU_CM_boolean_dash_ 0 0 0 1 ECU_ADDRESS 0x1FFE7563 /end MEASUREMENT
/begin MEASUREMENT BPIU_ErrCellUMin1IRV "Error Cell Voltage Minimum 1" UBYTE swc_BatProtnIU_CM_boolean_dash_ 0 0 0 1 ECU_ADDRESS 0x1FFE7564 /end MEASUREMENT
/begin MEASUREMENT BPIU_ErrCellUMin2IRV "Error Cell Voltage Minimum 2" UBYTE swc_BatProtnIU_CM_boolean_dash_ 0 0 0 1 ECU_ADDRESS 0x1FFE7565 /end MEASUREMENT
/begin MEASUREMENT BPIU_ErrCellUMin3IRV "Error Cell Voltage Minimum 3" UBYTE swc_BatProtnIU_CM_boolean_dash_ 0 0 0 1 ECU_ADDRESS 0x1FFE7566 /end MEASUREMENT
/begin MEASUREMENT BPIU_ErrCellUOutOfRngIRV "Error Cell Voltage Out Of Range" UBYTE swc_BatProtnIU_CM_boolean_dash_ 0 0 0 1 ECU_ADDRESS 0x1FFE7567 /end MEASUREMENT
/begin MEASUREMENT BPIU_ErrCellUOver "Voltage Error Cell Voltage Over" UBYTE swc_BatProtnIU_CM_uint8_dash_ 0 0 0 255 ECU_ADDRESS 0x1FFE7554 /end MEASUREMENT
/begin MEASUREMENT BPIU_ErrCellUOverMaxIRV "Error Cell Voltage Over Maximum" UBYTE swc_BatProtnIU_CM_boolean_dash_ 0 0 0 1 ECU_ADDRESS 0x1FFE7568 /end MEASUREMENT
/begin MEASUREMENT BPIU_ErrCellUOverMinIRV "Error Cell Voltage Over Minimum" UBYTE swc_BatProtnIU_CM_boolean_dash_ 0 0 0 1 ECU_ADDRESS 0x1FFE7569 /end MEASUREMENT
/begin MEASUREMENT BPIU_ErrCellURateIRV "Voltage change rate signal" UBYTE swc_BatProtnIU_CM_boolean_dash_ 0 0 0 1 ECU_ADDRESS 0x1FFE756A /end MEASUREMENT
/begin MEASUREMENT BPIU_ErrIChLim "Error flag for exceeding charging current limit (logging)" UBYTE swc_BatProtnIU_CM_uint8_dash_ 0 0 0 255 ECU_ADDRESS 0x1FFE7555 /end MEASUREMENT
/begin MEASUREMENT BPIU_ErrIDchaLim "Error status for exceeding discharge current limit (logging)" UBYTE swc_BatProtnIU_CM_uint8_dash_ 0 0 0 255 ECU_ADDRESS 0x1FFE7556 /end MEASUREMENT
/begin MEASUREMENT BPIU_ErrInfo "Each bit of the fault Flag represents a fault, and the corresponding relationship between the Bit bit and the fault should be noted in a table in the model" ULONG swc_BatProtnIU_CM_uint32_dash_ 0 0 0 65535 ECU_ADDRESS 0x1FFE4114 /end MEASUREMENT
/begin MEASUREMENT BPIU_ErrMdulUOutOfRngIRV "Error Module Voltage Out Of Range" UBYTE swc_BatProtnIU_CM_boolean_dash_ 0 0 0 1 ECU_ADDRESS 0x1FFE756B /end MEASUREMENT
/begin MEASUREMENT BPIU_ErrPackSnsrI "Current sensor fault" UBYTE swc_BatProtnIU_CM_uint8_dash_ 0 0 0 255 ECU_ADDRESS 0x1FFE7557 /end MEASUREMENT
/begin MEASUREMENT BPIU_ErrPackUColctIRV "Error Pack Voltage Collect" UBYTE swc_BatProtnIU_CM_boolean_dash_ 0 0 0 1 ECU_ADDRESS 0x1FFE756C /end MEASUREMENT
/begin MEASUREMENT BPIU_ErrUAcqn "Voltage Acquisition Plausibility:\n      0x0: No erro\n      0x1: Error\n      0x2:  Reserved" UBYTE swc_BatProtnIU_CM_uint8_dash_ 0 0 0 255 ECU_ADDRESS 0x1FFE7558 /end MEASUREMENT
/begin MEASUREMENT BPIU_ErrUAcqnIRV "HighVoltageDiagnosis" UBYTE swc_BatProtnIU_CM_boolean_dash_ 0 0 0 1 ECU_ADDRESS 0x1FFE756D /end MEASUREMENT
/begin MEASUREMENT BPIU_ErrUIntIRV "TotalVoltageFault" UBYTE swc_BatProtnIU_CM_boolean_dash_ 0 0 0 1 ECU_ADDRESS 0x1FFE756E /end MEASUREMENT
/begin MEASUREMENT BPIU_IDchaDiagLim "Discharge current limit used for current limit diagnosis as input" FLOAT32_IEEE swc_BatProtnIU_CM_single_A 0 0 -3.40282346639e+038 3.40282346639e+038 ECU_ADDRESS 0x1FFE4118 /end MEASUREMENT
/begin MEASUREMENT BPIU_IdCellUMax "The ID of the cell the currently reports the highest voltage" UWORD swc_BatProtnIU_CM_uint16_dash_ 0 0 0 65535 ECU_ADDRESS 0x1FFE7490 /end MEASUREMENT
/begin MEASUREMENT BPIU_IdCellUMin "The ID of the cell the currently reports the lowest voltage" UWORD swc_BatProtnIU_CM_uint16_dash_ 0 0 0 65535 ECU_ADDRESS 0x1FFE7492 /end MEASUREMENT
/begin MEASUREMENT BPIU_IdMdulForCellUMax "Module ID where the maximum voltage of a single battery is located" UBYTE swc_BatProtnIU_CM_uint8_dash_ 0 0 0 255 ECU_ADDRESS 0x1FFE7559 /end MEASUREMENT
/begin MEASUREMENT BPIU_IdMdulForCellUMin "Module ID where the minimum voltage of a single battery is located" UBYTE swc_BatProtnIU_CM_uint8_dash_ 0 0 0 255 ECU_ADDRESS 0x1FFE755A /end MEASUREMENT
/begin MEASUREMENT BPIU_StCellUChkOverMax "State Cell Voltage Check Over Maximum" UBYTE swc_BatProtnIU_CM_uint8_dash_ 0 0 0 255 ECU_ADDRESS 0x1FFE755B /end MEASUREMENT
/begin MEASUREMENT BPIU_StCellUChkOverMin "State Cell Voltage Check Over Minimum" UBYTE swc_BatProtnIU_CM_uint8_dash_ 0 0 0 255 ECU_ADDRESS 0x1FFE755C /end MEASUREMENT
/begin MEASUREMENT BPIU_StChkUMax "State Check Voltage Maximum" UBYTE swc_BatProtnIU_CM_uint8_dash_ 0 0 0 255 ECU_ADDRESS 0x1FFE755D /end MEASUREMENT
/begin MEASUREMENT BPIU_StChkUMin "State Check Voltage Minimum" UBYTE swc_BatProtnIU_CM_uint8_dash_ 0 0 0 255 ECU_ADDRESS 0x1FFE755E /end MEASUREMENT
/begin MEASUREMENT BPIU_UCellMax "Maximum Cell Voltage" FLOAT32_IEEE swc_BatProtnIU_CM_single_V 0 0 0 5 ECU_ADDRESS 0x1FFE411C /end MEASUREMENT
/begin MEASUREMENT BPIU_UCellMin "Minimum Cell Voltage" FLOAT32_IEEE swc_BatProtnIU_CM_single_V 0 0 0 5 ECU_ADDRESS 0x1FFE4120 /end MEASUREMENT
/begin MEASUREMENT BPIU_bErrCellUDif "Error Flag Cell Voltage Difference" UBYTE swc_BatProtnIU_CM_boolean_dash_ 0 0 0 1 ECU_ADDRESS 0x1FFE756F /end MEASUREMENT
/begin MEASUREMENT BPIU_bErrUAcqn "Error flag for Voltage acquisition" UBYTE swc_BatProtnIU_CM_boolean_dash_ 0 0 0 1 ECU_ADDRESS 0x1FFE7570 /end MEASUREMENT
/begin MEASUREMENT BSOF_AcvChManSuspd "Reason for charger charging suspension: Manual suspension" UBYTE swc_CIL_CM_uint8_dash_ 0 0 0 255 ECU_ADDRESS 0x1FFE75C1 /end MEASUREMENT
/begin MEASUREMENT BSOF_AcvChSuspdByBms "Reason for charger charging suspension: Active suspension by BMS" UBYTE swc_CIL_CM_uint8_dash_ 0 0 0 255 ECU_ADDRESS 0x1FFE75C2 /end MEASUREMENT
/begin MEASUREMENT BSOF_AcvChSuspdCdnRchd "Reason for charger charging suspension: reach the set suspension condition of charger" UBYTE swc_CIL_CM_uint8_dash_ 0 0 0 255 ECU_ADDRESS 0x1FFE75C3 /end MEASUREMENT
/begin MEASUREMENT BSOF_AcvChSuspdFlt "Reason for charger charging suspension: Suspension due to fault" UBYTE swc_CIL_CM_uint8_dash_ 0 0 0 255 ECU_ADDRESS 0x1FFE75C4 /end MEASUREMENT
/begin MEASUREMENT BSOF_ChAllwd "Charging allowed 0x00:pause 0x01:permit" UBYTE swc_CIL_CM_uint8_dash_ 0 0 0 255 ECU_ADDRESS 0x1FFE75C5 /end MEASUREMENT
/begin MEASUREMENT BSOF_DirChAndDcha "Direction for charging and discharging" UBYTE swc_CIL_CM_uint8_dash_ 0 0 0 255 ECU_ADDRESS 0x1FFE75C6 /end MEASUREMENT
/begin MEASUREMENT BSOF_EChSng "Single charge energy (when charger is online)" FLOAT32_IEEE swc_CIL_CM_single_kWh 0 0 0 65535 ECU_ADDRESS 0x1FFE5D9C /end MEASUREMENT
/begin MEASUREMENT BSOF_ErrChImpo "Reason for charger charging suspension fault: Unable to transmit the required electric energy" UBYTE swc_CIL_CM_uint8_dash_ 0 0 0 255 ECU_ADDRESS 0x1FFE75C7 /end MEASUREMENT
/begin MEASUREMENT BSOF_ErrChrgrOutpFlt "Reason for charger charging suspension fault: Charger connector fault" UBYTE swc_CIL_CM_uint8_dash_ 0 0 0 255 ECU_ADDRESS 0x1FFE75C8 /end MEASUREMENT
/begin MEASUREMENT BSOF_ErrChrgrOvtempFlt "Reason for charger charging suspension fault: Charger over-temperature fault" UBYTE swc_CIL_CM_uint8_dash_ 0 0 0 255 ECU_ADDRESS 0x1FFE75C9 /end MEASUREMENT
/begin MEASUREMENT BSOF_ErrChrgrOvtempIntFlt "Reason for charger charging suspension fault: Internal over-temperature fault of charger" UBYTE swc_CIL_CM_uint8_dash_ 0 0 0 255 ECU_ADDRESS 0x1FFE75CA /end MEASUREMENT
/begin MEASUREMENT BSOF_ErrChrgrShtdnEmcy "Reason for charger charging suspension fault: Charger emergency shutdown fault" UBYTE swc_CIL_CM_uint8_dash_ 0 0 0 255 ECU_ADDRESS 0x1FFE75CB /end MEASUREMENT
/begin MEASUREMENT BSOF_ErrIDe "Reason for charger charging suspension error: Current not matching" UBYTE swc_CIL_CM_uint8_dash_ 0 0 0 255 ECU_ADDRESS 0x1FFE75CC /end MEASUREMENT
/begin MEASUREMENT BSOF_ErrUAbno "Reason for charger charging suspension error: Abnormal voltage" UBYTE swc_CIL_CM_uint8_dash_ 0 0 0 255 ECU_ADDRESS 0x1FFE75CD /end MEASUREMENT
/begin MEASUREMENT BSOF_ErrUndfnd "Reason for charger charging suspension fault: Other fault" UBYTE swc_CIL_CM_uint8_dash_ 0 0 0 255 ECU_ADDRESS 0x1FFE75CE /end MEASUREMENT
/begin MEASUREMENT BSOF_IChrgr "Current output (A)" FLOAT32_IEEE swc_CIL_CM_single_A 0 0 -3.40282346639e+038 3.40282346639e+038 ECU_ADDRESS 0x1FFE5DA0 /end MEASUREMENT
/begin MEASUREMENT BSOF_IChrgrMax "Maximum charger current" FLOAT32_IEEE swc_CIL_CM_single_A 0 0 -3.40282346639e+038 3.40282346639e+038 ECU_ADDRESS 0x1FFE5DA4 /end MEASUREMENT
/begin MEASUREMENT BSOF_IChrgrMin "For automated CAN tests" FLOAT32_IEEE swc_CIL_CM_single_A 0 0 -3.40282346639e+038 3.40282346639e+038 ECU_ADDRESS 0x1FFE5DA8 /end MEASUREMENT
/begin MEASUREMENT BSOF_IDchaMax "Maximum discharge current" FLOAT32_IEEE swc_CIL_CM_single_A 0 0 -3.40282346639e+038 3.40282346639e+038 ECU_ADDRESS 0x1FFE5DAC /end MEASUREMENT
/begin MEASUREMENT BSOF_IDchaMin "Minimum discharge current" FLOAT32_IEEE swc_CIL_CM_single_A 0 0 -3.40282346639e+038 3.40282346639e+038 ECU_ADDRESS 0x1FFE5DB0 /end MEASUREMENT
/begin MEASUREMENT BSOF_MsgChrgrRcgtn "flag of CHM recieved : 0-unrecieved, 0xAA-rerceived." UBYTE swc_CIL_CM_uint8_dash_ 0 0 0 255 ECU_ADDRESS 0x1FFE75CF /end MEASUREMENT
/begin MEASUREMENT BSOF_MsgChrgrRdy "For automated CAN tests" UBYTE swc_CIL_CM_uint8_dash_ 0 0 0 255 ECU_ADDRESS 0x1FFE75D0 /end MEASUREMENT
/begin MEASUREMENT BSOF_NrChrgrComVers "Communication protocol version number of charger; this Standard defines the present version as V1.1, and it is expressed as byte3, byte2-0001H; byte1-01H" UBYTE swc_CIL_CM_uint8_dash_ 0 0 0 255 ECU_ADDRESS 0x1FFE75D1 /end MEASUREMENT
/begin MEASUREMENT BSOF_SocDchaMax "maximun Soc dicharge allowed" UBYTE swc_CIL_CM_uint8_percent_ 0 0 0 255 ECU_ADDRESS 0x1FFE75D2 /end MEASUREMENT
/begin MEASUREMENT BSOF_SocDchaMin "minimun Soc dicharge allowed" UBYTE swc_CIL_CM_uint8_percent_ 0 0 0 255 ECU_ADDRESS 0x1FFE75D3 /end MEASUREMENT
/begin MEASUREMENT BSOF_TiChAccumd "Accumulated charging time (min)" UWORD swc_CIL_CM_uint16_min 0 0 0 65535 ECU_ADDRESS 0x1FFE74A4 /end MEASUREMENT
/begin MEASUREMENT BSOF_UChrgr "Voltage output (V)" FLOAT32_IEEE swc_CIL_CM_single_V 0 0 -3.40282346639e+038 3.40282346639e+038 ECU_ADDRESS 0x1FFE5DB4 /end MEASUREMENT
/begin MEASUREMENT BSOF_UChrgrMax "For automated CAN tests" FLOAT32_IEEE swc_CIL_CM_single_V 0 0 -3.40282346639e+038 3.40282346639e+038 ECU_ADDRESS 0x1FFE5DB8 /end MEASUREMENT
/begin MEASUREMENT BSOF_UChrgrMin "For automated CAN tests" FLOAT32_IEEE swc_CIL_CM_single_V 0 0 -3.40282346639e+038 3.40282346639e+038 ECU_ADDRESS 0x1FFE5DBC /end MEASUREMENT
/begin MEASUREMENT BSOF_UDchaMax "Maximum discharge voltage" FLOAT32_IEEE swc_CIL_CM_single_V 0 0 -3.40282346639e+038 3.40282346639e+038 ECU_ADDRESS 0x1FFE5DC0 /end MEASUREMENT
/begin MEASUREMENT BSOF_UDchaMin "Minimum discharge voltage" FLOAT32_IEEE swc_CIL_CM_single_V 0 0 -3.40282346639e+038 3.40282346639e+038 ECU_ADDRESS 0x1FFE5DC4 /end MEASUREMENT
/begin MEASUREMENT BSOF_bAcvDcChrgrPlg "flag of DC charger plug (CC2): 0-unplugged 1-plugged" UBYTE swc_CIL_CM_boolean_dash_ 0 0 0 1 ECU_ADDRESS 0x1FFE75FB /end MEASUREMENT
/begin MEASUREMENT BSOF_bEnaMsgChrgrChDetd "flag of CCD recieved : 0-unrecieved, 1-received" UBYTE swc_CIL_CM_boolean_dash_ 0 0 0 1 ECU_ADDRESS 0x1FFE75FC /end MEASUREMENT
/begin MEASUREMENT BSOF_bEnaMsgChrgrChSt "flag of CCS recieved : 0-unrecieved, 1-received" UBYTE swc_CIL_CM_boolean_dash_ 0 0 0 1 ECU_ADDRESS 0x1FFE75FD /end MEASUREMENT
/begin MEASUREMENT BSOF_bEnaMsgChrgrChSuspd "flag of CST recieved : 0-unrecieved, 1-received" UBYTE swc_CIL_CM_boolean_dash_ 0 0 0 1 ECU_ADDRESS 0x1FFE75FE /end MEASUREMENT
/begin MEASUREMENT BSOF_bEnaMsgChrgrDetnCnct "flag of CDC recieved : 0-unrecieved, 1-received" UBYTE swc_CIL_CM_boolean_dash_ 0 0 0 1 ECU_ADDRESS 0x1FFE75FF /end MEASUREMENT
/begin MEASUREMENT BSOF_bEnaMsgChrgrErr "flag of CEM recieved : 0-unrecieved, 1-received" UBYTE swc_CIL_CM_boolean_dash_ 0 0 0 1 ECU_ADDRESS 0x1FFE7600 /end MEASUREMENT
/begin MEASUREMENT BSOF_bEnaMsgChrgrHdshk "flag of CHM recieved : 0-unrecieved, 1-received" UBYTE swc_CIL_CM_boolean_dash_ 0 0 0 1 ECU_ADDRESS 0x1FFE7601 /end MEASUREMENT
/begin MEASUREMENT BSOF_bEnaMsgChrgrMaxOut "flag of CML recieved : 0-unrecieved, 1-received" UBYTE swc_CIL_CM_boolean_dash_ 0 0 0 1 ECU_ADDRESS 0x1FFE7602 /end MEASUREMENT
/begin MEASUREMENT BSOF_bEnaMsgChrgrMaxOutPgtn "flag of CMLP recieved : 0-unrecieved, 1-received" UBYTE swc_CIL_CM_boolean_dash_ 0 0 0 1 ECU_ADDRESS 0x1FFE7603 /end MEASUREMENT
/begin MEASUREMENT BSOF_bEnaMsgChrgrRcgtn "flag of CHM recieved : 0-unrecieved, 1-received" UBYTE swc_CIL_CM_boolean_dash_ 0 0 0 1 ECU_ADDRESS 0x1FFE7604 /end MEASUREMENT
/begin MEASUREMENT BSOF_bEnaMsgChrgrRdy "flag of CRO recieved : 0-unrecieved, 1-received" UBYTE swc_CIL_CM_boolean_dash_ 0 0 0 1 ECU_ADDRESS 0x1FFE7605 /end MEASUREMENT
/begin MEASUREMENT BSOF_bEnaMsgChrgrStstc "flag of CSD recieved : 0-unrecieved, 1-received" UBYTE swc_CIL_CM_boolean_dash_ 0 0 0 1 ECU_ADDRESS 0x1FFE7606 /end MEASUREMENT
/begin MEASUREMENT BSOF_bEnaMsgChrgrStstcForPgtn "flag of CSDP recieved : 0-unrecieved, 1-received" UBYTE swc_CIL_CM_boolean_dash_ 0 0 0 1 ECU_ADDRESS 0x1FFE7607 /end MEASUREMENT
/begin MEASUREMENT BSOF_bErrMsgTout "flag of CEM message timeout" ULONG swc_CIL_CM_uint32_dash_ 0 0 0 4294967295 ECU_ADDRESS 0x1FFE5DC8 /end MEASUREMENT
/begin MEASUREMENT BSTC_DayRtcLstNv "Non-volatile memory variable: Real time when the relays start to disconnect. Unit: day" UBYTE swc_BcuStTranCtl_CM_uint8_day 0 0 0 255 ECU_ADDRESS 0x1FFE7593 /end MEASUREMENT
/begin MEASUREMENT BSTC_ErrInfo "Error information of Bcu State Transition Control" ULONG swc_BcuStTranCtl_CM_uint32_dash_ 0 0 0 4294967295 ECU_ADDRESS 0x1FFE4C50 /end MEASUREMENT
/begin MEASUREMENT BSTC_HourRtcLstNv "Non-volatile memory variable: Real time when the relays start to disconnect. Unit: hour" UBYTE swc_BcuStTranCtl_CM_uint8_h 0 0 0 255 ECU_ADDRESS 0x1FFE7594 /end MEASUREMENT
/begin MEASUREMENT BSTC_MinuRtcLstNv "Non-volatile memory variable: Real time when the relays start to disconnect. Unit: minute" UBYTE swc_BcuStTranCtl_CM_uint8_min 0 0 0 255 ECU_ADDRESS 0x1FFE7595 /end MEASUREMENT
/begin MEASUREMENT BSTC_MonthRtcLstNv "Non-volatile memory variable: Real time when the relays start to disconnect. Unit: mouth" UBYTE swc_BcuStTranCtl_CM_uint8_month 0 0 0 255 ECU_ADDRESS 0x1FFE7596 /end MEASUREMENT
/begin MEASUREMENT BSTC_ReqEmcyHvOffFromBms "Emergency cut off  HV request from BMS" UBYTE swc_BcuStTranCtl_CM_uint8_dash_ 0 0 0 255 ECU_ADDRESS 0x1FFE7597 /end MEASUREMENT
/begin MEASUREMENT BSTC_ReqEmcyHvOffFromVcu "Emergency cut off  HV request from VCU" UBYTE swc_BcuStTranCtl_CM_boolean_dash_ 0 0 0 1 ECU_ADDRESS 0x1FFE759C /end MEASUREMENT
/begin MEASUREMENT BSTC_ReqShtdnBas "Bsw low voltage cutoff request\n      0x0: No request\n      0x1: Request  BSW save data\n      0x2: Request BSW LV cut off" UBYTE swc_BcuStTranCtl_CM_uint8_dash_ 0 0 0 255 ECU_ADDRESS 0x1FFE7598 /end MEASUREMENT
/begin MEASUREMENT BSTC_RstCmd "Command to reset various functions like error handler depending on wake signals." UBYTE swc_BcuStTranCtl_CM_boolean_dash_ 0 0 0 1 ECU_ADDRESS 0x1FFE759D /end MEASUREMENT
/begin MEASUREMENT BSTC_RstCmd100 "Command to reset various functions like error handler depending on wake signals. 100ms signal." UBYTE swc_BcuStTranCtl_CM_boolean_dash_ 0 0 0 1 ECU_ADDRESS 0x1FFE759E /end MEASUREMENT
/begin MEASUREMENT BSTC_SecRtcLstNv "Non-volatile memory variable: Real time when the relays start to disconnect. Unit: second" UBYTE swc_BcuStTranCtl_CM_uint8_s 0 0 0 255 ECU_ADDRESS 0x1FFE7599 /end MEASUREMENT
/begin MEASUREMENT BSTC_StBcu "BCU actual state\n      0x1: Initial\n      0x2: Standby\n      0x3: Discharging\n      0x4: Charging\n      0x5: Shutdown_HV\n      0x6: After run" UBYTE swc_BcuStTranCtl_CM_uint8_dash_ 0 0 0 255 ECU_ADDRESS 0x1FFE759A /end MEASUREMENT
/begin MEASUREMENT BSTC_StBcuInt "BCU internal state\n      " UBYTE swc_BcuStTranCtl_CM_uint8_dash_ 0 0 0 255 ECU_ADDRESS 0x1FFE759B /end MEASUREMENT
/begin MEASUREMENT BSTC_StBmsChk "Bms check state\n      0x0: No Error\n      0x1: Error" UBYTE swc_BcuStTranCtl_CM_boolean_dash_ 0 0 0 1 ECU_ADDRESS 0x1FFE759F /end MEASUREMENT
/begin MEASUREMENT BSTC_TiBalAftCh "BMS balance time after charging" FLOAT32_IEEE swc_BcuStTranCtl_CM_single_s 0 0 -3.40282346639e+038 3.40282346639e+038 ECU_ADDRESS 0x1FFE4C54 /end MEASUREMENT
/begin MEASUREMENT BSTC_TiBalAftChLst "BMS balance time after charging when relay disconnection is complete" FLOAT32_IEEE swc_BcuStTranCtl_CM_single_s 0 0 -3.40282346639e+038 3.40282346639e+038 ECU_ADDRESS 0x1FFE4C58 /end MEASUREMENT
/begin MEASUREMENT BSTC_TiBalForCh "Time since the last connect of the battery to the load circuit. This time stops to count at disconnecting of the main contactors." FLOAT32_IEEE swc_BcuStTranCtl_CM_single_s 0 0 -3.40282346639e+038 3.40282346639e+038 ECU_ADDRESS 0x1FFE4C5C /end MEASUREMENT
/begin MEASUREMENT BSTC_TiBatOff "Time since the last disconnect of the battery from the load circuit. This time stops to count at connecting of the main contactors." ULONG swc_BcuStTranCtl_CM_uint32_s 0 0 0 4294967295 ECU_ADDRESS 0x1FFE4C60 /end MEASUREMENT
/begin MEASUREMENT BSTC_TiBatOn "Time since the last connect of the battery to the load circuit. This time stops to count at disconnecting of the main contactors." ULONG swc_BcuStTranCtl_CM_uint32_s 0 0 0 4294967295 ECU_ADDRESS 0x1FFE4C64 /end MEASUREMENT
/begin MEASUREMENT BSTC_TrigChScs "The trigger of successful BMS charging" UBYTE swc_BcuStTranCtl_CM_boolean_dash_ 0 0 0 1 ECU_ADDRESS 0x1FFE75A0 /end MEASUREMENT
/begin MEASUREMENT BSTC_YearRtcLstNv "Non-volatile memory variable: Real time when the relays start to disconnect. Unit: year" UWORD swc_BcuStTranCtl_CM_uint16_year 0 0 0 65535 ECU_ADDRESS 0x1FFE7494 /end MEASUREMENT
/begin MEASUREMENT BSTC_bAcvCutoffLvFromBms "BMS allows that low voltage to be cut off\n      0x0: Not Allow\n      0x1: Allow\n      0x2: Reserved\n      0x3: Invalid" UBYTE swc_BcuStTranCtl_CM_boolean_dash_ 0 0 0 1 ECU_ADDRESS 0x1FFE75A1 /end MEASUREMENT
/begin MEASUREMENT BSTC_bAcvDcStChToStHvOffNorm "Transition BCU internal state from fast charge to normal shutdown" UBYTE swc_BcuStTranCtl_CM_boolean_dash_ 0 0 0 1 ECU_ADDRESS 0x1FFE75A2 /end MEASUREMENT
/begin MEASUREMENT BSTC_bAcvHvOffNormFromVcu "Vcu allows the BMS to shut down normally\n      0x0: Not Allow\n      0x1: Allow\n      0x2: Reserved\n      0x3: Invalid" UBYTE swc_BcuStTranCtl_CM_boolean_dash_ 0 0 0 1 ECU_ADDRESS 0x1FFE75A3 /end MEASUREMENT
/begin MEASUREMENT BSTC_bAcvObcOff "BMS allows OBC to shutoff\n      0x0: Not Allow\n      0x1: Allow\n      0x2: Reserved\n      0x3: Invalid" UBYTE swc_BcuStTranCtl_CM_boolean_dash_ 0 0 0 1 ECU_ADDRESS 0x1FFE75A4 /end MEASUREMENT
/begin MEASUREMENT BSTC_bAcvRstDecrTiBalForCh "Active flag for reseting reduced balance time" UBYTE swc_BcuStTranCtl_CM_boolean_dash_ 0 0 0 1 ECU_ADDRESS 0x1FFE75A5 /end MEASUREMENT
/begin MEASUREMENT BSTC_bAcvStAftRunToStInin "Transition BCU state from afterrun to Initialization" UBYTE swc_BcuStTranCtl_CM_boolean_dash_ 0 0 0 1 ECU_ADDRESS 0x1FFE75A6 /end MEASUREMENT
/begin MEASUREMENT BSTC_bAcvStAftRunToStSleep "Transition BCU state from afterrun to sleep" UBYTE swc_BcuStTranCtl_CM_boolean_dash_ 0 0 0 1 ECU_ADDRESS 0x1FFE75A7 /end MEASUREMENT
/begin MEASUREMENT BSTC_bAcvStDchaToStHvOffNorm "Transition BCU internal state from discharge to normal shutdown" UBYTE swc_BcuStTranCtl_CM_boolean_dash_ 0 0 0 1 ECU_ADDRESS 0x1FFE75A8 /end MEASUREMENT
/begin MEASUREMENT BSTC_bAcvStHvOffToStAftRun "Transition BCU state from Shutdown-HV to afterrun" UBYTE swc_BcuStTranCtl_CM_boolean_dash_ 0 0 0 1 ECU_ADDRESS 0x1FFE75A9 /end MEASUREMENT
/begin MEASUREMENT BSTC_bAcvStIninToStSleep "Transition BCU state from initialization to sleep" UBYTE swc_BcuStTranCtl_CM_boolean_dash_ 0 0 0 1 ECU_ADDRESS 0x1FFE75AA /end MEASUREMENT
/begin MEASUREMENT BSTC_bAcvStRunToStHvOffEmcy "Transition BCU internal state from discharge or charge to emergency shutdown" UBYTE swc_BcuStTranCtl_CM_boolean_dash_ 0 0 0 1 ECU_ADDRESS 0x1FFE75AB /end MEASUREMENT
/begin MEASUREMENT BSTC_bAcvStSleepToStInin "Transition BCU state from sleep to initialization" UBYTE swc_BcuStTranCtl_CM_boolean_dash_ 0 0 0 1 ECU_ADDRESS 0x1FFE75AC /end MEASUREMENT
/begin MEASUREMENT BSTC_bAcvStStbToStAftRun "Transition BCU state from standby to afterrun" UBYTE swc_BcuStTranCtl_CM_boolean_dash_ 0 0 0 1 ECU_ADDRESS 0x1FFE75AD /end MEASUREMENT
/begin MEASUREMENT BSTC_bAcvStStbToStDcha "Transition BCU state from standby to discharge" UBYTE swc_BcuStTranCtl_CM_boolean_dash_ 0 0 0 1 ECU_ADDRESS 0x1FFE75AE /end MEASUREMENT
/begin MEASUREMENT BSTC_bAcvTiDecrBal "active flag for when the battery balance time starts to decrease" UBYTE swc_BcuStTranCtl_CM_boolean_dash_ 0 0 0 1 ECU_ADDRESS 0x1FFE75AF /end MEASUREMENT
/begin MEASUREMENT BSTC_bAcvTranBtwnStDchaAndStCh "Transition BCU internal state between discharge and charge\n      0x0: Transition BCU internal state from charge to discharge\n      0x1: Transition BCU internal state from discharge to charge\n      " UBYTE swc_BcuStTranCtl_CM_boolean_dash_ 0 0 0 1 ECU_ADDRESS 0x1FFE75B0 /end MEASUREMENT
/begin MEASUREMENT BSTC_bErrHvOffAbno "BMS unanticipated power down failure\n      0x0: No Error\n      0x1: Error" UBYTE swc_BcuStTranCtl_CM_boolean_dash_ 0 0 0 1 ECU_ADDRESS 0x1FFE75B1 /end MEASUREMENT
/begin MEASUREMENT BSTC_bErrPwrOff "BMS failure to power down" UBYTE swc_BcuStTranCtl_CM_boolean_dash_ 0 0 0 1 ECU_ADDRESS 0x1FFE75B2 /end MEASUREMENT
/begin MEASUREMENT BSTC_bErrToutForRxCutoffLvReq "Error flag of timeout to receive low voltage off request from Vcu" UBYTE swc_BcuStTranCtl_CM_boolean_dash_ 0 0 0 1 ECU_ADDRESS 0x1FFE75B3 /end MEASUREMENT
/begin MEASUREMENT BSTC_bErrToutForRxHvOffReq "Receive the HV off request from VCU timeout" UBYTE swc_BcuStTranCtl_CM_boolean_dash_ 0 0 0 1 ECU_ADDRESS 0x1FFE75B4 /end MEASUREMENT
/begin MEASUREMENT BSTC_bErrToutForRxVldMsg "Receive a valid message timeout" UBYTE swc_BcuStTranCtl_CM_boolean_dash_ 0 0 0 1 ECU_ADDRESS 0x1FFE75B5 /end MEASUREMENT
/begin MEASUREMENT BSWIOSP_Mode_Request_shutdown "The app requests a low-voltage power down, and the application layer needs to detect whether the power down condition is met (0x0: No request\n      0x1: Request  BSW save data\n      0x2: Request BSW LV cut off)" UBYTE swc_COL_CM_uint8_dash_ 0 0 0 255 ECU_ADDRESS 0x1FFE767E /end MEASUREMENT
/begin MEASUREMENT BSWIOSP_Request_BCL "Request to send a BCL packet" UBYTE swc_COL_CM_uint8_dash_ 0 0 0 255 ECU_ADDRESS 0x1FFE767F /end MEASUREMENT
/begin MEASUREMENT BSWIOSP_Request_BCP "Request to send a BCP packet" UBYTE swc_COL_CM_uint8_dash_ 0 0 0 255 ECU_ADDRESS 0x1FFE7680 /end MEASUREMENT
/begin MEASUREMENT BSWIOSP_Request_BCPP "Request to send a BCPP packet" UBYTE swc_COL_CM_uint8_dash_ 0 0 0 255 ECU_ADDRESS 0x1FFE7681 /end MEASUREMENT
/begin MEASUREMENT BSWIOSP_Request_BCS "Request to send a BCS packet" UBYTE swc_COL_CM_uint8_dash_ 0 0 0 255 ECU_ADDRESS 0x1FFE7682 /end MEASUREMENT
/begin MEASUREMENT BSWIOSP_Request_BCSP "Request to send a BCSP packet" UBYTE swc_COL_CM_uint8_dash_ 0 0 0 255 ECU_ADDRESS 0x1FFE7683 /end MEASUREMENT
/begin MEASUREMENT BSWIOSP_Request_BDC "Request to send a BDC packet" UBYTE swc_COL_CM_uint8_dash_ 0 0 0 255 ECU_ADDRESS 0x1FFE7684 /end MEASUREMENT
/begin MEASUREMENT BSWIOSP_Request_BEM "Request to send a BEM packet" UBYTE swc_COL_CM_uint8_dash_ 0 0 0 255 ECU_ADDRESS 0x1FFE7685 /end MEASUREMENT
/begin MEASUREMENT BSWIOSP_Request_BHM "Request to send a BHM packet" UBYTE swc_COL_CM_uint8_dash_ 0 0 0 255 ECU_ADDRESS 0x1FFE7686 /end MEASUREMENT
/begin MEASUREMENT BSWIOSP_Request_BMS_FastChgStopInfo "Request send BMS_FastChgStopInfo message" UBYTE swc_COL_CM_uint8_dash_ 0 0 0 255 ECU_ADDRESS 0x1FFE7687 /end MEASUREMENT
/begin MEASUREMENT BSWIOSP_Request_BMT "Request to send a BMT packet" UBYTE swc_COL_CM_uint8_dash_ 0 0 0 255 ECU_ADDRESS 0x1FFE7688 /end MEASUREMENT
/begin MEASUREMENT BSWIOSP_Request_BMV "Request a BMV message" UBYTE swc_COL_CM_uint8_dash_ 0 0 0 255 ECU_ADDRESS 0x1FFE7689 /end MEASUREMENT
/begin MEASUREMENT BSWIOSP_Request_BRM "Request to send a BRM packet" UBYTE swc_COL_CM_uint8_dash_ 0 0 0 255 ECU_ADDRESS 0x1FFE768A /end MEASUREMENT
/begin MEASUREMENT BSWIOSP_Request_BRO "Request a BRO message" UBYTE swc_COL_CM_uint8_dash_ 0 0 0 255 ECU_ADDRESS 0x1FFE768B /end MEASUREMENT
/begin MEASUREMENT BSWIOSP_Request_BSD "Request to send a BSD message" UBYTE swc_COL_CM_uint8_dash_ 0 0 0 255 ECU_ADDRESS 0x1FFE768C /end MEASUREMENT
/begin MEASUREMENT BSWIOSP_Request_BSM "Request to send a BSM packet" UBYTE swc_COL_CM_uint8_dash_ 0 0 0 255 ECU_ADDRESS 0x1FFE768D /end MEASUREMENT
/begin MEASUREMENT BSWIOSP_Request_BSP "Request to send a BSP packet" UBYTE swc_COL_CM_uint8_dash_ 0 0 0 255 ECU_ADDRESS 0x1FFE768E /end MEASUREMENT
/begin MEASUREMENT BSWIOSP_Request_BST "Request to send a BST packet" UBYTE swc_COL_CM_uint8_dash_ 0 0 0 255 ECU_ADDRESS 0x1FFE768F /end MEASUREMENT
/begin MEASUREMENT BTHM_ErrChEnd "error to stopping charge" UBYTE swc_BatThermHndlgMngt_CM_uint8_dash_ 0 0 0 255 ECU_ADDRESS 0x1FFE75B6 /end MEASUREMENT
/begin MEASUREMENT BTHM_ErrInfo "Diagnosis for thermal management" ULONG swc_BatThermHndlgMngt_CM_uint32_dash_ 0 0 0 4294967295 ECU_ADDRESS 0x1FFE4C68 /end MEASUREMENT
/begin MEASUREMENT BTHM_IdCellTMax "Detecting point number of maximum temperature" UBYTE swc_BatThermHndlgMngt_CM_uint8_dash_ 0 0 0 255 ECU_ADDRESS 0x1FFE75B7 /end MEASUREMENT
/begin MEASUREMENT BTHM_IdCellTMin "Detecting point number of minimum temperature of traction battery" UBYTE swc_BatThermHndlgMngt_CM_uint8_dash_ 0 0 0 255 ECU_ADDRESS 0x1FFE75B8 /end MEASUREMENT
/begin MEASUREMENT BTHM_IdMdulTMax "ID of the module in which maximum temperature in the pack was measured" UBYTE swc_BatThermHndlgMngt_CM_uint8_dash_ 0 0 0 255 ECU_ADDRESS 0x1FFE75B9 /end MEASUREMENT
/begin MEASUREMENT BTHM_IdMdulTMin "ID of the module in which minimum temperature in the pack was measured" UBYTE swc_BatThermHndlgMngt_CM_uint8_dash_ 0 0 0 255 ECU_ADDRESS 0x1FFE75BA /end MEASUREMENT
/begin MEASUREMENT BTHM_MfCoolt "Massflow for cooling" FLOAT32_IEEE swc_BatThermHndlgMngt_CM_single_l_per_min 0 0 -3.40282346639e+038 3.40282346639e+038 ECU_ADDRESS 0x1FFE4C6C MATRIX_DIM 24 1 1 /end MEASUREMENT
/begin MEASUREMENT BTHM_StErrTOver "The diagnosis for temperature over \n      0:  OK\n      1:  Debouncing\n      2:  Error" UBYTE swc_BatThermHndlgMngt_CM_uint8_dash_ 0 0 0 255 ECU_ADDRESS 0x1FFE75BB /end MEASUREMENT
/begin MEASUREMENT BTHM_StRlyHeatReq "The request for heating relay" UBYTE swc_BatThermHndlgMngt_CM_uint8_dash_ 0 0 0 255 ECU_ADDRESS 0x1FFE75BC /end MEASUREMENT
/begin MEASUREMENT BTHM_StRlyMainNeg "request of main negtive relay" UBYTE swc_BatThermHndlgMngt_CM_uint8_dash_ 0 0 0 255 ECU_ADDRESS 0x1FFE75BD /end MEASUREMENT
/begin MEASUREMENT BTHM_StSys "state of thermal management" UWORD swc_BatThermHndlgMngt_CM_uint16_dash_ 0 0 0 65535 ECU_ADDRESS 0x1FFE7496 /end MEASUREMENT
/begin MEASUREMENT BTHM_StThermReq "Battery thermal request for VCU:\n      0 - homogenization of temperatures\n      1 - heating request\n      2 - cooling request" UBYTE swc_BatThermHndlgMngt_CM_uint8_dash_ 0 0 0 255 ECU_ADDRESS 0x1FFE75BE /end MEASUREMENT
/begin MEASUREMENT BTHM_TBatTgt "Target battery temperature" FLOAT32_IEEE swc_BatThermHndlgMngt_CM_single_degC 0 0 -3.40282346639e+038 3.40282346639e+038 ECU_ADDRESS 0x1FFE4CCC /end MEASUREMENT
/begin MEASUREMENT BTHM_TBcuSnsr "Measured value of BCU board temperature sensor." FLOAT32_IEEE swc_BatThermHndlgMngt_CM_single__ 0 0 -60 140 ECU_ADDRESS 0x1FFE4CD0 /end MEASUREMENT
/begin MEASUREMENT BTHM_TCooltPackInSnsr "Measured value of battery pack intake coolant temperature" FLOAT32_IEEE swc_BatThermHndlgMngt_CM_single__ 0 0 -60 140 ECU_ADDRESS 0x1FFE4CD4 /end MEASUREMENT
/begin MEASUREMENT BTHM_TCooltPackOutSnsr "Measured value of battery pack output coolant temperature" FLOAT32_IEEE swc_BatThermHndlgMngt_CM_single__ 0 0 -60 140 ECU_ADDRESS 0x1FFE4CD8 /end MEASUREMENT
/begin MEASUREMENT BTHM_TMdulCtlrSnsr "Temperature of Module Controller PCB." FLOAT32_IEEE swc_BatThermHndlgMngt_CM_single__ 0 0 -60 140 ECU_ADDRESS 0x1FFE4CDC MATRIX_DIM 32 1 1 /end MEASUREMENT
/begin MEASUREMENT BTHM_TMdulCtlrSnsrMax "Maximum measured MC temperature of battery pack." FLOAT32_IEEE swc_BatThermHndlgMngt_CM_single__ 0 0 -60 140 ECU_ADDRESS 0x1FFE4D5C /end MEASUREMENT
/begin MEASUREMENT BTHM_TMdulCtlrSnsrMin "Minimum measured MC temperature of battery pack." FLOAT32_IEEE swc_BatThermHndlgMngt_CM_single__ 0 0 -60 140 ECU_ADDRESS 0x1FFE4D60 /end MEASUREMENT
/begin MEASUREMENT BTHM_TMdulMaxAry "This array contains the maximum temperature of each module. The array position stands for the corresponding module index." FLOAT32_IEEE swc_BatThermHndlgMngt_CM_single__ 0 0 -60 140 ECU_ADDRESS 0x1FFE4D64 MATRIX_DIM 24 1 1 /end MEASUREMENT
/begin MEASUREMENT BTHM_TMdulMeanAry "This array contains the mean temperature of each module. The array position stands for the corresponding module index." FLOAT32_IEEE swc_BatThermHndlgMngt_CM_single__ 0 0 -60 140 ECU_ADDRESS 0x1FFE4DC4 MATRIX_DIM 24 1 1 /end MEASUREMENT
/begin MEASUREMENT BTHM_TMdulMinAry "This array contains the minimum temperature of each module. The array position stands for the corresponding module index." FLOAT32_IEEE swc_BatThermHndlgMngt_CM_single__ 0 0 -60 140 ECU_ADDRESS 0x1FFE4E24 MATRIX_DIM 24 1 1 /end MEASUREMENT
/begin MEASUREMENT BTHM_TMdulSnsr "Cell temperature sensor measurement values." FLOAT32_IEEE swc_BatThermHndlgMngt_CM_single__ 0 0 -60 140 ECU_ADDRESS 0x1FFE4E84 MATRIX_DIM 54 1 1 /end MEASUREMENT
/begin MEASUREMENT BTHM_TMdulSnsrMax "Maximum measured cell temperature of battery pack." FLOAT32_IEEE swc_BatThermHndlgMngt_CM_single__ 0 0 -60 140 ECU_ADDRESS 0x1FFE4F5C /end MEASUREMENT
/begin MEASUREMENT BTHM_TMdulSnsrMaxRaw "Maximum measured raw cell temperature of battery pack." FLOAT32_IEEE swc_BatThermHndlgMngt_CM_single__ 0 0 -60 140 ECU_ADDRESS 0x1FFE4F60 /end MEASUREMENT
/begin MEASUREMENT BTHM_TMdulSnsrMin "Minimum measured cell temperature of battery pack." FLOAT32_IEEE swc_BatThermHndlgMngt_CM_single__ 0 0 -60 140 ECU_ADDRESS 0x1FFE4F64 /end MEASUREMENT
/begin MEASUREMENT BTHM_TMdulSnsrMinRaw "Minimum measured raw cell temperature of battery pack." FLOAT32_IEEE swc_BatThermHndlgMngt_CM_single__ 0 0 -60 140 ECU_ADDRESS 0x1FFE4F68 /end MEASUREMENT
/begin MEASUREMENT BTHM_TMdulSnsrRaw "Not corrected temperature sensor measurement values." FLOAT32_IEEE swc_BatThermHndlgMngt_CM_single__ 0 0 -60 140 ECU_ADDRESS 0x1FFE4F6C MATRIX_DIM 54 1 1 /end MEASUREMENT
/begin MEASUREMENT BTHM_TOptmMax "Upper range of the optimal battery operation temperature" FLOAT32_IEEE swc_BatThermHndlgMngt_CM_single__ 0 0 -60 140 ECU_ADDRESS 0x1FFE5044 /end MEASUREMENT
/begin MEASUREMENT BTHM_TOptmMin "Lower range of the optimal battery operation temperature" FLOAT32_IEEE swc_BatThermHndlgMngt_CM_single__ 0 0 -60 140 ECU_ADDRESS 0x1FFE5048 /end MEASUREMENT
/begin MEASUREMENT BTHM_TPack "Mean Temperature of Pack" FLOAT32_IEEE swc_BatThermHndlgMngt_CM_single__ 0 0 -60 140 ECU_ADDRESS 0x1FFE504C /end MEASUREMENT
/begin MEASUREMENT BWLD_CtrCh "Cumulative number of battery charges (charger online)" UWORD swc_BatWntyLogtcData_CM_uint16_dash_ 0 0 0 65535 ECU_ADDRESS 0x1FFE7498 /end MEASUREMENT
/begin MEASUREMENT BWLD_CtrChNv "Non-volatile memory variable: Cumulative number of battery charges (charger online)" UWORD swc_BatWntyLogtcData_CM_uint16_dash_ 0 0 0 65535 ECU_ADDRESS 0x1FFE749A /end MEASUREMENT
/begin MEASUREMENT BWLD_CtrDcha "Cumulative number of battery discharges (V2V)" UWORD swc_BatWntyLogtcData_CM_uint16_dash_ 0 0 0 65535 ECU_ADDRESS 0x1FFE749C /end MEASUREMENT
/begin MEASUREMENT BWLD_CtrDchaNv "Non-volatile memory variable: Cumulative number of battery discharges (V2V)" UWORD swc_BatWntyLogtcData_CM_uint16_dash_ 0 0 0 65535 ECU_ADDRESS 0x1FFE749E /end MEASUREMENT
/begin MEASUREMENT BWLD_CtrMdulWrNv "Number of module controller NV write events." UWORD swc_BatWntyLogtcData_CM_uint16_dash_ 0 0 0 65535 ECU_ADDRESS 0x1FFE74A0 /end MEASUREMENT
/begin MEASUREMENT BWLD_CtrMdulWrNvTmp "Number of module controller NV write events temporary." UWORD swc_BatWntyLogtcData_CM_uint16_dash_ 0 0 0 65535 ECU_ADDRESS 0x1FFE74A2 /end MEASUREMENT
/begin MEASUREMENT BWLD_EBatChDrvCyc "Energy stored in battery during current operation cycle" FLOAT32_IEEE swc_BatWntyLogtcData_CM_single_kWh 0 0 0 1000000 ECU_ADDRESS 0x1FFE58C4 /end MEASUREMENT
/begin MEASUREMENT BWLD_EBatChTot "Total energy stored in battery during its life cycle" FLOAT32_IEEE swc_BatWntyLogtcData_CM_single_kWh 0 0 0 1000000000 ECU_ADDRESS 0x1FFE58C8 /end MEASUREMENT
/begin MEASUREMENT BWLD_EBatChTotNv "Non-volatile memory variable: total energy stored in battery during its life cycle" FLOAT32_IEEE swc_BatWntyLogtcData_CM_single_kWh 0 0 0 1000000000 ECU_ADDRESS 0x1FFE58CC /end MEASUREMENT
/begin MEASUREMENT BWLD_EBatChTotRaw "Total energy stored in battery during its life cycle" FLOAT32_IEEE swc_BatWntyLogtcData_CM_single_kWh 0 0 -3.40282346639e+038 3.40282346639e+038 ECU_ADDRESS 0x1FFE58D0 /end MEASUREMENT
/begin MEASUREMENT BWLD_EBatDchaDrvCyc "Energy supplied by battery during current operation cycle" FLOAT32_IEEE swc_BatWntyLogtcData_CM_single_kWh 0 0 0 1000000 ECU_ADDRESS 0x1FFE58D4 /end MEASUREMENT
/begin MEASUREMENT BWLD_EBatDchaTot "Total energy supplied by battery during its life cycle" FLOAT32_IEEE swc_BatWntyLogtcData_CM_single_kWh 0 0 0 1000000000 ECU_ADDRESS 0x1FFE58D8 /end MEASUREMENT
/begin MEASUREMENT BWLD_EBatDchaTotNv "Non-volatile memory variable: total energy supplied by battery during its life cycle" FLOAT32_IEEE swc_BatWntyLogtcData_CM_single_kWh 0 0 0 1000000000 ECU_ADDRESS 0x1FFE58DC /end MEASUREMENT
/begin MEASUREMENT BWLD_EBatDchaTotRaw "Total energy supplied by battery during its life cycle" FLOAT32_IEEE swc_BatWntyLogtcData_CM_single_kWh 0 0 -3.40282346639e+038 3.40282346639e+038 ECU_ADDRESS 0x1FFE58E0 /end MEASUREMENT
/begin MEASUREMENT BWLD_EBatMemChTot "Parameter to retrieve the total stored energy by battery during its life." FLOAT32_IEEE swc_BatWntyLogtcData_CM_single_kWh 0 0 0 1000000000 ECU_ADDRESS 0x1FFE58E4 /end MEASUREMENT
/begin MEASUREMENT BWLD_EBatMemDchaTot "Parameter to retrieve the total supplied energy by battery during its life." FLOAT32_IEEE swc_BatWntyLogtcData_CM_single_kWh 0 0 0 1000000000 ECU_ADDRESS 0x1FFE58E8 /end MEASUREMENT
/begin MEASUREMENT BWLD_IBatChMax "Maximum current during battery charging within its life cycle" FLOAT32_IEEE swc_BatWntyLogtcData_CM_single_A 0 0 0 2000 ECU_ADDRESS 0x1FFE58EC /end MEASUREMENT
/begin MEASUREMENT BWLD_IBatChMaxNv "Non-volatile memory variable: Maximum current during battery charging within its life cycle" FLOAT32_IEEE swc_BatWntyLogtcData_CM_single_A 0 0 0 2000 ECU_ADDRESS 0x1FFE58F0 /end MEASUREMENT
/begin MEASUREMENT BWLD_IBatChMaxRaw "Maximum current during battery charging within its life cycle" FLOAT32_IEEE swc_BatWntyLogtcData_CM_single_A 0 0 -3.40282346639e+038 3.40282346639e+038 ECU_ADDRESS 0x1FFE58F4 /end MEASUREMENT
/begin MEASUREMENT BWLD_IBatDchaMax "Maximum current during battery discharging within its life cycle" FLOAT32_IEEE swc_BatWntyLogtcData_CM_single_A 0 0 0 2000 ECU_ADDRESS 0x1FFE58F8 /end MEASUREMENT
/begin MEASUREMENT BWLD_IBatDchaMaxNv "Non-volatile memory variable: Maximum current during battery discharging within its life cycle" FLOAT32_IEEE swc_BatWntyLogtcData_CM_single_A 0 0 0 2000 ECU_ADDRESS 0x1FFE58FC /end MEASUREMENT
/begin MEASUREMENT BWLD_IBatDchaMaxRaw "Maximum current during battery discharging within its life cycle" FLOAT32_IEEE swc_BatWntyLogtcData_CM_single_A 0 0 -3.40282346639e+038 3.40282346639e+038 ECU_ADDRESS 0x1FFE5900 /end MEASUREMENT
/begin MEASUREMENT BWLD_LvlAcs "Global access level for service command requests. Is determined from current access key." UBYTE swc_BatWntyLogtcData_CM_uint8_dash_ 0 0 0 255 ECU_ADDRESS 0x1FFE75BF /end MEASUREMENT
/begin MEASUREMENT BWLD_LvlAcsRaw "Global access level for service command requests. Is determined from current access key." UBYTE swc_BatWntyLogtcData_CM_uint8_dash_ 0 0 0 255 ECU_ADDRESS 0x1FFE75C0 /end MEASUREMENT
/begin MEASUREMENT BWLD_PBatChMax "Maximum power during battery charging within its life cycle" FLOAT32_IEEE swc_BatWntyLogtcData_CM_single_kW 0 0 0 600 ECU_ADDRESS 0x1FFE5904 /end MEASUREMENT
/begin MEASUREMENT BWLD_PBatChMaxNv "Non-volatile memory variable: maximum power during battery charging within its life cycle" FLOAT32_IEEE swc_BatWntyLogtcData_CM_single_kW 0 0 0 600 ECU_ADDRESS 0x1FFE5908 /end MEASUREMENT
/begin MEASUREMENT BWLD_PBatChMaxRaw "Maximum power during battery charging within its life cycle" FLOAT32_IEEE swc_BatWntyLogtcData_CM_single_kW 0 0 -3.40282346639e+038 3.40282346639e+038 ECU_ADDRESS 0x1FFE590C /end MEASUREMENT
/begin MEASUREMENT BWLD_PBatDchaMax "Maximum power during battery discharging within its life cycle" FLOAT32_IEEE swc_BatWntyLogtcData_CM_single_kW 0 0 0 600 ECU_ADDRESS 0x1FFE5910 /end MEASUREMENT
/begin MEASUREMENT BWLD_PBatDchaMaxNv "Non-volatile memory variable: maximum power during battery discharging within its life cycle" FLOAT32_IEEE swc_BatWntyLogtcData_CM_single_kW 0 0 0 600 ECU_ADDRESS 0x1FFE5914 /end MEASUREMENT
/begin MEASUREMENT BWLD_PBatDchaMaxRaw "Maximum power during battery discharging within its life cycle" FLOAT32_IEEE swc_BatWntyLogtcData_CM_single_kW 0 0 -3.40282346639e+038 3.40282346639e+038 ECU_ADDRESS 0x1FFE5918 /end MEASUREMENT
/begin MEASUREMENT BWLD_SocBatMax "Maximum state of charge of battery during its life cycle" FLOAT32_IEEE swc_BatWntyLogtcData_CM_single_dash_ 0 0 0 1 ECU_ADDRESS 0x1FFE591C /end MEASUREMENT
/begin MEASUREMENT BWLD_SocBatMaxNv "Non-volatile memory variable: Maximum state of charge of battery during its life cycle" FLOAT32_IEEE swc_BatWntyLogtcData_CM_single_dash_ 0 0 0 1 ECU_ADDRESS 0x1FFE5920 /end MEASUREMENT
/begin MEASUREMENT BWLD_SocBatMaxRaw "Maximum state of charge of battery during its life cycle" FLOAT32_IEEE swc_BatWntyLogtcData_CM_single_dash_ 0 0 -3.40282346639e+038 3.40282346639e+038 ECU_ADDRESS 0x1FFE5924 /end MEASUREMENT
/begin MEASUREMENT BWLD_SocBatMin "Minimum state of charge of battery during its life cycle" FLOAT32_IEEE swc_BatWntyLogtcData_CM_single_dash_ 0 0 0 1 ECU_ADDRESS 0x1FFE5928 /end MEASUREMENT
/begin MEASUREMENT BWLD_SocBatMinNv "Non-volatile memory variable: Minimum state of charge of battery during its life cycle" FLOAT32_IEEE swc_BatWntyLogtcData_CM_single_dash_ 0 0 0 1 ECU_ADDRESS 0x1FFE592C /end MEASUREMENT
/begin MEASUREMENT BWLD_SocBatMinRaw "Minimum state of charge of battery during its life cycle" FLOAT32_IEEE swc_BatWntyLogtcData_CM_single_dash_ 0 0 -3.40282346639e+038 3.40282346639e+038 ECU_ADDRESS 0x1FFE5930 /end MEASUREMENT
/begin MEASUREMENT BWLD_TMdulSnsrMax "Maximum temperature measured by sensors in battery modules during battery life cycle" FLOAT32_IEEE swc_BatWntyLogtcData_CM_single__ 0 0 -60 140 ECU_ADDRESS 0x1FFE5934 /end MEASUREMENT
/begin MEASUREMENT BWLD_TMdulSnsrMaxNv "Non-volatile memory variable: Maximum temperature measured by sensors in battery modules during battery life cycle" FLOAT32_IEEE swc_BatWntyLogtcData_CM_single__ 0 0 -60 140 ECU_ADDRESS 0x1FFE5938 /end MEASUREMENT
/begin MEASUREMENT BWLD_TMdulSnsrMaxRaw "Maximum temperature measured by sensors in battery modules during battery life cycle" FLOAT32_IEEE swc_BatWntyLogtcData_CM_single_C_ 0 0 -3.40282346639e+038 3.40282346639e+038 ECU_ADDRESS 0x1FFE593C /end MEASUREMENT
/begin MEASUREMENT BWLD_TMdulSnsrMin "Minimum temperature measured by sensors in battery modules during battery life cycle" FLOAT32_IEEE swc_BatWntyLogtcData_CM_single__ 0 0 -60 140 ECU_ADDRESS 0x1FFE5940 /end MEASUREMENT
/begin MEASUREMENT BWLD_TMdulSnsrMinNv "Non-volatile memory variable: Minimum temperature measured by sensors in battery modules during battery life cycle" FLOAT32_IEEE swc_BatWntyLogtcData_CM_single__ 0 0 -60 140 ECU_ADDRESS 0x1FFE5944 /end MEASUREMENT
/begin MEASUREMENT BWLD_TMdulSnsrMinRaw "Minimum temperature measured by sensors in battery modules during battery life cycle" FLOAT32_IEEE swc_BatWntyLogtcData_CM_single_C_ 0 0 -3.40282346639e+038 3.40282346639e+038 ECU_ADDRESS 0x1FFE5948 /end MEASUREMENT
/begin MEASUREMENT BWLD_TiBatAgi "Time of battery in use with closed contactors" ULONG swc_BatWntyLogtcData_CM_uint32_s 0 0 0 4294967295 ECU_ADDRESS 0x1FFE594C /end MEASUREMENT
/begin MEASUREMENT BWLD_TiBatAgiNv "Non-volatile memory variable: Time of battery in use with closed contactors" ULONG swc_BatWntyLogtcData_CM_uint32_s 0 0 0 4294967295 ECU_ADDRESS 0x1FFE5950 /end MEASUREMENT
/begin MEASUREMENT BWLD_TiBatAgiRaw "Time of battery in use with closed contactors" ULONG swc_BatWntyLogtcData_CM_uint32_s 0 0 0 4294967295 ECU_ADDRESS 0x1FFE5954 /end MEASUREMENT
/begin MEASUREMENT BWLD_UBatCtctrClsdMax "Maximum voltage of battery with closed contactors during its life cycle" FLOAT32_IEEE swc_BatWntyLogtcData_CM_single_V 0 0 0 1000 ECU_ADDRESS 0x1FFE5958 /end MEASUREMENT
/begin MEASUREMENT BWLD_UBatCtctrClsdMaxNv "Non-volatile memory variable: Maximum voltage of battery with closed contactors during its life cycle" FLOAT32_IEEE swc_BatWntyLogtcData_CM_single_V 0 0 0 1000 ECU_ADDRESS 0x1FFE595C /end MEASUREMENT
/begin MEASUREMENT BWLD_UBatCtctrClsdMaxRaw "Maximum voltage of battery with closed contactors during its life cycle" FLOAT32_IEEE swc_BatWntyLogtcData_CM_single_V 0 0 -3.40282346639e+038 3.40282346639e+038 ECU_ADDRESS 0x1FFE5960 /end MEASUREMENT
/begin MEASUREMENT BWLD_UBatCtctrClsdMin "Minimum voltage of battery with closed contactors during its life cycle" FLOAT32_IEEE swc_BatWntyLogtcData_CM_single_V 0 0 0 1000 ECU_ADDRESS 0x1FFE5964 /end MEASUREMENT
/begin MEASUREMENT BWLD_UBatCtctrClsdMinNv "Non-volatile memory variable: Minimum voltage of battery with closed contactors during its life cycle" FLOAT32_IEEE swc_BatWntyLogtcData_CM_single_V 0 0 0 1000 ECU_ADDRESS 0x1FFE5968 /end MEASUREMENT
/begin MEASUREMENT BWLD_UBatCtctrClsdMinRaw "Minimum voltage of battery with closed contactors during its life cycle" FLOAT32_IEEE swc_BatWntyLogtcData_CM_single_V 0 0 -3.40282346639e+038 3.40282346639e+038 ECU_ADDRESS 0x1FFE596C /end MEASUREMENT
/begin MEASUREMENT BWLD_UBatCtctrOpenMax "Maximum voltage of battery with open contactors during its life cycle" FLOAT32_IEEE swc_BatWntyLogtcData_CM_single_V 0 0 0 1000 ECU_ADDRESS 0x1FFE5970 /end MEASUREMENT
/begin MEASUREMENT BWLD_UBatCtctrOpenMaxNv "Non-volatile memory variable: Maximum voltage of battery with open contactors during its life cycle" FLOAT32_IEEE swc_BatWntyLogtcData_CM_single_V 0 0 0 1000 ECU_ADDRESS 0x1FFE5974 /end MEASUREMENT
/begin MEASUREMENT BWLD_UBatCtctrOpenMaxRaw "Maximum voltage of battery with open contactors during its life cycle" FLOAT32_IEEE swc_BatWntyLogtcData_CM_single_V 0 0 -3.40282346639e+038 3.40282346639e+038 ECU_ADDRESS 0x1FFE5978 /end MEASUREMENT
/begin MEASUREMENT BWLD_UBatCtctrOpenMin "Minimum voltage of battery with open contactors during its life cycle" FLOAT32_IEEE swc_BatWntyLogtcData_CM_single_V 0 0 0 1000 ECU_ADDRESS 0x1FFE597C /end MEASUREMENT
/begin MEASUREMENT BWLD_UBatCtctrOpenMinNv "Non-volatile memory variable: Minimum voltage of battery with open contactors during its life cycle" FLOAT32_IEEE swc_BatWntyLogtcData_CM_single_V 0 0 0 1000 ECU_ADDRESS 0x1FFE5980 /end MEASUREMENT
/begin MEASUREMENT BWLD_UBatCtctrOpenMinRaw "Minimum voltage of battery with open contactors during its life cycle" FLOAT32_IEEE swc_BatWntyLogtcData_CM_single_V 0 0 -3.40282346639e+038 3.40282346639e+038 ECU_ADDRESS 0x1FFE5984 /end MEASUREMENT
/begin MEASUREMENT BWLD_UCellMax "Maximum cell voltage of battery during its life cycle" FLOAT32_IEEE swc_BatWntyLogtcData_CM_single_V 0 0 0 5 ECU_ADDRESS 0x1FFE5988 /end MEASUREMENT
/begin MEASUREMENT BWLD_UCellMaxNv "Non-volatile memory variable: Maximum cell voltage of battery during its life cycle" FLOAT32_IEEE swc_BatWntyLogtcData_CM_single_V 0 0 0 5 ECU_ADDRESS 0x1FFE598C /end MEASUREMENT
/begin MEASUREMENT BWLD_UCellMaxRaw "Maximum cell voltage of battery during its life cycle" FLOAT32_IEEE swc_BatWntyLogtcData_CM_single_V 0 0 -3.40282346639e+038 3.40282346639e+038 ECU_ADDRESS 0x1FFE5990 /end MEASUREMENT
/begin MEASUREMENT BWLD_UCellMin "Minimum cell voltage of battery during its life cycle" FLOAT32_IEEE swc_BatWntyLogtcData_CM_single_V 0 0 0 5 ECU_ADDRESS 0x1FFE5994 /end MEASUREMENT
/begin MEASUREMENT BWLD_UCellMinNv "Non-volatile memory variable: Minimum cell voltage of battery during its life cycle" FLOAT32_IEEE swc_BatWntyLogtcData_CM_single_V 0 0 0 5 ECU_ADDRESS 0x1FFE5998 /end MEASUREMENT
/begin MEASUREMENT BWLD_UCellMinRaw "Minimum cell voltage of battery during its life cycle" FLOAT32_IEEE swc_BatWntyLogtcData_CM_single_V 0 0 -3.40282346639e+038 3.40282346639e+038 ECU_ADDRESS 0x1FFE599C /end MEASUREMENT
/begin MEASUREMENT BatteryChargingOvercurrent "BSM: Power battery charging (discharging) overcurrent" UBYTE swc_COL_CM_uint8_A 0 0 0 255 ECU_ADDRESS 0x1FFE7690 /end MEASUREMENT
/begin MEASUREMENT BatteryExcessTemperature "BSM: The power battery temperature is too high" UBYTE swc_COL_CM_uint8_dash_ 0 0 0 255 ECU_ADDRESS 0x1FFE7691 /end MEASUREMENT
/begin MEASUREMENT BatteryHighestTemp "BSM: Maximum power battery temperature" UBYTE swc_COL_CM_uint8___C 0 0 0 255 ECU_ADDRESS 0x1FFE7692 /end MEASUREMENT
/begin MEASUREMENT BatteryHighestTempSerNo "BSM: Maximum Temperature Detection Point Number" UBYTE swc_COL_CM_uint8_dash_ 0 0 0 255 ECU_ADDRESS 0x1FFE7693 /end MEASUREMENT
/begin MEASUREMENT BatteryInsulationState "BSM: Power battery insulation state" UBYTE swc_COL_CM_uint8_dash_ 0 0 0 255 ECU_ADDRESS 0x1FFE7694 /end MEASUREMENT
/begin MEASUREMENT BatteryLowestTemp "BSM: Minimum power battery temperature" UBYTE swc_COL_CM_uint8___C 0 0 0 255 ECU_ADDRESS 0x1FFE7695 /end MEASUREMENT
/begin MEASUREMENT BatteryLowestTempSerNo "BSM: Minimum power battery temperature detection point number" UBYTE swc_COL_CM_uint8_dash_ 0 0 0 255 ECU_ADDRESS 0x1FFE7696 /end MEASUREMENT
/begin MEASUREMENT BatteryOutputConnectorState "BSM: Power battery pack output connector connection status" UBYTE swc_COL_CM_uint8_dash_ 0 0 0 255 ECU_ADDRESS 0x1FFE7697 /end MEASUREMENT
/begin MEASUREMENT BatterySystemCapacity "BRM rated capacity" UWORD swc_COL_CM_uint16_Ah 0 0 0 65535 ECU_ADDRESS 0x1FFE74EC /end MEASUREMENT
/begin MEASUREMENT BatterySystemVoltage "BRM rated total pressure" UWORD swc_COL_CM_uint16_V 0 0 0 65535 ECU_ADDRESS 0x1FFE74EE /end MEASUREMENT
/begin MEASUREMENT BatteryType "BRM battery type: Send 03H: lithium iron phosphate battery" UBYTE swc_COL_CM_uint8_dash_ 0 0 0 255 ECU_ADDRESS 0x1FFE7698 /end MEASUREMENT
/begin MEASUREMENT BmsReadyForCharging "BRO: Whether the vehicle is ready to charge (discharge) (<0x00 >: = idle waiting; <0xAA >: = normal working mode ready; <0xFF>:= invalid)" UBYTE swc_COL_CM_uint8_dash_ 0 0 0 255 ECU_ADDRESS 0x1FFE7699 /end MEASUREMENT
/begin MEASUREMENT BmsRevision "BRM software version: send calibration, must be sent, 0x101" UBYTE swc_COL_CM_uint8_dash_ 0 0 0 255 ECU_ADDRESS 0x1FFE769A /end MEASUREMENT
/begin MEASUREMENT BmsSoftwareVersion_CompileDay "BRM software version: send calibration, must be sent, 0x101" UWORD swc_COL_CM_uint16_dash_ 0 0 0 65535 ECU_ADDRESS 0x1FFE74F0 /end MEASUREMENT
/begin MEASUREMENT BmsSuspCause_ActiveSuspend "BST: The charging (discharging) motor is actively aborted" UBYTE swc_COL_CM_uint8_dash_ 0 0 0 255 ECU_ADDRESS 0x1FFE769B /end MEASUREMENT
/begin MEASUREMENT BmsSuspCause_SOC "BST reaches SOC setpoint" UBYTE swc_COL_CM_uint8_dash_ 0 0 0 255 ECU_ADDRESS 0x1FFE769C /end MEASUREMENT
/begin MEASUREMENT BmsSuspCause_SingleVoltage "BST reaches the monomer voltage setpoint" UBYTE swc_COL_CM_uint8_dash_ 0 0 0 255 ECU_ADDRESS 0x1FFE769D /end MEASUREMENT
/begin MEASUREMENT BmsSuspCause_TotalVoltage "BST reaches the total voltage setpoint" UBYTE swc_COL_CM_uint8_dash_ 0 0 0 255 ECU_ADDRESS 0x1FFE769E /end MEASUREMENT
/begin MEASUREMENT BmsSuspError_AbnormalVoltage "The BST voltage is abnormal" UBYTE swc_COL_CM_uint8_dash_ 0 0 0 255 ECU_ADDRESS 0x1FFE769F /end MEASUREMENT
/begin MEASUREMENT BmsSuspError_ExcessiveCurrent "BST current is too large" UBYTE swc_COL_CM_uint8_dash_ 0 0 0 255 ECU_ADDRESS 0x1FFE76A0 /end MEASUREMENT
/begin MEASUREMENT BmsSuspFault_BatteryTemp "BST battery pack temperature too high fault" UBYTE swc_COL_CM_uint8_dash_ 0 0 0 255 ECU_ADDRESS 0x1FFE76A1 /end MEASUREMENT
/begin MEASUREMENT BmsSuspFault_BmsTemp "BST BMS components, output connectors are overtemperatured" UBYTE swc_COL_CM_uint8_dash_ 0 0 0 255 ECU_ADDRESS 0x1FFE76A2 /end MEASUREMENT
/begin MEASUREMENT BmsSuspFault_ChargeConn "The BST charging connector is faulty" UBYTE swc_COL_CM_uint8_dash_ 0 0 0 255 ECU_ADDRESS 0x1FFE76A3 /end MEASUREMENT
/begin MEASUREMENT BmsSuspFault_Insulation "BST insulation failure" UBYTE swc_COL_CM_uint8_dash_ 0 0 0 255 ECU_ADDRESS 0x1FFE76A4 /end MEASUREMENT
/begin MEASUREMENT BmsSuspFault_OtherFaults "BST other failures" UBYTE swc_COL_CM_uint8_dash_ 0 0 0 255 ECU_ADDRESS 0x1FFE76A5 /end MEASUREMENT
/begin MEASUREMENT BmsSuspFault_OutputConnTemp "BST output connector overtemperature fault" UBYTE swc_COL_CM_uint8_dash_ 0 0 0 255 ECU_ADDRESS 0x1FFE76A6 /end MEASUREMENT
/begin MEASUREMENT BmsSuspFault_VoltageDetection "BST Check Point 2 voltage detection fault" UBYTE swc_COL_CM_uint8_dash_ 0 0 0 255 ECU_ADDRESS 0x1FFE76A7 /end MEASUREMENT
/begin MEASUREMENT BmsSuspFault_VoltageRelay "BST high voltage relay failure" UBYTE swc_COL_CM_uint8_dash_ 0 0 0 255 ECU_ADDRESS 0x1FFE76A8 /end MEASUREMENT
/begin MEASUREMENT BmsVersion "BRM software version: send calibration, must be sent, 0x101" UWORD swc_COL_CM_uint16_dash_ 0 0 0 65535 ECU_ADDRESS 0x1FFE74F2 /end MEASUREMENT
/begin MEASUREMENT BmuControl_BalanceControl "Passive equalization control (each bit pair should be the position of the cell under the module, and the array dimension subscript corresponds to the module)" ULONG swc_COL_CM_uint32_dash_ 0 0 0 4294967295 ECU_ADDRESS 0x1FFE6100 MATRIX_DIM 9 1 1 /end MEASUREMENT
/begin MEASUREMENT BsmChargingPermissible "BSM: Charging (discharging) permitted" UBYTE swc_COL_CM_uint8_dash_ 0 0 0 255 ECU_ADDRESS 0x1FFE76A9 /end MEASUREMENT
/begin MEASUREMENT CIL_CtrIslnRSamplg "Insulation resistance sampling count" UWORD swc_CIL_CM_uint16_dash_ 0 0 0 65535 ECU_ADDRESS 0x1FFE74A6 /end MEASUREMENT
/begin MEASUREMENT CIL_DayRtc "Real time clcok - day" UBYTE swc_CIL_CM_uint8_day 0 0 0 255 ECU_ADDRESS 0x1FFE75D4 /end MEASUREMENT
/begin MEASUREMENT CIL_DucycCrash "Crash duty cycle response" ULONG swc_CIL_CM_uint32_percent_ 0 0 0 4294967295 ECU_ADDRESS 0x1FFE5DCC /end MEASUREMENT
/begin MEASUREMENT CIL_DucycCtlPilot "CP duty" UBYTE swc_CIL_CM_uint8_dash_ 0 0 0 255 ECU_ADDRESS 0x1FFE75D5 /end MEASUREMENT
/begin MEASUREMENT CIL_DucycHvil "High voltage interlock loop duty cycle response" ULONG swc_CIL_CM_uint32_percent_ 0 0 0 4294967295 ECU_ADDRESS 0x1FFE5DD0 /end MEASUREMENT
/begin MEASUREMENT CIL_ErrAcScktSnsrT "Error in the temperature sensor of the AC charging socket\n      1:Hardware failure\n      2:Disconnect\n      4:Short circuit" UBYTE swc_CIL_CM_uint8_dash_ 0 0 0 255 ECU_ADDRESS 0x1FFE75D6 /end MEASUREMENT
/begin MEASUREMENT CIL_ErrDcScktSnsrT "Error in the temperature sensor of the DC charging socket\n      1:Hardware failure\n      2:Disconnect\n      4:Short circuit" UBYTE swc_CIL_CM_uint8_dash_ 0 0 0 255 ECU_ADDRESS 0x1FFE75D7 /end MEASUREMENT
/begin MEASUREMENT CIL_FrqCrash "Crash frequency response" ULONG swc_CIL_CM_uint32_Hz 0 0 0 4294967295 ECU_ADDRESS 0x1FFE5DD4 /end MEASUREMENT
/begin MEASUREMENT CIL_FrqHvil "High voltage interlock loop frequency response" ULONG swc_CIL_CM_uint32_Hz 0 0 0 4294967295 ECU_ADDRESS 0x1FFE5DD8 /end MEASUREMENT
/begin MEASUREMENT CIL_HourRtc "Real time clock - hour" UBYTE swc_CIL_CM_uint8_h 0 0 0 255 ECU_ADDRESS 0x1FFE75D8 /end MEASUREMENT
/begin MEASUREMENT CIL_IBatHv "HV battery current" FLOAT32_IEEE swc_CIL_CM_single_A 0 0 -3.40282346639e+038 3.40282346639e+038 ECU_ADDRESS 0x1FFE5DDC /end MEASUREMENT
/begin MEASUREMENT CIL_IDcdcLvAct "Current at the low voltage side of DCDC" UBYTE swc_CIL_CM_uint8_A 0 0 0 255 ECU_ADDRESS 0x1FFE75D9 /end MEASUREMENT
/begin MEASUREMENT CIL_IEACAct "current of electric air condition" FLOAT32_IEEE swc_CIL_CM_single_A 0 0 -3.40282346639e+038 3.40282346639e+038 ECU_ADDRESS 0x1FFE5DE0 /end MEASUREMENT
/begin MEASUREMENT CIL_IObcChOutp "Output charging current of Obc" FLOAT32_IEEE swc_CIL_CM_single_A 0 0 -500 65035 ECU_ADDRESS 0x1FFE5DE4 /end MEASUREMENT
/begin MEASUREMENT CIL_MinuRtc "Real time clock - minute" UBYTE swc_CIL_CM_uint8_min 0 0 0 255 ECU_ADDRESS 0x1FFE75DA /end MEASUREMENT
/begin MEASUREMENT CIL_ModeMotDrv "Drive motor operation mode(0x0: Idle mode 0x1: Driving mode 0x2: Reverse mode 0x3: Brake power regeneration 0x4: Ready to cut off low voltage or sleep 0x5: Discharging 0x6: Discharge finish 0x7: Initializing 0xF: Invalid)" UBYTE swc_CIL_CM_uint8_dash_ 0 0 0 255 ECU_ADDRESS 0x1FFE75DB /end MEASUREMENT
/begin MEASUREMENT CIL_ModeSysWup "Wake-up mode\n      0: Unknown wake-up source.\n      1: This time wake up by hard line.\n      2: Wake up by Rtc this time\n      3: Wake up by Can this time" UBYTE swc_CIL_CM_uint8_dash_ 0 0 0 255 ECU_ADDRESS 0x1FFE75DC /end MEASUREMENT
/begin MEASUREMENT CIL_MonthRtc "Real time clock - month" UBYTE swc_CIL_CM_uint8_month 0 0 0 255 ECU_ADDRESS 0x1FFE75DD /end MEASUREMENT
/begin MEASUREMENT CIL_PwrEACAct "power of electric air condition" FLOAT32_IEEE swc_CIL_CM_single_kW 0 0 -3.40282346639e+038 3.40282346639e+038 ECU_ADDRESS 0x1FFE5DE8 /end MEASUREMENT
/begin MEASUREMENT CIL_PwrPtcAct "power of PTC" FLOAT32_IEEE swc_CIL_CM_single_kW 0 0 -3.40282346639e+038 3.40282346639e+038 ECU_ADDRESS 0x1FFE5DEC /end MEASUREMENT
/begin MEASUREMENT CIL_RAcChCnctn "CC resistance" UBYTE swc_CIL_CM_uint8_dash_ 0 0 0 255 ECU_ADDRESS 0x1FFE75DE /end MEASUREMENT
/begin MEASUREMENT CIL_RIslnNeg "Negative insulation resistance value" SLONG swc_CIL_CM_int32_kOhm 0 0 -2147483648 2147483647 ECU_ADDRESS 0x1FFE5DF0 /end MEASUREMENT
/begin MEASUREMENT CIL_RIslnPos "Positive insulation resistance value" SLONG swc_CIL_CM_int32_kOhm 0 0 -2147483648 2147483647 ECU_ADDRESS 0x1FFE5DF4 /end MEASUREMENT
/begin MEASUREMENT CIL_RngElec "Pure electric range" FLOAT32_IEEE swc_CIL_CM_single_km 0 0 -3.40282346639e+038 3.40282346639e+038 ECU_ADDRESS 0x1FFE5DF8 /end MEASUREMENT
/begin MEASUREMENT CIL_SecRtc "Real time clock - second" UBYTE swc_CIL_CM_uint8_s 0 0 0 255 ECU_ADDRESS 0x1FFE75DF /end MEASUREMENT
/begin MEASUREMENT CIL_SpdMot "MCU motor speed" FLOAT32_IEEE swc_CIL_CM_single_rpm 0 0 -3.40282346639e+038 3.40282346639e+038 ECU_ADDRESS 0x1FFE5DFC /end MEASUREMENT
/begin MEASUREMENT CIL_SpdVeh "Vehicle speed" FLOAT32_IEEE swc_CIL_CM_single_km_per_h 0 0 -3.40282346639e+038 3.40282346639e+038 ECU_ADDRESS 0x1FFE5E00 /end MEASUREMENT
/begin MEASUREMENT CIL_StAcChCnct "State of CC from Obc" UBYTE swc_CIL_CM_uint8_dash_ 0 0 0 255 ECU_ADDRESS 0x1FFE75E0 /end MEASUREMENT
/begin MEASUREMENT CIL_StBatHvReq "high voltage control request to HV battery(0x0: No request 0x1: HV on 0x2: Normal cut off HV 0x3: Emergency cut off  HV)" UBYTE swc_CIL_CM_uint8_dash_ 0 0 0 255 ECU_ADDRESS 0x1FFE75E1 /end MEASUREMENT
/begin MEASUREMENT CIL_StBatLvCutoffReq "battery low voltage cutoff request (0x0: No request 0x1: Power off 0x2: Reserved 0x3: Invalid)" UBYTE swc_CIL_CM_uint8_dash_ 0 0 0 255 ECU_ADDRESS 0x1FFE75E2 /end MEASUREMENT
/begin MEASUREMENT CIL_StCellT "Cell temperature state\n      1: open circuit\n      2: short circuit" UBYTE swc_CIL_CM_uint8_dash_ 0 0 0 255 ECU_ADDRESS 0x1FFE5FD0 MATRIX_DIM 18 1 1 /end MEASUREMENT
/begin MEASUREMENT CIL_StCellTSamplgExcpn "Cell temperature sampling disconnection status:\n      0 No disconnection\n      1 Single disconnection\n      2 Multiple disconnections" UBYTE swc_CIL_CM_uint8_dash_ 0 0 0 255 ECU_ADDRESS 0x1FFE75E3 /end MEASUREMENT
/begin MEASUREMENT CIL_StCellUSamplgExcpn "Cell voltage sampling disconnection status:\n      0 No disconnection\n      1 Single disconnection\n      2 Multiple disconnections" UBYTE swc_CIL_CM_uint8_dash_ 0 0 0 255 ECU_ADDRESS 0x1FFE75E4 /end MEASUREMENT
/begin MEASUREMENT CIL_StChAllwd "Charge allowed from VCU" UBYTE swc_CIL_CM_uint8_dash_ 0 0 0 255 ECU_ADDRESS 0x1FFE75E5 /end MEASUREMENT
/begin MEASUREMENT CIL_StChWup "A+ signal status (0x0: off 0x1: on)" UBYTE swc_CIL_CM_uint8_dash_ 0 0 0 255 ECU_ADDRESS 0x1FFE75E6 /end MEASUREMENT
/begin MEASUREMENT CIL_StCrash "Crash output status indicated by ACU" UBYTE swc_CIL_CM_uint8_dash_ 0 0 0 255 ECU_ADDRESS 0x1FFE75E7 /end MEASUREMENT
/begin MEASUREMENT CIL_StMsgToutForPMS "PMS CAN message timeout flag (0x0: no timeout 0x1: timeout)" UBYTE swc_CIL_CM_uint8_dash_ 0 0 0 255 ECU_ADDRESS 0x1FFE75E8 /end MEASUREMENT
/begin MEASUREMENT CIL_StObc "On board charger status" UBYTE swc_CIL_CM_uint8_dash_ 0 0 0 255 ECU_ADDRESS 0x1FFE75E9 /end MEASUREMENT
/begin MEASUREMENT CIL_StPtIndcr "Powertrain READY indicator state\n      0x0: No Ready\n      0x1: Ready\n      0x2: Error\n      0x3: Invalid" UBYTE swc_CIL_CM_uint8_dash_ 0 0 0 255 ECU_ADDRESS 0x1FFE75EA /end MEASUREMENT
/begin MEASUREMENT CIL_StPtcW "State of ptc work mode" UBYTE swc_CIL_CM_uint8_dash_ 0 0 0 255 ECU_ADDRESS 0x1FFE75EB /end MEASUREMENT
/begin MEASUREMENT CIL_StTrml15 "KL15 state (0x0: off 0x1: on)" UBYTE swc_CIL_CM_uint8_dash_ 0 0 0 255 ECU_ADDRESS 0x1FFE75EC /end MEASUREMENT
/begin MEASUREMENT CIL_TAcChPointNeg "Slow charging port negative contact temperature" FLOAT32_IEEE swc_CIL_CM_single__ 0 0 -3.40282346639e+038 3.40282346639e+038 ECU_ADDRESS 0x1FFE5E04 /end MEASUREMENT
/begin MEASUREMENT CIL_TAcChPointPos "Slow charging port positive contact temperature" FLOAT32_IEEE swc_CIL_CM_single__ 0 0 -3.40282346639e+038 3.40282346639e+038 ECU_ADDRESS 0x1FFE5E08 /end MEASUREMENT
/begin MEASUREMENT CIL_TBdSnsr "Temperature of the BCU board" FLOAT32_IEEE swc_CIL_CM_single__ 0 0 -3.40282346639e+038 3.40282346639e+038 ECU_ADDRESS 0x1FFE5E0C MATRIX_DIM 9 1 1 /end MEASUREMENT
/begin MEASUREMENT CIL_TCooltPackInSnsr "Temperature of water inlet" SWORD swc_CIL_CM_int16__ 0 0 -32768 32767 ECU_ADDRESS 0x1FFE74A8 /end MEASUREMENT
/begin MEASUREMENT CIL_TCooltPackOutSnsr "Temperature of water outlet" SWORD swc_CIL_CM_int16__ 0 0 -32768 32767 ECU_ADDRESS 0x1FFE74AA /end MEASUREMENT
/begin MEASUREMENT CIL_TDcChPointNeg "Fast charging port negative contact temperature" FLOAT32_IEEE swc_CIL_CM_single__ 0 0 -3.40282346639e+038 3.40282346639e+038 ECU_ADDRESS 0x1FFE5E30 /end MEASUREMENT
/begin MEASUREMENT CIL_TDcChPointPos "Fast charging port positive contact temperature" FLOAT32_IEEE swc_CIL_CM_single__ 0 0 -3.40282346639e+038 3.40282346639e+038 ECU_ADDRESS 0x1FFE5E34 /end MEASUREMENT
/begin MEASUREMENT CIL_TMdul "Temperature of the modules" FLOAT32_IEEE swc_CIL_CM_single__ 0 0 -3.40282346639e+038 3.40282346639e+038 ECU_ADDRESS 0x1FFE5E38 MATRIX_DIM 54 1 1 /end MEASUREMENT
/begin MEASUREMENT CIL_TMdulCtlr "Temperature of the module controllers" FLOAT32_IEEE swc_CIL_CM_single__ 0 0 -3.40282346639e+038 3.40282346639e+038 ECU_ADDRESS 0x1FFE5F10 MATRIX_DIM 32 1 1 /end MEASUREMENT
/begin MEASUREMENT CIL_TSnsrI "Current sensor temperature" SWORD swc_CIL_CM_int16__ 0 0 -32768 32767 ECU_ADDRESS 0x1FFE74AC /end MEASUREMENT
/begin MEASUREMENT CIL_TiSysRun "System runtime" ULONG swc_CIL_CM_uint32_ms 0 0 0 4294967295 ECU_ADDRESS 0x1FFE5F90 /end MEASUREMENT
/begin MEASUREMENT CIL_UChPoleHiSideDrv "High side drive voltage of fast charge relay" FLOAT32_IEEE swc_CIL_CM_single_V 0 0 -3.40282346639e+038 3.40282346639e+038 ECU_ADDRESS 0x1FFE5F94 /end MEASUREMENT
/begin MEASUREMENT CIL_UDcdcLvAct "Voltage at the low voltage side of DCDC" FLOAT32_IEEE swc_CIL_CM_single_V 0 0 -3.40282346639e+038 3.40282346639e+038 ECU_ADDRESS 0x1FFE5F98 /end MEASUREMENT
/begin MEASUREMENT CIL_UEACAct "Voltage of electric air condition" FLOAT32_IEEE swc_CIL_CM_single_V 0 0 -3.40282346639e+038 3.40282346639e+038 ECU_ADDRESS 0x1FFE5F9C /end MEASUREMENT
/begin MEASUREMENT CIL_UHeatPoleHiSideDrv "High side drive voltage of heat relay" FLOAT32_IEEE swc_CIL_CM_single_V 0 0 -3.40282346639e+038 3.40282346639e+038 ECU_ADDRESS 0x1FFE5FA0 /end MEASUREMENT
/begin MEASUREMENT CIL_UMainNegPoleAftRly "Pole voltage after main negative relay" FLOAT32_IEEE swc_CIL_CM_single_V 0 0 -3.40282346639e+038 3.40282346639e+038 ECU_ADDRESS 0x1FFE5FA4 /end MEASUREMENT
/begin MEASUREMENT CIL_UMainNegPoleHiSideDrv "High side drive voltage of  main negative relay" FLOAT32_IEEE swc_CIL_CM_single_V 0 0 -3.40282346639e+038 3.40282346639e+038 ECU_ADDRESS 0x1FFE5FA8 /end MEASUREMENT
/begin MEASUREMENT CIL_UMainPosPoleAftRly "Main positive pole voltage after relay" FLOAT32_IEEE swc_CIL_CM_single_V 0 0 -3.40282346639e+038 3.40282346639e+038 ECU_ADDRESS 0x1FFE5FAC /end MEASUREMENT
/begin MEASUREMENT CIL_UMainPosPoleBefRly "Main positive pole voltage before relay" FLOAT32_IEEE swc_CIL_CM_single_V 0 0 -3.40282346639e+038 3.40282346639e+038 ECU_ADDRESS 0x1FFE5FB0 /end MEASUREMENT
/begin MEASUREMENT CIL_UMainPosPoleHiSideDrv "High side drive voltage of  main positive relay" FLOAT32_IEEE swc_CIL_CM_single_V 0 0 -3.40282346639e+038 3.40282346639e+038 ECU_ADDRESS 0x1FFE5FB4 /end MEASUREMENT
/begin MEASUREMENT CIL_UObcChInp "input charging voltage of Obc" FLOAT32_IEEE swc_CIL_CM_single_V 0 0 0 65535 ECU_ADDRESS 0x1FFE5FB8 /end MEASUREMENT
/begin MEASUREMENT CIL_UObcChOutp "Output charging voltage of Obc" FLOAT32_IEEE swc_CIL_CM_single_V 0 0 0 65535 ECU_ADDRESS 0x1FFE5FBC /end MEASUREMENT
/begin MEASUREMENT CIL_UPoleAftRlyCh "Pole voltage after charge relay" FLOAT32_IEEE swc_CIL_CM_single_V 0 0 -3.40282346639e+038 3.40282346639e+038 ECU_ADDRESS 0x1FFE5FC0 /end MEASUREMENT
/begin MEASUREMENT CIL_UPoleAftRlyHeat "Pole voltage after heat relay" FLOAT32_IEEE swc_CIL_CM_single_V 0 0 -3.40282346639e+038 3.40282346639e+038 ECU_ADDRESS 0x1FFE5FC4 /end MEASUREMENT
/begin MEASUREMENT CIL_URlyPrechHiSideDrv "High side drive voltage of pre charging relay" FLOAT32_IEEE swc_CIL_CM_single_V 0 0 -3.40282346639e+038 3.40282346639e+038 ECU_ADDRESS 0x1FFE5FC8 /end MEASUREMENT
/begin MEASUREMENT CIL_UTrml30 "KL30 voltage" FLOAT32_IEEE swc_CIL_CM_single_dash_ 0 0 -3.40282346639e+038 3.40282346639e+038 ECU_ADDRESS 0x1FFE5FCC /end MEASUREMENT
/begin MEASUREMENT CIL_YearRtc "Real time clock - year" UWORD swc_CIL_CM_uint16_year 0 0 0 65535 ECU_ADDRESS 0x1FFE74AE /end MEASUREMENT
/begin MEASUREMENT CIL_bRdyBswStoreFnshd "The sign that the basic software has finished storing data" UBYTE swc_CIL_CM_uint8_dash_ 0 0 0 255 ECU_ADDRESS 0x1FFE75ED /end MEASUREMENT
/begin MEASUREMENT CIL_bVldBatIHv "HV battery current sampling valid flag:\n      0 Sampling not ready\n      1 Sampling ready" UBYTE swc_CIL_CM_uint8_dash_ 0 0 0 255 ECU_ADDRESS 0x1FFE75EE /end MEASUREMENT
/begin MEASUREMENT CIL_bVldCellTSamplg "Cell temperature sampling valid flag:\n      0 Sampling not ready\n      1 Sampling ready\n      " UBYTE swc_CIL_CM_uint8_dash_ 0 0 0 255 ECU_ADDRESS 0x1FFE75EF /end MEASUREMENT
/begin MEASUREMENT CIL_bVldCellUSamplg "Cell voltage sampling valid flag:\n      0 Sampling not ready\n      1 Sampling ready\n      " UBYTE swc_CIL_CM_uint8_dash_ 0 0 0 255 ECU_ADDRESS 0x1FFE75F0 /end MEASUREMENT
/begin MEASUREMENT CIL_bVldIslnR "Insulation resistance value sampling valid flag:\n      0 Sampling not ready\n      1 Sampling ready" UBYTE swc_CIL_CM_uint8_dash_ 0 0 0 255 ECU_ADDRESS 0x1FFE75F1 /end MEASUREMENT
/begin MEASUREMENT CIL_bVldUMainNegPoleAftRly "Pole voltage after main negative relay sampling valid flag:\n      0 Sampling not ready\n      1 Sampling ready" UBYTE swc_CIL_CM_uint8_dash_ 0 0 0 255 ECU_ADDRESS 0x1FFE75F2 /end MEASUREMENT
/begin MEASUREMENT CIL_bVldUMainPosPoleAftRly "Main positive pole voltage after relay sampling valid flag:\n      0 Sampling not ready\n      1 Sampling ready" UBYTE swc_CIL_CM_uint8_dash_ 0 0 0 255 ECU_ADDRESS 0x1FFE75F3 /end MEASUREMENT
/begin MEASUREMENT CIL_bVldUMainPosPoleBefRly "Main positive pole voltage before relay sampling valid flag:\n      0 Sampling not ready\n      1 Sampling ready\n      " UBYTE swc_CIL_CM_uint8_dash_ 0 0 0 255 ECU_ADDRESS 0x1FFE75F4 /end MEASUREMENT
/begin MEASUREMENT CIL_bVldUPoleAftRlyCh "Pole voltage after charge relay sampling valid flag:\n      0 Sampling not ready\n      1 Sampling ready" UBYTE swc_CIL_CM_uint8_dash_ 0 0 0 255 ECU_ADDRESS 0x1FFE75F5 /end MEASUREMENT
/begin MEASUREMENT CIL_bVldUPoleAftRlyHeat "Pole voltage after heat relay sampling valid flag:\n      0 Sampling not ready\n      1 Sampling ready" UBYTE swc_CIL_CM_uint8_dash_ 0 0 0 255 ECU_ADDRESS 0x1FFE75F6 /end MEASUREMENT
/begin MEASUREMENT CTC_CtrCtctrAgiChIni "Initialisation of the deterioration (ageing) counter of the charge contactor. This counter represents the theoretical switching cycles which are dependent on the current flow during make/break events." FLOAT32_IEEE swc_CtctrTranCtl_CM_single_dash_ 0 0 0 10000000 ECU_ADDRESS 0x1FFE6184 /end MEASUREMENT
/begin MEASUREMENT CTC_CtrCtctrAgiChNv "Non-volatile memory variable: Deterioration (aging) counter of the charge contactor. This counter represents the theoretical switching cycles which are dependent on the current flow during make/break events." FLOAT32_IEEE swc_CtctrTranCtl_CM_single_dash_ 0 0 0 10000000 ECU_ADDRESS 0x1FFE6188 /end MEASUREMENT
/begin MEASUREMENT CTC_CtrCtctrAgiHeatNv "Non-volatile memory variable: Deterioration (aging) counter of the heat contactor. This counter represents the theoretical switching cycles which are dependent on the current flow during make/break events." FLOAT32_IEEE swc_CtctrTranCtl_CM_single_dash_ 0 0 0 10000000 ECU_ADDRESS 0x1FFE618C /end MEASUREMENT
/begin MEASUREMENT CTC_CtrCtctrAgiNegIni "Initialisation of the deterioration (ageing) counter of the negative contactor. This counter represents the theoretical switching cycles which are dependent on the current flow during make/break events." FLOAT32_IEEE swc_CtctrTranCtl_CM_single_dash_ 0 0 0 10000000 ECU_ADDRESS 0x1FFE6194 /end MEASUREMENT
/begin MEASUREMENT CTC_CtrCtctrAgiNegNv "Non-volatile memory variable: Deterioration (aging) counter of the negative contactor. This counter represents the theoretical switching cycles which are dependent on the current flow during make/break events." FLOAT32_IEEE swc_CtctrTranCtl_CM_single_dash_ 0 0 0 10000000 ECU_ADDRESS 0x1FFE6198 /end MEASUREMENT
/begin MEASUREMENT CTC_CtrCtctrAgiPosIni "Initialisation of the deterioration (ageing) counter of the positive contactor. This counter represents the theoretical switching cycles which are dependent on the current flow during make/break events." FLOAT32_IEEE swc_CtctrTranCtl_CM_single_dash_ 0 0 0 10000000 ECU_ADDRESS 0x1FFE61A0 /end MEASUREMENT
/begin MEASUREMENT CTC_CtrCtctrAgiPosNv "Non-volatile memory variable: Deterioration (aging) counter of the positive contactor. This counter represents the theoretical switching cycles which are dependent on the current flow during make/break events." FLOAT32_IEEE swc_CtctrTranCtl_CM_single_dash_ 0 0 0 10000000 ECU_ADDRESS 0x1FFE61A4 /end MEASUREMENT
/begin MEASUREMENT CTC_CtrCtctrAgiPrechIni "Initialisation of the deterioration (ageing) counter of the precharge contactor. This counter represents the theoretical switching cycles which are dependent on the current flow during make/break events." FLOAT32_IEEE swc_CtctrTranCtl_CM_single_dash_ 0 0 0 10000000 ECU_ADDRESS 0x1FFE61AC /end MEASUREMENT
/begin MEASUREMENT CTC_CtrCtctrAgiPrechNv "Non-volatile memory variable: Deterioration (aging) counter of the precharge contactor. This counter represents the theoretical switching cycles which are dependent on the current flow during make/break events." FLOAT32_IEEE swc_CtctrTranCtl_CM_single_dash_ 0 0 0 10000000 ECU_ADDRESS 0x1FFE61B0 /end MEASUREMENT
/begin MEASUREMENT CTC_ErrInfo "Error information of Contactor Transition Control" ULONG swc_CtctrTranCtl_CM_uint32_dash_ 0 0 0 4294967295 ECU_ADDRESS 0x1FFE61B4 /end MEASUREMENT
/begin MEASUREMENT CTC_ErrLoopHv "Hv loop error state\n      0x0: No error\n      0x1: Error\n      0x2: Reserved\n      0x3: Invalid" UBYTE swc_CtctrTranCtl_CM_uint8_dash_ 0 0 0 255 ECU_ADDRESS 0x1FFE76BC /end MEASUREMENT
/begin MEASUREMENT CTC_ErrRlyCh "Fast charge relay error state\n      0x0: No error\n      0x1: Drive Error\n      0x2: Welded\n      0x3: Invalid" UBYTE swc_CtctrTranCtl_CM_uint8_dash_ 0 0 0 255 ECU_ADDRESS 0x1FFE76BD /end MEASUREMENT
/begin MEASUREMENT CTC_ErrRlyHeat "Heat relay error state\n      0x0: No error\n      0x1: Drive Error\n      0x2: Welded\n      0x3: Invalid" UBYTE swc_CtctrTranCtl_CM_uint8_dash_ 0 0 0 255 ECU_ADDRESS 0x1FFE76BE /end MEASUREMENT
/begin MEASUREMENT CTC_ErrRlyNeg "Negative relay error state\n      0x0: No error\n      0x1: Drive Error\n      0x2: Welded\n      0x3: Invalid" UBYTE swc_CtctrTranCtl_CM_uint8_dash_ 0 0 0 255 ECU_ADDRESS 0x1FFE76BF /end MEASUREMENT
/begin MEASUREMENT CTC_ErrRlyPos "Positive relay error state\n      0x0: No error\n      0x1: Drive Error\n      0x2: Welded\n      0x3: Invalid" UBYTE swc_CtctrTranCtl_CM_uint8_dash_ 0 0 0 255 ECU_ADDRESS 0x1FFE76C0 /end MEASUREMENT
/begin MEASUREMENT CTC_ErrRlyPrech "Precharge relay error state\n      0x0: No error\n      0x1: Drive Error\n      0x2: Welded\n      0x3: Invalid" UBYTE swc_CtctrTranCtl_CM_uint8_dash_ 0 0 0 255 ECU_ADDRESS 0x1FFE76C1 /end MEASUREMENT
/begin MEASUREMENT CTC_IDriftZero "Zero-drift current" FLOAT32_IEEE swc_CtctrTranCtl_CM_single_A 0 0 -3.40282346639e+038 3.40282346639e+038 ECU_ADDRESS 0x1FFE61B8 /end MEASUREMENT
/begin MEASUREMENT CTC_ModeMotDchaFnshd "The motor work mode is discharge finish" UBYTE swc_CtctrTranCtl_CM_boolean_dash_ 0 0 0 1 ECU_ADDRESS 0x1FFE76D2 /end MEASUREMENT
/begin MEASUREMENT CTC_PctgCtctrAgiCh "Deterioration (aging) counter of the charge contactor. This counter represents the theoretical switching cycles which are dependent on the current flow during make/break events." FLOAT32_IEEE swc_CtctrTranCtl_CM_single_dash_ 0 0 0 10000000 ECU_ADDRESS 0x1FFE61BC /end MEASUREMENT
/begin MEASUREMENT CTC_PctgCtctrAgiHeat "Deterioration (aging) counter of the heat contactor. This counter represents the theoretical switching cycles which are dependent on the current flow during make/break events." FLOAT32_IEEE swc_CtctrTranCtl_CM_single_dash_ 0 0 0 10000000 ECU_ADDRESS 0x1FFE61C0 /end MEASUREMENT
/begin MEASUREMENT CTC_PctgCtctrAgiNeg "Deterioration (aging) counter of the negative contactor. This counter represents the theoretical switching cycles which are dependent on the current flow during make/break events." FLOAT32_IEEE swc_CtctrTranCtl_CM_single_dash_ 0 0 0 10000000 ECU_ADDRESS 0x1FFE61C4 /end MEASUREMENT
/begin MEASUREMENT CTC_PctgCtctrAgiPos "Deterioration (aging) counter of the positive contactor. This counter represents the theoretical switching cycles which are dependent on the current flow during make/break events." FLOAT32_IEEE swc_CtctrTranCtl_CM_single_dash_ 0 0 0 10000000 ECU_ADDRESS 0x1FFE61C8 /end MEASUREMENT
/begin MEASUREMENT CTC_PctgCtctrAgiPrech "Deterioration (aging) counter of the precharge contactor. This counter represents the theoretical switching cycles which are dependent on the current flow during make/break events." FLOAT32_IEEE swc_CtctrTranCtl_CM_single_dash_ 0 0 0 10000000 ECU_ADDRESS 0x1FFE61CC /end MEASUREMENT
/begin MEASUREMENT CTC_ReqRlyCh "Request for DC charge relay control\n      0x0: Open\n      0x1: Close\n      0x2: Reserved\n      0x3: Invalid" UBYTE swc_CtctrTranCtl_CM_uint8_dash_ 0 0 0 255 ECU_ADDRESS 0x1FFE76C2 /end MEASUREMENT
/begin MEASUREMENT CTC_ReqRlyHeat "Request for heat relay control\n      0x0: Open\n      0x1: Close\n      0x2: Reserved\n      0x3: Invalid" UBYTE swc_CtctrTranCtl_CM_uint8_dash_ 0 0 0 255 ECU_ADDRESS 0x1FFE76C3 /end MEASUREMENT
/begin MEASUREMENT CTC_ReqRlyNeg "Request for negative relay control\n      0x0: Open\n      0x1: Close\n      0x2: Reserved\n      0x3: Invalid" UBYTE swc_CtctrTranCtl_CM_uint8_dash_ 0 0 0 255 ECU_ADDRESS 0x1FFE76C4 /end MEASUREMENT
/begin MEASUREMENT CTC_ReqRlyPos "Request for postive relay control\n      0x0: Open\n      0x1: Close\n      0x2: Reserved\n      0x3: Invalid" UBYTE swc_CtctrTranCtl_CM_uint8_dash_ 0 0 0 255 ECU_ADDRESS 0x1FFE76C5 /end MEASUREMENT
/begin MEASUREMENT CTC_ReqRlyPrech "Request for precharge relay \n      0x0: Open\n      0x1: Close\n      0x2: Reserved\n      0x3: Invalid" UBYTE swc_CtctrTranCtl_CM_uint8_dash_ 0 0 0 255 ECU_ADDRESS 0x1FFE76C6 /end MEASUREMENT
/begin MEASUREMENT CTC_StHvbat "HV Battery Operation State. 0:Undefined, 1:Offline, 2:Precharge, 3:Connect, 4:Online, 5:Shutoff, 6:Disconnect, 8:DC_charge, 9:AC_charge, 10:Emergency_disconnect, 14:Service_mode" UBYTE swc_CtctrTranCtl_CM_uint8_dash_ 0 0 0 255 ECU_ADDRESS 0x1FFE76C7 /end MEASUREMENT
/begin MEASUREMENT CTC_StLoopHv "HV loop state\n      0x0: Open\n      0x1: Precharging\n      0x2: Precharg Finish\n      0x3: Prechage Fault\n      0x4: Precharge lock\n      0x5: Normal drive" UBYTE swc_CtctrTranCtl_CM_uint8_dash_ 0 0 0 255 ECU_ADDRESS 0x1FFE76C8 /end MEASUREMENT
/begin MEASUREMENT CTC_StRlyCh "DC charge relay state" UBYTE swc_CtctrTranCtl_CM_uint8_dash_ 0 0 0 255 ECU_ADDRESS 0x1FFE76C9 /end MEASUREMENT
/begin MEASUREMENT CTC_StRlyChkCh "Fast charge relay self-check state\n      0:  OK\n      1:  Debouncing\n      2:  Error " UBYTE swc_CtctrTranCtl_CM_uint8_dash_ 0 0 0 255 ECU_ADDRESS 0x1FFE76CA /end MEASUREMENT
/begin MEASUREMENT CTC_StRlyChkHeat "Heat relay self-check state\n      0:  OK\n      1:  Debouncing\n      2:  Error " UBYTE swc_CtctrTranCtl_CM_uint8_dash_ 0 0 0 255 ECU_ADDRESS 0x1FFE76CB /end MEASUREMENT
/begin MEASUREMENT CTC_StRlyChkPos "Positive relay self-check state\n      0:  OK\n      1:  Debouncing\n      2:  Error " UBYTE swc_CtctrTranCtl_CM_uint8_dash_ 0 0 0 255 ECU_ADDRESS 0x1FFE76CC /end MEASUREMENT
/begin MEASUREMENT CTC_StRlyHeat "Heat relay state" UBYTE swc_CtctrTranCtl_CM_uint8_dash_ 0 0 0 255 ECU_ADDRESS 0x1FFE76CD /end MEASUREMENT
/begin MEASUREMENT CTC_StRlyNeg "Negative relay state" UBYTE swc_CtctrTranCtl_CM_uint8_dash_ 0 0 0 255 ECU_ADDRESS 0x1FFE76CE /end MEASUREMENT
/begin MEASUREMENT CTC_StRlyPos "Positive relay state" UBYTE swc_CtctrTranCtl_CM_uint8_dash_ 0 0 0 255 ECU_ADDRESS 0x1FFE76CF /end MEASUREMENT
/begin MEASUREMENT CTC_StRlyPrech "Precharge relay state" UBYTE swc_CtctrTranCtl_CM_uint8_dash_ 0 0 0 255 ECU_ADDRESS 0x1FFE76D0 /end MEASUREMENT
/begin MEASUREMENT CTC_StSysInt "Internal state of Contactor Transition Control" UWORD swc_CtctrTranCtl_CM_uint16_dash_ 0 0 0 65535 ECU_ADDRESS 0x1FFE7512 /end MEASUREMENT
/begin MEASUREMENT CTC_StsTProtnRPrech "Fault status of the diagnosis: Temperature protection of precharge resistor" UBYTE swc_CtctrTranCtl_CM_uint8_dash_ 0 0 0 255 ECU_ADDRESS 0x1FFE76D1 /end MEASUREMENT
/begin MEASUREMENT CTC_UPrechAccumd "Accumulated precharged voltage used for precharge resistor protection" FLOAT32_IEEE swc_CtctrTranCtl_CM_single_V 0 0 0 10000 ECU_ADDRESS 0x1FFE61D0 /end MEASUREMENT
/begin MEASUREMENT CTC_UPrechAccumdNv "Non-volatile memory variable: Accumulated precharged voltage used for precharge resistor protection" FLOAT32_IEEE swc_CtctrTranCtl_CM_single_V 0 0 0 10000 ECU_ADDRESS 0x1FFE61D4 /end MEASUREMENT
/begin MEASUREMENT CTC_bAcvCh "acitve flag of charging" UBYTE swc_CtctrTranCtl_CM_boolean_dash_ 0 0 0 1 ECU_ADDRESS 0x1FFE76D3 /end MEASUREMENT
/begin MEASUREMENT CTC_bAcvChPoleHiSideDrv "Active flag for charge relay high side drive" UBYTE swc_CtctrTranCtl_CM_boolean_dash_ 0 0 0 1 ECU_ADDRESS 0x1FFE76D4 /end MEASUREMENT
/begin MEASUREMENT CTC_bAcvHeatPoleHiSideDrv "Active flag for heat relay high side drive" UBYTE swc_CtctrTranCtl_CM_boolean_dash_ 0 0 0 1 ECU_ADDRESS 0x1FFE76D5 /end MEASUREMENT
/begin MEASUREMENT CTC_bAcvLoopTranToStNormDrv "Active flag for Hv loop state transitions to normal drive" UBYTE swc_CtctrTranCtl_CM_boolean_dash_ 0 0 0 1 ECU_ADDRESS 0x1FFE76D6 /end MEASUREMENT
/begin MEASUREMENT CTC_bAcvLoopTranToStOpen "Active flag for Hv loop state transitions to open" UBYTE swc_CtctrTranCtl_CM_boolean_dash_ 0 0 0 1 ECU_ADDRESS 0x1FFE76D7 /end MEASUREMENT
/begin MEASUREMENT CTC_bAcvLoopTranToStPrech "Active flag for Hv loop state transitions to precharging" UBYTE swc_CtctrTranCtl_CM_boolean_dash_ 0 0 0 1 ECU_ADDRESS 0x1FFE76D8 /end MEASUREMENT
/begin MEASUREMENT CTC_bAcvLoopTranToStPrechFlt "Active flag for Hv loop state transitions to precharge fault" UBYTE swc_CtctrTranCtl_CM_boolean_dash_ 0 0 0 1 ECU_ADDRESS 0x1FFE76D9 /end MEASUREMENT
/begin MEASUREMENT CTC_bAcvLoopTranToStPrechFnshd "Active flag for Hv loop state transitions to precharg finished" UBYTE swc_CtctrTranCtl_CM_boolean_dash_ 0 0 0 1 ECU_ADDRESS 0x1FFE76DA /end MEASUREMENT
/begin MEASUREMENT CTC_bAcvMainNegPoleHiSideDrv "Active flag for negative relay high side drive" UBYTE swc_CtctrTranCtl_CM_boolean_dash_ 0 0 0 1 ECU_ADDRESS 0x1FFE76DB /end MEASUREMENT
/begin MEASUREMENT CTC_bAcvMainPosPoleHiSideDrv "Active flag for positive relay high side drive " UBYTE swc_CtctrTranCtl_CM_boolean_dash_ 0 0 0 1 ECU_ADDRESS 0x1FFE76DC /end MEASUREMENT
/begin MEASUREMENT CTC_bAcvMotDchaTout "Active flag for motor discharge timeout" UBYTE swc_CtctrTranCtl_CM_boolean_dash_ 0 0 0 1 ECU_ADDRESS 0x1FFE76DD /end MEASUREMENT
/begin MEASUREMENT CTC_bAcvRlyChkPrech "Active flag for precharge relay check" UBYTE swc_CtctrTranCtl_CM_boolean_dash_ 0 0 0 1 ECU_ADDRESS 0x1FFE76DE /end MEASUREMENT
/begin MEASUREMENT CTC_bAcvRlyCls "Active flag for relay close" UBYTE swc_CtctrTranCtl_CM_boolean_dash_ 0 0 0 1 ECU_ADDRESS 0x1FFE76DF /end MEASUREMENT
/begin MEASUREMENT CTC_bAcvRlyPrechHiSideDrv "Active flag for precharge relay high side drive " UBYTE swc_CtctrTranCtl_CM_boolean_dash_ 0 0 0 1 ECU_ADDRESS 0x1FFE76E0 /end MEASUREMENT
/begin MEASUREMENT CTC_bAcvRlyStrtOpen "Active flag for the start of relay disconnection" UBYTE swc_CtctrTranCtl_CM_boolean_dash_ 0 0 0 1 ECU_ADDRESS 0x1FFE76E1 /end MEASUREMENT
/begin MEASUREMENT CTC_bAcvTrml15Chk "Active flag for check KL15 state" UBYTE swc_CtctrTranCtl_CM_boolean_dash_ 0 0 0 1 ECU_ADDRESS 0x1FFE76E2 /end MEASUREMENT
/begin MEASUREMENT CTC_bErrIDriftZero "Excessive zero drift fault in current sensor" UBYTE swc_CtctrTranCtl_CM_boolean_dash_ 0 0 0 1 ECU_ADDRESS 0x1FFE76E3 /end MEASUREMENT
/begin MEASUREMENT CTC_bErrIPrech "Excessive precharge current error" UBYTE swc_CtctrTranCtl_CM_boolean_dash_ 0 0 0 1 ECU_ADDRESS 0x1FFE76E4 /end MEASUREMENT
/begin MEASUREMENT CTC_bErrLoaShoPrech "Precharge load short-circuit error" UBYTE swc_CtctrTranCtl_CM_boolean_dash_ 0 0 0 1 ECU_ADDRESS 0x1FFE76E5 /end MEASUREMENT
/begin MEASUREMENT CTC_bErrPrech "Precharge failure" UBYTE swc_CtctrTranCtl_CM_boolean_dash_ 0 0 0 1 ECU_ADDRESS 0x1FFE76E6 /end MEASUREMENT
/begin MEASUREMENT CTC_bErrRlyAgiCh "Deterioration error of charge relay" UBYTE swc_CtctrTranCtl_CM_boolean_dash_ 0 0 0 1 ECU_ADDRESS 0x1FFE76E7 /end MEASUREMENT
/begin MEASUREMENT CTC_bErrRlyAgiNeg "Deterioration error of negative relay" UBYTE swc_CtctrTranCtl_CM_boolean_dash_ 0 0 0 1 ECU_ADDRESS 0x1FFE76E8 /end MEASUREMENT
/begin MEASUREMENT CTC_bErrRlyAgiPos "Deterioration error of positive relay" UBYTE swc_CtctrTranCtl_CM_boolean_dash_ 0 0 0 1 ECU_ADDRESS 0x1FFE76E9 /end MEASUREMENT
/begin MEASUREMENT CTC_bErrRlyAgiPrech "Deterioration error of precharge relay" UBYTE swc_CtctrTranCtl_CM_boolean_dash_ 0 0 0 1 ECU_ADDRESS 0x1FFE76EA /end MEASUREMENT
/begin MEASUREMENT CTC_bErrRlyChHiDrvShoToGnd "Fast charging relay high side drive circuit shorted to ground" UBYTE swc_CtctrTranCtl_CM_boolean_dash_ 0 0 0 1 ECU_ADDRESS 0x1FFE76EB /end MEASUREMENT
/begin MEASUREMENT CTC_bErrRlyChHiDrvShoToPwr "Fast charging relay high side drive circuit shorted to power source" UBYTE swc_CtctrTranCtl_CM_boolean_dash_ 0 0 0 1 ECU_ADDRESS 0x1FFE76EC /end MEASUREMENT
/begin MEASUREMENT CTC_bErrRlyChHiSideDrv "Fast charging relay high side drive error" UBYTE swc_CtctrTranCtl_CM_boolean_dash_ 0 0 0 1 ECU_ADDRESS 0x1FFE76ED /end MEASUREMENT
/begin MEASUREMENT CTC_bErrRlyChWldd "Fast charging relay weld error" UBYTE swc_CtctrTranCtl_CM_boolean_dash_ 0 0 0 1 ECU_ADDRESS 0x1FFE76EE /end MEASUREMENT
/begin MEASUREMENT CTC_bErrRlyHeatHiDrvShoToGnd "Heat relay high side drive circuit shorted to ground" UBYTE swc_CtctrTranCtl_CM_boolean_dash_ 0 0 0 1 ECU_ADDRESS 0x1FFE76EF /end MEASUREMENT
/begin MEASUREMENT CTC_bErrRlyHeatHiDrvShoToPwr "Heat relay high side drive circuit shorted to power source" UBYTE swc_CtctrTranCtl_CM_boolean_dash_ 0 0 0 1 ECU_ADDRESS 0x1FFE76F0 /end MEASUREMENT
/begin MEASUREMENT CTC_bErrRlyHeatHiSideDrv "Heat relay high side drive error" UBYTE swc_CtctrTranCtl_CM_boolean_dash_ 0 0 0 1 ECU_ADDRESS 0x1FFE76F1 /end MEASUREMENT
/begin MEASUREMENT CTC_bErrRlyHeatWldd "Heat relay weld error" UBYTE swc_CtctrTranCtl_CM_boolean_dash_ 0 0 0 1 ECU_ADDRESS 0x1FFE76F2 /end MEASUREMENT
/begin MEASUREMENT CTC_bErrRlyNegHiDrvShoToGnd "Main negative relay high side drive circuit shorted to ground" UBYTE swc_CtctrTranCtl_CM_boolean_dash_ 0 0 0 1 ECU_ADDRESS 0x1FFE76F3 /end MEASUREMENT
/begin MEASUREMENT CTC_bErrRlyNegHiDrvShoToPwr "Main negative relay high side drive circuit shorted to power source" UBYTE swc_CtctrTranCtl_CM_boolean_dash_ 0 0 0 1 ECU_ADDRESS 0x1FFE76F4 /end MEASUREMENT
/begin MEASUREMENT CTC_bErrRlyNegHiSideDrv "Main negative relay high side drive error" UBYTE swc_CtctrTranCtl_CM_boolean_dash_ 0 0 0 1 ECU_ADDRESS 0x1FFE76F5 /end MEASUREMENT
/begin MEASUREMENT CTC_bErrRlyNegWldd "Main negative relay weld error" UBYTE swc_CtctrTranCtl_CM_boolean_dash_ 0 0 0 1 ECU_ADDRESS 0x1FFE76F6 /end MEASUREMENT
/begin MEASUREMENT CTC_bErrRlyPosHiDrvShoToGnd "Main positive relay high side drive circuit shorted to ground" UBYTE swc_CtctrTranCtl_CM_boolean_dash_ 0 0 0 1 ECU_ADDRESS 0x1FFE76F7 /end MEASUREMENT
/begin MEASUREMENT CTC_bErrRlyPosHiDrvShoToPwr "Main positive relay high side drive circuit shorted to power source" UBYTE swc_CtctrTranCtl_CM_boolean_dash_ 0 0 0 1 ECU_ADDRESS 0x1FFE76F8 /end MEASUREMENT
/begin MEASUREMENT CTC_bErrRlyPosHiSideDrv "Main positive relay high side drive error" UBYTE swc_CtctrTranCtl_CM_boolean_dash_ 0 0 0 1 ECU_ADDRESS 0x1FFE76F9 /end MEASUREMENT
/begin MEASUREMENT CTC_bErrRlyPosWldd "Main positive relay weld error" UBYTE swc_CtctrTranCtl_CM_boolean_dash_ 0 0 0 1 ECU_ADDRESS 0x1FFE76FA /end MEASUREMENT
/begin MEASUREMENT CTC_bErrRlyPrechHiDrvShoToGnd "Precharge relay high side drive circuit shorted to ground" UBYTE swc_CtctrTranCtl_CM_boolean_dash_ 0 0 0 1 ECU_ADDRESS 0x1FFE76FB /end MEASUREMENT
/begin MEASUREMENT CTC_bErrRlyPrechHiDrvShoToPwr "Precharge relay high side drive circuit shorted to power source" UBYTE swc_CtctrTranCtl_CM_boolean_dash_ 0 0 0 1 ECU_ADDRESS 0x1FFE76FC /end MEASUREMENT
/begin MEASUREMENT CTC_bErrSigChWupLost "Charging wake-up signal loss fault" UBYTE swc_CtctrTranCtl_CM_boolean_dash_ 0 0 0 1 ECU_ADDRESS 0x1FFE76FD /end MEASUREMENT
/begin MEASUREMENT CTC_bErrToutForMotDcha "Motor discharge time out" UBYTE swc_CtctrTranCtl_CM_boolean_dash_ 0 0 0 1 ECU_ADDRESS 0x1FFE76FE /end MEASUREMENT
/begin MEASUREMENT CTC_bErrToutForMotDchaToDiag "Motor discharge time out" UBYTE swc_CtctrTranCtl_CM_boolean_dash_ 0 0 0 1 ECU_ADDRESS 0x1FFE76FF /end MEASUREMENT
/begin MEASUREMENT CTC_bErrToutPrech "Precharge timeout error" UBYTE swc_CtctrTranCtl_CM_boolean_dash_ 0 0 0 1 ECU_ADDRESS 0x1FFE7700 /end MEASUREMENT
/begin MEASUREMENT CTC_bVldUCls "The valid flag that the voltage before and after the positive relay has been similar" UBYTE swc_CtctrTranCtl_CM_boolean_dash_ 0 0 0 1 ECU_ADDRESS 0x1FFE7701 /end MEASUREMENT
/begin MEASUREMENT CTC_bVldUDecr "The valid flag that the voltage after the positive relay has decreased" UBYTE swc_CtctrTranCtl_CM_boolean_dash_ 0 0 0 1 ECU_ADDRESS 0x1FFE7702 /end MEASUREMENT
/begin MEASUREMENT CTC_bVldUEqu "The valid flag that the voltage before and after the positive relay has been equal" UBYTE swc_CtctrTranCtl_CM_boolean_dash_ 0 0 0 1 ECU_ADDRESS 0x1FFE7703 /end MEASUREMENT
/begin MEASUREMENT CTC_bVldUEquForCh "The valid flag that the voltage before and after the charge relay has been equal" UBYTE swc_CtctrTranCtl_CM_boolean_dash_ 0 0 0 1 ECU_ADDRESS 0x1FFE7704 /end MEASUREMENT
/begin MEASUREMENT CTC_bVldUEquForHeat "The valid flag that the voltage before and after the heat relay has been equal" UBYTE swc_CtctrTranCtl_CM_boolean_dash_ 0 0 0 1 ECU_ADDRESS 0x1FFE7705 /end MEASUREMENT
/begin MEASUREMENT CTC_bWarnRlyAgiCh "Deterioration warning of charge relay" UBYTE swc_CtctrTranCtl_CM_boolean_dash_ 0 0 0 1 ECU_ADDRESS 0x1FFE7706 /end MEASUREMENT
/begin MEASUREMENT CTC_bWarnRlyAgiNeg "Deterioration warning of negative relay" UBYTE swc_CtctrTranCtl_CM_boolean_dash_ 0 0 0 1 ECU_ADDRESS 0x1FFE7707 /end MEASUREMENT
/begin MEASUREMENT CTC_bWarnRlyAgiPos "Deterioration warning of positive relay" UBYTE swc_CtctrTranCtl_CM_boolean_dash_ 0 0 0 1 ECU_ADDRESS 0x1FFE7708 /end MEASUREMENT
/begin MEASUREMENT CTC_bWarnRlyAgiPrech "Deterioration warning of precharge relay" UBYTE swc_CtctrTranCtl_CM_boolean_dash_ 0 0 0 1 ECU_ADDRESS 0x1FFE7709 /end MEASUREMENT
/begin MEASUREMENT ChargingMode "BCL: Charging mode (0x01: constant voltage charging 0x02: constant current charging 0x03: Discharge)" UBYTE swc_COL_CM_uint8_dash_ 0 0 0 255 ECU_ADDRESS 0x1FFE76AA /end MEASUREMENT
/begin MEASUREMENT CurrentChargeState "BCS: Current state of charge" UBYTE swc_COL_CM_uint8_percent_ 0 0 0 255 ECU_ADDRESS 0x1FFE76AB /end MEASUREMENT
/begin MEASUREMENT CurrentDemand "BCL: Charging Demand Current/Discharge Allowable Current" UWORD swc_COL_CM_uint16_A 0 0 0 65535 ECU_ADDRESS 0x1FFE74F4 /end MEASUREMENT
/begin MEASUREMENT CurrentVehicleBatteryVoltage "BCP: The current battery voltage of the vehicle power battery" UWORD swc_COL_CM_uint16_V 0 0 0 65535 ECU_ADDRESS 0x1FFE74F6 /end MEASUREMENT
/begin MEASUREMENT DEH_EnaDiagGlb "global diagnosis enable flag" UBYTE swc_DiagcEveHndlg_CM_boolean_dash_ 0 0 0 1 ECU_ADDRESS 0x1FFE7714 /end MEASUREMENT
/begin MEASUREMENT DEH_ErrCfmd1 "DTC confirmed status 1" ULONG swc_DiagcEveHndlg_CM_uint32_dash_ 0 0 0 4294967295 ECU_ADDRESS 0x1FFE6240 /end MEASUREMENT
/begin MEASUREMENT DEH_ErrCfmd2 "DTC confirmed status 2" ULONG swc_DiagcEveHndlg_CM_uint32_dash_ 0 0 0 4294967295 ECU_ADDRESS 0x1FFE6244 /end MEASUREMENT
/begin MEASUREMENT DEH_ErrCfmd3 "DTC confirmed status 3" ULONG swc_DiagcEveHndlg_CM_uint32_dash_ 0 0 0 4294967295 ECU_ADDRESS 0x1FFE6248 /end MEASUREMENT
/begin MEASUREMENT DEH_ErrCfmd4 "DTC confirmed status 4" ULONG swc_DiagcEveHndlg_CM_uint32_dash_ 0 0 0 4294967295 ECU_ADDRESS 0x1FFE624C /end MEASUREMENT
/begin MEASUREMENT DEH_ErrCfmd5 "DTC confirmed status 5" ULONG swc_DiagcEveHndlg_CM_uint32_dash_ 0 0 0 4294967295 ECU_ADDRESS 0x1FFE6250 /end MEASUREMENT
/begin MEASUREMENT DEH_ErrCfmd6 "DTC confirmed status 6" ULONG swc_DiagcEveHndlg_CM_uint32_dash_ 0 0 0 4294967295 ECU_ADDRESS 0x1FFE6254 /end MEASUREMENT
/begin MEASUREMENT DEH_LvlErr "Error Level calculated by DEH\n      0x00 = No error \n      0x01 = level1\n      0x02 = level2\n      0x03 = level3" UBYTE swc_DiagcEveHndlg_CM_uint8_dash_ 0 0 0 255 ECU_ADDRESS 0x1FFE770A /end MEASUREMENT
/begin MEASUREMENT DEH_LvlErrSb "Sub Error Level calculated by DEH\n      0x00 = No error \n      0x01 = level1\n      0x02 = level2\n      0x03 = level3" UBYTE swc_DiagcEveHndlg_CM_uint8_dash_ 0 0 0 255 ECU_ADDRESS 0x1FFE770B /end MEASUREMENT
/begin MEASUREMENT DEH_ReqBatSrv "Service Command from external device." UBYTE swc_DiagcEveHndlg_CM_uint8_dash_ 0 0 0 255 ECU_ADDRESS 0x1FFE770C /end MEASUREMENT
/begin MEASUREMENT DEH_StFltLampIndcn "fault lamp state" UBYTE swc_DiagcEveHndlg_CM_uint8_dash_ 0 0 0 255 ECU_ADDRESS 0x1FFE770D /end MEASUREMENT
/begin MEASUREMENT DEH_StsIninNv "Error information: Non-volatile memory of HVCU is not initialized properly/corrupt/in error state and should not be trusted (0 no error; 1 error)" UBYTE swc_DiagcEveHndlg_CM_uint8_dash_ 0 0 0 1 ECU_ADDRESS 0x1FFE770E /end MEASUREMENT
/begin MEASUREMENT DEH_TrigCMdulAgiFac "NVM store trigger from Modules capacity ageing factor" UBYTE swc_DiagcEveHndlg_CM_boolean_dash_ 0 0 0 1 ECU_ADDRESS 0x1FFE7715 /end MEASUREMENT
/begin MEASUREMENT DEH_TrigEBatChTot "NVM store trigger from total energy stored in battery during its life cycle" UBYTE swc_DiagcEveHndlg_CM_boolean_dash_ 0 0 0 1 ECU_ADDRESS 0x1FFE7716 /end MEASUREMENT
/begin MEASUREMENT DEH_TrigEBatDchaTot "NVM store trigger from total energy supplied by battery during its life cycle" UBYTE swc_DiagcEveHndlg_CM_boolean_dash_ 0 0 0 1 ECU_ADDRESS 0x1FFE7717 /end MEASUREMENT
/begin MEASUREMENT DEH_TrigRMdulAgiFac "NVM store trigger from Module resistance ageing factors" UBYTE swc_DiagcEveHndlg_CM_boolean_dash_ 0 0 0 1 ECU_ADDRESS 0x1FFE7718 /end MEASUREMENT
/begin MEASUREMENT DEH_TrigSocMdul "NVM store trigger from Module SOC" UBYTE swc_DiagcEveHndlg_CM_boolean_dash_ 0 0 0 1 ECU_ADDRESS 0x1FFE7719 /end MEASUREMENT
/begin MEASUREMENT DEH_TrigSohRDelta "NVM store trigger from Delta R based SOH value" UBYTE swc_DiagcEveHndlg_CM_boolean_dash_ 0 0 0 1 ECU_ADDRESS 0x1FFE771A /end MEASUREMENT
/begin MEASUREMENT DEH_TrigSohSocDelta "NVM store trigger from DeltaSOC based SOH value" UBYTE swc_DiagcEveHndlg_CM_boolean_dash_ 0 0 0 1 ECU_ADDRESS 0x1FFE771B /end MEASUREMENT
/begin MEASUREMENT DEH_TrigStoreNv "NVRAM store trigger" UBYTE swc_DiagcEveHndlg_CM_boolean_dash_ 0 0 0 1 ECU_ADDRESS 0x1FFE771C /end MEASUREMENT
/begin MEASUREMENT DEH_TrigStoreNvRaw "NVRAM store trigger (Raw)" UBYTE swc_DiagcEveHndlg_CM_boolean_dash_ 0 0 0 1 ECU_ADDRESS 0x1FFE771D /end MEASUREMENT
/begin MEASUREMENT DEH_bAcvAcChInh "Battery AC charge inhibition flag" UBYTE swc_DiagcEveHndlg_CM_boolean_dash_ 0 0 0 1 ECU_ADDRESS 0x1FFE771E /end MEASUREMENT
/begin MEASUREMENT DEH_bAcvChInh "Battery charge inhibition flag" UBYTE swc_DiagcEveHndlg_CM_boolean_dash_ 0 0 0 1 ECU_ADDRESS 0x1FFE771F /end MEASUREMENT
/begin MEASUREMENT DEH_bAcvDcChInh "Battery DC charge inhibition flag" UBYTE swc_DiagcEveHndlg_CM_boolean_dash_ 0 0 0 1 ECU_ADDRESS 0x1FFE7720 /end MEASUREMENT
/begin MEASUREMENT DEH_bAcvDchaInh "Battery discharge inhibition flag" UBYTE swc_DiagcEveHndlg_CM_boolean_dash_ 0 0 0 1 ECU_ADDRESS 0x1FFE7721 /end MEASUREMENT
/begin MEASUREMENT DEH_bAcvEmcyHvOff1 "Emergency Hv Off flag 1" UBYTE swc_DiagcEveHndlg_CM_boolean_dash_ 0 0 0 1 ECU_ADDRESS 0x1FFE7722 /end MEASUREMENT
/begin MEASUREMENT DEH_bAcvEmcyHvOff2 "Emergency Hv Off flag 2" UBYTE swc_DiagcEveHndlg_CM_boolean_dash_ 0 0 0 1 ECU_ADDRESS 0x1FFE7723 /end MEASUREMENT
/begin MEASUREMENT DEH_bAcvHeatInh "Battery heat inhibition flag" UBYTE swc_DiagcEveHndlg_CM_boolean_dash_ 0 0 0 1 ECU_ADDRESS 0x1FFE7724 /end MEASUREMENT
/begin MEASUREMENT DEH_bAcvLvlErr1 "Battery error level 1" UBYTE swc_DiagcEveHndlg_CM_boolean_dash_ 0 0 0 1 ECU_ADDRESS 0x1FFE7725 /end MEASUREMENT
/begin MEASUREMENT DEH_bAcvLvlErr2 "Battery error level 2" UBYTE swc_DiagcEveHndlg_CM_boolean_dash_ 0 0 0 1 ECU_ADDRESS 0x1FFE7726 /end MEASUREMENT
/begin MEASUREMENT DEH_bAcvLvlErr3 "Battery error level 3" UBYTE swc_DiagcEveHndlg_CM_boolean_dash_ 0 0 0 1 ECU_ADDRESS 0x1FFE7727 /end MEASUREMENT
/begin MEASUREMENT DEH_bAcvLvlErrSb1 "Battery sub error level 1" UBYTE swc_DiagcEveHndlg_CM_boolean_dash_ 0 0 0 1 ECU_ADDRESS 0x1FFE7728 /end MEASUREMENT
/begin MEASUREMENT DEH_bAcvLvlErrSb2 "Battery sub error level 2" UBYTE swc_DiagcEveHndlg_CM_boolean_dash_ 0 0 0 1 ECU_ADDRESS 0x1FFE7729 /end MEASUREMENT
/begin MEASUREMENT DEH_bAcvLvlErrSb3 "Battery sub error level 3" UBYTE swc_DiagcEveHndlg_CM_boolean_dash_ 0 0 0 1 ECU_ADDRESS 0x1FFE772A /end MEASUREMENT
/begin MEASUREMENT DEH_bAcvPowupInh "Powerup inhibition flag" UBYTE swc_DiagcEveHndlg_CM_boolean_dash_ 0 0 0 1 ECU_ADDRESS 0x1FFE772B /end MEASUREMENT
/begin MEASUREMENT DEH_bAcvPwrChLim1 "Limit battery charge power to 50 percent" UBYTE swc_DiagcEveHndlg_CM_boolean_dash_ 0 0 0 1 ECU_ADDRESS 0x1FFE772C /end MEASUREMENT
/begin MEASUREMENT DEH_bAcvPwrChLim2 "Limit battery charge power to 75 percent" UBYTE swc_DiagcEveHndlg_CM_boolean_dash_ 0 0 0 1 ECU_ADDRESS 0x1FFE772D /end MEASUREMENT
/begin MEASUREMENT DEH_bAcvPwrDchaLim1 "Limit battery discharge power to 50 percent" UBYTE swc_DiagcEveHndlg_CM_boolean_dash_ 0 0 0 1 ECU_ADDRESS 0x1FFE772E /end MEASUREMENT
/begin MEASUREMENT DEH_bAcvPwrDchaLim2 "Limit battery discharge power to 75 percent" UBYTE swc_DiagcEveHndlg_CM_boolean_dash_ 0 0 0 1 ECU_ADDRESS 0x1FFE772F /end MEASUREMENT
/begin MEASUREMENT DEH_bAcvPwrRecupLim1 "Limit battery recuperation power to 50 percent" UBYTE swc_DiagcEveHndlg_CM_boolean_dash_ 0 0 0 1 ECU_ADDRESS 0x1FFE7730 /end MEASUREMENT
/begin MEASUREMENT DEH_bAcvPwrRecupLim2 "Limit battery recuperation power to 75 percent" UBYTE swc_DiagcEveHndlg_CM_boolean_dash_ 0 0 0 1 ECU_ADDRESS 0x1FFE7731 /end MEASUREMENT
/begin MEASUREMENT DEH_bAcvPwrdNorm "BMS normal powerdown trigger" UBYTE swc_DiagcEveHndlg_CM_boolean_dash_ 0 0 0 1 ECU_ADDRESS 0x1FFE7732 /end MEASUREMENT
/begin MEASUREMENT DEH_bAcvRecupInh "Recuperation inhibition flag" UBYTE swc_DiagcEveHndlg_CM_boolean_dash_ 0 0 0 1 ECU_ADDRESS 0x1FFE7733 /end MEASUREMENT
/begin MEASUREMENT DEH_bAcvSleepNorm "BMS normal sleep trigger" UBYTE swc_DiagcEveHndlg_CM_boolean_dash_ 0 0 0 1 ECU_ADDRESS 0x1FFE7734 /end MEASUREMENT
/begin MEASUREMENT ELHPN_ErrInfo "Error information packed in uint16.\n      " UWORD swc_EltlLnkHzrdProtnNet_CM_uint16_dash_ 0 0 0 65535 ECU_ADDRESS 0x1FFE751A /end MEASUREMENT
/begin MEASUREMENT ELHPN_RIslnNeg "Negative isolation resistance value" FLOAT32_IEEE swc_EltlLnkHzrdProtnNet_CM_single_kOhm 0 0 -3.40282346639e+038 3.40282346639e+038 ECU_ADDRESS 0x1FFE747C /end MEASUREMENT
/begin MEASUREMENT ELHPN_RIslnNegNv "Negative isolation resistance value to NvRAM." FLOAT32_IEEE swc_EltlLnkHzrdProtnNet_CM_single_kOhm 0 0 -3.40282346639e+038 3.40282346639e+038 ECU_ADDRESS 0x1FFE7480 /end MEASUREMENT
/begin MEASUREMENT ELHPN_RIslnPos "Positive isolation resistance value" FLOAT32_IEEE swc_EltlLnkHzrdProtnNet_CM_single_kOhm 0 0 -3.40282346639e+038 3.40282346639e+038 ECU_ADDRESS 0x1FFE7484 /end MEASUREMENT
/begin MEASUREMENT ELHPN_RIslnPosNv "Positive isolation resistance value to NvRAM." FLOAT32_IEEE swc_EltlLnkHzrdProtnNet_CM_single_kOhm 0 0 -3.40282346639e+038 3.40282346639e+038 ECU_ADDRESS 0x1FFE7488 /end MEASUREMENT
/begin MEASUREMENT ELHPN_StCrash "State of crash. (0: No crash; 1: Crash occurs)" UBYTE swc_EltlLnkHzrdProtnNet_CM_boolean_dash_ 0 0 0 1 ECU_ADDRESS 0x1FFE773D /end MEASUREMENT
/begin MEASUREMENT ELHPN_StCrashIni "iState of crash while initializing. (0: No crash; 1: Crash occurs)" UBYTE swc_EltlLnkHzrdProtnNet_CM_uint8_dash_ 0 0 0 1 ECU_ADDRESS 0x1FFE7735 /end MEASUREMENT
/begin MEASUREMENT ELHPN_StErrHvIntlc "Indicates error state for high voltage interlock condition after debouncing" UBYTE swc_EltlLnkHzrdProtnNet_CM_uint8_dash_ 0 0 0 255 ECU_ADDRESS 0x1FFE7736 /end MEASUREMENT
/begin MEASUREMENT ELHPN_StErrIniHvIntlc "Indicates error state for high voltage interlock condition while initializing." UBYTE swc_EltlLnkHzrdProtnNet_CM_uint8_dash_ 0 0 0 255 ECU_ADDRESS 0x1FFE7737 /end MEASUREMENT
/begin MEASUREMENT ELHPN_StErrIniHvIntlc2 "Indicates error state for non-power high voltage interlock condition while initializing." UBYTE swc_EltlLnkHzrdProtnNet_CM_uint8_dash_ 0 0 0 255 ECU_ADDRESS 0x1FFE7738 /end MEASUREMENT
/begin MEASUREMENT ELHPN_StIsln "State of isolation measurement; 0: OK, 1: error (open contactors), 2: error (closed contactors), 3: error" UBYTE swc_EltlLnkHzrdProtnNet_CM_uint8_dash_ 0 0 0 255 ECU_ADDRESS 0x1FFE7739 /end MEASUREMENT
/begin MEASUREMENT ELHPN_StIslnErr "State of Isolation measurement Error; 0x0: No error, 0x1: Positive isolation fault,  0x2: Negative isolation fault, 0x3: Both P and N fault, 0x4: Isolation test circuit fault, 0x1F: Invalid" UBYTE swc_EltlLnkHzrdProtnNet_CM_uint8_dash_ 0 0 0 255 ECU_ADDRESS 0x1FFE773A /end MEASUREMENT
/begin MEASUREMENT ELHPN_StVehIsln "Vehicle isolation state. (0: Isolation ok; 1: Isolation fault)" UBYTE swc_EltlLnkHzrdProtnNet_CM_uint8_dash_ 0 0 0 255 ECU_ADDRESS 0x1FFE773B /end MEASUREMENT
/begin MEASUREMENT ELHPN_StVehIslnIni "Vehicle isolation state while initializing. (0: Isolation ok; 1: Isolation fault)" UBYTE swc_EltlLnkHzrdProtnNet_CM_uint8_dash_ 0 0 0 255 ECU_ADDRESS 0x1FFE773C /end MEASUREMENT
/begin MEASUREMENT ELHPN_bInhIslnMeas "Signal indicates disabled isolation measurement" UBYTE swc_EltlLnkHzrdProtnNet_CM_boolean_dash_ 0 0 0 1 ECU_ADDRESS 0x1FFE773E /end MEASUREMENT
/begin MEASUREMENT EstimatedRemainingChargingTime "BCS: Estimate the remaining charging time" UWORD swc_COL_CM_uint16_min 0 0 0 65535 ECU_ADDRESS 0x1FFE74F8 /end MEASUREMENT
/begin MEASUREMENT HvSysSample_DisableIso "Turn off the insulation" UBYTE swc_COL_CM_uint8_dash_ 0 0 0 255 ECU_ADDRESS 0x1FFE76AC /end MEASUREMENT
/begin MEASUREMENT MCC_NrCellByMdul "This output defines the number of cells in serial connected to each module controller. The array position stands for the module controller." UBYTE swc_CIL_CM_uint8_dash_ 0 0 0 255 ECU_ADDRESS 0x1FFE5FE4 MATRIX_DIM 24 1 1 /end MEASUREMENT
/begin MEASUREMENT MCC_NrCellTot "Total number of cells (serial) in the system" UWORD swc_CIL_CM_uint16_dash_ 0 0 0 256 ECU_ADDRESS 0x1FFE74B0 /end MEASUREMENT
/begin MEASUREMENT MCC_NrCtlrSnsrTByMdul "Number of module controller PCB temperature sensors per module (identical for each module controller)." UBYTE swc_CIL_CM_uint8_dash_ 0 0 0 255 ECU_ADDRESS 0x1FFE5FFC MATRIX_DIM 24 1 1 /end MEASUREMENT
/begin MEASUREMENT MCC_NrMdulCtlrSnsrTTot "Total number of module controller PCB temperature measurements" UBYTE swc_CIL_CM_uint8_dash_ 0 0 0 255 ECU_ADDRESS 0x1FFE75F7 /end MEASUREMENT
/begin MEASUREMENT MCC_NrMdulTot "Total number of modules in the system" UBYTE swc_CIL_CM_uint8_dash_ 0 0 0 255 ECU_ADDRESS 0x1FFE75F8 /end MEASUREMENT
/begin MEASUREMENT MCC_NrSnsrTByMdul "This output defines the number of temperature sensors connected to each module controller. The array position stands for the module controller." UBYTE swc_CIL_CM_uint8_dash_ 0 0 0 255 ECU_ADDRESS 0x1FFE6014 MATRIX_DIM 24 1 1 /end MEASUREMENT
/begin MEASUREMENT MCC_NrSnsrTTot "Total number of cell temperature sensors in the system" UBYTE swc_CIL_CM_uint8_dash_ 0 0 0 255 ECU_ADDRESS 0x1FFE75F9 /end MEASUREMENT
/begin MEASUREMENT MCC_StMdulCu "State of the module control units (CMCs)." UBYTE swc_CIL_CM_uint8_dash_ 0 0 0 255 ECU_ADDRESS 0x1FFE75FA /end MEASUREMENT
/begin MEASUREMENT MaxChargingVoltage "BHM: Maximum allowable total charging voltage" UWORD swc_COL_CM_uint16_V 0 0 0 65535 ECU_ADDRESS 0x1FFE74FA /end MEASUREMENT
/begin MEASUREMENT MaxPermChargingCurrent "BCP: Maximum allowable charging current" UWORD swc_COL_CM_uint16_A 0 0 0 65535 ECU_ADDRESS 0x1FFE74FC /end MEASUREMENT
/begin MEASUREMENT MaxPermTemperature "BCP: Maximum permissible temperature" UBYTE swc_COL_CM_uint8___C 0 0 0 255 ECU_ADDRESS 0x1FFE76AD /end MEASUREMENT
/begin MEASUREMENT MaxSingleBattChargingVoltage "BCP: The maximum allowable charging voltage of a single power battery" UWORD swc_COL_CM_uint16_V 0 0 0 65535 ECU_ADDRESS 0x1FFE74FE /end MEASUREMENT
/begin MEASUREMENT MeasuredChargingCurrent "BCS: Charge (discharge) current measurement" UWORD swc_COL_CM_uint16_A 0 0 0 65535 ECU_ADDRESS 0x1FFE7500 /end MEASUREMENT
/begin MEASUREMENT MeasuredChargingVoltage "BCS: Charging (discharging) voltage measurements" UWORD swc_COL_CM_uint16_V 0 0 0 65535 ECU_ADDRESS 0x1FFE7502 /end MEASUREMENT
/begin MEASUREMENT NVM_CMdulAgiFacFls "Modules capacity ageing factor stored" FLOAT32_IEEE swc_DiagcEveHndlg_CM_single_dash_ 0 0 -3.40282346639e+038 3.40282346639e+038 ECU_ADDRESS 0x1FFE63D8 MATRIX_DIM 24 1 1 /end MEASUREMENT
/begin MEASUREMENT NVM_CtrCh "Non-volatile memory variable: Cumulative number of battery charges (charger online)" UWORD swc_DiagcEveHndlg_CM_uint16_dash_ 0 0 0 65535 ECU_ADDRESS 0x1FFE7514 /end MEASUREMENT
/begin MEASUREMENT NVM_CtrCtctrAgiCh "Non-volatile memory variable: Deterioration (aging) counter of the charge contactor. This counter represents the theoretical switching cycles which are dependent on the current flow during make/break events." FLOAT32_IEEE swc_DiagcEveHndlg_CM_single_dash_ 0 0 0 10000000 ECU_ADDRESS 0x1FFE6438 /end MEASUREMENT
/begin MEASUREMENT NVM_CtrCtctrAgiHeat "Non-volatile memory variable: Deterioration (aging) counter of the heat contactor. This counter represents the theoretical switching cycles which are dependent on the current flow during make/break events." FLOAT32_IEEE swc_DiagcEveHndlg_CM_single_dash_ 0 0 0 10000000 ECU_ADDRESS 0x1FFE643C /end MEASUREMENT
/begin MEASUREMENT NVM_CtrCtctrAgiNeg "Non-volatile memory variable: Deterioration (aging) counter of the negative contactor. This counter represents the theoretical switching cycles which are dependent on the current flow during make/break events." FLOAT32_IEEE swc_DiagcEveHndlg_CM_single_dash_ 0 0 0 10000000 ECU_ADDRESS 0x1FFE6440 /end MEASUREMENT
/begin MEASUREMENT NVM_CtrCtctrAgiPos "Non-volatile memory variable: Deterioration (aging) counter of the positive contactor. This counter represents the theoretical switching cycles which are dependent on the current flow during make/break events." FLOAT32_IEEE swc_DiagcEveHndlg_CM_single_dash_ 0 0 0 10000000 ECU_ADDRESS 0x1FFE6444 /end MEASUREMENT
/begin MEASUREMENT NVM_CtrCtctrAgiPrech "Non-volatile memory variable: Deterioration (aging) counter of the precharge contactor. This counter represents the theoretical switching cycles which are dependent on the current flow during make/break events." FLOAT32_IEEE swc_DiagcEveHndlg_CM_single_dash_ 0 0 0 10000000 ECU_ADDRESS 0x1FFE6448 /end MEASUREMENT
/begin MEASUREMENT NVM_CtrDcha "Non-volatile memory variable: Cumulative number of battery discharges (V2V)" UWORD swc_DiagcEveHndlg_CM_uint16_dash_ 0 0 0 65535 ECU_ADDRESS 0x1FFE7516 /end MEASUREMENT
/begin MEASUREMENT NVM_DayRtcLst "Non-volatile memory variable: Real time when the relays start to disconnect. Unit: day" UBYTE swc_DiagcEveHndlg_CM_uint8_day 0 0 0 255 ECU_ADDRESS 0x1FFE770F /end MEASUREMENT
/begin MEASUREMENT NVM_EBatChTot "Non-volatile memory variable: total energy stored in battery during its life cycle" FLOAT32_IEEE swc_DiagcEveHndlg_CM_single_kWh 0 0 0 1000000000 ECU_ADDRESS 0x1FFE644C /end MEASUREMENT
/begin MEASUREMENT NVM_EBatDchaTot "Non-volatile memory variable: total energy supplied by battery during its life cycle" FLOAT32_IEEE swc_DiagcEveHndlg_CM_single_kWh 0 0 0 1000000000 ECU_ADDRESS 0x1FFE6450 /end MEASUREMENT
/begin MEASUREMENT NVM_HourRtcLst "Non-volatile memory variable: Real time when the relays start to disconnect. Unit: hour" UBYTE swc_DiagcEveHndlg_CM_uint8_h 0 0 0 255 ECU_ADDRESS 0x1FFE7710 /end MEASUREMENT
/begin MEASUREMENT NVM_IBatChMax "Non-volatile memory variable: Maximum current during battery charging within its life cycle" FLOAT32_IEEE swc_DiagcEveHndlg_CM_single_A 0 0 0 2000 ECU_ADDRESS 0x1FFE6454 /end MEASUREMENT
/begin MEASUREMENT NVM_IBatDchaMax "Non-volatile memory variable: Maximum current during battery discharging within its life cycle" FLOAT32_IEEE swc_DiagcEveHndlg_CM_single_A 0 0 0 2000 ECU_ADDRESS 0x1FFE6458 /end MEASUREMENT
/begin MEASUREMENT NVM_MinuRtcLst "Non-volatile memory variable: Real time when the relays start to disconnect. Unit: minute" UBYTE swc_DiagcEveHndlg_CM_uint8_min 0 0 0 255 ECU_ADDRESS 0x1FFE7711 /end MEASUREMENT
/begin MEASUREMENT NVM_MonthRtcLst "Non-volatile memory variable: Real time when the relays start to disconnect. Unit: mouth" UBYTE swc_DiagcEveHndlg_CM_uint8_month 0 0 0 255 ECU_ADDRESS 0x1FFE7712 /end MEASUREMENT
/begin MEASUREMENT NVM_PBatChMax "Non-volatile memory variable: maximum power during battery charging within its life cycle" FLOAT32_IEEE swc_DiagcEveHndlg_CM_single_kW 0 0 0 600 ECU_ADDRESS 0x1FFE645C /end MEASUREMENT
/begin MEASUREMENT NVM_PBatDchaMax "Non-volatile memory variable: maximum power during battery discharging within its life cycle" FLOAT32_IEEE swc_DiagcEveHndlg_CM_single_kW 0 0 0 600 ECU_ADDRESS 0x1FFE6460 /end MEASUREMENT
/begin MEASUREMENT NVM_RIslnNeg "Negative isolation resistance value from NvRAM." FLOAT32_IEEE swc_DiagcEveHndlg_CM_single_kOhm 0 0 -3.40282346639e+038 3.40282346639e+038 ECU_ADDRESS 0x1FFE6464 /end MEASUREMENT
/begin MEASUREMENT NVM_RIslnPos "Positive isolation resistance value from NvRAM." FLOAT32_IEEE swc_DiagcEveHndlg_CM_single_kOhm 0 0 -3.40282346639e+038 3.40282346639e+038 ECU_ADDRESS 0x1FFE6468 /end MEASUREMENT
/begin MEASUREMENT NVM_RMdulAgiFacFls "Module resistance ageing factors stored" FLOAT32_IEEE swc_DiagcEveHndlg_CM_single_dash_ 0 0 -3.40282346639e+038 3.40282346639e+038 ECU_ADDRESS 0x1FFE646C MATRIX_DIM 24 1 1 /end MEASUREMENT
/begin MEASUREMENT NVM_SecRtcLst "Non-volatile memory variable: Real time when the relays start to disconnect. Unit: second" UBYTE swc_DiagcEveHndlg_CM_uint8_s 0 0 0 255 ECU_ADDRESS 0x1FFE7713 /end MEASUREMENT
/begin MEASUREMENT NVM_SocBatMax "Non-volatile memory variable: Maximum state of charge of battery during its life cycle" FLOAT32_IEEE swc_DiagcEveHndlg_CM_single_dash_ 0 0 0 1 ECU_ADDRESS 0x1FFE64CC /end MEASUREMENT
/begin MEASUREMENT NVM_SocBatMin "Non-volatile memory variable: Minimum state of charge of battery during its life cycle" FLOAT32_IEEE swc_DiagcEveHndlg_CM_single_dash_ 0 0 0 1 ECU_ADDRESS 0x1FFE64D0 /end MEASUREMENT
/begin MEASUREMENT NVM_SohRDeltaFls "Delta R based SOH value in flash" FLOAT32_IEEE swc_DiagcEveHndlg_CM_single_dash_ 0 0 -3.40282346639e+038 3.40282346639e+038 ECU_ADDRESS 0x1FFE64D4 MATRIX_DIM 24 1 1 /end MEASUREMENT
/begin MEASUREMENT NVM_SohSocDeltaFls "DeltaSOC based SOH value in flash" FLOAT32_IEEE swc_DiagcEveHndlg_CM_single_dash_ 0 0 -3.40282346639e+038 3.40282346639e+038 ECU_ADDRESS 0x1FFE6534 MATRIX_DIM 24 1 1 /end MEASUREMENT
/begin MEASUREMENT NVM_StAryFls "Module model states of electrical and thermal model" FLOAT32_IEEE swc_DiagcEveHndlg_CM_single_dash_ 0 0 -3.40282346639e+038 3.40282346639e+038 ECU_ADDRESS 0x1FFE6594 MATRIX_DIM 144 1 1 /end MEASUREMENT
/begin MEASUREMENT NVM_TMdulSnsrMax "Non-volatile memory variable: Maximum temperature measured by sensors in battery modules during battery life cycle" FLOAT32_IEEE swc_DiagcEveHndlg_CM_single__ 0 0 -60 140 ECU_ADDRESS 0x1FFE67D4 /end MEASUREMENT
/begin MEASUREMENT NVM_TMdulSnsrMin "Non-volatile memory variable: Minimum temperature measured by sensors in battery modules during battery life cycle" FLOAT32_IEEE swc_DiagcEveHndlg_CM_single__ 0 0 -60 140 ECU_ADDRESS 0x1FFE67D8 /end MEASUREMENT
/begin MEASUREMENT NVM_TiBatAgi "Non-volatile memory variable: Time of battery in use with closed contactors" ULONG swc_DiagcEveHndlg_CM_uint32_s 0 0 0 4294967295 ECU_ADDRESS 0x1FFE67DC /end MEASUREMENT
/begin MEASUREMENT NVM_TiBatOffForMdulCFls "TiBatOff stored in flash for Mdul C Observer" ULONG swc_DiagcEveHndlg_CM_uint32_dash_ 0 0 0 4294967295 ECU_ADDRESS 0x1FFE67E0 MATRIX_DIM 24 1 1 /end MEASUREMENT
/begin MEASUREMENT NVM_TiBatOffForMdulRFls "TiBatOff stored in flash for Mdul R Observer" ULONG swc_DiagcEveHndlg_CM_uint32_dash_ 0 0 0 4294967295 ECU_ADDRESS 0x1FFE6840 MATRIX_DIM 24 1 1 /end MEASUREMENT
/begin MEASUREMENT NVM_UBatCtctrClsdMax "Non-volatile memory variable: Maximum voltage of battery with closed contactors during its life cycle" FLOAT32_IEEE swc_DiagcEveHndlg_CM_single_V 0 0 0 1000 ECU_ADDRESS 0x1FFE68A0 /end MEASUREMENT
/begin MEASUREMENT NVM_UBatCtctrClsdMin "Non-volatile memory variable: Minimum voltage of battery with closed contactors during its life cycle" FLOAT32_IEEE swc_DiagcEveHndlg_CM_single_V 0 0 0 1000 ECU_ADDRESS 0x1FFE68A4 /end MEASUREMENT
/begin MEASUREMENT NVM_UBatCtctrOpenMax "Non-volatile memory variable: Maximum voltage of battery with open contactors during its life cycle" FLOAT32_IEEE swc_DiagcEveHndlg_CM_single_V 0 0 0 1000 ECU_ADDRESS 0x1FFE68A8 /end MEASUREMENT
/begin MEASUREMENT NVM_UBatCtctrOpenMin "Non-volatile memory variable: Minimum voltage of battery with open contactors during its life cycle" FLOAT32_IEEE swc_DiagcEveHndlg_CM_single_V 0 0 0 1000 ECU_ADDRESS 0x1FFE68AC /end MEASUREMENT
/begin MEASUREMENT NVM_UCellMax "Non-volatile memory variable: Maximum cell voltage of battery during its life cycle" FLOAT32_IEEE swc_DiagcEveHndlg_CM_single_V 0 0 0 5 ECU_ADDRESS 0x1FFE68B0 /end MEASUREMENT
/begin MEASUREMENT NVM_UCellMin "Non-volatile memory variable: Minimum cell voltage of battery during its life cycle" FLOAT32_IEEE swc_DiagcEveHndlg_CM_single_V 0 0 0 5 ECU_ADDRESS 0x1FFE68B4 /end MEASUREMENT
/begin MEASUREMENT NVM_UPrechAccumd "Non-volatile memory variable: Accumulated precharged voltage used for precharge resistor protection" FLOAT32_IEEE swc_DiagcEveHndlg_CM_single_V 0 0 0 10000 ECU_ADDRESS 0x1FFE68B8 /end MEASUREMENT
/begin MEASUREMENT NVM_YearRtcLst "Non-volatile memory variable: Real time when the relays start to disconnect. Unit: year" UWORD swc_DiagcEveHndlg_CM_uint16_year 0 0 0 65535 ECU_ADDRESS 0x1FFE7518 /end MEASUREMENT
/begin MEASUREMENT NVM_bErrMdulSocInvldFls "Soc Estimation Error Flag per Module" UBYTE swc_DiagcEveHndlg_CM_uint8_dash_ 0 0 0 255 ECU_ADDRESS 0x1FFE68BC MATRIX_DIM 24 1 1 /end MEASUREMENT
/begin MEASUREMENT SingleBatteryHighestVoltage "BCS: Maximum monomer power battery voltage" UWORD swc_COL_CM_uint16_V 0 0 0 65535 ECU_ADDRESS 0x1FFE7504 /end MEASUREMENT
/begin MEASUREMENT SingleBatteryHighestVoltageGroup "BCS: The highest single power battery voltage and its group number" UBYTE swc_COL_CM_uint8_dash_ 0 0 0 255 ECU_ADDRESS 0x1FFE76AE /end MEASUREMENT
/begin MEASUREMENT SingleBatteryHighestVoltageSerNo "BSM: The number of the highest single power battery voltage" UBYTE swc_COL_CM_uint8_dash_ 0 0 0 255 ECU_ADDRESS 0x1FFE76AF /end MEASUREMENT
/begin MEASUREMENT SingleBatteryMaxTemperature "BSD: Maximum temperature of the power battery" UBYTE swc_COL_CM_uint8___C 0 0 0 255 ECU_ADDRESS 0x1FFE76B0 /end MEASUREMENT
/begin MEASUREMENT SingleBatteryMaxVoltage "BSD: The highest voltage of the power battery unit" UWORD swc_COL_CM_uint16_V 0 0 0 65535 ECU_ADDRESS 0x1FFE7506 /end MEASUREMENT
/begin MEASUREMENT SingleBatteryMinTemperature "BSD: Minimum temperature of the power battery" UBYTE swc_COL_CM_uint8___C 0 0 0 255 ECU_ADDRESS 0x1FFE76B1 /end MEASUREMENT
/begin MEASUREMENT SingleBatteryMinVoltage "BSD: The lowest voltage of the power battery unit" UWORD swc_COL_CM_uint16_V 0 0 0 65535 ECU_ADDRESS 0x1FFE7508 /end MEASUREMENT
/begin MEASUREMENT SingleBatteryUnusualVoltage "BSM: The voltage of the single power battery is too high/too low" UBYTE swc_COL_CM_uint8_dash_ 0 0 0 255 ECU_ADDRESS 0x1FFE76B2 /end MEASUREMENT
/begin MEASUREMENT StatusVehiclePowerStorageBattery "BCP: the state of charge of the vehicle power battery" UWORD swc_COL_CM_uint16_percent_ 0 0 0 65535 ECU_ADDRESS 0x1FFE750A /end MEASUREMENT
/begin MEASUREMENT SuspendStateOfChargeSOC "BSD: Abort State of Charge SOC" UBYTE swc_COL_CM_uint8_percent_ 0 0 0 255 ECU_ADDRESS 0x1FFE76B3 /end MEASUREMENT
/begin MEASUREMENT Timeout_CCS "BEM: ccs timeout" UBYTE swc_COL_CM_uint8_dash_ 0 0 0 255 ECU_ADDRESS 0x1FFE76B4 /end MEASUREMENT
/begin MEASUREMENT Timeout_CRM_Recognized "BEM" UBYTE swc_COL_CM_uint8_dash_ 0 0 0 255 ECU_ADDRESS 0x1FFE76B5 /end MEASUREMENT
/begin MEASUREMENT Timeout_CRM_Unrecognized "BEM" UBYTE swc_COL_CM_uint8_dash_ 0 0 0 255 ECU_ADDRESS 0x1FFE76B6 /end MEASUREMENT
/begin MEASUREMENT Timeout_CRO "BEM" UBYTE swc_COL_CM_uint8_dash_ 0 0 0 255 ECU_ADDRESS 0x1FFE76B7 /end MEASUREMENT
/begin MEASUREMENT Timeout_CSD "BEM" UBYTE swc_COL_CM_uint8_dash_ 0 0 0 255 ECU_ADDRESS 0x1FFE76B8 /end MEASUREMENT
/begin MEASUREMENT Timeout_CST "BEM" UBYTE swc_COL_CM_uint8_dash_ 0 0 0 255 ECU_ADDRESS 0x1FFE76B9 /end MEASUREMENT
/begin MEASUREMENT Timeout_CTS_CML "BEM" UBYTE swc_COL_CM_uint8_dash_ 0 0 0 255 ECU_ADDRESS 0x1FFE76BA /end MEASUREMENT
/begin MEASUREMENT TotalMaxPermChargingVoltage "BCP: Maximum allowable total charging voltage" UWORD swc_COL_CM_uint16_V 0 0 0 65535 ECU_ADDRESS 0x1FFE750C /end MEASUREMENT
/begin MEASUREMENT TotalNominalEnergy "BCP: The nominal total energy of the power battery" UWORD swc_COL_CM_uint16_Ah 0 0 0 65535 ECU_ADDRESS 0x1FFE750E /end MEASUREMENT
/begin MEASUREMENT VehicleBatteryUnusualChargeState "BSM: The SOC of the whole vehicle power battery is too high/too low" UBYTE swc_COL_CM_uint8_dash_ 0 0 0 255 ECU_ADDRESS 0x1FFE76BB /end MEASUREMENT
/begin MEASUREMENT VoltageDemand "BCL: Charging Demand Voltage/Discharge Permissible Voltage" UWORD swc_COL_CM_uint16_V 0 0 0 65535 ECU_ADDRESS 0x1FFE7510 /end MEASUREMENT
/begin GROUP swc_BatProtnIU "swc_BatProtnIU" ROOT /begin SUB_GROUP Root_CellUDiag Root_PackIDiag /end SUB_GROUP
 /begin REF_MEASUREMENT BPIU_ErrCellU BPIU_ErrCellUColctIRV BPIU_ErrCellUDif BPIU_ErrCellUDifIRV BPIU_ErrCellUMax1IRV BPIU_ErrCellUMax2IRV BPIU_ErrCellUMax3IRV BPIU_ErrCellUMin1IRV BPIU_ErrCellUMin2IRV BPIU_ErrCellUMin3IRV BPIU_ErrCellUOutOfRngIRV BPIU_ErrCellUOver BPIU_ErrCellUOverMaxIRV BPIU_ErrCellUOverMinIRV BPIU_ErrCellURateIRV BPIU_ErrIChLim BPIU_ErrIDchaLim BPIU_ErrInfo BPIU_ErrMdulUOutOfRngIRV BPIU_ErrPackSnsrI BPIU_ErrPackUColctIRV BPIU_ErrUAcqn BPIU_ErrUAcqnIRV BPIU_ErrUIntIRV BPIU_IDchaDiagLim BPIU_IdCellUMax BPIU_IdCellUMin BPIU_IdMdulForCellUMax BPIU_IdMdulForCellUMin BPIU_StCellUChkOverMax BPIU_StCellUChkOverMin BPIU_StChkUMax BPIU_StChkUMin BPIU_UCellMax BPIU_UCellMin BPIU_bErrCellUDif BPIU_bErrUAcqn /end REF_MEASUREMENT
/end GROUP
/begin GROUP swc_BatProtnPack "swc_BatProtnPack" ROOT /begin SUB_GROUP S1_1000ms S2_10ms /end SUB_GROUP /end GROUP
/begin GROUP swc_BatThermHndlgMngt "swc_BatThermHndlgMngt" ROOT /begin SUB_GROUP Root_BTHM_100ms_sys /end SUB_GROUP
 /begin REF_MEASUREMENT BTHM_ErrChEnd BTHM_ErrInfo BTHM_IdCellTMax BTHM_IdCellTMin BTHM_IdMdulTMax BTHM_IdMdulTMin BTHM_MfCoolt BTHM_StErrTOver BTHM_StRlyHeatReq BTHM_StRlyMainNeg BTHM_StSys BTHM_StThermReq BTHM_TBatTgt BTHM_TBcuSnsr BTHM_TCooltPackInSnsr BTHM_TCooltPackOutSnsr BTHM_TMdulCtlrSnsr BTHM_TMdulCtlrSnsrMax BTHM_TMdulCtlrSnsrMin BTHM_TMdulMaxAry BTHM_TMdulMeanAry BTHM_TMdulMinAry BTHM_TMdulSnsr BTHM_TMdulSnsrMax BTHM_TMdulSnsrMaxRaw BTHM_TMdulSnsrMin BTHM_TMdulSnsrMinRaw BTHM_TMdulSnsrRaw BTHM_TOptmMax BTHM_TOptmMin BTHM_TPack /end REF_MEASUREMENT
/end GROUP
/begin GROUP swc_BatWntyLogtcData "swc_BatWntyLogtcData" ROOT /begin SUB_GROUP Root_100ms Root_10ms /end SUB_GROUP
 /begin REF_MEASUREMENT BWLD_CtrCh BWLD_CtrChNv BWLD_CtrDcha BWLD_CtrDchaNv BWLD_CtrMdulWrNv BWLD_CtrMdulWrNvTmp BWLD_EBatChDrvCyc BWLD_EBatChTot BWLD_EBatChTotNv BWLD_EBatChTotRaw BWLD_EBatDchaDrvCyc BWLD_EBatDchaTot BWLD_EBatDchaTotNv BWLD_EBatDchaTotRaw BWLD_EBatMemChTot BWLD_EBatMemDchaTot BWLD_IBatChMax BWLD_IBatChMaxNv BWLD_IBatChMaxRaw BWLD_IBatDchaMax BWLD_IBatDchaMaxNv BWLD_IBatDchaMaxRaw BWLD_LvlAcs BWLD_LvlAcsRaw BWLD_PBatChMax BWLD_PBatChMaxNv BWLD_PBatChMaxRaw BWLD_PBatDchaMax BWLD_PBatDchaMaxNv BWLD_PBatDchaMaxRaw BWLD_SocBatMax BWLD_SocBatMaxNv BWLD_SocBatMaxRaw BWLD_SocBatMin BWLD_SocBatMinNv BWLD_SocBatMinRaw BWLD_TMdulSnsrMax BWLD_TMdulSnsrMaxNv BWLD_TMdulSnsrMaxRaw BWLD_TMdulSnsrMin BWLD_TMdulSnsrMinNv BWLD_TMdulSnsrMinRaw BWLD_TiBatAgi BWLD_TiBatAgiNv BWLD_TiBatAgiRaw BWLD_UBatCtctrClsdMax BWLD_UBatCtctrClsdMaxNv BWLD_UBatCtctrClsdMaxRaw BWLD_UBatCtctrClsdMin BWLD_UBatCtctrClsdMinNv BWLD_UBatCtctrClsdMinRaw BWLD_UBatCtctrOpenMax BWLD_UBatCtctrOpenMaxNv BWLD_UBatCtctrOpenMaxRaw BWLD_UBatCtctrOpenMin BWLD_UBatCtctrOpenMinNv BWLD_UBatCtctrOpenMinRaw BWLD_UCellMax BWLD_UCellMaxNv BWLD_UCellMaxRaw BWLD_UCellMin BWLD_UCellMinNv BWLD_UCellMinRaw /end REF_MEASUREMENT
/end GROUP
/begin GROUP swc_BcuStTranCtl "swc_BcuStTranCtl" ROOT /begin SUB_GROUP Root_BcuStTranCtl_sys /end SUB_GROUP
 /begin REF_MEASUREMENT BSTC_DayRtcLstNv BSTC_ErrInfo BSTC_HourRtcLstNv BSTC_MinuRtcLstNv BSTC_MonthRtcLstNv BSTC_ReqEmcyHvOffFromBms BSTC_ReqEmcyHvOffFromVcu BSTC_ReqShtdnBas BSTC_RstCmd BSTC_RstCmd100 BSTC_SecRtcLstNv BSTC_StBcu BSTC_StBcuInt BSTC_StBmsChk BSTC_TiBalAftCh BSTC_TiBalAftChLst BSTC_TiBalForCh BSTC_TiBatOff BSTC_TiBatOn BSTC_TrigChScs BSTC_YearRtcLstNv BSTC_bAcvCutoffLvFromBms BSTC_bAcvDcStChToStHvOffNorm BSTC_bAcvHvOffNormFromVcu BSTC_bAcvObcOff BSTC_bAcvRstDecrTiBalForCh BSTC_bAcvStAftRunToStInin BSTC_bAcvStAftRunToStSleep BSTC_bAcvStDchaToStHvOffNorm BSTC_bAcvStHvOffToStAftRun BSTC_bAcvStIninToStSleep BSTC_bAcvStRunToStHvOffEmcy BSTC_bAcvStSleepToStInin BSTC_bAcvStStbToStAftRun BSTC_bAcvStStbToStDcha BSTC_bAcvTiDecrBal BSTC_bAcvTranBtwnStDchaAndStCh BSTC_bErrHvOffAbno BSTC_bErrPwrOff BSTC_bErrToutForRxCutoffLvReq BSTC_bErrToutForRxHvOffReq BSTC_bErrToutForRxVldMsg /end REF_MEASUREMENT
/end GROUP
/begin GROUP swc_CIL "swc_CIL" ROOT /begin SUB_GROUP Root_CIL_100ms_sys Root_CIL_10ms_sys /end SUB_GROUP
 /begin REF_MEASUREMENT BMC_UCell BSOF_AcvChManSuspd BSOF_AcvChSuspdByBms BSOF_AcvChSuspdCdnRchd BSOF_AcvChSuspdFlt BSOF_ChAllwd BSOF_DirChAndDcha BSOF_EChSng BSOF_ErrChImpo BSOF_ErrChrgrOutpFlt BSOF_ErrChrgrOvtempFlt BSOF_ErrChrgrOvtempIntFlt BSOF_ErrChrgrShtdnEmcy BSOF_ErrIDe BSOF_ErrUAbno BSOF_ErrUndfnd BSOF_IChrgr BSOF_IChrgrMax BSOF_IChrgrMin BSOF_IDchaMax BSOF_IDchaMin BSOF_MsgChrgrRcgtn BSOF_MsgChrgrRdy BSOF_NrChrgrComVers BSOF_SocDchaMax BSOF_SocDchaMin BSOF_TiChAccumd BSOF_UChrgr BSOF_UChrgrMax BSOF_UChrgrMin BSOF_UDchaMax BSOF_UDchaMin BSOF_bAcvDcChrgrPlg BSOF_bEnaMsgChrgrChDetd BSOF_bEnaMsgChrgrChSt BSOF_bEnaMsgChrgrChSuspd BSOF_bEnaMsgChrgrDetnCnct BSOF_bEnaMsgChrgrErr BSOF_bEnaMsgChrgrHdshk BSOF_bEnaMsgChrgrMaxOut BSOF_bEnaMsgChrgrMaxOutPgtn BSOF_bEnaMsgChrgrRcgtn BSOF_bEnaMsgChrgrRdy BSOF_bEnaMsgChrgrStstc BSOF_bEnaMsgChrgrStstcForPgtn BSOF_bErrMsgTout CIL_CtrIslnRSamplg CIL_DayRtc CIL_DucycCrash CIL_DucycCtlPilot CIL_DucycHvil CIL_ErrAcScktSnsrT CIL_ErrDcScktSnsrT CIL_FrqCrash CIL_FrqHvil CIL_HourRtc CIL_IBatHv CIL_IDcdcLvAct CIL_IEACAct CIL_IObcChOutp CIL_MinuRtc CIL_ModeMotDrv CIL_ModeSysWup CIL_MonthRtc CIL_PwrEACAct CIL_PwrPtcAct CIL_RAcChCnctn CIL_RIslnNeg CIL_RIslnPos CIL_RngElec CIL_SecRtc CIL_SpdMot CIL_SpdVeh CIL_StAcChCnct CIL_StBatHvReq CIL_StBatLvCutoffReq CIL_StCellT CIL_StCellTSamplgExcpn CIL_StCellUSamplgExcpn CIL_StChAllwd CIL_StChWup CIL_StCrash CIL_StMsgToutForPMS CIL_StObc CIL_StPtIndcr CIL_StPtcW CIL_StTrml15 CIL_TAcChPointNeg CIL_TAcChPointPos CIL_TBdSnsr CIL_TCooltPackInSnsr CIL_TCooltPackOutSnsr CIL_TDcChPointNeg CIL_TDcChPointPos CIL_TMdul CIL_TMdulCtlr CIL_TSnsrI CIL_TiSysRun CIL_UChPoleHiSideDrv CIL_UDcdcLvAct CIL_UEACAct CIL_UHeatPoleHiSideDrv CIL_UMainNegPoleAftRly CIL_UMainNegPoleHiSideDrv CIL_UMainPosPoleAftRly CIL_UMainPosPoleBefRly CIL_UMainPosPoleHiSideDrv CIL_UObcChInp CIL_UObcChOutp CIL_UPoleAftRlyCh CIL_UPoleAftRlyHeat CIL_URlyPrechHiSideDrv CIL_UTrml30 CIL_YearRtc CIL_bRdyBswStoreFnshd CIL_bVldBatIHv CIL_bVldCellTSamplg CIL_bVldCellUSamplg CIL_bVldIslnR CIL_bVldUMainNegPoleAftRly CIL_bVldUMainPosPoleAftRly CIL_bVldUMainPosPoleBefRly CIL_bVldUPoleAftRlyCh CIL_bVldUPoleAftRlyHeat MCC_NrCellByMdul MCC_NrCellTot MCC_NrCtlrSnsrTByMdul MCC_NrMdulCtlrSnsrTTot MCC_NrMdulTot MCC_NrSnsrTByMdul MCC_NrSnsrTTot MCC_StMdulCu /end REF_MEASUREMENT
/end GROUP
/begin GROUP swc_COL "swc_COL" ROOT /begin SUB_GROUP Root_COL_1000ms_sys Root_COL_100ms_sys Root_COL_10ms_sys /end SUB_GROUP
 /begin REF_MEASUREMENT B2V_ST1_ChgMode B2V_SingleChgEnergy BCPP_Max_Allow_DCCur BCPP_Max_Allow_DCV BCPP_Min_Allow_CellV BCPP_Min_Allow_Soc BCSP_Remaining_discharge_time BCSP_Remaining_range BCSP_reserved BDC_Battery_capacity BDC_Battery_energy BDC_Current_V2GCirculate BDC_Remainder_CruisingRange BDC_Remainder_V2GCirculate BDC_Soc BDC_Vin1_Copy_1 BDC_Vin1_Copy_10 BDC_Vin1_Copy_11 BDC_Vin1_Copy_12 BDC_Vin1_Copy_13 BDC_Vin1_Copy_14 BDC_Vin1_Copy_15 BDC_Vin1_Copy_16 BDC_Vin1_Copy_17 BDC_Vin1_Copy_2 BDC_Vin1_Copy_3 BDC_Vin1_Copy_4 BDC_Vin1_Copy_5 BDC_Vin1_Copy_6 BDC_Vin1_Copy_7 BDC_Vin1_Copy_8 BDC_Vin1_Copy_9 BMS_ActWorkSts BMS_BBMSensorCurr BMS_BMSStopChgErrReason BMS_BMSStopChgFltReason BMS_BMSStopChgReason BMS_BattCellVolFault BMS_BattCellsNum BMS_BattConsistencyFlt BMS_BattCurr BMS_BattEqualizationSts BMS_BattIsolationSts BMS_BattManuCode BMS_BattManufDay BMS_BattManufMonth BMS_BattManufYear BMS_BattMaxTemp1 BMS_BattMaxWorkTemp BMS_BattMinTemp1 BMS_BattMinWorkTemp BMS_BattPACKSerNum BMS_BattPackInCoolTemp BMS_BattPackMatchFault BMS_BattPackNum BMS_BattPackOutCoolTemp BMS_BattPackRemainEgy BMS_BattPackVolFault BMS_BattRateCapacity BMS_BattRateVol BMS_BattSOC BMS_BattSOCFault BMS_BattSOH BMS_BattSysFltCode BMS_BattTempFault BMS_BattTotalChgEny BMS_BattTotalDischgEny BMS_BattVol BMS_BattaryType BMS_Batty_ThermalMangeReq BMS_CANComFault BMS_CCUStopChgErrReason BMS_CCUStopChgFltReason BMS_CCUStopChgReason BMS_CellTempDiffFault BMS_CellVolDiffFault BMS_Cell_Avg_Temp BMS_ChargeCurrFault BMS_ChgCount BMS_ChgStatus BMS_ChgTimeRemain BMS_CoolNegRelayCtrl BMS_CoolPosRelayCtrl BMS_CurrSensorFault BMS_CutOffLVFbToOBC BMS_DCChargRelayCtrl BMS_DCChgNegTemp BMS_DCChgPlugSts BMS_DCChgPosTemp BMS_DCChgReady BMS_DCChgStage BMS_DischargeCurrFault BMS_ElectroniclockSts BMS_EmergCutoffHVReq BMS_EnyRecoCurrHighFlt BMS_FastChgConnStsFb BMS_FastChgRelayFlt BMS_FaultLevel BMS_HVIsolationSts BMS_HVLoopWorkSts BMS_HeatNegRelayCtrl_Reserved BMS_HeatNegRelayFault_Reserved BMS_HeatPosRelayCtrl_Reserved BMS_HeatPosRelayFault_Reserved BMS_HeatRelaySts BMS_HeatingSatus BMS_IC_Temp BMS_InsideFltCode BMS_IsolationFault BMS_MILTelltale BMS_MSDFault BMS_MainNegRelay1Ctrl BMS_MainNegRelay2Ctrl BMS_MainPosConnSts BMS_MaxCellVolt BMS_MaxChgCurrent BMS_MaxChgVoltage BMS_MaxPmtDischgCurr BMS_MaxPmtEnyRecoCurr BMS_MaxPmtEnyRecoVol BMS_MaxTemp1PackNum BMS_MaxTemp1SnsNum BMS_MaxVoltCellNum BMS_MaxVoltCellPackNum BMS_MinCellVolt BMS_MinPmtSOC BMS_MinTemp1PackNum BMS_MinTemp1SnsNum BMS_MinVoltCellNum BMS_MinVoltCellPackNum BMS_NegIsolationRes BMS_NegRelayFault BMS_NegRelaySts BMS_OBCChgContrlCmd BMS_OverChgFault BMS_PTCConnStsFb BMS_PmtCutoffLVFb BMS_PosIsolationRes BMS_PosRelayFault BMS_PowerActiveMode BMS_PreChgConnSts BMS_PreChgRelayFlt BMS_SOCJumpFault BMS_SOC_01 BMS_ST1_Flt_HVIL BMS_ST1_Flt_HW BMS_SelfChkState BMS_SetTgtTemp BMS_SingleDisChgEny BMS_SubFltLevell BMS_TempOutofCtr BMS_TempSnsNum BMS_TestFrame BSWIOSP_Mode_Request_shutdown BSWIOSP_Request_BCL BSWIOSP_Request_BCP BSWIOSP_Request_BCPP BSWIOSP_Request_BCS BSWIOSP_Request_BCSP BSWIOSP_Request_BDC BSWIOSP_Request_BEM BSWIOSP_Request_BHM BSWIOSP_Request_BMS_FastChgStopInfo BSWIOSP_Request_BMT BSWIOSP_Request_BMV BSWIOSP_Request_BRM BSWIOSP_Request_BRO BSWIOSP_Request_BSD BSWIOSP_Request_BSM BSWIOSP_Request_BSP BSWIOSP_Request_BST BatteryChargingOvercurrent BatteryExcessTemperature BatteryHighestTemp BatteryHighestTempSerNo BatteryInsulationState BatteryLowestTemp BatteryLowestTempSerNo BatteryOutputConnectorState BatterySystemCapacity BatterySystemVoltage BatteryType BmsReadyForCharging BmsRevision BmsSoftwareVersion_CompileDay BmsSuspCause_ActiveSuspend BmsSuspCause_SOC BmsSuspCause_SingleVoltage BmsSuspCause_TotalVoltage BmsSuspError_AbnormalVoltage BmsSuspError_ExcessiveCurrent BmsSuspFault_BatteryTemp BmsSuspFault_BmsTemp BmsSuspFault_ChargeConn BmsSuspFault_Insulation BmsSuspFault_OtherFaults BmsSuspFault_OutputConnTemp BmsSuspFault_VoltageDetection BmsSuspFault_VoltageRelay BmsVersion BmuControl_BalanceControl BsmChargingPermissible ChargingMode CurrentChargeState CurrentDemand CurrentVehicleBatteryVoltage EstimatedRemainingChargingTime HvSysSample_DisableIso MaxChargingVoltage MaxPermChargingCurrent MaxPermTemperature MaxSingleBattChargingVoltage MeasuredChargingCurrent MeasuredChargingVoltage SingleBatteryHighestVoltage SingleBatteryHighestVoltageGroup SingleBatteryHighestVoltageSerNo SingleBatteryMaxTemperature SingleBatteryMaxVoltage SingleBatteryMinTemperature SingleBatteryMinVoltage SingleBatteryUnusualVoltage StatusVehiclePowerStorageBattery SuspendStateOfChargeSOC Timeout_CCS Timeout_CRM_Recognized Timeout_CRM_Unrecognized Timeout_CRO Timeout_CSD Timeout_CST Timeout_CTS_CML TotalMaxPermChargingVoltage TotalNominalEnergy VehicleBatteryUnusualChargeState VoltageDemand /end REF_MEASUREMENT
/end GROUP
/begin GROUP swc_CtctrTranCtl "swc_CtctrTranCtl" ROOT /begin SUB_GROUP Root_CtcrtTranCtl_sys /end SUB_GROUP
 /begin REF_MEASUREMENT CTC_CtrCtctrAgiChIni CTC_CtrCtctrAgiChNv CTC_CtrCtctrAgiHeatNv CTC_CtrCtctrAgiNegIni CTC_CtrCtctrAgiNegNv CTC_CtrCtctrAgiPosIni CTC_CtrCtctrAgiPosNv CTC_CtrCtctrAgiPrechIni CTC_CtrCtctrAgiPrechNv CTC_ErrInfo CTC_ErrLoopHv CTC_ErrRlyCh CTC_ErrRlyHeat CTC_ErrRlyNeg CTC_ErrRlyPos CTC_ErrRlyPrech CTC_IDriftZero CTC_ModeMotDchaFnshd CTC_PctgCtctrAgiCh CTC_PctgCtctrAgiHeat CTC_PctgCtctrAgiNeg CTC_PctgCtctrAgiPos CTC_PctgCtctrAgiPrech CTC_ReqRlyCh CTC_ReqRlyHeat CTC_ReqRlyNeg CTC_ReqRlyPos CTC_ReqRlyPrech CTC_StHvbat CTC_StLoopHv CTC_StRlyCh CTC_StRlyChkCh CTC_StRlyChkHeat CTC_StRlyChkPos CTC_StRlyHeat CTC_StRlyNeg CTC_StRlyPos CTC_StRlyPrech CTC_StSysInt CTC_StsTProtnRPrech CTC_UPrechAccumd CTC_UPrechAccumdNv CTC_bAcvCh CTC_bAcvChPoleHiSideDrv CTC_bAcvHeatPoleHiSideDrv CTC_bAcvLoopTranToStNormDrv CTC_bAcvLoopTranToStOpen CTC_bAcvLoopTranToStPrech CTC_bAcvLoopTranToStPrechFlt CTC_bAcvLoopTranToStPrechFnshd CTC_bAcvMainNegPoleHiSideDrv CTC_bAcvMainPosPoleHiSideDrv CTC_bAcvMotDchaTout CTC_bAcvRlyChkPrech CTC_bAcvRlyCls CTC_bAcvRlyPrechHiSideDrv CTC_bAcvRlyStrtOpen CTC_bAcvTrml15Chk CTC_bErrIDriftZero CTC_bErrIPrech CTC_bErrLoaShoPrech CTC_bErrPrech CTC_bErrRlyAgiCh CTC_bErrRlyAgiNeg CTC_bErrRlyAgiPos CTC_bErrRlyAgiPrech CTC_bErrRlyChHiDrvShoToGnd CTC_bErrRlyChHiDrvShoToPwr CTC_bErrRlyChHiSideDrv CTC_bErrRlyChWldd CTC_bErrRlyHeatHiDrvShoToGnd CTC_bErrRlyHeatHiDrvShoToPwr CTC_bErrRlyHeatHiSideDrv CTC_bErrRlyHeatWldd CTC_bErrRlyNegHiDrvShoToGnd CTC_bErrRlyNegHiDrvShoToPwr CTC_bErrRlyNegHiSideDrv CTC_bErrRlyNegWldd CTC_bErrRlyPosHiDrvShoToGnd CTC_bErrRlyPosHiDrvShoToPwr CTC_bErrRlyPosHiSideDrv CTC_bErrRlyPosWldd CTC_bErrRlyPrechHiDrvShoToGnd CTC_bErrRlyPrechHiDrvShoToPwr CTC_bErrSigChWupLost CTC_bErrToutForMotDcha CTC_bErrToutForMotDchaToDiag CTC_bErrToutPrech CTC_bVldUCls CTC_bVldUDecr CTC_bVldUEqu CTC_bVldUEquForCh CTC_bVldUEquForHeat CTC_bWarnRlyAgiCh CTC_bWarnRlyAgiNeg CTC_bWarnRlyAgiPos CTC_bWarnRlyAgiPrech /end REF_MEASUREMENT
/end GROUP
/begin GROUP swc_DiagcEveHndlg "swc_DiagcEveHndlg" ROOT
 /begin SUB_GROUP Root_DEH_10ms_sys Root_NVM_Read_10ms_sys Root_NVM_Write_100ms_sys /end SUB_GROUP
 /begin REF_MEASUREMENT DEH_EnaDiagGlb DEH_ErrCfmd1 DEH_ErrCfmd2 DEH_ErrCfmd3 DEH_ErrCfmd4 DEH_ErrCfmd5 DEH_ErrCfmd6 DEH_LvlErr DEH_LvlErrSb DEH_ReqBatSrv DEH_StFltLampIndcn DEH_StsIninNv DEH_TrigCMdulAgiFac DEH_TrigEBatChTot DEH_TrigEBatDchaTot DEH_TrigRMdulAgiFac DEH_TrigSocMdul DEH_TrigSohRDelta DEH_TrigSohSocDelta DEH_TrigStoreNv DEH_TrigStoreNvRaw DEH_bAcvAcChInh DEH_bAcvChInh DEH_bAcvDcChInh DEH_bAcvDchaInh DEH_bAcvEmcyHvOff1 DEH_bAcvEmcyHvOff2 DEH_bAcvHeatInh DEH_bAcvLvlErr1 DEH_bAcvLvlErr2 DEH_bAcvLvlErr3 DEH_bAcvLvlErrSb1 DEH_bAcvLvlErrSb2 DEH_bAcvLvlErrSb3 DEH_bAcvPowupInh DEH_bAcvPwrChLim1 DEH_bAcvPwrChLim2 DEH_bAcvPwrDchaLim1 DEH_bAcvPwrDchaLim2 DEH_bAcvPwrRecupLim1 DEH_bAcvPwrRecupLim2 DEH_bAcvPwrdNorm DEH_bAcvRecupInh DEH_bAcvSleepNorm NVM_CMdulAgiFacFls NVM_CtrCh NVM_CtrCtctrAgiCh NVM_CtrCtctrAgiHeat NVM_CtrCtctrAgiNeg NVM_CtrCtctrAgiPos NVM_CtrCtctrAgiPrech NVM_CtrDcha NVM_DayRtcLst NVM_EBatChTot NVM_EBatDchaTot NVM_HourRtcLst NVM_IBatChMax NVM_IBatDchaMax NVM_MinuRtcLst NVM_MonthRtcLst NVM_PBatChMax NVM_PBatDchaMax NVM_RIslnNeg NVM_RIslnPos NVM_RMdulAgiFacFls NVM_SecRtcLst NVM_SocBatMax NVM_SocBatMin NVM_SohRDeltaFls NVM_SohSocDeltaFls NVM_StAryFls NVM_TMdulSnsrMax NVM_TMdulSnsrMin NVM_TiBatAgi NVM_TiBatOffForMdulCFls NVM_TiBatOffForMdulRFls NVM_UBatCtctrClsdMax NVM_UBatCtctrClsdMin NVM_UBatCtctrOpenMax NVM_UBatCtctrOpenMin NVM_UCellMax NVM_UCellMin NVM_UPrechAccumd NVM_YearRtcLst NVM_bErrMdulSocInvldFls /end REF_MEASUREMENT
/end GROUP
/begin GROUP swc_EltlLnkHzrdProtnNet "swc_EltlLnkHzrdProtnNet" ROOT /begin SUB_GROUP Root_ELHPN_10ms_sys /end SUB_GROUP
 /begin REF_MEASUREMENT ELHPN_ErrInfo ELHPN_RIslnNeg ELHPN_RIslnNegNv ELHPN_RIslnPos ELHPN_RIslnPosNv ELHPN_StCrash ELHPN_StCrashIni ELHPN_StErrHvIntlc ELHPN_StErrIniHvIntlc ELHPN_StErrIniHvIntlc2 ELHPN_StIsln ELHPN_StIslnErr ELHPN_StVehIsln ELHPN_StVehIslnIni ELHPN_bInhIslnMeas /end REF_MEASUREMENT
/end GROUP
/begin RECORD_LAYOUT SSV__FLOAT64_IEEE_S AXIS_PTS_X 1 FLOAT64_IEEE INDEX_INCR DIRECT /end RECORD_LAYOUT
/end MODULE
/end PROJECT
