ASAP2_VERSION 1 40
/begin PROJECT ProjectName "Project Comment Goes Here"
/begin HEADER "Header Comments go here" /end HEADER
/begin MODULE ModuleName "Module Comment Goes Here"
/begin MOD_COMMON "Mod Common Comment Here" BYTE_ORDER MSB_LAST ALIGNMENT_BYTE 1 ALIGNMENT_WORD 1 ALIGNMENT_LONG 1 ALIGNMENT_FLOAT32_IEEE 1 ALIGNMENT_FLOAT64_IEEE 1 /end MOD_COMMON
/begin COMPU_METHOD swc_BatChCtl_CM_boolean_dash_ "Q = V" RAT_FUNC "%1.0" "-" COEFFS 0 1 0 0 0 1 /end COMPU_METHOD
/begin COMPU_METHOD swc_BatChCtl_CM_single_C_ "Q = V" RAT_FUNC "%8.6" "C&#xFFFD;" COEFFS 0 1 0 0 0 1 /end COMPU_METHOD
/begin COMPU_METHOD swc_BatChCtl_CM_single_dash_ "Q = V" RAT_FUNC "%8.6" "-" COEFFS 0 1 0 0 0 1 /end COMPU_METHOD
/begin COMPU_METHOD swc_BatChCtl_CM_single_s "Q = V" RAT_FUNC "%8.6" "s" COEFFS 0 1 0 0 0 1 /end COMPU_METHOD
/begin COMPU_METHOD swc_BatChCtl_CM_uint16_dash_ "Q = V" RAT_FUNC "%5.0" "-" COEFFS 0 1 0 0 0 1 /end COMPU_METHOD
/begin COMPU_METHOD swc_BatChCtl_CM_uint8_dash_ "Q = V" RAT_FUNC "%3.0" "-" COEFFS 0 1 0 0 0 1 /end COMPU_METHOD
/begin COMPU_METHOD swc_BatCoreFct_CM_boolean_dash_ "Q = V" RAT_FUNC "%1.0" "-" COEFFS 0 1 0 0 0 1 /end COMPU_METHOD
/begin COMPU_METHOD swc_BatCoreFct_CM_single__ "Q = V" RAT_FUNC "%8.6" "癈" COEFFS 0 1 0 0 0 1 /end COMPU_METHOD
/begin COMPU_METHOD swc_BatCoreFct_CM_single_A "Q = V" RAT_FUNC "%8.6" "A" COEFFS 0 1 0 0 0 1 /end COMPU_METHOD
/begin COMPU_METHOD swc_BatCoreFct_CM_single_Ah "Q = V" RAT_FUNC "%8.6" "Ah" COEFFS 0 1 0 0 0 1 /end COMPU_METHOD
/begin COMPU_METHOD swc_BatCoreFct_CM_single_dash_ "Q = V" RAT_FUNC "%8.6" "-" COEFFS 0 1 0 0 0 1 /end COMPU_METHOD
/begin COMPU_METHOD swc_BatCoreFct_CM_single_J_per_K "Q = V" RAT_FUNC "%8.6" "J/K" COEFFS 0 1 0 0 0 1 /end COMPU_METHOD
/begin COMPU_METHOD swc_BatCoreFct_CM_single_kg "Q = V" RAT_FUNC "%8.6" "kg" COEFFS 0 1 0 0 0 1 /end COMPU_METHOD
/begin COMPU_METHOD swc_BatCoreFct_CM_single_kg_per_s "Q = V" RAT_FUNC "%8.6" "kg/s" COEFFS 0 1 0 0 0 1 /end COMPU_METHOD
/begin COMPU_METHOD swc_BatCoreFct_CM_single_Ohm "Q = V" RAT_FUNC "%8.6" "Ohm" COEFFS 0 1 0 0 0 1 /end COMPU_METHOD
/begin COMPU_METHOD swc_BatCoreFct_CM_single_s "Q = V" RAT_FUNC "%8.6" "s" COEFFS 0 1 0 0 0 1 /end COMPU_METHOD
/begin COMPU_METHOD swc_BatCoreFct_CM_single_V "Q = V" RAT_FUNC "%8.6" "V" COEFFS 0 1 0 0 0 1 /end COMPU_METHOD
/begin COMPU_METHOD swc_BatCoreFct_CM_single_W "Q = V" RAT_FUNC "%8.6" "W" COEFFS 0 1 0 0 0 1 /end COMPU_METHOD
/begin COMPU_METHOD swc_BatCoreFct_CM_single_W_per_K "Q = V" RAT_FUNC "%8.6" "W/K" COEFFS 0 1 0 0 0 1 /end COMPU_METHOD
/begin COMPU_METHOD swc_BatCoreFct_CM_uint8_dash_ "Q = V" RAT_FUNC "%3.0" "-" COEFFS 0 1 0 0 0 1 /end COMPU_METHOD
/begin COMPU_METHOD swc_BatThermHndlgMngt_CM_int8_dash_ "Q = V" RAT_FUNC "%3.0" "-" COEFFS 0 1 0 0 0 1 /end COMPU_METHOD
/begin COMPU_METHOD swc_BatThermHndlgMngt_CM_single__ "Q = V" RAT_FUNC "%8.6" "癈" COEFFS 0 1 0 0 0 1 /end COMPU_METHOD
/begin COMPU_METHOD swc_BatThermHndlgMngt_CM_single_C_ "Q = V" RAT_FUNC "%8.6" "C&#xFFFD;" COEFFS 0 1 0 0 0 1 /end COMPU_METHOD
/begin COMPU_METHOD swc_CIL_CM_int16__ "Q = V" RAT_FUNC "%5.0" "癈" COEFFS 0 1 0 0 0 1 /end COMPU_METHOD
/begin COMPU_METHOD swc_CIL_CM_single_A "Q = V" RAT_FUNC "%8.6" "A" COEFFS 0 1 0 0 0 1 /end COMPU_METHOD
/begin COMPU_METHOD swc_CIL_CM_single_kW "Q = V" RAT_FUNC "%8.6" "kW" COEFFS 0 1 0 0 0 1 /end COMPU_METHOD
/begin COMPU_METHOD swc_CIL_CM_single_kWh "Q = V" RAT_FUNC "%8.6" "kWh" COEFFS 0 1 0 0 0 1 /end COMPU_METHOD
/begin COMPU_METHOD swc_CIL_CM_single_V "Q = V" RAT_FUNC "%8.6" "V" COEFFS 0 1 0 0 0 1 /end COMPU_METHOD
/begin COMPU_METHOD swc_CIL_CM_uint16_dash_ "Q = V" RAT_FUNC "%5.0" "-" COEFFS 0 1 0 0 0 1 /end COMPU_METHOD
/begin COMPU_METHOD swc_CIL_CM_uint8_dash_ "Q = V" RAT_FUNC "%3.0" "-" COEFFS 0 1 0 0 0 1 /end COMPU_METHOD
/begin COMPU_METHOD swc_CIL_CM_uint8_percent_ "Q = V" RAT_FUNC "%3.0" "%" COEFFS 0 1 0 0 0 1 /end COMPU_METHOD
/begin COMPU_METHOD swc_COL_CM_single_A "Q = V" RAT_FUNC "%8.6" "A" COEFFS 0 1 0 0 0 1 /end COMPU_METHOD
/begin COMPU_METHOD swc_COL_CM_single_V "Q = V" RAT_FUNC "%8.6" "V" COEFFS 0 1 0 0 0 1 /end COMPU_METHOD
/begin COMPU_METHOD swc_COL_CM_uint32_dash_ "Q = V" RAT_FUNC "%10.0" "-" COEFFS 0 1 0 0 0 1 /end COMPU_METHOD
/begin COMPU_METHOD swc_COL_CM_uint8_dash_ "Q = V" RAT_FUNC "%3.0" "-" COEFFS 0 1 0 0 0 1 /end COMPU_METHOD
/begin COMPU_METHOD swc_CtctrTranCtl_CM_boolean_dash_ "Q = V" RAT_FUNC "%1.0" "-" COEFFS 0 1 0 0 0 1 /end COMPU_METHOD
/begin COMPU_METHOD swc_CtctrTranCtl_CM_single_A "Q = V" RAT_FUNC "%8.6" "A" COEFFS 0 1 0 0 0 1 /end COMPU_METHOD
/begin COMPU_METHOD swc_CtctrTranCtl_CM_single_dash_ "Q = V" RAT_FUNC "%8.6" "-" COEFFS 0 1 0 0 0 1 /end COMPU_METHOD
/begin COMPU_METHOD swc_CtctrTranCtl_CM_uint32_dash_ "Q = V" RAT_FUNC "%10.0" "-" COEFFS 0 1 0 0 0 1 /end COMPU_METHOD
/begin COMPU_METHOD swc_CtctrTranCtl_CM_uint8_dash_ "Q = V" RAT_FUNC "%3.0" "-" COEFFS 0 1 0 0 0 1 /end COMPU_METHOD
/begin COMPU_METHOD swc_DiagcEveHndlg_CM_boolean_dash_ "Q = V" RAT_FUNC "%1.0" "-" COEFFS 0 1 0 0 0 1 /end COMPU_METHOD
/begin COMPU_METHOD swc_EltlLnkHzrdProtnNet_CM_single_s "Q = V" RAT_FUNC "%8.6" "s" COEFFS 0 1 0 0 0 1 /end COMPU_METHOD
/begin CHARACTERISTIC BCF_BvFilFacAct_M "Butler-Volmer Filter Factor curve for actual SOF (pre-calculated)" CURVE 0x1FFE7EC0 Lookup1D_FLOAT32_IEEE 0 swc_BatCoreFct_CM_single_dash_ -3.40282346639e+038 3.40282346639e+038
 /begin AXIS_DESCR COM_AXIS NO_INPUT_QUANTITY swc_BatCoreFct_CM_single__ 9 -3.40282346639e+038 3.40282346639e+038 DEPOSIT ABSOLUTE AXIS_PTS_REF BCF_TRngVld_A /end AXIS_DESCR
/end CHARACTERISTIC
/begin CHARACTERISTIC BCF_BvFilFacPred_M "Butler-Volmer Filter Factor curve for SOF Prediction (pre-calculated)" CURVE 0x1FFE7EE4 Lookup1D_FLOAT32_IEEE 0 swc_BatCoreFct_CM_single_dash_ -3.40282346639e+038 3.40282346639e+038
 /begin AXIS_DESCR COM_AXIS NO_INPUT_QUANTITY swc_BatCoreFct_CM_single__ 9 -3.40282346639e+038 3.40282346639e+038 DEPOSIT ABSOLUTE AXIS_PTS_REF BCF_TRngVld_A /end AXIS_DESCR
/end CHARACTERISTIC
/begin CHARACTERISTIC BCF_CPackNom_P "Nominal capacity of battery pack (from datasheet)" VALUE 0x1FFE7FD0 Scalar_FLOAT32_IEEE 0 swc_BatCoreFct_CM_single_Ah -3.40282346639e+038 3.40282346639e+038 /end CHARACTERISTIC
/begin CHARACTERISTIC BCF_CRateCTest_P "C-rate for capacity test" VALUE 0x1FFE7FD4 Scalar_FLOAT32_IEEE 0 swc_BatCoreFct_CM_single_dash_ -3.40282346639e+038 3.40282346639e+038 /end CHARACTERISTIC
/begin CHARACTERISTIC BCF_ChtMdul_P "Heat capacity of module" VALUE 0x1FFE7FDC Scalar_FLOAT32_IEEE 0 swc_BatCoreFct_CM_single_J_per_K -3.40282346639e+038 3.40282346639e+038 /end CHARACTERISTIC
/begin CHARACTERISTIC BCF_CndctvtyTherm_P "The thermal conductivity coefficient between cell and sensor" VALUE 0x1FFE7FE0 Scalar_FLOAT32_IEEE 0 swc_BatCoreFct_CM_single_W_per_K -3.40282346639e+038 3.40282346639e+038 /end CHARACTERISTIC
/begin CHARACTERISTIC BCF_CoeffSohChLim_M "StateOfHealth based Charge Limit Coefficient Curve" CURVE 0x1FFE7FF4 Lookup1D_FLOAT32_IEEE 0 swc_BatCoreFct_CM_single_dash_ -3.40282346639e+038 3.40282346639e+038
 /begin AXIS_DESCR COM_AXIS NO_INPUT_QUANTITY swc_BatCoreFct_CM_single_dash_ 6 -3.40282346639e+038 3.40282346639e+038 DEPOSIT ABSOLUTE AXIS_PTS_REF BCF_SohChDchaLim_A /end AXIS_DESCR
/end CHARACTERISTIC
/begin CHARACTERISTIC BCF_CoeffSohDchaLim_M "StateOfHealth based Discharge Limit Coefficient Curve" CURVE 0x1FFE800C Lookup1D_FLOAT32_IEEE 0 swc_BatCoreFct_CM_single_dash_ -3.40282346639e+038 3.40282346639e+038
 /begin AXIS_DESCR COM_AXIS NO_INPUT_QUANTITY swc_BatCoreFct_CM_single_dash_ 6 -3.40282346639e+038 3.40282346639e+038 DEPOSIT ABSOLUTE AXIS_PTS_REF BCF_SohChDchaLim_A /end AXIS_DESCR
/end CHARACTERISTIC
/begin CHARACTERISTIC BCF_CpCoolt_P "Heat capacity of the coolant" VALUE 0x1FFE8024 Scalar_FLOAT32_IEEE 0 swc_BatCoreFct_CM_single_dash_ -3.40282346639e+038 3.40282346639e+038 /end CHARACTERISTIC
/begin CHARACTERISTIC BCF_CswPackSoc_P "Battery Core Function ConfigurationSwitch Pack StateOfCharge _Parameter" VALUE 0x20008A7D Scalar_BOOLEAN 0 swc_BatCoreFct_CM_boolean_dash_ 0 1 /end CHARACTERISTIC
/begin CHARACTERISTIC BCF_ErrSohSocCellDelta_M "Cell Delta SOC Error Limit Curve" CURVE 0x1FFE803C Lookup1D_FLOAT32_IEEE 0 swc_BatCoreFct_CM_single_dash_ -3.40282346639e+038 3.40282346639e+038
 /begin AXIS_DESCR COM_AXIS NO_INPUT_QUANTITY swc_BatCoreFct_CM_single_dash_ 11 -3.40282346639e+038 3.40282346639e+038 DEPOSIT ABSOLUTE AXIS_PTS_REF BCF_SohSocCellDeltaErr_A /end AXIS_DESCR
/end CHARACTERISTIC
/begin AXIS_PTS BCF_Htc_A "Mass flow of coolant to choose heat transfer coefficient through surface area" 0x1FFE8070 NO_INPUT_QUANTITY Lookup1D_X_FLOAT32_IEEE 0 swc_BatCoreFct_CM_single_kg_per_s 11 -3.40282346639e+038 3.40282346639e+038 DEPOSIT ABSOLUTE /end AXIS_PTS
/begin CHARACTERISTIC BCF_Htc_M "Heat transfer coefficient through surface area" CURVE 0x1FFE809C Lookup1D_FLOAT32_IEEE 0 swc_BatCoreFct_CM_single_W_per_K -3.40282346639e+038 3.40282346639e+038
 /begin AXIS_DESCR COM_AXIS NO_INPUT_QUANTITY swc_BatCoreFct_CM_single_kg_per_s 11 -3.40282346639e+038 3.40282346639e+038 DEPOSIT ABSOLUTE AXIS_PTS_REF BCF_Htc_A /end AXIS_DESCR
/end CHARACTERISTIC
/begin CHARACTERISTIC BCF_IChActLimBySocT_M "Actual Charge Current Limited By StateOfCharge and Temperature Map" MAP 0x1FFE80C8 Lookup2D_FLOAT32_IEEE 0 swc_BatCoreFct_CM_single_A -3.40282346639e+038 3.40282346639e+038
 /begin AXIS_DESCR COM_AXIS NO_INPUT_QUANTITY swc_BatCoreFct_CM_single_dash_ 12 -3.40282346639e+038 3.40282346639e+038 DEPOSIT ABSOLUTE AXIS_PTS_REF BCF_SocForIChDchaLim_A /end AXIS_DESCR
 /begin AXIS_DESCR COM_AXIS NO_INPUT_QUANTITY swc_BatCoreFct_CM_single__ 9 -3.40282346639e+038 3.40282346639e+038 DEPOSIT ABSOLUTE AXIS_PTS_REF BCF_TRngVld_A /end AXIS_DESCR
/end CHARACTERISTIC
/begin CHARACTERISTIC BCF_IChMax_P "Maximum Absolute Charge Current" VALUE 0x1FFE8278 Scalar_FLOAT32_IEEE 0 swc_BatCoreFct_CM_single_A -3.40282346639e+038 3.40282346639e+038 /end CHARACTERISTIC
/begin CHARACTERISTIC BCF_IChPredLimBySocT_M "Predicted Charge Current Limited By StateOfCharge and Temperature Map" MAP 0x1FFE827C Lookup2D_FLOAT32_IEEE 0 swc_BatCoreFct_CM_single_A -3.40282346639e+038 3.40282346639e+038
 /begin AXIS_DESCR COM_AXIS NO_INPUT_QUANTITY swc_BatCoreFct_CM_single_dash_ 12 -3.40282346639e+038 3.40282346639e+038 DEPOSIT ABSOLUTE AXIS_PTS_REF BCF_SocForIChDchaLim_A /end AXIS_DESCR
 /begin AXIS_DESCR COM_AXIS NO_INPUT_QUANTITY swc_BatCoreFct_CM_single__ 9 -3.40282346639e+038 3.40282346639e+038 DEPOSIT ABSOLUTE AXIS_PTS_REF BCF_TRngVld_A /end AXIS_DESCR
/end CHARACTERISTIC
/begin CHARACTERISTIC BCF_IDchaActLimBySocT_M "Actual Discharge Current Limited By StateOfCharge and Temperature Map" MAP 0x1FFE842C Lookup2D_FLOAT32_IEEE 0 swc_BatCoreFct_CM_single_A -3.40282346639e+038 3.40282346639e+038
 /begin AXIS_DESCR COM_AXIS NO_INPUT_QUANTITY swc_BatCoreFct_CM_single_dash_ 12 -3.40282346639e+038 3.40282346639e+038 DEPOSIT ABSOLUTE AXIS_PTS_REF BCF_SocForIChDchaLim_A /end AXIS_DESCR
 /begin AXIS_DESCR COM_AXIS NO_INPUT_QUANTITY swc_BatCoreFct_CM_single__ 9 -3.40282346639e+038 3.40282346639e+038 DEPOSIT ABSOLUTE AXIS_PTS_REF BCF_TRngVld_A /end AXIS_DESCR
/end CHARACTERISTIC
/begin CHARACTERISTIC BCF_IDchaMax_P "Maximum Absolute Discharge Current" VALUE 0x1FFE85DC Scalar_FLOAT32_IEEE 0 swc_BatCoreFct_CM_single_A -3.40282346639e+038 3.40282346639e+038 /end CHARACTERISTIC
/begin CHARACTERISTIC BCF_IDchaPredLimBySocT_M "Predicted Discharge Current Limited By StateOfCharge and Temperature Map" MAP 0x1FFE85E0 Lookup2D_FLOAT32_IEEE 0 swc_BatCoreFct_CM_single_A -3.40282346639e+038 3.40282346639e+038
 /begin AXIS_DESCR COM_AXIS NO_INPUT_QUANTITY swc_BatCoreFct_CM_single_dash_ 12 -3.40282346639e+038 3.40282346639e+038 DEPOSIT ABSOLUTE AXIS_PTS_REF BCF_SocForIChDchaLim_A /end AXIS_DESCR
 /begin AXIS_DESCR COM_AXIS NO_INPUT_QUANTITY swc_BatCoreFct_CM_single__ 9 -3.40282346639e+038 3.40282346639e+038 DEPOSIT ABSOLUTE AXIS_PTS_REF BCF_TRngVld_A /end AXIS_DESCR
/end CHARACTERISTIC
/begin CHARACTERISTIC BCF_ILimnFacAct_P "SOF - Pack Charge Current Limitation Scaling Factor - Actual " VALUE 0x1FFE8798 Scalar_FLOAT32_IEEE 0 swc_BatCoreFct_CM_single_dash_ -3.40282346639e+038 3.40282346639e+038 /end CHARACTERISTIC
/begin CHARACTERISTIC BCF_ILimnFacPred_P "SOF - Pack Charge Current Limitation Scaling Factor - Predicted " VALUE 0x1FFE879C Scalar_FLOAT32_IEEE 0 swc_BatCoreFct_CM_single_dash_ -3.40282346639e+038 3.40282346639e+038 /end CHARACTERISTIC
/begin CHARACTERISTIC BCF_InvldMdlFacForRDelta_P "Factor to scale Cell DeltaR variance limit when electrical model operation condition is invalid" VALUE 0x1FFE87E8 Scalar_FLOAT32_IEEE 0 swc_BatCoreFct_CM_single_dash_ -3.40282346639e+038 3.40282346639e+038 /end CHARACTERISTIC
/begin CHARACTERISTIC BCF_InvldMdlFacForSocDelta_P "Factor to scale Cell DeltaSOC variance limit when electrical model operation condition is invalid" VALUE 0x1FFE87EC Scalar_FLOAT32_IEEE 0 swc_BatCoreFct_CM_single_dash_ -3.40282346639e+038 3.40282346639e+038 /end CHARACTERISTIC
/begin CHARACTERISTIC BCF_MCooltMdul_P "Module coolant mass" VALUE 0x1FFE87F0 Scalar_FLOAT32_IEEE 0 swc_BatCoreFct_CM_single_kg -3.40282346639e+038 3.40282346639e+038 /end CHARACTERISTIC
/begin CHARACTERISTIC BCF_NrCellPack_P "Battery Core Function Number Cell Pack _Parameter" VALUE 0x1FFE87F4 Scalar_FLOAT32_IEEE 0 swc_BatCoreFct_CM_single_dash_ -3.40282346639e+038 3.40282346639e+038 /end CHARACTERISTIC
/begin CHARACTERISTIC BCF_NrMdulMax_P "Tunable maximum number of modules" VALUE 0x1FFEB52C Scalar_UBYTE 0 swc_BatCoreFct_CM_uint8_dash_ 0 255 /end CHARACTERISTIC
/begin CHARACTERISTIC BCF_PwrCellLossMax_M "SOF: Allowed Cell Power Loss Curve based on Temperature" CURVE 0x1FFE89C8 Lookup1D_FLOAT32_IEEE 0 swc_BatCoreFct_CM_single_W -3.40282346639e+038 3.40282346639e+038
 /begin AXIS_DESCR COM_AXIS NO_INPUT_QUANTITY swc_BatCoreFct_CM_single__ 9 -3.40282346639e+038 3.40282346639e+038 DEPOSIT ABSOLUTE AXIS_PTS_REF BCF_TRngVld_A /end AXIS_DESCR
/end CHARACTERISTIC
/begin CHARACTERISTIC BCF_PwrChWtng_P "SOF: Parameter  to enable non symmetric charge/discharge power loss limitation via weighting" VALUE 0x1FFE89EC Scalar_FLOAT32_IEEE 0 swc_BatCoreFct_CM_single_dash_ -3.40282346639e+038 3.40282346639e+038 /end CHARACTERISTIC
/begin CHARACTERISTIC BCF_PwrFilFacLossAct_P "SOF: Precomputed Power Loss Filter Factor Curve for Actual Limits" VALUE 0x1FFE89F4 Scalar_FLOAT32_IEEE 0 swc_BatCoreFct_CM_single_dash_ -3.40282346639e+038 3.40282346639e+038 /end CHARACTERISTIC
/begin CHARACTERISTIC BCF_PwrFilFacLossPred_P "SOF: Precomputed Power Loss Filter Factor Curve for Predicted Limits" VALUE 0x1FFE89F8 Scalar_FLOAT32_IEEE 0 swc_BatCoreFct_CM_single_dash_ -3.40282346639e+038 3.40282346639e+038 /end CHARACTERISTIC
/begin CHARACTERISTIC BCF_PwrFilTcLoss_P "SOF: Power Loss Filter Time Constant" VALUE 0x1FFE89FC Scalar_FLOAT32_IEEE 0 swc_BatCoreFct_CM_single_s -3.40282346639e+038 3.40282346639e+038 /end CHARACTERISTIC
/begin CHARACTERISTIC BCF_RDeltaSafe_P "Module R Delta Safety Factor in case of no valid signal" VALUE 0x1FFE9E48 Scalar_FLOAT32_IEEE 0 swc_BatCoreFct_CM_single_dash_ -3.40282346639e+038 3.40282346639e+038 /end CHARACTERISTIC
/begin CHARACTERISTIC BCF_RPack_P "Pack resistance (outside the modules) for SOF" VALUE 0x1FFE9F64 Scalar_FLOAT32_IEEE 0 swc_BatCoreFct_CM_single_Ohm -3.40282346639e+038 3.40282346639e+038 /end CHARACTERISTIC
/begin CHARACTERISTIC BCF_SocCellDeltaSafe_P "Cell SOC Delta Safety Factor in case of no valid signal" VALUE 0x1FFEA198 Scalar_FLOAT32_IEEE 0 swc_BatCoreFct_CM_single_dash_ -3.40282346639e+038 3.40282346639e+038 /end CHARACTERISTIC
/begin AXIS_PTS BCF_SocForIChDchaLim_A "Charge/Discharge Current Limit StateOfCharge axis" 0x1FFEA19C NO_INPUT_QUANTITY Lookup2D_X_FLOAT32_IEEE 0 swc_BatCoreFct_CM_single_dash_ 12 -3.40282346639e+038 3.40282346639e+038 DEPOSIT ABSOLUTE /end AXIS_PTS
/begin CHARACTERISTIC BCF_SocLimMax_P "Tunable SOC operating window higher limit for CAN message" VALUE 0x1FFEA22C Scalar_FLOAT32_IEEE 0 swc_BatCoreFct_CM_single_dash_ -3.40282346639e+038 3.40282346639e+038 /end CHARACTERISTIC
/begin CHARACTERISTIC BCF_SocLimMin_P "Tunable SOC operating window lower limit for CAN message" VALUE 0x20000F94 Scalar_FLOAT32_IEEE 0 swc_BatCoreFct_CM_single_dash_ -3.40282346639e+038 3.40282346639e+038 /end CHARACTERISTIC
/begin AXIS_PTS BCF_SocMdul_A "SOC axis for the curve that scales Cell DeltaR and Cell DeltaSOC variance limits" 0x1FFEA248 NO_INPUT_QUANTITY Lookup1D_X_FLOAT32_IEEE 0 swc_BatCoreFct_CM_single_dash_ 11 -3.40282346639e+038 3.40282346639e+038 DEPOSIT ABSOLUTE /end AXIS_PTS
/begin CHARACTERISTIC BCF_SocPackLimnMax_P "Maximum limit for SOC Pack" VALUE 0x1FFEA278 Scalar_FLOAT32_IEEE 0 swc_BatCoreFct_CM_single_dash_ 0 1 /end CHARACTERISTIC
/begin CHARACTERISTIC BCF_SocPackLimnMin_P "Minimum limit for SOC Pack  " VALUE 0x20000FA0 Scalar_FLOAT32_IEEE 0 swc_BatCoreFct_CM_single_dash_ 0 1 /end CHARACTERISTIC
/begin CHARACTERISTIC BCF_SocPackMan_P "Battery Core Function StateOfCharge Pack Manual _Parameter" VALUE 0x1FFEA27C Scalar_FLOAT32_IEEE 0 swc_BatCoreFct_CM_single_dash_ -3.40282346639e+038 3.40282346639e+038 /end CHARACTERISTIC
/begin AXIS_PTS BCF_SocPackMpg_A "Input axis for mapping BMS internal SOCs to Pack SOC" 0x1FFEA280 NO_INPUT_QUANTITY Lookup1D_X_FLOAT32_IEEE 0 swc_BatCoreFct_CM_single_dash_ 11 -3.40282346639e+038 3.40282346639e+038 DEPOSIT ABSOLUTE /end AXIS_PTS
/begin CHARACTERISTIC BCF_SocPackMpg_M "Mapping Curve of BMS internal SOCs to Reported Pack SOC" CURVE 0x1FFEA2AC Lookup1D_FLOAT32_IEEE 0 swc_BatCoreFct_CM_single_dash_ -3.40282346639e+038 3.40282346639e+038
 /begin AXIS_DESCR COM_AXIS NO_INPUT_QUANTITY swc_BatCoreFct_CM_single_dash_ 11 -3.40282346639e+038 3.40282346639e+038 DEPOSIT ABSOLUTE AXIS_PTS_REF BCF_SocPackMpg_A /end AXIS_DESCR
/end CHARACTERISTIC
/begin AXIS_PTS BCF_SocUDchaForSofVeri_A "Soc breakpoints for discharge voltage map used for Sof verification" 0x1FFEA338 NO_INPUT_QUANTITY Lookup2D_X_FLOAT32_IEEE 0 swc_BatCoreFct_CM_single_dash_ 12 -3.40282346639e+038 3.40282346639e+038 DEPOSIT ABSOLUTE /end AXIS_PTS
/begin AXIS_PTS BCF_SocWbz_A "Warburg Impedance Map (SOC axis)" 0x1FFEA370 NO_INPUT_QUANTITY Lookup2D_X_FLOAT32_IEEE 0 swc_BatCoreFct_CM_single_dash_ 12 -3.40282346639e+038 3.40282346639e+038 DEPOSIT ABSOLUTE /end AXIS_PTS
/begin CHARACTERISTIC BCF_SofIChAry_P "Array of Charge Currents for SOF" VAL_BLK 0x1FFEA3B8 Scalar_FLOAT32_IEEE 0 swc_BatCoreFct_CM_single_A 0 100000000 MATRIX_DIM 5 1 1 /end CHARACTERISTIC
/begin CHARACTERISTIC BCF_SofIDchaAry_P "Array of Discharge Currents for SOF" VAL_BLK 0x1FFEA3CC Scalar_FLOAT32_IEEE 0 swc_BatCoreFct_CM_single_A -3.40282346639e+038 3.40282346639e+038 MATRIX_DIM 5 1 1 /end CHARACTERISTIC
/begin CHARACTERISTIC BCF_SofTcAct_P "Time Constant for SOF Actual" VALUE 0x1FFEA3E0 Scalar_FLOAT32_IEEE 0 swc_BatCoreFct_CM_single_s -3.40282346639e+038 3.40282346639e+038 /end CHARACTERISTIC
/begin CHARACTERISTIC BCF_SofTcPred_P "Time Constant for SOF Prediction" VALUE 0x1FFEA3E4 Scalar_FLOAT32_IEEE 0 swc_BatCoreFct_CM_single_s -3.40282346639e+038 3.40282346639e+038 /end CHARACTERISTIC
/begin AXIS_PTS BCF_SohChDchaLim_A "StateOfHealth based Charge Discharge Limitation SOH axis" 0x1FFEA414 NO_INPUT_QUANTITY Lookup1D_X_FLOAT32_IEEE 0 swc_BatCoreFct_CM_single_dash_ 6 -3.40282346639e+038 3.40282346639e+038 DEPOSIT ABSOLUTE /end AXIS_PTS
/begin CHARACTERISTIC BCF_SohErrLimForRDelta_M "Cell Delta R Error Limit Curve" CURVE 0x1FFEA42C Lookup1D_FLOAT32_IEEE 0 swc_BatCoreFct_CM_single_dash_ -3.40282346639e+038 3.40282346639e+038
 /begin AXIS_DESCR COM_AXIS NO_INPUT_QUANTITY swc_BatCoreFct_CM_single_dash_ 11 -3.40282346639e+038 3.40282346639e+038 DEPOSIT ABSOLUTE AXIS_PTS_REF BCF_SohRCellDeltaErr_A /end AXIS_DESCR
/end CHARACTERISTIC
/begin CHARACTERISTIC BCF_SohRCellCorrnFac_M "The curve that scales Cell DeltaR variance limits based on current SOC for SOH update " CURVE 0x1FFEA45C Lookup1D_FLOAT32_IEEE 0 swc_BatCoreFct_CM_single_dash_ -3.40282346639e+038 3.40282346639e+038
 /begin AXIS_DESCR COM_AXIS NO_INPUT_QUANTITY swc_BatCoreFct_CM_single_dash_ 11 -3.40282346639e+038 3.40282346639e+038 DEPOSIT ABSOLUTE AXIS_PTS_REF BCF_SocMdul_A /end AXIS_DESCR
/end CHARACTERISTIC
/begin AXIS_PTS BCF_SohRCellDeltaErr_A "SOH axis of Cell Delta R Error Limit Curve" 0x1FFEA488 NO_INPUT_QUANTITY Lookup1D_X_FLOAT32_IEEE 0 swc_BatCoreFct_CM_single_dash_ 11 -3.40282346639e+038 3.40282346639e+038 DEPOSIT ABSOLUTE /end AXIS_PTS
/begin CHARACTERISTIC BCF_SohSocCellCorrnFac_M "The curve that Cell DeltaSOC variance limits based on current SOC for SOH update " CURVE 0x1FFEA4E4 Lookup1D_FLOAT32_IEEE 0 swc_BatCoreFct_CM_single_dash_ -3.40282346639e+038 3.40282346639e+038
 /begin AXIS_DESCR COM_AXIS NO_INPUT_QUANTITY swc_BatCoreFct_CM_single_dash_ 11 -3.40282346639e+038 3.40282346639e+038 DEPOSIT ABSOLUTE AXIS_PTS_REF BCF_SocMdul_A /end AXIS_DESCR
/end CHARACTERISTIC
/begin AXIS_PTS BCF_SohSocCellDeltaErr_A "SOH axis of Cell Delta SOC Error Limit Curve" 0x1FFEA510 NO_INPUT_QUANTITY Lookup1D_X_FLOAT32_IEEE 0 swc_BatCoreFct_CM_single_dash_ 11 -3.40282346639e+038 3.40282346639e+038 DEPOSIT ABSOLUTE /end AXIS_PTS
/begin CHARACTERISTIC BCF_TCooltHiLim_P "Higher limitation of the coolant temperature" VALUE 0x1FFEA570 Scalar_FLOAT32_IEEE 0 swc_BatCoreFct_CM_single__ -3.40282346639e+038 3.40282346639e+038 /end CHARACTERISTIC
/begin CHARACTERISTIC BCF_TCooltLoLim_P "Lower limitation of the coolant temperature" VALUE 0x1FFEA574 Scalar_FLOAT32_IEEE 0 swc_BatCoreFct_CM_single__ -3.40282346639e+038 3.40282346639e+038 /end CHARACTERISTIC
/begin CHARACTERISTIC BCF_TMdulHiLim_P "Higher limit of estimated module temperature" VALUE 0x1FFEA584 Scalar_FLOAT32_IEEE 0 swc_BatCoreFct_CM_single__ -3.40282346639e+038 3.40282346639e+038 /end CHARACTERISTIC
/begin CHARACTERISTIC BCF_TMdulLoLim_P "Lower limitation of estimated module temperature" VALUE 0x1FFEA588 Scalar_FLOAT32_IEEE 0 swc_BatCoreFct_CM_single__ -3.40282346639e+038 3.40282346639e+038 /end CHARACTERISTIC
/begin AXIS_PTS BCF_TRngVld_A "Valid Temperature range of of the model" 0x1FFEA590 NO_INPUT_QUANTITY Lookup2D_X_FLOAT32_IEEE 0 swc_BatCoreFct_CM_single__ 9 -3.40282346639e+038 3.40282346639e+038 DEPOSIT ABSOLUTE /end AXIS_PTS
/begin CHARACTERISTIC BCF_UCellChnCfg_P "Cell voltage measurement channel configuration parameter to extract cell voltages out of module controller\'s measurement array." VAL_BLK 0x1FFEB414 Scalar_BOOLEAN 0 swc_BatCoreFct_CM_boolean_dash_ 0 1 MATRIX_DIM 255 1 1 /end CHARACTERISTIC
/begin AXIS_PTS BCF_UChLim_A "Reference Temperature axis for Cell Charging Voltage Limitation" 0x1FFEA624 NO_INPUT_QUANTITY Lookup1D_X_FLOAT32_IEEE 0 swc_BatCoreFct_CM_single_dash_ 5 -3.40282346639e+038 3.40282346639e+038 DEPOSIT ABSOLUTE /end AXIS_PTS
/begin CHARACTERISTIC BCF_UChLim_M "Cell Charging Voltage Limitation based on reference Temperature" CURVE 0x1FFEA638 Lookup1D_FLOAT32_IEEE 0 swc_BatCoreFct_CM_single_dash_ -3.40282346639e+038 3.40282346639e+038
 /begin AXIS_DESCR COM_AXIS NO_INPUT_QUANTITY swc_BatCoreFct_CM_single_dash_ 5 -3.40282346639e+038 3.40282346639e+038 DEPOSIT ABSOLUTE AXIS_PTS_REF BCF_UChLim_A /end AXIS_DESCR
/end CHARACTERISTIC
/begin CHARACTERISTIC BCF_UDchaLimForSofVeri_M "Cell discharge voltage limiting map for Sof verification" MAP 0x1FFEAAA8 Lookup2D_FLOAT32_IEEE 0 swc_BatCoreFct_CM_single_V -3.40282346639e+038 3.40282346639e+038
 /begin AXIS_DESCR COM_AXIS NO_INPUT_QUANTITY swc_BatCoreFct_CM_single_dash_ 12 -3.40282346639e+038 3.40282346639e+038 DEPOSIT ABSOLUTE AXIS_PTS_REF BCF_SocUDchaForSofVeri_A /end AXIS_DESCR
 /begin AXIS_DESCR COM_AXIS NO_INPUT_QUANTITY swc_BatCoreFct_CM_single__ 9 -3.40282346639e+038 3.40282346639e+038 DEPOSIT ABSOLUTE AXIS_PTS_REF BCF_TRngVld_A /end AXIS_DESCR
/end CHARACTERISTIC
/begin AXIS_PTS BCF_UDchaLim_A "Reference Temperature axis for Cell Discharging Voltage Limitation" 0x1FFEAC58 NO_INPUT_QUANTITY Lookup1D_X_FLOAT32_IEEE 0 swc_BatCoreFct_CM_single_dash_ 5 -3.40282346639e+038 3.40282346639e+038 DEPOSIT ABSOLUTE /end AXIS_PTS
/begin CHARACTERISTIC BCF_UDchaLim_M "Cell Discharging Voltage Limitation based on reference Temperature" CURVE 0x1FFEAC6C Lookup1D_FLOAT32_IEEE 0 swc_BatCoreFct_CM_single_dash_ -3.40282346639e+038 3.40282346639e+038
 /begin AXIS_DESCR COM_AXIS NO_INPUT_QUANTITY swc_BatCoreFct_CM_single_dash_ 5 -3.40282346639e+038 3.40282346639e+038 DEPOSIT ABSOLUTE AXIS_PTS_REF BCF_UDchaLim_A /end AXIS_DESCR
/end CHARACTERISTIC
/begin CHARACTERISTIC BCF_WbzFac_P "Warburg Impedance Factor for the 2nd term" VALUE 0x1FFEB1DC Scalar_FLOAT32_IEEE 0 swc_BatCoreFct_CM_single_dash_ -3.40282346639e+038 3.40282346639e+038 /end CHARACTERISTIC
/begin CHARACTERISTIC BCF_WbzFilFacAct_M "Warburg Impedance Filter Factor curve for actual SOF (pre-calculated)" CURVE 0x1FFEB1E0 Lookup1D_FLOAT32_IEEE 0 swc_BatCoreFct_CM_single_s -3.40282346639e+038 3.40282346639e+038
 /begin AXIS_DESCR COM_AXIS NO_INPUT_QUANTITY swc_BatCoreFct_CM_single__ 9 -3.40282346639e+038 3.40282346639e+038 DEPOSIT ABSOLUTE AXIS_PTS_REF BCF_TRngVld_A /end AXIS_DESCR
/end CHARACTERISTIC
/begin CHARACTERISTIC BCF_WbzFilFacPred_M "Warburg Impedance Filter Factor curve for SOF Prediction (pre-calculated)" CURVE 0x1FFEB204 Lookup1D_FLOAT32_IEEE 0 swc_BatCoreFct_CM_single_s -3.40282346639e+038 3.40282346639e+038
 /begin AXIS_DESCR COM_AXIS NO_INPUT_QUANTITY swc_BatCoreFct_CM_single__ 9 -3.40282346639e+038 3.40282346639e+038 DEPOSIT ABSOLUTE AXIS_PTS_REF BCF_TRngVld_A /end AXIS_DESCR
/end CHARACTERISTIC
/begin CHARACTERISTIC BCF_Wbz_M "Warburg Impedance Map" MAP 0x1FFEB250 Lookup2D_FLOAT32_IEEE 0 swc_BatCoreFct_CM_single_Ohm -3.40282346639e+038 3.40282346639e+038
 /begin AXIS_DESCR COM_AXIS NO_INPUT_QUANTITY swc_BatCoreFct_CM_single_dash_ 12 -3.40282346639e+038 3.40282346639e+038 DEPOSIT ABSOLUTE AXIS_PTS_REF BCF_SocWbz_A /end AXIS_DESCR
 /begin AXIS_DESCR COM_AXIS NO_INPUT_QUANTITY swc_BatCoreFct_CM_single__ 9 -3.40282346639e+038 3.40282346639e+038 DEPOSIT ABSOLUTE AXIS_PTS_REF BCF_TRngVld_A /end AXIS_DESCR
/end CHARACTERISTIC
/begin CHARACTERISTIC BCF_bAcvDynLim_P "Dynamic limitation active flag. 1 = active, 0 = deactive (only static limits I=f(SOC,T) are activated)" VALUE 0x1FFEB52E Scalar_BOOLEAN 0 swc_BatCoreFct_CM_boolean_dash_ 0 1 /end CHARACTERISTIC
/begin CHARACTERISTIC BCF_bAcvHtcCfg_P "Checks if the configuration considers the heat transfer coefficient" VALUE 0x1FFEB52F Scalar_BOOLEAN 0 swc_BatCoreFct_CM_boolean_dash_ 0 1 /end CHARACTERISTIC
/begin CHARACTERISTIC BCF_bAcvSocMin_P "Activation of minimum cell SOC for pack SOC selection instead of average cell SOC; 1: Pack SOC = min Cell SOC, 0: Pack SOC = mean cell SOC" VALUE 0x20008A80 Scalar_BOOLEAN 0 swc_BatCoreFct_CM_boolean_dash_ 0 1 /end CHARACTERISTIC
/begin CHARACTERISTIC BCF_bAcvSofVeri_P "Sof verification active flag" VALUE 0x20008A81 Scalar_BOOLEAN 0 swc_BatCoreFct_CM_boolean_dash_ 0 1 /end CHARACTERISTIC
/begin CHARACTERISTIC BCF_bAcvTEstimnForSof_P "Activation of temperature estimation for SOF" VALUE 0x20008A83 Scalar_BOOLEAN 0 swc_BatCoreFct_CM_boolean_dash_ 0 1 /end CHARACTERISTIC
/begin CHARACTERISTIC BMS_CoolNegRelayCtrl_P "Water-cooled negative relay control command (0x0: Open\n      0x1: Close\n      0x2: Reserved\n      0x3: Invalid)" VALUE 0x20019CD1 Scalar_UBYTE 0 swc_COL_CM_uint8_dash_ 0 255 /end CHARACTERISTIC
/begin CHARACTERISTIC BMS_CoolPosRelayCtrl_P "Water-cooled positive relay control command (0x0: Open\n      0x1: Close\n      0x2: Reserved\n      0x3: Invalid)" VALUE 0x20019CD2 Scalar_UBYTE 0 swc_COL_CM_uint8_dash_ 0 255 /end CHARACTERISTIC
/begin CHARACTERISTIC BMS_HeatNegRelayCtrl_Reserved_P "Heating negative relay control command (0x0: Open\n      0x1: Close\n      0x2: Reserved\n      0x3: Invalid)" VALUE 0x20019CDF Scalar_UBYTE 0 swc_COL_CM_uint8_dash_ 0 255 /end CHARACTERISTIC
/begin CHARACTERISTIC BMS_HeatPosRelayCtrl_Reserved_P "Heating positive relay control command (0x0: Open\n      0x1: Close\n      0x2: Reserved\n      0x3: Invalid)" VALUE 0x20019CE1 Scalar_UBYTE 0 swc_COL_CM_uint8_dash_ 0 255 /end CHARACTERISTIC
/begin CHARACTERISTIC BMS_InsideFltCode_P "BMS internal fault code" VALUE 0x20019CE5 Scalar_UBYTE 0 swc_COL_CM_uint8_dash_ 0 255 /end CHARACTERISTIC
/begin CHARACTERISTIC BMS_MainNegRelay1Ctrl_P "BMS negative relay 1 control command (0x0: Open\n      0x1: Close\n      0x2: Reserved\n      0x3: Invalid)" VALUE 0x20019CE8 Scalar_UBYTE 0 swc_COL_CM_uint8_dash_ 0 255 /end CHARACTERISTIC
/begin CHARACTERISTIC BMS_MainNegRelay2Ctrl_P "BMS positive relay 2 control command (0x0: Open\n      0x1: Close\n      0x2: Reserved\n      0x3: Invalid)" VALUE 0x20019CE9 Scalar_UBYTE 0 swc_COL_CM_uint8_dash_ 0 255 /end CHARACTERISTIC
/begin CHARACTERISTIC BMS_TestFrame_P "Test frame" VALUE 0x20019CFE Scalar_UBYTE 0 swc_COL_CM_uint8_dash_ 0 255 /end CHARACTERISTIC
/begin CHARACTERISTIC BSOF_DirChAndDcha_P "Direction for charging and discharging" VALUE 0x20019C6D Scalar_UBYTE 0 swc_CIL_CM_uint8_dash_ 0 255 /end CHARACTERISTIC
/begin CHARACTERISTIC BSOF_EChSng_P "Single charge energy (when charger is online)" VALUE 0x200192DC Scalar_FLOAT32_IEEE 0 swc_CIL_CM_single_kWh -3.40282346639e+038 3.40282346639e+038 /end CHARACTERISTIC
/begin CHARACTERISTIC BSOF_ErrMsgTout1_P "BRM timeout" VALUE 0x20019C74 Scalar_UBYTE 0 swc_CIL_CM_uint8_dash_ 0 255 /end CHARACTERISTIC
/begin CHARACTERISTIC BSOF_ErrMsgTout2_P "BCP timeout" VALUE 0x20019C75 Scalar_UBYTE 0 swc_CIL_CM_uint8_dash_ 0 255 /end CHARACTERISTIC
/begin CHARACTERISTIC BSOF_ErrMsgTout3_P "BRO timeout" VALUE 0x20019C76 Scalar_UBYTE 0 swc_CIL_CM_uint8_dash_ 0 255 /end CHARACTERISTIC
/begin CHARACTERISTIC BSOF_ErrMsgTout4_P "BCS timeout" VALUE 0x0 Scalar_UBYTE 0 swc_CIL_CM_uint8_dash_ 0 255 /end CHARACTERISTIC
/begin CHARACTERISTIC BSOF_ErrMsgTout5_P "BSM timeout" VALUE 0x0 Scalar_UBYTE 0 swc_CIL_CM_uint8_dash_ 0 255 /end CHARACTERISTIC
/begin CHARACTERISTIC BSOF_ErrMsgTout6_P "BST timeout" VALUE 0x0 Scalar_UBYTE 0 swc_CIL_CM_uint8_dash_ 0 255 /end CHARACTERISTIC
/begin CHARACTERISTIC BSOF_ErrMsgTout7_P "BSD timeout" VALUE 0x0 Scalar_UBYTE 0 swc_CIL_CM_uint8_dash_ 0 255 /end CHARACTERISTIC
/begin CHARACTERISTIC BSOF_IChrgrMax_P "Maximum charger current(replacement value)" VALUE 0x200192E0 Scalar_FLOAT32_IEEE 0 swc_CIL_CM_single_A 0 65535 /end CHARACTERISTIC
/begin CHARACTERISTIC BSOF_IChrgrMin_P "For automated CAN tests(replacement value)" VALUE 0x200192E4 Scalar_FLOAT32_IEEE 0 swc_CIL_CM_single_A 0 65535 /end CHARACTERISTIC
/begin CHARACTERISTIC BSOF_IDchaMax_P "Maximum discharge current" VALUE 0x200192EC Scalar_FLOAT32_IEEE 0 swc_CIL_CM_single_A -3.40282346639e+038 3.40282346639e+038 /end CHARACTERISTIC
/begin CHARACTERISTIC BSOF_IDchaMin_P "Minimum discharge current" VALUE 0x200192F0 Scalar_FLOAT32_IEEE 0 swc_CIL_CM_single_A -3.40282346639e+038 3.40282346639e+038 /end CHARACTERISTIC
/begin CHARACTERISTIC BSOF_MsgChrgrRcgtn_P "flag of CHM recieved : 0-unrecieved, 0xaa-received(replacement value)" VALUE 0x20019C79 Scalar_UBYTE 0 swc_CIL_CM_uint8_dash_ 0 1 /end CHARACTERISTIC
/begin CHARACTERISTIC BSOF_MsgChrgrRdy_P "Charger is ready for charging or not (<0 x 00 >: = charger is not ready); <0 x AA >: = charger is ready; <0 x FF>: = invalid)(replacement value)" VALUE 0x20019C7A Scalar_UBYTE 0 swc_CIL_CM_uint8_dash_ 0 255 /end CHARACTERISTIC
/begin CHARACTERISTIC BSOF_NrChrgrComVers_P "Communication protocol version number of charger; this Standard defines the present version as V1.1, and it is expressed as byte3, byte2-0001H; byte1-01H(replacement value)" VALUE 0x20019C7B Scalar_UBYTE 0 swc_CIL_CM_uint8_dash_ 0 255 /end CHARACTERISTIC
/begin CHARACTERISTIC BSOF_SocDchaMax_P "maximun Soc dicharge allowed" VALUE 0x20019C7C Scalar_UBYTE 0 swc_CIL_CM_uint8_percent_ 0 255 /end CHARACTERISTIC
/begin CHARACTERISTIC BSOF_SocDchaMin_P "minimun Soc dicharge allowed" VALUE 0x20019C7D Scalar_UBYTE 0 swc_CIL_CM_uint8_percent_ 0 255 /end CHARACTERISTIC
/begin CHARACTERISTIC BSOF_UChrgrMax_P "Max voltage of the DC charger(replacement value)" VALUE 0x2001932C Scalar_FLOAT32_IEEE 0 swc_CIL_CM_single_V 0 65535 /end CHARACTERISTIC
/begin CHARACTERISTIC BSOF_UChrgrMin_P "Min voltage of the DC charger(replacement value)" VALUE 0x20019330 Scalar_FLOAT32_IEEE 0 swc_CIL_CM_single_V 0 65535 /end CHARACTERISTIC
/begin CHARACTERISTIC BSOF_UDchaMax_P "Maximum discharge voltage" VALUE 0x20019338 Scalar_FLOAT32_IEEE 0 swc_CIL_CM_single_V 0 65535 /end CHARACTERISTIC
/begin CHARACTERISTIC BSOF_UDchaMin_P "Minimum discharge voltage" VALUE 0x2001933C Scalar_FLOAT32_IEEE 0 swc_CIL_CM_single_V 0 65535 /end CHARACTERISTIC
/begin CHARACTERISTIC BSWIOSP_Mode_Request_shutdown_P "The app requests a low-voltage power down, and the application layer needs to detect whether the power down condition is met (0x0: No request\n      0x1: Request  BSW save data\n      0x2: Request BSW LV cut off)" VALUE 0x20019CFF Scalar_UBYTE 0 swc_COL_CM_uint8_dash_ 0 255 /end CHARACTERISTIC
/begin CHARACTERISTIC BSWIOSP_Request_BCL_P "Request to send a BCL packet" VALUE 0x20019D00 Scalar_UBYTE 0 swc_COL_CM_uint8_dash_ 0 255 /end CHARACTERISTIC
/begin CHARACTERISTIC BSWIOSP_Request_BCPP_P "Request to send a BCPP packet" VALUE 0x20019D01 Scalar_UBYTE 0 swc_COL_CM_uint8_dash_ 0 255 /end CHARACTERISTIC
/begin CHARACTERISTIC BSWIOSP_Request_BCP_P "Request to send a BCP packet" VALUE 0x20019D02 Scalar_UBYTE 0 swc_COL_CM_uint8_dash_ 0 255 /end CHARACTERISTIC
/begin CHARACTERISTIC BSWIOSP_Request_BCSP_P "Request to send a BCSP packet" VALUE 0x20019D03 Scalar_UBYTE 0 swc_COL_CM_uint8_dash_ 0 255 /end CHARACTERISTIC
/begin CHARACTERISTIC BSWIOSP_Request_BCS_P "Request to send a BCS packet" VALUE 0x20019D04 Scalar_UBYTE 0 swc_COL_CM_uint8_dash_ 0 255 /end CHARACTERISTIC
/begin CHARACTERISTIC BSWIOSP_Request_BDC_P "Request to send a BDC packet" VALUE 0x20019D05 Scalar_UBYTE 0 swc_COL_CM_uint8_dash_ 0 255 /end CHARACTERISTIC
/begin CHARACTERISTIC BSWIOSP_Request_BEM_P "Request to send a BEM packet" VALUE 0x20019D06 Scalar_UBYTE 0 swc_COL_CM_uint8_dash_ 0 255 /end CHARACTERISTIC
/begin CHARACTERISTIC BSWIOSP_Request_BHM_P "Request to send a BHM packet" VALUE 0x20019D07 Scalar_UBYTE 0 swc_COL_CM_uint8_dash_ 0 255 /end CHARACTERISTIC
/begin CHARACTERISTIC BSWIOSP_Request_BMS_FastChgStopInfo_P "Request send BMS_FastChgStopInfo message" VALUE 0x20019D08 Scalar_UBYTE 0 swc_COL_CM_uint8_dash_ 0 255 /end CHARACTERISTIC
/begin CHARACTERISTIC BSWIOSP_Request_BMT_P "Request to send a BMT packet" VALUE 0x20019D09 Scalar_UBYTE 0 swc_COL_CM_uint8_dash_ 0 255 /end CHARACTERISTIC
/begin CHARACTERISTIC BSWIOSP_Request_BMV_P "Request a BMV message" VALUE 0x20019D0A Scalar_UBYTE 0 swc_COL_CM_uint8_dash_ 0 255 /end CHARACTERISTIC
/begin CHARACTERISTIC BSWIOSP_Request_BRM_P "Request to send a BRM packet" VALUE 0x20019D0B Scalar_UBYTE 0 swc_COL_CM_uint8_dash_ 0 255 /end CHARACTERISTIC
/begin CHARACTERISTIC BSWIOSP_Request_BRO_P "Request a BRO message" VALUE 0x20019D0C Scalar_UBYTE 0 swc_COL_CM_uint8_dash_ 0 255 /end CHARACTERISTIC
/begin CHARACTERISTIC BSWIOSP_Request_BSD_P "Request to send a BSD message" VALUE 0x20019D0D Scalar_UBYTE 0 swc_COL_CM_uint8_dash_ 0 255 /end CHARACTERISTIC
/begin CHARACTERISTIC BSWIOSP_Request_BSM_P "Request to send a BSM packet" VALUE 0x20019D0E Scalar_UBYTE 0 swc_COL_CM_uint8_dash_ 0 255 /end CHARACTERISTIC
/begin CHARACTERISTIC BSWIOSP_Request_BSP_P "Request to send a BSP packet" VALUE 0x20019D0F Scalar_UBYTE 0 swc_COL_CM_uint8_dash_ 0 255 /end CHARACTERISTIC
/begin CHARACTERISTIC BSWIOSP_Request_BST_P "Request to send a BST packet" VALUE 0x20019D10 Scalar_UBYTE 0 swc_COL_CM_uint8_dash_ 0 255 /end CHARACTERISTIC
/begin CHARACTERISTIC BTHM_DincrtDataErr_P "Debounce counter increment value of electrical data check" VALUE 0x20019C54 Scalar_BYTE 0 swc_BatThermHndlgMngt_CM_int8_dash_ 0 127 /end CHARACTERISTIC
/begin CHARACTERISTIC BTHM_DincrtMdulSnsrErr_P "Debounce counter increment value of electrical data check for cell temperature sensor" VALUE 0x20019C55 Scalar_BYTE 0 swc_BatThermHndlgMngt_CM_int8_dash_ 0 127 /end CHARACTERISTIC
/begin CHARACTERISTIC BTHM_DmaxDataErr_P "Debounce counter maximum value for error condition of electrical data check" VALUE 0x20019C56 Scalar_BYTE 0 swc_BatThermHndlgMngt_CM_int8_dash_ 0 127 /end CHARACTERISTIC
/begin CHARACTERISTIC BTHM_DmaxMdulSnsrErr_P "Debounce counter maximum value for error condition of electrical data check for cell temperature sensor" VALUE 0x20019C57 Scalar_BYTE 0 swc_BatThermHndlgMngt_CM_int8_dash_ 0 127 /end CHARACTERISTIC
/begin CHARACTERISTIC BTHM_DminDataErr_P "Debounce counter minimum value for heal condition of electrical data check" VALUE 0x20019C58 Scalar_BYTE 0 swc_BatThermHndlgMngt_CM_int8_dash_ 0 127 /end CHARACTERISTIC
/begin CHARACTERISTIC BTHM_DminMdulSnsrErr_P "Debounce counter minimum value for heal condition of electrical data check for cell temperature sensor" VALUE 0x20019C59 Scalar_BYTE 0 swc_BatThermHndlgMngt_CM_int8_dash_ 0 127 /end CHARACTERISTIC
/begin CHARACTERISTIC BTHM_TBcuSnsrUMax_P "Maximum voltage for BCU temperature sensor" VALUE 0x20018CCC Scalar_FLOAT32_IEEE 0 swc_BatThermHndlgMngt_CM_single_C_ -3.40282346639e+038 3.40282346639e+038 /end CHARACTERISTIC
/begin CHARACTERISTIC BTHM_TBcuSnsrUMin_P "Minimum voltage for BCU temperature sensor" VALUE 0x20018CD0 Scalar_FLOAT32_IEEE 0 swc_BatThermHndlgMngt_CM_single_C_ -3.40282346639e+038 3.40282346639e+038 /end CHARACTERISTIC
/begin CHARACTERISTIC BTHM_TMdulCtlrSnsrUMax_P "Maximum limit for module controller temperature sensor meassurement value" VALUE 0x20018D30 Scalar_FLOAT32_IEEE 0 swc_BatThermHndlgMngt_CM_single__ -3.40282346639e+038 3.40282346639e+038 /end CHARACTERISTIC
/begin CHARACTERISTIC BTHM_TMdulCtlrSnsrUMin_P "Minimum limit for module controller temperature sensor meassurement value" VALUE 0x20018D34 Scalar_FLOAT32_IEEE 0 swc_BatThermHndlgMngt_CM_single__ -3.40282346639e+038 3.40282346639e+038 /end CHARACTERISTIC
/begin CHARACTERISTIC BmsSuspCause_ActiveSuspend_P "BST: The charging (discharging) motor is actively aborted" VALUE 0x20019D1B Scalar_UBYTE 0 swc_COL_CM_uint8_dash_ 0 255 /end CHARACTERISTIC
/begin CHARACTERISTIC BmsSuspCause_SOC_P "BST reaches SOC setpoint" VALUE 0x20019D1C Scalar_UBYTE 0 swc_COL_CM_uint8_dash_ 0 255 /end CHARACTERISTIC
/begin CHARACTERISTIC BmsSuspCause_SingleVoltage_P "BST reaches the monomer voltage setpoint" VALUE 0x20019D1D Scalar_UBYTE 0 swc_COL_CM_uint8_dash_ 0 255 /end CHARACTERISTIC
/begin CHARACTERISTIC BmsSuspCause_TotalVoltage_P "BST reaches the total voltage setpoint" VALUE 0x20019D1E Scalar_UBYTE 0 swc_COL_CM_uint8_dash_ 0 255 /end CHARACTERISTIC
/begin CHARACTERISTIC BmsSuspError_AbnormalVoltage_P "The BST voltage is abnormal" VALUE 0x20019D1F Scalar_UBYTE 0 swc_COL_CM_uint8_dash_ 0 255 /end CHARACTERISTIC
/begin CHARACTERISTIC BmsSuspError_ExcessiveCurrent_P "BST current is too large" VALUE 0x20019D20 Scalar_UBYTE 0 swc_COL_CM_uint8_dash_ 0 255 /end CHARACTERISTIC
/begin CHARACTERISTIC BmsSuspFault_BatteryTemp_P "BST battery pack temperature too high fault" VALUE 0x20019D21 Scalar_UBYTE 0 swc_COL_CM_uint8_dash_ 0 255 /end CHARACTERISTIC
/begin CHARACTERISTIC BmsSuspFault_BmsTemp_P "BST BMS components, output connectors are overtemperatured" VALUE 0x20019D22 Scalar_UBYTE 0 swc_COL_CM_uint8_dash_ 0 255 /end CHARACTERISTIC
/begin CHARACTERISTIC BmsSuspFault_ChargeConn_P "The BST charging connector is faulty" VALUE 0x20019D23 Scalar_UBYTE 0 swc_COL_CM_uint8_dash_ 0 255 /end CHARACTERISTIC
/begin CHARACTERISTIC BmsSuspFault_Insulation_P "BST insulation failure" VALUE 0x20019D24 Scalar_UBYTE 0 swc_COL_CM_uint8_dash_ 0 255 /end CHARACTERISTIC
/begin CHARACTERISTIC BmsSuspFault_OtherFaults_P "BST other failures" VALUE 0x20019D25 Scalar_UBYTE 0 swc_COL_CM_uint8_dash_ 0 255 /end CHARACTERISTIC
/begin CHARACTERISTIC BmsSuspFault_OutputConnTemp_P "BST output connector overtemperature fault" VALUE 0x20019D26 Scalar_UBYTE 0 swc_COL_CM_uint8_dash_ 0 255 /end CHARACTERISTIC
/begin CHARACTERISTIC BmsSuspFault_VoltageDetection_P "BST Check Point 2 voltage detection fault" VALUE 0x20019D27 Scalar_UBYTE 0 swc_COL_CM_uint8_dash_ 0 255 /end CHARACTERISTIC
/begin CHARACTERISTIC BmsSuspFault_VoltageRelay_P "BST high voltage relay failure" VALUE 0x20019D28 Scalar_UBYTE 0 swc_COL_CM_uint8_dash_ 0 255 /end CHARACTERISTIC
/begin CHARACTERISTIC BmuControl_BalanceControl_P "Passive equalization control (each bit pair should be the position of the cell under the module, and the array dimension subscript corresponds to the module)" VAL_BLK 0x20019688 Scalar_ULONG 0 swc_COL_CM_uint32_dash_ 0 4294967295 MATRIX_DIM 9 1 1 /end CHARACTERISTIC
/begin CHARACTERISTIC CIL_Csw7_P "configuration switch for Veh_CAN (100ms)" VALUE 0x20019BEC Scalar_UWORD 0 swc_CIL_CM_uint16_dash_ 0 65535 /end CHARACTERISTIC
/begin CHARACTERISTIC CIL_Csw8_P "configuration switch for GB_CAN (100ms)" VALUE 0x20019BEE Scalar_UWORD 0 swc_CIL_CM_uint16_dash_ 0 65535 /end CHARACTERISTIC
/begin CHARACTERISTIC CIL_DucycCtlPilot_P "CP duty cycle response" VALUE 0x20019C7F Scalar_UBYTE 0 swc_CIL_CM_uint8_dash_ 0 255 /end CHARACTERISTIC
/begin CHARACTERISTIC CIL_IEACAct_P "current of electric air condition" VALUE 0x2001936C Scalar_FLOAT32_IEEE 0 swc_CIL_CM_single_A -3.40282346639e+038 3.40282346639e+038 /end CHARACTERISTIC
/begin CHARACTERISTIC CIL_IObcChOutp_P "Output charging current of Obc" VALUE 0x20019370 Scalar_FLOAT32_IEEE 0 swc_CIL_CM_single_A -3.40282346639e+038 3.40282346639e+038 /end CHARACTERISTIC
/begin CHARACTERISTIC CIL_PwrEACAct_P "power of EAC" VALUE 0x200193B8 Scalar_FLOAT32_IEEE 0 swc_CIL_CM_single_kW 0 65535 /end CHARACTERISTIC
/begin CHARACTERISTIC CIL_PwrPtcAct_P "power of PTC" VALUE 0x200193BC Scalar_FLOAT32_IEEE 0 swc_CIL_CM_single_kW 0 65535 /end CHARACTERISTIC
/begin CHARACTERISTIC CIL_RAcChCnctn_P "CC resistance" VALUE 0x20019C88 Scalar_UBYTE 0 swc_CIL_CM_uint8_dash_ 0 255 /end CHARACTERISTIC
/begin CHARACTERISTIC CIL_StAcChCnct_P "State of CC from Obc" VALUE 0x20019C8A Scalar_UBYTE 0 swc_CIL_CM_uint8_dash_ 0 255 /end CHARACTERISTIC
/begin CHARACTERISTIC CIL_StBatHvReq_P "high voltage control request to HV battery(0x0: No request 0x1: HV on 0x2: Normal cut off HV 0x3: Emergency cut off  HV)" VALUE 0x20019C8B Scalar_UBYTE 0 swc_CIL_CM_uint8_dash_ 0 255 /end CHARACTERISTIC
/begin CHARACTERISTIC CIL_StBatLvCutoffReq_P "battery low voltage cutoff request (0x0: No request 0x1: Power off 0x2: Reserved 0x3: Invalid)" VALUE 0x20019C8C Scalar_UBYTE 0 swc_CIL_CM_uint8_dash_ 0 255 /end CHARACTERISTIC
/begin CHARACTERISTIC CIL_StChAllwd_P "Charge allowed from VCU" VALUE 0x20019C8F Scalar_UBYTE 0 swc_CIL_CM_uint8_dash_ 0 255 /end CHARACTERISTIC
/begin CHARACTERISTIC CIL_StObc_P "On board charger status" VALUE 0x20019C93 Scalar_UBYTE 0 swc_CIL_CM_uint8_dash_ 0 255 /end CHARACTERISTIC
/begin CHARACTERISTIC CIL_StPtIndcr_P "Powertrain READY indicator state\n      0x0: No Ready\n      0x1: Ready\n      0x2: Error\n      0x3: Invalid" VALUE 0x20019C94 Scalar_UBYTE 0 swc_CIL_CM_uint8_dash_ 0 255 /end CHARACTERISTIC
/begin CHARACTERISTIC CIL_StPtcW_P "State of ptc work mode" VALUE 0x20019C95 Scalar_UBYTE 0 swc_CIL_CM_uint8_dash_ 0 255 /end CHARACTERISTIC
/begin CHARACTERISTIC CIL_TCooltPackInSnsr_P "Temperature of water inlet" VALUE 0x20019BF2 Scalar_SWORD 0 swc_CIL_CM_int16__ -32768 32767 /end CHARACTERISTIC
/begin CHARACTERISTIC CIL_TCooltPackOutSnsr_P "Temperature of water outlet" VALUE 0x20019BF4 Scalar_SWORD 0 swc_CIL_CM_int16__ -32768 32767 /end CHARACTERISTIC
/begin CHARACTERISTIC CIL_UEACAct_P "Voltage of electric air condition" VALUE 0x20019570 Scalar_FLOAT32_IEEE 0 swc_CIL_CM_single_A -3.40282346639e+038 3.40282346639e+038 /end CHARACTERISTIC
/begin CHARACTERISTIC CIL_UObcChInp_P "input charging voltage of Obc" VALUE 0x2001958C Scalar_FLOAT32_IEEE 0 swc_CIL_CM_single_V -3.40282346639e+038 3.40282346639e+038 /end CHARACTERISTIC
/begin CHARACTERISTIC CIL_UObcChOutp_P "Output charging voltage of Obc" VALUE 0x20019590 Scalar_FLOAT32_IEEE 0 swc_CIL_CM_single_V -3.40282346639e+038 3.40282346639e+038 /end CHARACTERISTIC
/begin CHARACTERISTIC COL_Csw1_P "Code word 1 for activation of replacement values" VALUE 0x200196AC Scalar_ULONG 0 swc_COL_CM_uint32_dash_ 0 4294967295 /end CHARACTERISTIC
/begin CHARACTERISTIC CTC_Csw1_P "Configuration swtich for CTC outputs" VALUE 0x2001970C Scalar_ULONG 0 swc_CtctrTranCtl_CM_uint32_dash_ 0 4294967295 /end CHARACTERISTIC
/begin MEASUREMENT CTC_CtrCtctrAgiCh "Deterioration (aging) counter of the charge contactor. This counter represents the theoretical switching cycles which are dependent on the current flow during make/break events." FLOAT32_IEEE swc_CtctrTranCtl_CM_single_dash_ 0 0 0 10000000 ECU_ADDRESS 0x1FFE6180 /end MEASUREMENT
/begin CHARACTERISTIC CTC_CtrCtctrAgiCh_M "This map contains the theoretical switching cycles that the contactors see during a make/break event under specific current flow - charging contactor" CURVE 0x20019718 Lookup1D_FLOAT32_IEEE 0 swc_CtctrTranCtl_CM_single_dash_ 0 5000000
 /begin AXIS_DESCR COM_AXIS NO_INPUT_QUANTITY swc_CtctrTranCtl_CM_single_A 12 -10000 10000 DEPOSIT ABSOLUTE AXIS_PTS_REF CTC_ICtctrAgiCh_A /end AXIS_DESCR
/end CHARACTERISTIC
/begin MEASUREMENT CTC_CtrCtctrAgiNeg "Deterioration (aging) counter of the negative contactor. This counter represents the theoretical switching cycles which are dependent on the current flow during make/break events." FLOAT32_IEEE swc_CtctrTranCtl_CM_single_dash_ 0 0 0 10000000 ECU_ADDRESS 0x1FFE6190 /end MEASUREMENT
/begin CHARACTERISTIC CTC_CtrCtctrAgiNeg_M "This map contains the theoretical switching cycles that the main contactors see during a make/break event under specific current flow - negative contactor" CURVE 0x20019748 Lookup1D_FLOAT32_IEEE 0 swc_CtctrTranCtl_CM_single_dash_ 0 10000000
 /begin AXIS_DESCR COM_AXIS NO_INPUT_QUANTITY swc_CtctrTranCtl_CM_single_A 16 -10000 10000 DEPOSIT ABSOLUTE AXIS_PTS_REF CTC_ICtctrAgiNeg_A /end AXIS_DESCR
/end CHARACTERISTIC
/begin MEASUREMENT CTC_CtrCtctrAgiPos "Deterioration (aging) counter of the positive contactor. This counter represents the theoretical switching cycles which are dependent on the current flow during make/break events." FLOAT32_IEEE swc_CtctrTranCtl_CM_single_dash_ 0 0 0 10000000 ECU_ADDRESS 0x1FFE619C /end MEASUREMENT
/begin CHARACTERISTIC CTC_CtrCtctrAgiPos_M "This map contains the theoretical switching cycles that the main contactors see during a make/break event under specific current flow - positive contactor" CURVE 0x20019788 Lookup1D_FLOAT32_IEEE 0 swc_CtctrTranCtl_CM_single_dash_ 0 10000000
 /begin AXIS_DESCR COM_AXIS NO_INPUT_QUANTITY swc_CtctrTranCtl_CM_single_A 16 -10000 10000 DEPOSIT ABSOLUTE AXIS_PTS_REF CTC_ICtctrAgiPos_A /end AXIS_DESCR
/end CHARACTERISTIC
/begin MEASUREMENT CTC_CtrCtctrAgiPrech "Deterioration (aging) counter of the precharge contactor. This counter represents the theoretical switching cycles which are dependent on the current flow during make/break events." FLOAT32_IEEE swc_CtctrTranCtl_CM_single_dash_ 0 0 0 10000000 ECU_ADDRESS 0x1FFE61A8 /end MEASUREMENT
/begin CHARACTERISTIC CTC_CtrCtctrAgiPrech_M "This map contains the theoretical switching cycles that the contactors see during a make/break event under specific current flow - precharge contactor" CURVE 0x200197C8 Lookup1D_FLOAT32_IEEE 0 swc_CtctrTranCtl_CM_single_dash_ 0 5000000
 /begin AXIS_DESCR COM_AXIS NO_INPUT_QUANTITY swc_CtctrTranCtl_CM_single_A 12 -10000 10000 DEPOSIT ABSOLUTE AXIS_PTS_REF CTC_ICtctrAgiPrech_A /end AXIS_DESCR
/end CHARACTERISTIC
/begin AXIS_PTS CTC_ICtctrAgiCh_A "Current flow axis for contactor aging (deterioration) determination - charging contactor" 0x20019818 NO_INPUT_QUANTITY Lookup1D_X_FLOAT32_IEEE 0 swc_CtctrTranCtl_CM_single_A 12 -10000 10000 DEPOSIT ABSOLUTE /end AXIS_PTS
/begin AXIS_PTS CTC_ICtctrAgiNeg_A "Current flow axis for negative contactor aging (deterioration) determination" 0x20019848 NO_INPUT_QUANTITY Lookup1D_X_FLOAT32_IEEE 0 swc_CtctrTranCtl_CM_single_A 16 -10000 10000 DEPOSIT ABSOLUTE /end AXIS_PTS
/begin AXIS_PTS CTC_ICtctrAgiPos_A "Current flow axis for positive contactor aging (deterioration) determination" 0x20019888 NO_INPUT_QUANTITY Lookup1D_X_FLOAT32_IEEE 0 swc_CtctrTranCtl_CM_single_A 16 -10000 10000 DEPOSIT ABSOLUTE /end AXIS_PTS
/begin AXIS_PTS CTC_ICtctrAgiPrech_A "Current flow axis for contactor aging (deterioration) determination - precharge contactor" 0x200198C8 NO_INPUT_QUANTITY Lookup1D_X_FLOAT32_IEEE 0 swc_CtctrTranCtl_CM_single_A 12 -10000 10000 DEPOSIT ABSOLUTE /end AXIS_PTS
/begin CHARACTERISTIC CTC_StHvbat_P "HV Battery Operation State. 0:Undefined, 1:Offline, 2:Precharge, 3:Connect, 4:Online, 5:Shutoff, 6:Disconnect, 8:DC_charge, 9:AC_charge, 10:Emergency_disconnect, 14:Service_mode" VALUE 0x20019D41 Scalar_UBYTE 0 swc_CtctrTranCtl_CM_uint8_dash_ 0 255 /end CHARACTERISTIC
/begin CHARACTERISTIC CTC_StLoopHv_P "HV loop state\n      0x0: Open\n      0x1: Precharging\n      0x2: Precharg Finish\n      0x3: Prechage Fault\n      0x4: Precharge lock\n      0x5: Normal drive" VALUE 0x20019D42 Scalar_UBYTE 0 swc_CtctrTranCtl_CM_uint8_dash_ 0 1 /end CHARACTERISTIC
/begin CHARACTERISTIC CTC_bDisaUDecr_P "The valid flag that the voltage after the positive relay has decreased" VALUE 0x20019D4F Scalar_BOOLEAN 0 swc_CtctrTranCtl_CM_boolean_dash_ 0 1 /end CHARACTERISTIC
/begin CHARACTERISTIC ChargingMode_P "BCL: Charging mode (0x01: constant voltage charging 0x02: constant current charging 0x03: Discharge)" VALUE 0x20019D2A Scalar_UBYTE 0 swc_COL_CM_uint8_dash_ 0 255 /end CHARACTERISTIC
/begin CHARACTERISTIC CurrentDemand_P "BCL: Charging Demand Current/Discharge Allowable Current" VALUE 0x200196C8 Scalar_FLOAT32_IEEE 0 swc_COL_CM_single_A 0 65535 /end CHARACTERISTIC
/begin CHARACTERISTIC DEH_bAcvSwt_P "Switch for MIL test" VALUE 0x20019D82 Scalar_BOOLEAN 0 swc_DiagcEveHndlg_CM_boolean_dash_ 0 1 /end CHARACTERISTIC
/begin CHARACTERISTIC ELHPN_TiDebIniOffHvIntlc_P "Time delay off for debounce of high voltege interlock error state while initialization." VALUE 0x20019B3C Scalar_FLOAT32_IEEE 0 swc_EltlLnkHzrdProtnNet_CM_single_s -3.40282346639e+038 3.40282346639e+038 /end CHARACTERISTIC
/begin CHARACTERISTIC ELHPN_TiDebIniOnHvIntlc_P "Time delay on for debounce of high voltege interlock error state while initialization." VALUE 0x20019B40 Scalar_FLOAT32_IEEE 0 swc_EltlLnkHzrdProtnNet_CM_single_s -3.40282346639e+038 3.40282346639e+038 /end CHARACTERISTIC
/begin CHARACTERISTIC EVCSH_IChDecrThd_P "Current decrease threshold" VALUE 0x20017C28 Scalar_FLOAT32_IEEE 0 swc_BatChCtl_CM_single_dash_ -3.40282346639e+038 3.40282346639e+038 /end CHARACTERISTIC
/begin CHARACTERISTIC EVCSH_TMdulSnsrMax_P "DC charge max temperature" VALUE 0x20017C2C Scalar_FLOAT32_IEEE 0 swc_BatChCtl_CM_single_C_ -3.40282346639e+038 3.40282346639e+038 /end CHARACTERISTIC
/begin CHARACTERISTIC EVCSH_TMdulSnsrMin_P "DC charge min temperature" VALUE 0x20017C30 Scalar_FLOAT32_IEEE 0 swc_BatChCtl_CM_single_C_ -3.40282346639e+038 3.40282346639e+038 /end CHARACTERISTIC
/begin CHARACTERISTIC EVCSH_TiChSuspd1_P "Activate Charging Suspend Timer - Charger suspend or normal finish\n      \n      " VALUE 0x20019BB4 Scalar_UWORD 0 swc_BatChCtl_CM_uint16_dash_ 0 65535 /end CHARACTERISTIC
/begin CHARACTERISTIC EVCSH_TiChSuspd2_P "Activate Charging Suspend Timer - BMS suspend" VALUE 0x20019BB6 Scalar_UWORD 0 swc_BatChCtl_CM_uint16_dash_ 0 65535 /end CHARACTERISTIC
/begin CHARACTERISTIC EVCSH_TiChrgrChSt_P " CCS timeout" VALUE 0x20019BB8 Scalar_UWORD 0 swc_BatChCtl_CM_uint16_dash_ 0 65535 /end CHARACTERISTIC
/begin CHARACTERISTIC EVCSH_TiChrgrChSuspd_P "Time of CST timeout" VALUE 0x20019BBA Scalar_UWORD 0 swc_BatChCtl_CM_uint16_dash_ 0 65535 /end CHARACTERISTIC
/begin CHARACTERISTIC EVCSH_TiChrgrErrWait_P "CUSTOM timer, waiting for CML diagnosis" VALUE 0x20019BBC Scalar_UWORD 0 swc_BatChCtl_CM_uint16_dash_ 0 65535 /end CHARACTERISTIC
/begin CHARACTERISTIC EVCSH_TiChrgrHdshk_P "Time of CHM timeout" VALUE 0x20019BBE Scalar_UWORD 0 swc_BatChCtl_CM_uint16_dash_ 0 65535 /end CHARACTERISTIC
/begin CHARACTERISTIC EVCSH_TiChrgrMsgDly_P "If CRO 0xAA is received before 0x00, delay transition for two BRO 0xAA samples 500ms to guarantee that BRO 0xAA is sent" VALUE 0x20019BC0 Scalar_UWORD 0 swc_BatChCtl_CM_uint16_dash_ 0 65535 /end CHARACTERISTIC
/begin CHARACTERISTIC EVCSH_TiChrgrNotRdy_P "Time of CRO oxAA timeout" VALUE 0x20019BC2 Scalar_UWORD 0 swc_BatChCtl_CM_uint16_dash_ 0 65535 /end CHARACTERISTIC
/begin CHARACTERISTIC EVCSH_TiChrgrRcgtn1_P "Time of CRM Ox00 timeout" VALUE 0x20019BC4 Scalar_UWORD 0 swc_BatChCtl_CM_uint16_dash_ 0 65535 /end CHARACTERISTIC
/begin CHARACTERISTIC EVCSH_TiChrgrRcgtn2_P "Time of CRM 0xAA timeout" VALUE 0x20019BC6 Scalar_UWORD 0 swc_BatChCtl_CM_uint16_dash_ 0 65535 /end CHARACTERISTIC
/begin CHARACTERISTIC EVCSH_TiChrgrRdy_P "Time of CRO 0x00 timeout" VALUE 0x20019BC8 Scalar_UWORD 0 swc_BatChCtl_CM_uint16_dash_ 0 65535 /end CHARACTERISTIC
/begin CHARACTERISTIC EVCSH_TiChrgrStstc_P "Time of CSD timeout" VALUE 0x20019BCA Scalar_UWORD 0 swc_BatChCtl_CM_uint16_dash_ 0 65535 /end CHARACTERISTIC
/begin CHARACTERISTIC EVCSH_TiChrgrSync_P "Time of CTS" VALUE 0x20019BCC Scalar_UWORD 0 swc_BatChCtl_CM_uint16_dash_ 0 65535 /end CHARACTERISTIC
/begin CHARACTERISTIC EVCSH_TiDlyComSeq_P "when CST received outside of charging phase, start sending BST, wait for this time and then deactivate BST and send BSD" VALUE 0x20019BCE Scalar_UWORD 0 swc_BatChCtl_CM_uint16_dash_ 0 65535 /end CHARACTERISTIC
/begin CHARACTERISTIC EVCSH_TiSysWup_P "System awake timer" VALUE 0x20019BD0 Scalar_UWORD 0 swc_BatChCtl_CM_uint16_dash_ 0 65535 /end CHARACTERISTIC
/begin CHARACTERISTIC EVCSH_TiToutChgDetnCnct_P "Time delay of handshake restart in case of CDC timeout." VALUE 0x20019BD2 Scalar_UWORD 0 swc_BatChCtl_CM_uint16_dash_ 0 65535 /end CHARACTERISTIC
/begin CHARACTERISTIC EVCSH_TiToutHdshkDly_P "Time delay of handshake restart in case of CRM0xAA timeout." VALUE 0x20019BD4 Scalar_UWORD 0 swc_BatChCtl_CM_uint16_dash_ 0 65535 /end CHARACTERISTIC
/begin CHARACTERISTIC EVCSH_TranChrgrChStMan_P "Manual transition CCS parameter" VALUE 0x20019C2F Scalar_UBYTE 0 swc_BatChCtl_CM_uint8_dash_ 0 255 /end CHARACTERISTIC
/begin CHARACTERISTIC EVCSH_TranChrgrChSuspdMan_P "Manual transition CST parameter" VALUE 0x20019C30 Scalar_UBYTE 0 swc_BatChCtl_CM_uint8_dash_ 0 255 /end CHARACTERISTIC
/begin CHARACTERISTIC EVCSH_TranChrgrDetnCnct_P "Manual Transition CDC   Parameter" VALUE 0x20019C31 Scalar_UBYTE 0 swc_BatChCtl_CM_uint8_dash_ 0 255 /end CHARACTERISTIC
/begin CHARACTERISTIC EVCSH_TranChrgrErrMan_P "Manual tansition CEM parameter" VALUE 0x20019C32 Scalar_UBYTE 0 swc_BatChCtl_CM_uint8_dash_ 0 255 /end CHARACTERISTIC
/begin CHARACTERISTIC EVCSH_TranChrgrHdshkMan_P "Manual Transition CHM  Parameter" VALUE 0x20019C33 Scalar_UBYTE 0 swc_BatChCtl_CM_uint8_dash_ 0 255 /end CHARACTERISTIC
/begin CHARACTERISTIC EVCSH_TranChrgrMaxOutMan_P "Manual Transition CML Parameter" VALUE 0x20019C34 Scalar_UBYTE 0 swc_BatChCtl_CM_uint8_dash_ 0 255 /end CHARACTERISTIC
/begin CHARACTERISTIC EVCSH_TranChrgrNotRdyMan_P "Manual transition (CRO 0x00) parameter." VALUE 0x20019C35 Scalar_UBYTE 0 swc_BatChCtl_CM_uint8_dash_ 0 255 /end CHARACTERISTIC
/begin CHARACTERISTIC EVCSH_TranChrgrRcgtn00Man_P "Manual Transition CRM 0x00   Parameter" VALUE 0x20019C36 Scalar_UBYTE 0 swc_BatChCtl_CM_uint8_dash_ 0 255 /end CHARACTERISTIC
/begin CHARACTERISTIC EVCSH_TranChrgrRcgtnAAMan_P "Manual  Transition CRM 0xAA Parameter" VALUE 0x20019C37 Scalar_UBYTE 0 swc_BatChCtl_CM_uint8_dash_ 0 255 /end CHARACTERISTIC
/begin CHARACTERISTIC EVCSH_TranChrgrRdyMan_P "Manual transition (CRO 0xAA) parameter." VALUE 0x20019C38 Scalar_UBYTE 0 swc_BatChCtl_CM_uint8_dash_ 0 255 /end CHARACTERISTIC
/begin CHARACTERISTIC EVCSH_TranChrgrStstcMan_P "Manual transition CSD parameter" VALUE 0x20019C39 Scalar_UBYTE 0 swc_BatChCtl_CM_uint8_dash_ 0 255 /end CHARACTERISTIC
/begin CHARACTERISTIC EVCSH_TranMsgChrgrChDetd_P "Manual Transition CCD  Parameter" VALUE 0x20019C3A Scalar_UBYTE 0 swc_BatChCtl_CM_uint8_dash_ 0 255 /end CHARACTERISTIC
/begin CHARACTERISTIC EVCSH_TranMsgChrgrMaxOutPgtn_P "Manual Transition CMLP  Parameter" VALUE 0x20019C3B Scalar_UBYTE 0 swc_BatChCtl_CM_uint8_dash_ 0 255 /end CHARACTERISTIC
/begin CHARACTERISTIC EVCSH_bDisaTrsmMsgOpt_P "Disable Flag Transmission Message Optional" VALUE 0x20019C3F Scalar_BOOLEAN 0 swc_BatChCtl_CM_boolean_dash_ 0 1 /end CHARACTERISTIC
/begin CHARACTERISTIC HvSysSample_DisableIso_P "Turn off the insulation" VALUE 0x20019D2B Scalar_UBYTE 0 swc_COL_CM_uint8_dash_ 0 255 /end CHARACTERISTIC
/begin CHARACTERISTIC MCC_NrCellByMdul_P "This output defines the number of cells in serial connected to each module controller. The array position stands for the module controller." VAL_BLK 0x200195C0 Scalar_UBYTE 0 swc_CIL_CM_uint8_dash_ 0 255 MATRIX_DIM 24 1 1 /end CHARACTERISTIC
/begin CHARACTERISTIC MCC_NrCellTot_P "Total number of cells (serial) in the system" VALUE 0x20019BFA Scalar_UWORD 0 swc_CIL_CM_uint16_dash_ 0 65535 /end CHARACTERISTIC
/begin CHARACTERISTIC MCC_NrCtlrSnsrTByMdul_P "Number of module controller PCB temperature sensors per module (identical for each module controller)." VAL_BLK 0x200195D8 Scalar_UBYTE 0 swc_CIL_CM_uint8_dash_ 0 255 MATRIX_DIM 24 1 1 /end CHARACTERISTIC
/begin CHARACTERISTIC MCC_NrMdulCtlrSnsrTTot_P "Total number of module controller PCB temperature measurements" VALUE 0x20019CA0 Scalar_UBYTE 0 swc_CIL_CM_uint8_dash_ 0 255 /end CHARACTERISTIC
/begin CHARACTERISTIC MCC_NrMdulTot_P "This parameter defines the total number of modules (serial) in the system" VALUE 0x20019CA1 Scalar_UBYTE 0 swc_CIL_CM_uint8_dash_ 0 255 /end CHARACTERISTIC
/begin CHARACTERISTIC MCC_NrSnsrTByMdul_P "This parameter defines the number of temperature sensors connected to each module controller. The array position stands for the module controller." VAL_BLK 0x200195F0 Scalar_UBYTE 0 swc_CIL_CM_uint8_dash_ 0 255 MATRIX_DIM 24 1 1 /end CHARACTERISTIC
/begin CHARACTERISTIC MCC_NrSnsrTTot_P "Total number of cell temperature sensors in the system" VALUE 0x20019CA2 Scalar_UBYTE 0 swc_CIL_CM_uint8_dash_ 0 255 /end CHARACTERISTIC
/begin CHARACTERISTIC SMObc_TiWaitForTout1_P "Time for AC charge delay" VALUE 0x20017C40 Scalar_FLOAT32_IEEE 0 swc_BatChCtl_CM_single_s -3.40282346639e+038 3.40282346639e+038 /end CHARACTERISTIC
/begin CHARACTERISTIC SMObc_TiWaitForTout2_P "Time for AC charge delay" VALUE 0x20017C44 Scalar_FLOAT32_IEEE 0 swc_BatChCtl_CM_single_s -3.40282346639e+038 3.40282346639e+038 /end CHARACTERISTIC
/begin CHARACTERISTIC SMObc_TiWaitForTout_P "Time for AC charge delay" VALUE 0x20017C48 Scalar_FLOAT32_IEEE 0 swc_BatChCtl_CM_single_s -3.40282346639e+038 3.40282346639e+038 /end CHARACTERISTIC
/begin CHARACTERISTIC VoltageDemand_P "BCL: Charging Demand Voltage/Discharge Permissible Voltage" VALUE 0x20019708 Scalar_FLOAT32_IEEE 0 swc_COL_CM_single_V 0 65535 /end CHARACTERISTIC
/begin GROUP S449_BCF_Wbz_M "swc_BatCoreFct/BCF_100ms_sys/BatCoreFct/PackObs/PackObsLoop/MdulObs/MdulSocObsr/MdulStateObs/MdulModel/Measurement Equation hfun/BCF_Wbz_M" /begin REF_CHARACTERISTIC BCF_Wbz_M /end REF_CHARACTERISTIC /end GROUP
/begin GROUP S449_BCF_WbzFac_P "swc_BatCoreFct/BCF_100ms_sys/BatCoreFct/PackObs/PackObsLoop/MdulObs/MdulSocObsr/MdulStateObs/MdulModel/Measurement Equation hfun/BCF_WbzFac_P" /begin REF_CHARACTERISTIC BCF_WbzFac_P /end REF_CHARACTERISTIC /end GROUP
/begin GROUP S458_OptionalMessages "swc_BatChCtl/DC_10ms_sys/ElecVehChegnStHdlr_Sys/ElecVehChegnStHdlr/Main/OverrideFlags/OptionalMessages" /begin SUB_GROUP S464_EVCSH_bDisaTrsmMsgOpt_P /end SUB_GROUP /end GROUP
/begin GROUP S45_BTHM_DincrtDataErr_P1 "swc_BatThermHndlgMngt/BTHM_100ms_sys/100ms/DataPrep/DataChk/TBcuSnsrChk/BTHM_DincrtDataErr_P1" /begin REF_CHARACTERISTIC BTHM_DincrtDataErr_P /end REF_CHARACTERISTIC /end GROUP
/begin GROUP S45_BTHM_DmaxDataErr_P1 "swc_BatThermHndlgMngt/BTHM_100ms_sys/100ms/DataPrep/DataChk/TBcuSnsrChk/BTHM_DmaxDataErr_P1" /begin REF_CHARACTERISTIC BTHM_DmaxDataErr_P /end REF_CHARACTERISTIC /end GROUP
/begin GROUP S45_BTHM_DminDataErr_P1 "swc_BatThermHndlgMngt/BTHM_100ms_sys/100ms/DataPrep/DataChk/TBcuSnsrChk/BTHM_DminDataErr_P1" /begin REF_CHARACTERISTIC BTHM_DminDataErr_P /end REF_CHARACTERISTIC /end GROUP
/begin GROUP S45_BTHM_TBcuSnsrUMax_P1 "swc_BatThermHndlgMngt/BTHM_100ms_sys/100ms/DataPrep/DataChk/TBcuSnsrChk/BTHM_TBcuSnsrUMax_P1" /begin REF_CHARACTERISTIC BTHM_TBcuSnsrUMax_P /end REF_CHARACTERISTIC /end GROUP
/begin GROUP S45_BTHM_TBcuSnsrUMin_P1 "swc_BatThermHndlgMngt/BTHM_100ms_sys/100ms/DataPrep/DataChk/TBcuSnsrChk/BTHM_TBcuSnsrUMin_P1" /begin REF_CHARACTERISTIC BTHM_TBcuSnsrUMin_P /end REF_CHARACTERISTIC /end GROUP
/begin GROUP S461_Start_Conditions "swc_BatChCtl/DC_10ms_sys/ElecVehChegnStHdlr_Sys/ElecVehChegnStHdlr/Main/TerminateConditions/Start_Conditions"
 /begin SUB_GROUP S470_CompareToCalibrationPara1 S470_CompareToCalibrationPara23 /end SUB_GROUP
/end GROUP
/begin GROUP S462_EVCSH_TiChrgrChSt_P "swc_BatChCtl/DC_10ms_sys/ElecVehChegnStHdlr_Sys/ElecVehChegnStHdlr/Main/Timeouts/EVCSH_TiChrgrChSt_P" /begin REF_CHARACTERISTIC EVCSH_TiChrgrChSt_P /end REF_CHARACTERISTIC /end GROUP
/begin GROUP S462_EVCSH_TiChrgrChSuspd_P "swc_BatChCtl/DC_10ms_sys/ElecVehChegnStHdlr_Sys/ElecVehChegnStHdlr/Main/Timeouts/EVCSH_TiChrgrChSuspd_P" /begin REF_CHARACTERISTIC EVCSH_TiChrgrChSuspd_P /end REF_CHARACTERISTIC /end GROUP
/begin GROUP S462_EVCSH_TiChrgrErrWait_P "swc_BatChCtl/DC_10ms_sys/ElecVehChegnStHdlr_Sys/ElecVehChegnStHdlr/Main/Timeouts/EVCSH_TiChrgrErrWait_P" /begin REF_CHARACTERISTIC EVCSH_TiChrgrErrWait_P /end REF_CHARACTERISTIC /end GROUP
/begin GROUP S462_EVCSH_TiChrgrHdshk_P "swc_BatChCtl/DC_10ms_sys/ElecVehChegnStHdlr_Sys/ElecVehChegnStHdlr/Main/Timeouts/EVCSH_TiChrgrHdshk_P" /begin REF_CHARACTERISTIC EVCSH_TiChrgrHdshk_P /end REF_CHARACTERISTIC /end GROUP
/begin GROUP S462_EVCSH_TiChrgrMsgDly_P "swc_BatChCtl/DC_10ms_sys/ElecVehChegnStHdlr_Sys/ElecVehChegnStHdlr/Main/Timeouts/EVCSH_TiChrgrMsgDly_P" /begin REF_CHARACTERISTIC EVCSH_TiChrgrMsgDly_P /end REF_CHARACTERISTIC /end GROUP
/begin GROUP S462_EVCSH_TiChrgrNotRdy_P "swc_BatChCtl/DC_10ms_sys/ElecVehChegnStHdlr_Sys/ElecVehChegnStHdlr/Main/Timeouts/EVCSH_TiChrgrNotRdy_P" /begin REF_CHARACTERISTIC EVCSH_TiChrgrNotRdy_P /end REF_CHARACTERISTIC /end GROUP
/begin GROUP S462_EVCSH_TiChrgrRcgtn1_P "swc_BatChCtl/DC_10ms_sys/ElecVehChegnStHdlr_Sys/ElecVehChegnStHdlr/Main/Timeouts/EVCSH_TiChrgrRcgtn1_P" /begin REF_CHARACTERISTIC EVCSH_TiChrgrRcgtn1_P /end REF_CHARACTERISTIC /end GROUP
/begin GROUP S462_EVCSH_TiChrgrRcgtn2_P "swc_BatChCtl/DC_10ms_sys/ElecVehChegnStHdlr_Sys/ElecVehChegnStHdlr/Main/Timeouts/EVCSH_TiChrgrRcgtn2_P" /begin REF_CHARACTERISTIC EVCSH_TiChrgrRcgtn2_P /end REF_CHARACTERISTIC /end GROUP
/begin GROUP S462_EVCSH_TiChrgrRdy_P "swc_BatChCtl/DC_10ms_sys/ElecVehChegnStHdlr_Sys/ElecVehChegnStHdlr/Main/Timeouts/EVCSH_TiChrgrRdy_P" /begin REF_CHARACTERISTIC EVCSH_TiChrgrRdy_P /end REF_CHARACTERISTIC /end GROUP
/begin GROUP S462_EVCSH_TiChrgrStstc_P "swc_BatChCtl/DC_10ms_sys/ElecVehChegnStHdlr_Sys/ElecVehChegnStHdlr/Main/Timeouts/EVCSH_TiChrgrStstc_P" /begin REF_CHARACTERISTIC EVCSH_TiChrgrStstc_P /end REF_CHARACTERISTIC /end GROUP
/begin GROUP S462_EVCSH_TiChrgrSync_P "swc_BatChCtl/DC_10ms_sys/ElecVehChegnStHdlr_Sys/ElecVehChegnStHdlr/Main/Timeouts/EVCSH_TiChrgrSync_P" /begin REF_CHARACTERISTIC EVCSH_TiChrgrSync_P /end REF_CHARACTERISTIC /end GROUP
/begin GROUP S462_EVCSH_TiChSuspd1_P "swc_BatChCtl/DC_10ms_sys/ElecVehChegnStHdlr_Sys/ElecVehChegnStHdlr/Main/Timeouts/EVCSH_TiChSuspd1_P" /begin REF_CHARACTERISTIC EVCSH_TiChSuspd1_P /end REF_CHARACTERISTIC /end GROUP
/begin GROUP S462_EVCSH_TiChSuspd2_P "swc_BatChCtl/DC_10ms_sys/ElecVehChegnStHdlr_Sys/ElecVehChegnStHdlr/Main/Timeouts/EVCSH_TiChSuspd2_P" /begin REF_CHARACTERISTIC EVCSH_TiChSuspd2_P /end REF_CHARACTERISTIC /end GROUP
/begin GROUP S462_EVCSH_TiDlyComSeq_P "swc_BatChCtl/DC_10ms_sys/ElecVehChegnStHdlr_Sys/ElecVehChegnStHdlr/Main/Timeouts/EVCSH_TiDlyComSeq_P" /begin REF_CHARACTERISTIC EVCSH_TiDlyComSeq_P /end REF_CHARACTERISTIC /end GROUP
/begin GROUP S462_EVCSH_TiSysWup_P "swc_BatChCtl/DC_10ms_sys/ElecVehChegnStHdlr_Sys/ElecVehChegnStHdlr/Main/Timeouts/EVCSH_TiSysWup_P" /begin REF_CHARACTERISTIC EVCSH_TiSysWup_P /end REF_CHARACTERISTIC /end GROUP
/begin GROUP S462_EVCSH_TiToutChgDetnCnct_P "swc_BatChCtl/DC_10ms_sys/ElecVehChegnStHdlr_Sys/ElecVehChegnStHdlr/Main/Timeouts/EVCSH_TiToutChgDetnCnct_P" /begin REF_CHARACTERISTIC EVCSH_TiToutChgDetnCnct_P /end REF_CHARACTERISTIC /end GROUP
/begin GROUP S462_EVCSH_TiToutHdshkDly_P "swc_BatChCtl/DC_10ms_sys/ElecVehChegnStHdlr_Sys/ElecVehChegnStHdlr/Main/Timeouts/EVCSH_TiToutHdshkDly_P" /begin REF_CHARACTERISTIC EVCSH_TiToutHdshkDly_P /end REF_CHARACTERISTIC /end GROUP
/begin GROUP S462_EVCSH_TiToutHdshkDly_P1 "swc_BatChCtl/DC_10ms_sys/ElecVehChegnStHdlr_Sys/ElecVehChegnStHdlr/Main/Timeouts/EVCSH_TiToutHdshkDly_P1" /begin REF_CHARACTERISTIC EVCSH_TiToutHdshkDly_P /end REF_CHARACTERISTIC /end GROUP
/begin GROUP S462_EVCSH_TiToutHdshkDly_P3 "swc_BatChCtl/DC_10ms_sys/ElecVehChegnStHdlr_Sys/ElecVehChegnStHdlr/Main/Timeouts/EVCSH_TiToutHdshkDly_P3" /begin REF_CHARACTERISTIC EVCSH_TiToutHdshkDly_P /end REF_CHARACTERISTIC /end GROUP
/begin GROUP S463_CCD "swc_BatChCtl/DC_10ms_sys/ElecVehChegnStHdlr_Sys/ElecVehChegnStHdlr/Main/TransitionManager/CCD" /begin SUB_GROUP S508_EVCSH_TranMsgChrgrChDetd_P /end SUB_GROUP /end GROUP
/begin GROUP S463_CCS "swc_BatChCtl/DC_10ms_sys/ElecVehChegnStHdlr_Sys/ElecVehChegnStHdlr/Main/TransitionManager/CCS" /begin SUB_GROUP S509_EVCSH_TranChrgrChStMan_P /end SUB_GROUP /end GROUP
/begin GROUP S463_CDC "swc_BatChCtl/DC_10ms_sys/ElecVehChegnStHdlr_Sys/ElecVehChegnStHdlr/Main/TransitionManager/CDC" /begin SUB_GROUP S510_EVCSH_TranChrgrDetnCnct_P /end SUB_GROUP /end GROUP
/begin GROUP S463_CEM "swc_BatChCtl/DC_10ms_sys/ElecVehChegnStHdlr_Sys/ElecVehChegnStHdlr/Main/TransitionManager/CEM" /begin SUB_GROUP S511_EVCSH_TranChrgrErrMan_P /end SUB_GROUP /end GROUP
/begin GROUP S463_CHM "swc_BatChCtl/DC_10ms_sys/ElecVehChegnStHdlr_Sys/ElecVehChegnStHdlr/Main/TransitionManager/CHM" /begin SUB_GROUP S512_EVCSH_TranChrgrHdshkMan_P /end SUB_GROUP /end GROUP
/begin GROUP S463_CML "swc_BatChCtl/DC_10ms_sys/ElecVehChegnStHdlr_Sys/ElecVehChegnStHdlr/Main/TransitionManager/CML" /begin SUB_GROUP S513_EVCSH_TranChrgrMaxOutMan_P /end SUB_GROUP /end GROUP
/begin GROUP S463_CMLP "swc_BatChCtl/DC_10ms_sys/ElecVehChegnStHdlr_Sys/ElecVehChegnStHdlr/Main/TransitionManager/CMLP" /begin SUB_GROUP S514_EVCSH_TranMsgChrgrMaxOutPgtn_P /end SUB_GROUP /end GROUP
/begin GROUP S463_CRM "swc_BatChCtl/DC_10ms_sys/ElecVehChegnStHdlr_Sys/ElecVehChegnStHdlr/Main/TransitionManager/CRM"
 /begin SUB_GROUP S515_EVCSH_TranChrgrRcgtn00Man_P S515_EVCSH_TranChrgrRcgtnAAMan_P /end SUB_GROUP
/end GROUP
/begin GROUP S463_CRO "swc_BatChCtl/DC_10ms_sys/ElecVehChegnStHdlr_Sys/ElecVehChegnStHdlr/Main/TransitionManager/CRO"
 /begin SUB_GROUP S516_EVCSH_TranChrgrNotRdyMan_P S516_EVCSH_TranChrgrRdyMan_P /end SUB_GROUP
/end GROUP
/begin GROUP S463_CSD "swc_BatChCtl/DC_10ms_sys/ElecVehChegnStHdlr_Sys/ElecVehChegnStHdlr/Main/TransitionManager/CSD" /begin SUB_GROUP S517_EVCSH_TranChrgrStstcMan_P /end SUB_GROUP /end GROUP
/begin GROUP S463_CST "swc_BatChCtl/DC_10ms_sys/ElecVehChegnStHdlr_Sys/ElecVehChegnStHdlr/Main/TransitionManager/CST" /begin SUB_GROUP S518_EVCSH_TranChrgrChSuspdMan_P /end SUB_GROUP /end GROUP
/begin GROUP S463_TranIChDecr "swc_BatChCtl/DC_10ms_sys/ElecVehChegnStHdlr_Sys/ElecVehChegnStHdlr/Main/TransitionManager/TranIChDecr" /begin SUB_GROUP S521_EVCSH_IChDecrThd_P /end SUB_GROUP /end GROUP
/begin GROUP S464_EVCSH_bDisaTrsmMsgOpt_P "swc_BatChCtl/DC_10ms_sys/ElecVehChegnStHdlr_Sys/ElecVehChegnStHdlr/Main/OverrideFlags/OptionalMessages/EVCSH_bDisaTrsmMsgOpt_P" /begin REF_CHARACTERISTIC EVCSH_bDisaTrsmMsgOpt_P /end REF_CHARACTERISTIC /end GROUP
/begin GROUP S46_BTHM_DincrtMdulSnsrErr_P "swc_BatThermHndlgMngt/BTHM_100ms_sys/100ms/DataPrep/DataChk/TMdulCtlrSnsrChk/BTHM_DincrtMdulSnsrErr_P" /begin REF_CHARACTERISTIC BTHM_DincrtMdulSnsrErr_P /end REF_CHARACTERISTIC /end GROUP
/begin GROUP S46_BTHM_DmaxMdulSnsrErr_P "swc_BatThermHndlgMngt/BTHM_100ms_sys/100ms/DataPrep/DataChk/TMdulCtlrSnsrChk/BTHM_DmaxMdulSnsrErr_P" /begin REF_CHARACTERISTIC BTHM_DmaxMdulSnsrErr_P /end REF_CHARACTERISTIC /end GROUP
/begin GROUP S46_BTHM_DminMdulSnsrErr_P "swc_BatThermHndlgMngt/BTHM_100ms_sys/100ms/DataPrep/DataChk/TMdulCtlrSnsrChk/BTHM_DminMdulSnsrErr_P" /begin REF_CHARACTERISTIC BTHM_DminMdulSnsrErr_P /end REF_CHARACTERISTIC /end GROUP
/begin GROUP S46_BTHM_TMdulCtlrSnsrUMax_P "swc_BatThermHndlgMngt/BTHM_100ms_sys/100ms/DataPrep/DataChk/TMdulCtlrSnsrChk/BTHM_TMdulCtlrSnsrUMax_P" /begin REF_CHARACTERISTIC BTHM_TMdulCtlrSnsrUMax_P /end REF_CHARACTERISTIC /end GROUP
/begin GROUP S46_BTHM_TMdulCtlrSnsrUMin_P "swc_BatThermHndlgMngt/BTHM_100ms_sys/100ms/DataPrep/DataChk/TMdulCtlrSnsrChk/BTHM_TMdulCtlrSnsrUMin_P" /begin REF_CHARACTERISTIC BTHM_TMdulCtlrSnsrUMin_P /end REF_CHARACTERISTIC /end GROUP
/begin GROUP S470_CompareToCalibrationPara1 "swc_BatChCtl/DC_10ms_sys/ElecVehChegnStHdlr_Sys/ElecVehChegnStHdlr/Main/TerminateConditions/Start_Conditions/CompareToCalibrationPara1" /begin REF_CHARACTERISTIC EVCSH_TMdulSnsrMax_P /end REF_CHARACTERISTIC /end GROUP
/begin GROUP S470_CompareToCalibrationPara23 "swc_BatChCtl/DC_10ms_sys/ElecVehChegnStHdlr_Sys/ElecVehChegnStHdlr/Main/TerminateConditions/Start_Conditions/CompareToCalibrationPara23" /begin REF_CHARACTERISTIC EVCSH_TMdulSnsrMin_P /end REF_CHARACTERISTIC /end GROUP
/begin GROUP S472_BCF_TCooltHiLim_P "swc_BatCoreFct/BCF_100ms_sys/BatCoreFct/PackObs/PackObsLoop/MdulObs/MdulSocObsr/MdulTObs/Evaluation of Estimation/BCF_TCooltHiLim_P" /begin REF_CHARACTERISTIC BCF_TCooltHiLim_P /end REF_CHARACTERISTIC /end GROUP
/begin GROUP S472_BCF_TCooltLoLim_P "swc_BatCoreFct/BCF_100ms_sys/BatCoreFct/PackObs/PackObsLoop/MdulObs/MdulSocObsr/MdulTObs/Evaluation of Estimation/BCF_TCooltLoLim_P" /begin REF_CHARACTERISTIC BCF_TCooltLoLim_P /end REF_CHARACTERISTIC /end GROUP
/begin GROUP S472_BCF_TMdulHiLim_P "swc_BatCoreFct/BCF_100ms_sys/BatCoreFct/PackObs/PackObsLoop/MdulObs/MdulSocObsr/MdulTObs/Evaluation of Estimation/BCF_TMdulHiLim_P" /begin REF_CHARACTERISTIC BCF_TMdulHiLim_P /end REF_CHARACTERISTIC /end GROUP
/begin GROUP S472_BCF_TMdulLoLim_P "swc_BatCoreFct/BCF_100ms_sys/BatCoreFct/PackObs/PackObsLoop/MdulObs/MdulSocObsr/MdulTObs/Evaluation of Estimation/BCF_TMdulLoLim_P" /begin REF_CHARACTERISTIC BCF_TMdulLoLim_P /end REF_CHARACTERISTIC /end GROUP
/begin GROUP S473_TCoolt_Estimation "swc_BatCoreFct/BCF_100ms_sys/BatCoreFct/PackObs/PackObsLoop/MdulObs/MdulSocObsr/MdulTObs/T Estimation/TCoolt Estimation"
 /begin SUB_GROUP S479_BCF_bAcvHtcCfg_P S479_BCF_CpCoolt_P S479_BCF_Htc_M S479_BCF_MCooltMdul_P S479_BCF_Td_P /end SUB_GROUP
/end GROUP
/begin GROUP S473_TMdul_Estimation "swc_BatCoreFct/BCF_100ms_sys/BatCoreFct/PackObs/PackObsLoop/MdulObs/MdulSocObsr/MdulTObs/T Estimation/TMdul Estimation"
 /begin SUB_GROUP S480_BCF_bAcvHtcCfg_P S480_BCF_ChtMdul_P S480_BCF_CndctvtyTherm_P S480_BCF_Htc_M S480_BCF_Td_P /end SUB_GROUP
/end GROUP
/begin GROUP S479_BCF_bAcvHtcCfg_P "swc_BatCoreFct/BCF_100ms_sys/BatCoreFct/PackObs/PackObsLoop/MdulObs/MdulSocObsr/MdulTObs/T Estimation/TCoolt Estimation/BCF_bAcvHtcCfg_P" /begin REF_CHARACTERISTIC BCF_bAcvHtcCfg_P /end REF_CHARACTERISTIC /end GROUP
/begin GROUP S479_BCF_CpCoolt_P "swc_BatCoreFct/BCF_100ms_sys/BatCoreFct/PackObs/PackObsLoop/MdulObs/MdulSocObsr/MdulTObs/T Estimation/TCoolt Estimation/BCF_CpCoolt_P" /begin REF_CHARACTERISTIC BCF_CpCoolt_P /end REF_CHARACTERISTIC /end GROUP
/begin GROUP S479_BCF_Htc_M "swc_BatCoreFct/BCF_100ms_sys/BatCoreFct/PackObs/PackObsLoop/MdulObs/MdulSocObsr/MdulTObs/T Estimation/TCoolt Estimation/BCF_Htc_M" /begin REF_CHARACTERISTIC BCF_Htc_M /end REF_CHARACTERISTIC /end GROUP
/begin GROUP S479_BCF_MCooltMdul_P "swc_BatCoreFct/BCF_100ms_sys/BatCoreFct/PackObs/PackObsLoop/MdulObs/MdulSocObsr/MdulTObs/T Estimation/TCoolt Estimation/BCF_MCooltMdul_P" /begin REF_CHARACTERISTIC BCF_MCooltMdul_P /end REF_CHARACTERISTIC /end GROUP
/begin GROUP S47_BitSelect1 "swc_CtctrTranCtl/CtcrtTranCtl_sys/CtcrtTranCtl/BitSelect1" /begin REF_CHARACTERISTIC CTC_Csw1_P /end REF_CHARACTERISTIC /end GROUP
/begin GROUP S47_BitSelect22 "swc_CtctrTranCtl/CtcrtTranCtl_sys/CtcrtTranCtl/BitSelect22" /begin REF_CHARACTERISTIC CTC_Csw1_P /end REF_CHARACTERISTIC /end GROUP
/begin GROUP S47_BSOF_DirChAndDcha_P "swc_CIL/CIL_100ms_sys/GB_CAN/BSOF_DirChAndDcha_P" /begin REF_CHARACTERISTIC BSOF_DirChAndDcha_P /end REF_CHARACTERISTIC /end GROUP
/begin GROUP S47_BSOF_EChSng_P "swc_CIL/CIL_100ms_sys/GB_CAN/BSOF_EChSng_P" /begin REF_CHARACTERISTIC BSOF_EChSng_P /end REF_CHARACTERISTIC /end GROUP
/begin GROUP S47_BSOF_ErrMsgTout1_P "swc_CIL/CIL_100ms_sys/GB_CAN/BSOF_ErrMsgTout1_P" /begin REF_CHARACTERISTIC BSOF_ErrMsgTout1_P /end REF_CHARACTERISTIC /end GROUP
/begin GROUP S47_BSOF_ErrMsgTout2_P "swc_CIL/CIL_100ms_sys/GB_CAN/BSOF_ErrMsgTout2_P" /begin REF_CHARACTERISTIC BSOF_ErrMsgTout2_P /end REF_CHARACTERISTIC /end GROUP
/begin GROUP S47_BSOF_ErrMsgTout3_P "swc_CIL/CIL_100ms_sys/GB_CAN/BSOF_ErrMsgTout3_P" /begin REF_CHARACTERISTIC BSOF_ErrMsgTout3_P /end REF_CHARACTERISTIC /end GROUP
/begin GROUP S47_BSOF_ErrMsgTout4_P "swc_CIL/CIL_100ms_sys/GB_CAN/BSOF_ErrMsgTout4_P" /begin REF_CHARACTERISTIC BSOF_ErrMsgTout4_P /end REF_CHARACTERISTIC /end GROUP
/begin GROUP S47_BSOF_ErrMsgTout5_P "swc_CIL/CIL_100ms_sys/GB_CAN/BSOF_ErrMsgTout5_P" /begin REF_CHARACTERISTIC BSOF_ErrMsgTout5_P /end REF_CHARACTERISTIC /end GROUP
/begin GROUP S47_BSOF_ErrMsgTout6_P "swc_CIL/CIL_100ms_sys/GB_CAN/BSOF_ErrMsgTout6_P" /begin REF_CHARACTERISTIC BSOF_ErrMsgTout6_P /end REF_CHARACTERISTIC /end GROUP
/begin GROUP S47_BSOF_ErrMsgTout7_P "swc_CIL/CIL_100ms_sys/GB_CAN/BSOF_ErrMsgTout7_P" /begin REF_CHARACTERISTIC BSOF_ErrMsgTout7_P /end REF_CHARACTERISTIC /end GROUP
/begin GROUP S47_BSOF_IChrgrMax_P "swc_CIL/CIL_100ms_sys/GB_CAN/BSOF_IChrgrMax_P" /begin REF_CHARACTERISTIC BSOF_IChrgrMax_P /end REF_CHARACTERISTIC /end GROUP
/begin GROUP S47_BSOF_IChrgrMin_P "swc_CIL/CIL_100ms_sys/GB_CAN/BSOF_IChrgrMin_P" /begin REF_CHARACTERISTIC BSOF_IChrgrMin_P /end REF_CHARACTERISTIC /end GROUP
/begin GROUP S47_BSOF_IDchaMax_P "swc_CIL/CIL_100ms_sys/GB_CAN/BSOF_IDchaMax_P" /begin REF_CHARACTERISTIC BSOF_IDchaMax_P /end REF_CHARACTERISTIC /end GROUP
/begin GROUP S47_BSOF_IDchaMin_P "swc_CIL/CIL_100ms_sys/GB_CAN/BSOF_IDchaMin_P" /begin REF_CHARACTERISTIC BSOF_IDchaMin_P /end REF_CHARACTERISTIC /end GROUP
/begin GROUP S47_BSOF_MsgChrgrRcgtn_P "swc_CIL/CIL_100ms_sys/GB_CAN/BSOF_MsgChrgrRcgtn_P" /begin REF_CHARACTERISTIC BSOF_MsgChrgrRcgtn_P /end REF_CHARACTERISTIC /end GROUP
/begin GROUP S47_BSOF_MsgChrgrRdy_P "swc_CIL/CIL_100ms_sys/GB_CAN/BSOF_MsgChrgrRdy_P" /begin REF_CHARACTERISTIC BSOF_MsgChrgrRdy_P /end REF_CHARACTERISTIC /end GROUP
/begin GROUP S47_BSOF_NrChrgrComVers_P "swc_CIL/CIL_100ms_sys/GB_CAN/BSOF_NrChrgrComVers_P" /begin REF_CHARACTERISTIC BSOF_NrChrgrComVers_P /end REF_CHARACTERISTIC /end GROUP
/begin GROUP S47_BSOF_SocDchaMax_P "swc_CIL/CIL_100ms_sys/GB_CAN/BSOF_SocDchaMax_P" /begin REF_CHARACTERISTIC BSOF_SocDchaMax_P /end REF_CHARACTERISTIC /end GROUP
/begin GROUP S47_BSOF_SocDchaMin_P "swc_CIL/CIL_100ms_sys/GB_CAN/BSOF_SocDchaMin_P" /begin REF_CHARACTERISTIC BSOF_SocDchaMin_P /end REF_CHARACTERISTIC /end GROUP
/begin GROUP S47_BSOF_UChrgrMax_P "swc_CIL/CIL_100ms_sys/GB_CAN/BSOF_UChrgrMax_P" /begin REF_CHARACTERISTIC BSOF_UChrgrMax_P /end REF_CHARACTERISTIC /end GROUP
/begin GROUP S47_BSOF_UChrgrMin_P "swc_CIL/CIL_100ms_sys/GB_CAN/BSOF_UChrgrMin_P" /begin REF_CHARACTERISTIC BSOF_UChrgrMin_P /end REF_CHARACTERISTIC /end GROUP
/begin GROUP S47_BSOF_UDchaMax_P "swc_CIL/CIL_100ms_sys/GB_CAN/BSOF_UDchaMax_P" /begin REF_CHARACTERISTIC BSOF_UDchaMax_P /end REF_CHARACTERISTIC /end GROUP
/begin GROUP S47_BSOF_UDchaMin_P "swc_CIL/CIL_100ms_sys/GB_CAN/BSOF_UDchaMin_P" /begin REF_CHARACTERISTIC BSOF_UDchaMin_P /end REF_CHARACTERISTIC /end GROUP
/begin GROUP S47_ContactorAgingObserver "swc_CtctrTranCtl/CtcrtTranCtl_sys/CtcrtTranCtl/ContactorAgingObserver"
 /begin SUB_GROUP S62_ConditionCalculation S62_CTC_CtrCtctrAgiCh_M S62_CTC_CtrCtctrAgiNeg_M S62_CTC_CtrCtctrAgiPos_M S62_CTC_CtrCtctrAgiPrech_M S62_TimerCh S62_TimerNeg S62_TimerPos S62_TimerPrec S62_WriteCtctrChDtrt S62_WriteCtctrNegDtrt S62_WriteCtctrPosDtrt S62_WriteCtctrPrecDtrt /end SUB_GROUP
 /begin REF_MEASUREMENT CTC_CtrCtctrAgiCh CTC_CtrCtctrAgiNeg CTC_CtrCtctrAgiPos CTC_CtrCtctrAgiPrech /end REF_MEASUREMENT
/end GROUP
/begin GROUP S47_CTC_bDisaUDecr_P "swc_CtctrTranCtl/CtcrtTranCtl_sys/CtcrtTranCtl/CTC_bDisaUDecr_P" /begin REF_CHARACTERISTIC CTC_bDisaUDecr_P /end REF_CHARACTERISTIC /end GROUP
/begin GROUP S47_CTC_bDisaUDecr_P1 "swc_CtctrTranCtl/CtcrtTranCtl_sys/CtcrtTranCtl/CTC_bDisaUDecr_P1" /begin REF_CHARACTERISTIC CTC_bDisaUDecr_P /end REF_CHARACTERISTIC /end GROUP
/begin GROUP S47_CTC_bDisaUDecr_P2 "swc_CtctrTranCtl/CtcrtTranCtl_sys/CtcrtTranCtl/CTC_bDisaUDecr_P2" /begin REF_CHARACTERISTIC CTC_bDisaUDecr_P /end REF_CHARACTERISTIC /end GROUP
/begin GROUP S47_CTC_StHvbat_P "swc_CtctrTranCtl/CtcrtTranCtl_sys/CtcrtTranCtl/CTC_StHvbat_P" /begin REF_CHARACTERISTIC CTC_StHvbat_P /end REF_CHARACTERISTIC /end GROUP
/begin GROUP S47_CTC_StLoopHv_P "swc_CtctrTranCtl/CtcrtTranCtl_sys/CtcrtTranCtl/CTC_StLoopHv_P" /begin REF_CHARACTERISTIC CTC_StLoopHv_P /end REF_CHARACTERISTIC /end GROUP
/begin GROUP S47_DTRC_Csw_P_1 "swc_CIL/CIL_100ms_sys/GB_CAN/DTRC_Csw_P.1" /begin REF_CHARACTERISTIC CIL_Csw8_P /end REF_CHARACTERISTIC /end GROUP
/begin GROUP S47_DTRC_Csw_P_2 "swc_CIL/CIL_100ms_sys/GB_CAN/DTRC_Csw_P.2" /begin REF_CHARACTERISTIC CIL_Csw8_P /end REF_CHARACTERISTIC /end GROUP
/begin GROUP S47_DTRC_Csw_P_3 "swc_CIL/CIL_100ms_sys/GB_CAN/DTRC_Csw_P.3" /begin REF_CHARACTERISTIC CIL_Csw8_P /end REF_CHARACTERISTIC /end GROUP
/begin GROUP S47_DTRC_Csw_P_32 "swc_CIL/CIL_100ms_sys/GB_CAN/DTRC_Csw_P.32" /begin REF_CHARACTERISTIC CIL_Csw8_P /end REF_CHARACTERISTIC /end GROUP
/begin GROUP S47_DTRC_Csw_P_33 "swc_CIL/CIL_100ms_sys/GB_CAN/DTRC_Csw_P.33" /begin REF_CHARACTERISTIC CIL_Csw8_P /end REF_CHARACTERISTIC /end GROUP
/begin GROUP S47_DTRC_Csw_P_34 "swc_CIL/CIL_100ms_sys/GB_CAN/DTRC_Csw_P.34" /begin REF_CHARACTERISTIC CIL_Csw8_P /end REF_CHARACTERISTIC /end GROUP
/begin GROUP S47_DTRC_Csw_P_35 "swc_CIL/CIL_100ms_sys/GB_CAN/DTRC_Csw_P.35" /begin REF_CHARACTERISTIC CIL_Csw8_P /end REF_CHARACTERISTIC /end GROUP
/begin GROUP S47_DTRC_Csw_P_38 "swc_CIL/CIL_100ms_sys/GB_CAN/DTRC_Csw_P.38" /begin REF_CHARACTERISTIC CIL_Csw8_P /end REF_CHARACTERISTIC /end GROUP
/begin GROUP S47_DTRC_Csw_P_39 "swc_CIL/CIL_100ms_sys/GB_CAN/DTRC_Csw_P.39" /begin REF_CHARACTERISTIC CIL_Csw8_P /end REF_CHARACTERISTIC /end GROUP
/begin GROUP S47_DTRC_Csw_P_4 "swc_CIL/CIL_100ms_sys/GB_CAN/DTRC_Csw_P.4" /begin REF_CHARACTERISTIC CIL_Csw8_P /end REF_CHARACTERISTIC /end GROUP
/begin GROUP S47_DTRC_Csw_P_5 "swc_CIL/CIL_100ms_sys/GB_CAN/DTRC_Csw_P.5" /begin REF_CHARACTERISTIC CIL_Csw8_P /end REF_CHARACTERISTIC /end GROUP
/begin GROUP S47_DTRC_Csw_P_57 "swc_CIL/CIL_100ms_sys/GB_CAN/DTRC_Csw_P.57" /begin REF_CHARACTERISTIC CIL_Csw8_P /end REF_CHARACTERISTIC /end GROUP
/begin GROUP S47_DTRC_Csw_P_58 "swc_CIL/CIL_100ms_sys/GB_CAN/DTRC_Csw_P.58" /begin REF_CHARACTERISTIC CIL_Csw8_P /end REF_CHARACTERISTIC /end GROUP
/begin GROUP S47_DTRC_Csw_P_59 "swc_CIL/CIL_100ms_sys/GB_CAN/DTRC_Csw_P.59" /begin REF_CHARACTERISTIC CIL_Csw8_P /end REF_CHARACTERISTIC /end GROUP
/begin GROUP S47_DTRC_Csw_P_6 "swc_CIL/CIL_100ms_sys/GB_CAN/DTRC_Csw_P.6" /begin REF_CHARACTERISTIC CIL_Csw8_P /end REF_CHARACTERISTIC /end GROUP
/begin GROUP S47_DTRC_Csw_P_60 "swc_CIL/CIL_100ms_sys/GB_CAN/DTRC_Csw_P.60" /begin REF_CHARACTERISTIC CIL_Csw8_P /end REF_CHARACTERISTIC /end GROUP
/begin GROUP S47_DTRC_Csw_P_61 "swc_CIL/CIL_100ms_sys/GB_CAN/DTRC_Csw_P.61" /begin REF_CHARACTERISTIC CIL_Csw8_P /end REF_CHARACTERISTIC /end GROUP
/begin GROUP S47_DTRC_Csw_P_62 "swc_CIL/CIL_100ms_sys/GB_CAN/DTRC_Csw_P.62" /begin REF_CHARACTERISTIC CIL_Csw8_P /end REF_CHARACTERISTIC /end GROUP
/begin GROUP S47_DTRC_Csw_P_63 "swc_CIL/CIL_100ms_sys/GB_CAN/DTRC_Csw_P.63" /begin REF_CHARACTERISTIC CIL_Csw8_P /end REF_CHARACTERISTIC /end GROUP
/begin GROUP S47_DTRC_Csw_P_64 "swc_CIL/CIL_100ms_sys/GB_CAN/DTRC_Csw_P.64" /begin REF_CHARACTERISTIC CIL_Csw8_P /end REF_CHARACTERISTIC /end GROUP
/begin GROUP S47_DTRC_Csw_P_7 "swc_CIL/CIL_100ms_sys/GB_CAN/DTRC_Csw_P.7" /begin REF_CHARACTERISTIC CIL_Csw8_P /end REF_CHARACTERISTIC /end GROUP
/begin GROUP S47_DTRC_Csw_P_70 "swc_CIL/CIL_100ms_sys/GB_CAN/DTRC_Csw_P.70" /begin REF_CHARACTERISTIC CIL_Csw8_P /end REF_CHARACTERISTIC /end GROUP
/begin GROUP S47_Enabled_Subsystem1 "swc_CtctrTranCtl/CtcrtTranCtl_sys/CtcrtTranCtl/Enabled Subsystem1" /begin SUB_GROUP S74_CTC_IdRlyNeg_P /end SUB_GROUP /end GROUP
/begin GROUP S47_Enabled_Subsystem2 "swc_CtctrTranCtl/CtcrtTranCtl_sys/CtcrtTranCtl/Enabled Subsystem2" /begin SUB_GROUP S75_CTC_IdRlyPos_P /end SUB_GROUP /end GROUP
/begin GROUP S47_Enabled_Subsystem3 "swc_CtctrTranCtl/CtcrtTranCtl_sys/CtcrtTranCtl/Enabled Subsystem3" /begin SUB_GROUP S76_CTC_IdRlyPrech_P /end SUB_GROUP /end GROUP
/begin GROUP S47_Enabled_Subsystem4 "swc_CtctrTranCtl/CtcrtTranCtl_sys/CtcrtTranCtl/Enabled Subsystem4" /begin SUB_GROUP S77_CTC_IdRlyCh_P /end SUB_GROUP /end GROUP
/begin GROUP S47_Enabled_Subsystem5 "swc_CtctrTranCtl/CtcrtTranCtl_sys/CtcrtTranCtl/Enabled Subsystem5" /begin SUB_GROUP S78_CTC_IdRlyHeat_P /end SUB_GROUP /end GROUP
/begin GROUP S47_Error "swc_CtctrTranCtl/CtcrtTranCtl_sys/CtcrtTranCtl/Error"
 /begin SUB_GROUP S79_ChargeSignalLost S79_CurrentZeroDriftError S79_FastChargeRelayError S79_HeatRelayError S79_MotorDischargeError S79_NegativeRelayError S79_PostiveRelayError S79_PrechargeError S79_PrechargeRelayError S79_ResistorTemperatureProtect /end SUB_GROUP
/end GROUP
/begin GROUP S47_Subsystem "swc_CtctrTranCtl/CtcrtTranCtl_sys/CtcrtTranCtl/Subsystem"
 /begin SUB_GROUP S82_BitSelect1 S82_BitSelect11 S82_BitSelect12 S82_BitSelect13 S82_BitSelect14 S82_BitSelect15 S82_BitSelect16 S82_BitSelect17 S82_BitSelect2 S82_BitSelect21 S82_BitSelect3 S82_BitSelect4 S82_BitSelect5 S82_BitSelect6 S82_BitSelect7 S82_BitSelect8 S82_BitSelect9 S82_CTC_bAcvCh_P S82_CTC_bAcvTrml15Chk_P S82_CTC_bErrToutForMotDcha_P S82_CTC_ErrLoopHv_P S82_CTC_ReqRlyCh_P S82_CTC_ReqRlyHeat_P S82_CTC_ReqRlyNeg_P S82_CTC_ReqRlyPos_P S82_CTC_ReqRlyPrech_P S82_CTC_StRlyCh_P S82_CTC_StRlyChkCh_P S82_CTC_StRlyChkHeat_P S82_CTC_StRlyChkPos_P S82_CTC_StRlyHeat_P S82_CTC_StRlyNeg_P S82_CTC_StRlyPos_P S82_CTC_StRlyPrech_P /end SUB_GROUP
/end GROUP
/begin GROUP S47_TiLoop "swc_CtctrTranCtl/CtcrtTranCtl_sys/CtcrtTranCtl/TiLoop" /begin SUB_GROUP S83_CTC_TiMaxMainPosAftRlyUDecr_P S83_CTC_TiProc_P /end SUB_GROUP /end GROUP
/begin GROUP S47_Time "swc_CtctrTranCtl/CtcrtTranCtl_sys/CtcrtTranCtl/Time"
 /begin SUB_GROUP S84_CTC_TiChkIni_P S84_CTC_TiCutoffLvReqFromVcu_P1 S84_CTC_TiEmcyHvOffReqFromVcu_P1 S84_CTC_TiLoopDchaEmcy_P1 S84_CTC_TiLoopDchaNorm_P1 S84_CTC_TiLoopNorm_P S84_CTC_TiLoopStTranToNorm_P S84_CTC_TiMaxMainPosAftRlyUDecr_P S84_CTC_TiMotDcha_P1 S84_CTC_TiPrechLim_P S84_CTC_TiProc_P S84_CTC_TiRlyChChkIni_P S84_CTC_TiRlyChkPosIni_P S84_CTC_TiRlyHeatChkIni_P S84_CTC_TiRlyNegOpen_P S84_CTC_TiRlyNegOpenEmcy_P1 S84_CTC_TiRlyNegOpenNorm_P1 S84_CTC_TiRlyPrechOpen_P S84_CTC_TiUDecr_P S84_CTC_TiValmaxIDecr_P1 S84_CTC_TiWaitMaxForRlyChCls_P S84_CTC_TiWaitMaxForRlyChOpen_P S84_CTC_TiWaitMaxForRlyHeatCls_P S84_CTC_TiWaitMaxForRlyHeatOpen_P S84_CTC_TiWaitPrech_P /end SUB_GROUP
/end GROUP
/begin GROUP S47_TransitionCondition "swc_CtctrTranCtl/CtcrtTranCtl_sys/CtcrtTranCtl/TransitionCondition"
 /begin SUB_GROUP S85_CTC_FacUMainPosPoleBefRly_P S85_CTC_IBatHvLimHvOff_P S85_CTC_ModeMotDchaFnshd_P S85_CTC_ReqHvOnFromVcu_P S85_CTC_StBcuStb_P S85_CTC_TiProc_P S85_CTC_UChPoleHiSideDrv_P S85_CTC_UClsLim_P S85_CTC_UDecrChkLim_P S85_CTC_UEqu_P S85_CTC_UEquForCh_P S85_CTC_UEquForHeat_P S85_CTC_UHeatPoleHiSideDrv_P S85_CTC_UIncChkLim_P S85_CTC_UMainNegPoleHiSideDrv_P S85_CTC_UMainPosPoleHiSideDrv_P S85_CTC_UMotDchaLim_P S85_CTC_URlyPrechHiSideDrv_P /end SUB_GROUP
/end GROUP
/begin GROUP S480_BCF_bAcvHtcCfg_P "swc_BatCoreFct/BCF_100ms_sys/BatCoreFct/PackObs/PackObsLoop/MdulObs/MdulSocObsr/MdulTObs/T Estimation/TMdul Estimation/BCF_bAcvHtcCfg_P" /begin REF_CHARACTERISTIC BCF_bAcvHtcCfg_P /end REF_CHARACTERISTIC /end GROUP
/begin GROUP S480_BCF_ChtMdul_P "swc_BatCoreFct/BCF_100ms_sys/BatCoreFct/PackObs/PackObsLoop/MdulObs/MdulSocObsr/MdulTObs/T Estimation/TMdul Estimation/BCF_ChtMdul_P" /begin REF_CHARACTERISTIC BCF_ChtMdul_P /end REF_CHARACTERISTIC /end GROUP
/begin GROUP S480_BCF_CndctvtyTherm_P "swc_BatCoreFct/BCF_100ms_sys/BatCoreFct/PackObs/PackObsLoop/MdulObs/MdulSocObsr/MdulTObs/T Estimation/TMdul Estimation/BCF_CndctvtyTherm_P" /begin REF_CHARACTERISTIC BCF_CndctvtyTherm_P /end REF_CHARACTERISTIC /end GROUP
/begin GROUP S480_BCF_Htc_M "swc_BatCoreFct/BCF_100ms_sys/BatCoreFct/PackObs/PackObsLoop/MdulObs/MdulSocObsr/MdulTObs/T Estimation/TMdul Estimation/BCF_Htc_M" /begin REF_CHARACTERISTIC BCF_Htc_M /end REF_CHARACTERISTIC /end GROUP
/begin GROUP S4_AC_Condition "swc_BatChCtl/AC_10ms_sys/AC_10ms_sys/AC_Condition"
 /begin SUB_GROUP S10_CompareToCalibrationPara1 S10_CompareToCalibrationPara23 /end SUB_GROUP
/end GROUP
/begin GROUP S4_Current_and_Voltage_Calculated "swc_BatChCtl/AC_10ms_sys/AC_10ms_sys/Current and Voltage Calculated"
 /begin SUB_GROUP S11_BCC_EffDcdc_P S11_BCC_EffObc_P S11_BCC_ILimByRAcChCnctn_M S11_BCC_IThermReq_P S11_BCC_PwrPtcTherm_P S11_BCC_UOfsThermReq_P /end SUB_GROUP
/end GROUP
/begin GROUP S4_DEH_bAcvSwt_P "swc_DiagcEveHndlg/NVM_Read_10ms_sys/DEH_bAcvSwt_P" /begin REF_CHARACTERISTIC DEH_bAcvSwt_P /end REF_CHARACTERISTIC /end GROUP
/begin GROUP S4_Diagnosis "swc_BatChCtl/AC_10ms_sys/AC_10ms_sys/Diagnosis"
 /begin SUB_GROUP S12_BCC_GainIDig101_P S12_BCC_GainIDig102_P S12_BCC_TiChAllwdOffDig_P S12_BCC_TiChAllwdOnDig_P S12_BCC_TiChCnctOffDig_P S12_BCC_TiChCnctOnDig_P S12_BCC_TiOffDig10_P S12_BCC_TiOffDig53_P S12_BCC_TiOffDig71_P S12_BCC_TiOffDig73_P S12_BCC_TiOnDig10_P S12_BCC_TiOnDig53_P S12_BCC_TiOnDig71_P S12_BCC_TiOnDig73_P S12_BCC_TiPwrUpOffDig_P S12_BCC_TiPwrUpOnDig_P S12_BCC_ValOfsDig101_P S12_BCC_ValOfsDig102_P S12_BitSelect S12_BitSelect1 S12_BitSelect10 S12_BitSelect11 S12_BitSelect12 S12_BitSelect13 S12_BitSelect14 S12_BitSelect15 S12_BitSelect16 S12_BitSelect17 S12_BitSelect18 S12_BitSelect2 S12_BitSelect22 S12_BitSelect23 S12_BitSelect3 S12_BitSelect4 S12_BitSelect5 S12_BitSelect6 S12_BitSelect7 S12_BitSelect8 S12_BitSelect9 S12_CompareToCalibrationPara S12_CompareToCalibrationPara1 S12_CompareToCalibrationPara10 S12_CompareToCalibrationPara11 S12_CompareToCalibrationPara12 S12_CompareToCalibrationPara13 S12_CompareToCalibrationPara2 S12_CompareToCalibrationPara3 S12_CompareToCalibrationPara4 S12_CompareToCalibrationPara5 S12_CompareToCalibrationPara6 S12_CompareToCalibrationPara7 S12_CompareToCalibrationPara8 S12_CompareToCalibrationPara9 S12_SMObc_TiProc_P S12_SMObc_TiProc_P1 S12_SMObc_TiProc_P2 S12_SMObc_TiProc_P3 S12_SMObc_TiProc_P4 S12_SMObc_TiProc_P5 S12_SMObc_TiProc_P6 /end SUB_GROUP
/end GROUP
/begin GROUP S4_SMObc_TiWaitForTout1_P "swc_BatChCtl/AC_10ms_sys/AC_10ms_sys/SMObc_TiWaitForTout1_P" /begin REF_CHARACTERISTIC SMObc_TiWaitForTout1_P /end REF_CHARACTERISTIC /end GROUP
/begin GROUP S4_SMObc_TiWaitForTout2_P "swc_BatChCtl/AC_10ms_sys/AC_10ms_sys/SMObc_TiWaitForTout2_P" /begin REF_CHARACTERISTIC SMObc_TiWaitForTout2_P /end REF_CHARACTERISTIC /end GROUP
/begin GROUP S4_SMObc_TiWaitForTout_P "swc_BatChCtl/AC_10ms_sys/AC_10ms_sys/SMObc_TiWaitForTout_P" /begin REF_CHARACTERISTIC SMObc_TiWaitForTout_P /end REF_CHARACTERISTIC /end GROUP
/begin GROUP S508_EVCSH_TranMsgChrgrChDetd_P "swc_BatChCtl/DC_10ms_sys/ElecVehChegnStHdlr_Sys/ElecVehChegnStHdlr/Main/TransitionManager/CCD/EVCSH_TranMsgChrgrChDetd_P" /begin REF_CHARACTERISTIC EVCSH_TranMsgChrgrChDetd_P /end REF_CHARACTERISTIC /end GROUP
/begin GROUP S509_EVCSH_TranChrgrChStMan_P "swc_BatChCtl/DC_10ms_sys/ElecVehChegnStHdlr_Sys/ElecVehChegnStHdlr/Main/TransitionManager/CCS/EVCSH_TranChrgrChStMan_P" /begin REF_CHARACTERISTIC EVCSH_TranChrgrChStMan_P /end REF_CHARACTERISTIC /end GROUP
/begin GROUP S510_EVCSH_TranChrgrDetnCnct_P "swc_BatChCtl/DC_10ms_sys/ElecVehChegnStHdlr_Sys/ElecVehChegnStHdlr/Main/TransitionManager/CDC/EVCSH_TranChrgrDetnCnct_P" /begin REF_CHARACTERISTIC EVCSH_TranChrgrDetnCnct_P /end REF_CHARACTERISTIC /end GROUP
/begin GROUP S511_EVCSH_TranChrgrErrMan_P "swc_BatChCtl/DC_10ms_sys/ElecVehChegnStHdlr_Sys/ElecVehChegnStHdlr/Main/TransitionManager/CEM/EVCSH_TranChrgrErrMan_P" /begin REF_CHARACTERISTIC EVCSH_TranChrgrErrMan_P /end REF_CHARACTERISTIC /end GROUP
/begin GROUP S512_EVCSH_TranChrgrHdshkMan_P "swc_BatChCtl/DC_10ms_sys/ElecVehChegnStHdlr_Sys/ElecVehChegnStHdlr/Main/TransitionManager/CHM/EVCSH_TranChrgrHdshkMan_P" /begin REF_CHARACTERISTIC EVCSH_TranChrgrHdshkMan_P /end REF_CHARACTERISTIC /end GROUP
/begin GROUP S513_EVCSH_TranChrgrMaxOutMan_P "swc_BatChCtl/DC_10ms_sys/ElecVehChegnStHdlr_Sys/ElecVehChegnStHdlr/Main/TransitionManager/CML/EVCSH_TranChrgrMaxOutMan_P" /begin REF_CHARACTERISTIC EVCSH_TranChrgrMaxOutMan_P /end REF_CHARACTERISTIC /end GROUP
/begin GROUP S514_EVCSH_TranMsgChrgrMaxOutPgtn_P "swc_BatChCtl/DC_10ms_sys/ElecVehChegnStHdlr_Sys/ElecVehChegnStHdlr/Main/TransitionManager/CMLP/EVCSH_TranMsgChrgrMaxOutPgtn_P" /begin REF_CHARACTERISTIC EVCSH_TranMsgChrgrMaxOutPgtn_P /end REF_CHARACTERISTIC /end GROUP
/begin GROUP S515_EVCSH_TranChrgrRcgtn00Man_P "swc_BatChCtl/DC_10ms_sys/ElecVehChegnStHdlr_Sys/ElecVehChegnStHdlr/Main/TransitionManager/CRM/EVCSH_TranChrgrRcgtn00Man_P" /begin REF_CHARACTERISTIC EVCSH_TranChrgrRcgtn00Man_P /end REF_CHARACTERISTIC /end GROUP
/begin GROUP S515_EVCSH_TranChrgrRcgtnAAMan_P "swc_BatChCtl/DC_10ms_sys/ElecVehChegnStHdlr_Sys/ElecVehChegnStHdlr/Main/TransitionManager/CRM/EVCSH_TranChrgrRcgtnAAMan_P" /begin REF_CHARACTERISTIC EVCSH_TranChrgrRcgtnAAMan_P /end REF_CHARACTERISTIC /end GROUP
/begin GROUP S516_EVCSH_TranChrgrNotRdyMan_P "swc_BatChCtl/DC_10ms_sys/ElecVehChegnStHdlr_Sys/ElecVehChegnStHdlr/Main/TransitionManager/CRO/EVCSH_TranChrgrNotRdyMan_P" /begin REF_CHARACTERISTIC EVCSH_TranChrgrNotRdyMan_P /end REF_CHARACTERISTIC /end GROUP
/begin GROUP S516_EVCSH_TranChrgrRdyMan_P "swc_BatChCtl/DC_10ms_sys/ElecVehChegnStHdlr_Sys/ElecVehChegnStHdlr/Main/TransitionManager/CRO/EVCSH_TranChrgrRdyMan_P" /begin REF_CHARACTERISTIC EVCSH_TranChrgrRdyMan_P /end REF_CHARACTERISTIC /end GROUP
/begin GROUP S517_EVCSH_TranChrgrStstcMan_P "swc_BatChCtl/DC_10ms_sys/ElecVehChegnStHdlr_Sys/ElecVehChegnStHdlr/Main/TransitionManager/CSD/EVCSH_TranChrgrStstcMan_P" /begin REF_CHARACTERISTIC EVCSH_TranChrgrStstcMan_P /end REF_CHARACTERISTIC /end GROUP
/begin GROUP S518_EVCSH_TranChrgrChSuspdMan_P "swc_BatChCtl/DC_10ms_sys/ElecVehChegnStHdlr_Sys/ElecVehChegnStHdlr/Main/TransitionManager/CST/EVCSH_TranChrgrChSuspdMan_P" /begin REF_CHARACTERISTIC EVCSH_TranChrgrChSuspdMan_P /end REF_CHARACTERISTIC /end GROUP
/begin GROUP S51_BatCoreInit "swc_BatCoreFct/BCF_100ms_sys/BatCoreFct/BatCoreInit"
 /begin SUB_GROUP S60_InitializationDecision S60_ManualSOCInitializationServiceMode S60_MemoryAndSignalInitializationInServiceMode S60_OCVInitializationServiceMode S60_StateInitialization /end SUB_GROUP
/end GROUP
/begin GROUP S51_BCF_NrCellPack_P "swc_BatCoreFct/BCF_100ms_sys/BatCoreFct/BCF_NrCellPack_P" /begin REF_CHARACTERISTIC BCF_NrCellPack_P /end REF_CHARACTERISTIC /end GROUP
/begin GROUP S51_NrMdulMax "swc_BatCoreFct/BCF_100ms_sys/BatCoreFct/NrMdulMax" /begin SUB_GROUP S62_BCF_NrMdulMax_P /end SUB_GROUP /end GROUP
/begin GROUP S51_PackObs "swc_BatCoreFct/BCF_100ms_sys/BatCoreFct/PackObs" /begin SUB_GROUP S64_PackObsLoop S64_TriggerMdulCObsr /end SUB_GROUP /end GROUP
/begin GROUP S51_PackStateClcn "swc_BatCoreFct/BCF_100ms_sys/BatCoreFct/PackStateClcn" /begin SUB_GROUP S65_PackSocClcn S65_PackSofClcn S65_PackSohClcn /end SUB_GROUP /end GROUP
/begin GROUP S51_SensorDelayForISD "swc_BatCoreFct/BCF_100ms_sys/BatCoreFct/SensorDelayForISD" /begin SUB_GROUP S67_BCF_Td_P S67_BCF_TiDlyForThrwyT_P /end SUB_GROUP /end GROUP
/begin GROUP S51_Signal_Mapping "swc_BatCoreFct/BCF_100ms_sys/BatCoreFct/Signal Mapping" /begin SUB_GROUP S68_BCF_UCellChnCfg_P /end SUB_GROUP /end GROUP
/begin GROUP S521_EVCSH_IChDecrThd_P "swc_BatChCtl/DC_10ms_sys/ElecVehChegnStHdlr_Sys/ElecVehChegnStHdlr/Main/TransitionManager/TranIChDecr/EVCSH_IChDecrThd_P" /begin REF_CHARACTERISTIC EVCSH_IChDecrThd_P /end REF_CHARACTERISTIC /end GROUP
/begin GROUP S525_BCF_bAcvSocMin_P "swc_BatCoreFct/BCF_100ms_sys/BatCoreFct/PackStateClcn/PackSocClcn/BCF_bAcvSocMin_P" /begin REF_CHARACTERISTIC BCF_bAcvSocMin_P /end REF_CHARACTERISTIC /end GROUP
/begin GROUP S525_BCF_CswPackSoc_P "swc_BatCoreFct/BCF_100ms_sys/BatCoreFct/PackStateClcn/PackSocClcn/BCF_CswPackSoc_P" /begin REF_CHARACTERISTIC BCF_CswPackSoc_P /end REF_CHARACTERISTIC /end GROUP
/begin GROUP S525_BCF_SocPackLimnMax_P "swc_BatCoreFct/BCF_100ms_sys/BatCoreFct/PackStateClcn/PackSocClcn/BCF_SocPackLimnMax_P" /begin REF_CHARACTERISTIC BCF_SocPackLimnMax_P /end REF_CHARACTERISTIC /end GROUP
/begin GROUP S525_BCF_SocPackLimnMin_P "swc_BatCoreFct/BCF_100ms_sys/BatCoreFct/PackStateClcn/PackSocClcn/BCF_SocPackLimnMin_P" /begin REF_CHARACTERISTIC BCF_SocPackLimnMin_P /end REF_CHARACTERISTIC /end GROUP
/begin GROUP S525_BCF_SocPackMan_P "swc_BatCoreFct/BCF_100ms_sys/BatCoreFct/PackStateClcn/PackSocClcn/BCF_SocPackMan_P" /begin REF_CHARACTERISTIC BCF_SocPackMan_P /end REF_CHARACTERISTIC /end GROUP
/begin GROUP S525_BCF_SocPackMpg_M "swc_BatCoreFct/BCF_100ms_sys/BatCoreFct/PackStateClcn/PackSocClcn/BCF_SocPackMpg_M" /begin REF_CHARACTERISTIC BCF_SocPackMpg_M /end REF_CHARACTERISTIC /end GROUP
/begin GROUP S526_Pack_Current_Limits_Calculation_and_Indication "swc_BatCoreFct/BCF_100ms_sys/BatCoreFct/PackStateClcn/PackSofClcn/Pack Current Limits Calculation and Indication"
 /begin SUB_GROUP S538_BCF_bAcvDynLim_P S538_BCF_CPackNom_P S538_BCF_CRateCTest_P S538_BCF_IChMax_P S538_BCF_IChMax_P1 S538_BCF_IDchaMax_P S538_BCF_IDchaMax_P1 /end SUB_GROUP
/end GROUP
/begin GROUP S526_Pack_Min_Max_Current_Calculation__PwrLoss___U_ "swc_BatCoreFct/BCF_100ms_sys/BatCoreFct/PackStateClcn/PackSofClcn/Pack Min Max Current Calculation (PwrLoss & U)"
 /begin SUB_GROUP S539_Find_Max_Current_within_the_Temperature_Limitations S539_Pred_Worst_Cell_Voltages_and_Power_Losses S539_T_Selection /end SUB_GROUP
/end GROUP
/begin GROUP S526_Pack_Min_Max_Current_Calculation__SOC_T___SOH_ "swc_BatCoreFct/BCF_100ms_sys/BatCoreFct/PackStateClcn/PackSofClcn/Pack Min Max Current Calculation (SOC,T & SOH)" /begin SUB_GROUP S540_SocTCellLim S540_SohLim /end SUB_GROUP /end GROUP
/begin GROUP S526_Pack_Min_Max_Voltage_Prediction "swc_BatCoreFct/BCF_100ms_sys/BatCoreFct/PackStateClcn/PackSofClcn/Pack Min Max Voltage Prediction"
 /begin SUB_GROUP S541_Add_Wiring_Resistance S541_Module_Min_Max_Voltage_Prediction /end SUB_GROUP
/end GROUP
/begin GROUP S526_RPack_Calculation "swc_BatCoreFct/BCF_100ms_sys/BatCoreFct/PackStateClcn/PackSofClcn/RPack Calculation"
 /begin SUB_GROUP S542_BCF_RBv_M S542_BCF_RCellCnct_P S542_BCF_RMdulCnct_P S542_BCF_RPack_P S542_BCF_Wbz_M S542_BCF_WbzFac_P /end SUB_GROUP
/end GROUP
/begin GROUP S526_Static_Limits_for_Soc_and_Current "swc_BatCoreFct/BCF_100ms_sys/BatCoreFct/PackStateClcn/PackSofClcn/Static Limits for Soc and Current"
 /begin SUB_GROUP S543_BCF_IChMax_P S543_BCF_IDchaMax_P S543_BCF_SocLimMax_P S543_BCF_SocLimMin_P /end SUB_GROUP
/end GROUP
/begin GROUP S527_SohPack_Evaluation "swc_BatCoreFct/BCF_100ms_sys/BatCoreFct/PackStateClcn/PackSohClcn/SohPack Evaluation"
 /begin SUB_GROUP S748_BCF_bAcvSohUpd_P S748_BCF_SohC_M S748_BCF_SohPackValmin_P S748_BCF_SohR_M /end SUB_GROUP
/end GROUP
/begin GROUP S527_SohRDelta_Calculation "swc_BatCoreFct/BCF_100ms_sys/BatCoreFct/PackStateClcn/PackSohClcn/SohRDelta Calculation" /begin SUB_GROUP S749_Error__Heal_Detection S749_Update_of_SohRDelta /end SUB_GROUP /end GROUP
/begin GROUP S527_SohSocDelta_Calculation "swc_BatCoreFct/BCF_100ms_sys/BatCoreFct/PackStateClcn/PackSohClcn/SohSocDelta Calculation" /begin SUB_GROUP S750_Error__Heal_Detection S750_SohSocDeltaEvaluation /end SUB_GROUP /end GROUP
/begin GROUP S538_BCF_bAcvDynLim_P "swc_BatCoreFct/BCF_100ms_sys/BatCoreFct/PackStateClcn/PackSofClcn/Pack Current Limits Calculation and Indication/BCF_bAcvDynLim_P" /begin REF_CHARACTERISTIC BCF_bAcvDynLim_P /end REF_CHARACTERISTIC /end GROUP
/begin GROUP S538_BCF_CPackNom_P "swc_BatCoreFct/BCF_100ms_sys/BatCoreFct/PackStateClcn/PackSofClcn/Pack Current Limits Calculation and Indication/BCF_CPackNom_P" /begin REF_CHARACTERISTIC BCF_CPackNom_P /end REF_CHARACTERISTIC /end GROUP
/begin GROUP S538_BCF_CRateCTest_P "swc_BatCoreFct/BCF_100ms_sys/BatCoreFct/PackStateClcn/PackSofClcn/Pack Current Limits Calculation and Indication/BCF_CRateCTest_P" /begin REF_CHARACTERISTIC BCF_CRateCTest_P /end REF_CHARACTERISTIC /end GROUP
/begin GROUP S538_BCF_IChMax_P "swc_BatCoreFct/BCF_100ms_sys/BatCoreFct/PackStateClcn/PackSofClcn/Pack Current Limits Calculation and Indication/BCF_IChMax_P" /begin REF_CHARACTERISTIC BCF_IChMax_P /end REF_CHARACTERISTIC /end GROUP
/begin GROUP S538_BCF_IChMax_P1 "swc_BatCoreFct/BCF_100ms_sys/BatCoreFct/PackStateClcn/PackSofClcn/Pack Current Limits Calculation and Indication/BCF_IChMax_P1" /begin REF_CHARACTERISTIC BCF_IChMax_P /end REF_CHARACTERISTIC /end GROUP
/begin GROUP S538_BCF_IDchaMax_P "swc_BatCoreFct/BCF_100ms_sys/BatCoreFct/PackStateClcn/PackSofClcn/Pack Current Limits Calculation and Indication/BCF_IDchaMax_P" /begin REF_CHARACTERISTIC BCF_IDchaMax_P /end REF_CHARACTERISTIC /end GROUP
/begin GROUP S538_BCF_IDchaMax_P1 "swc_BatCoreFct/BCF_100ms_sys/BatCoreFct/PackStateClcn/PackSofClcn/Pack Current Limits Calculation and Indication/BCF_IDchaMax_P1" /begin REF_CHARACTERISTIC BCF_IDchaMax_P /end REF_CHARACTERISTIC /end GROUP
/begin GROUP S539_Find_Max_Current_within_the_Temperature_Limitations "swc_BatCoreFct/BCF_100ms_sys/BatCoreFct/PackStateClcn/PackSofClcn/Pack Min Max Current Calculation (PwrLoss & U)/Find Max Current within the Temperature Limitations"
 /begin SUB_GROUP S556_Calc_Power_Loss_Buffer S556_Current_Limit_Calculation S556_Dimensions_of_UPredAry /end SUB_GROUP
/end GROUP
/begin GROUP S539_Pred_Worst_Cell_Voltages_and_Power_Losses "swc_BatCoreFct/BCF_100ms_sys/BatCoreFct/PackStateClcn/PackSofClcn/Pack Min Max Current Calculation (PwrLoss & U)/Pred Worst Cell Voltages and Power Losses"
 /begin SUB_GROUP S557_Dimensions_of_UPredAry S557_FindWorstCellForVoltageLimitation_AdjustOvervoltages S557_Pred_Losses S557_Predict_average_cell_voltages S557_Safety_Margins /end SUB_GROUP
/end GROUP
/begin GROUP S539_T_Selection "swc_BatCoreFct/BCF_100ms_sys/BatCoreFct/PackStateClcn/PackSofClcn/Pack Min Max Current Calculation (PwrLoss & U)/T Selection" /begin SUB_GROUP S558_BCF_bAcvTEstimnForSof_P /end SUB_GROUP /end GROUP
/begin GROUP S540_SocTCellLim "swc_BatCoreFct/BCF_100ms_sys/BatCoreFct/PackStateClcn/PackSofClcn/Pack Min Max Current Calculation (SOC,T & SOH)/SocTCellLim"
 /begin SUB_GROUP S667_BCF_bAcvTEstimnForSof_P S667_BCF_IChActLimBySocT_M S667_BCF_IChPredLimBySocT_M S667_BCF_IDchaActLimBySocT_M S667_BCF_IDchaPredLimBySocT_M /end SUB_GROUP
/end GROUP
/begin GROUP S540_SohLim "swc_BatCoreFct/BCF_100ms_sys/BatCoreFct/PackStateClcn/PackSofClcn/Pack Min Max Current Calculation (SOC,T & SOH)/SohLim" /begin SUB_GROUP S669_BCF_CoeffSohChLim_M S669_BCF_CoeffSohDchaLim_M /end SUB_GROUP /end GROUP
/begin GROUP S541_Add_Wiring_Resistance "swc_BatCoreFct/BCF_100ms_sys/BatCoreFct/PackStateClcn/PackSofClcn/Pack Min Max Voltage Prediction/Add Wiring Resistance" /begin SUB_GROUP S681_BCF_RPack_P S681_BCF_RPack_P1 /end SUB_GROUP /end GROUP
/begin GROUP S541_Module_Min_Max_Voltage_Prediction "swc_BatCoreFct/BCF_100ms_sys/BatCoreFct/PackStateClcn/PackSofClcn/Pack Min Max Voltage Prediction/Module Min Max Voltage Prediction"
 /begin SUB_GROUP S683_Calculate_forecast_filter_coefficients_actual S683_Calculate_forecast_filter_coefficients_predicted S683_SOF_Actual S683_SOF_Pred S683_Voltage_Limit_Actual_Assignment S683_Voltage_Limit_Predicted_Assignment /end SUB_GROUP
/end GROUP
/begin GROUP S542_BCF_RPack_P "swc_BatCoreFct/BCF_100ms_sys/BatCoreFct/PackStateClcn/PackSofClcn/RPack Calculation/BCF_RPack_P" /begin REF_CHARACTERISTIC BCF_RPack_P /end REF_CHARACTERISTIC /end GROUP
/begin GROUP S542_BCF_Wbz_M "swc_BatCoreFct/BCF_100ms_sys/BatCoreFct/PackStateClcn/PackSofClcn/RPack Calculation/BCF_Wbz_M" /begin REF_CHARACTERISTIC BCF_Wbz_M /end REF_CHARACTERISTIC /end GROUP
/begin GROUP S542_BCF_WbzFac_P "swc_BatCoreFct/BCF_100ms_sys/BatCoreFct/PackStateClcn/PackSofClcn/RPack Calculation/BCF_WbzFac_P" /begin REF_CHARACTERISTIC BCF_WbzFac_P /end REF_CHARACTERISTIC /end GROUP
/begin GROUP S543_BCF_IChMax_P "swc_BatCoreFct/BCF_100ms_sys/BatCoreFct/PackStateClcn/PackSofClcn/Static Limits for Soc and Current/BCF_IChMax_P" /begin REF_CHARACTERISTIC BCF_IChMax_P /end REF_CHARACTERISTIC /end GROUP
/begin GROUP S543_BCF_IDchaMax_P "swc_BatCoreFct/BCF_100ms_sys/BatCoreFct/PackStateClcn/PackSofClcn/Static Limits for Soc and Current/BCF_IDchaMax_P" /begin REF_CHARACTERISTIC BCF_IDchaMax_P /end REF_CHARACTERISTIC /end GROUP
/begin GROUP S543_BCF_SocLimMax_P "swc_BatCoreFct/BCF_100ms_sys/BatCoreFct/PackStateClcn/PackSofClcn/Static Limits for Soc and Current/BCF_SocLimMax_P" /begin REF_CHARACTERISTIC BCF_SocLimMax_P /end REF_CHARACTERISTIC /end GROUP
/begin GROUP S543_BCF_SocLimMin_P "swc_BatCoreFct/BCF_100ms_sys/BatCoreFct/PackStateClcn/PackSofClcn/Static Limits for Soc and Current/BCF_SocLimMin_P" /begin REF_CHARACTERISTIC BCF_SocLimMin_P /end REF_CHARACTERISTIC /end GROUP
/begin GROUP S556_Calc_Power_Loss_Buffer "swc_BatCoreFct/BCF_100ms_sys/BatCoreFct/PackStateClcn/PackSofClcn/Pack Min Max Current Calculation (PwrLoss & U)/Find Max Current within the Temperature Limitations/Calc Power Loss Buffer"
 /begin SUB_GROUP S560_Evaluate_Power_Loss S560_Power_Loss_According_to_Current_Direction S560_Simple_Filter /end SUB_GROUP
/end GROUP
/begin GROUP S556_Current_Limit_Calculation "swc_BatCoreFct/BCF_100ms_sys/BatCoreFct/PackStateClcn/PackSofClcn/Pack Min Max Current Calculation (PwrLoss & U)/Find Max Current within the Temperature Limitations/Current Limit Calculation"
 /begin SUB_GROUP S561_BCF_IChMax_P S561_BCF_IDchaMax_P S561_BCF_SofIChAry_P S561_BCF_SofIDchaAry_P /end SUB_GROUP
/end GROUP
/begin GROUP S556_Dimensions_of_UPredAry "swc_BatCoreFct/BCF_100ms_sys/BatCoreFct/PackStateClcn/PackSofClcn/Pack Min Max Current Calculation (PwrLoss & U)/Find Max Current within the Temperature Limitations/Dimensions of UPredAry" /begin SUB_GROUP S562_BCF_SofIChAry_P S562_BCF_SofIDchaAry_P /end SUB_GROUP /end GROUP
/begin GROUP S557_Dimensions_of_UPredAry "swc_BatCoreFct/BCF_100ms_sys/BatCoreFct/PackStateClcn/PackSofClcn/Pack Min Max Current Calculation (PwrLoss & U)/Pred Worst Cell Voltages and Power Losses/Dimensions of UPredAry" /begin SUB_GROUP S593_BCF_SofIChAry_P S593_BCF_SofIDchaAry_P /end SUB_GROUP /end GROUP
/begin GROUP S557_FindWorstCellForVoltageLimitation_AdjustOvervoltages "swc_BatCoreFct/BCF_100ms_sys/BatCoreFct/PackStateClcn/PackSofClcn/Pack Min Max Current Calculation (PwrLoss & U)/Pred Worst Cell Voltages and Power Losses/FindWorstCellForVoltageLimitation_AdjustOvervoltages"
 /begin SUB_GROUP S594_BCF_bAcvSofVeri_P S594_BCF_ILimnFacAct_P S594_BCF_ILimnFacPred_P S594_BCF_UChLim_M S594_BCF_UDchaLim_M S594_BCF_UDchaLimForSofVeri_M /end SUB_GROUP
/end GROUP
/begin GROUP S557_Pred_Losses "swc_BatCoreFct/BCF_100ms_sys/BatCoreFct/PackStateClcn/PackSofClcn/Pack Min Max Current Calculation (PwrLoss & U)/Pred Worst Cell Voltages and Power Losses/Pred Losses" /begin SUB_GROUP S595_BCF_SofIChAry_P S595_BCF_SofIDchaAry_P /end SUB_GROUP /end GROUP
/begin GROUP S557_Predict_average_cell_voltages "swc_BatCoreFct/BCF_100ms_sys/BatCoreFct/PackStateClcn/PackSofClcn/Pack Min Max Current Calculation (PwrLoss & U)/Pred Worst Cell Voltages and Power Losses/Predict average cell voltages"
 /begin SUB_GROUP S596_Current_Vector_Generation S596_Filter_Factors S596_Predict_Average_Cell_Voltages /end SUB_GROUP
/end GROUP
/begin GROUP S557_Safety_Margins "swc_BatCoreFct/BCF_100ms_sys/BatCoreFct/PackStateClcn/PackSofClcn/Pack Min Max Current Calculation (PwrLoss & U)/Pred Worst Cell Voltages and Power Losses/Safety Margins"
 /begin SUB_GROUP S597_BCF_ErrSohSocCellDelta_M S597_BCF_InvldMdlFacForRDelta_P S597_BCF_InvldMdlFacForSocDelta_P S597_BCF_RDeltaSafe_P S597_BCF_SocCellDeltaSafe_P S597_BCF_SohErrLimForRDelta_M S597_BCF_SohRCellCorrnFac_M S597_BCF_SohSocCellCorrnFac_M /end SUB_GROUP
/end GROUP
/begin GROUP S558_BCF_bAcvTEstimnForSof_P "swc_BatCoreFct/BCF_100ms_sys/BatCoreFct/PackStateClcn/PackSofClcn/Pack Min Max Current Calculation (PwrLoss & U)/T Selection/BCF_bAcvTEstimnForSof_P" /begin REF_CHARACTERISTIC BCF_bAcvTEstimnForSof_P /end REF_CHARACTERISTIC /end GROUP
/begin GROUP S55_CIL_DucycCtlPilot_P "swc_CIL/CIL_100ms_sys/Veh_CAN/CIL_DucycCtlPilot_P" /begin REF_CHARACTERISTIC CIL_DucycCtlPilot_P /end REF_CHARACTERISTIC /end GROUP
/begin GROUP S55_CIL_IEACAct_P "swc_CIL/CIL_100ms_sys/Veh_CAN/CIL_IEACAct_P" /begin REF_CHARACTERISTIC CIL_IEACAct_P /end REF_CHARACTERISTIC /end GROUP
/begin GROUP S55_CIL_IObcChOutp_P "swc_CIL/CIL_100ms_sys/Veh_CAN/CIL_IObcChOutp_P" /begin REF_CHARACTERISTIC CIL_IObcChOutp_P /end REF_CHARACTERISTIC /end GROUP
/begin GROUP S55_CIL_PwrEACAct_P "swc_CIL/CIL_100ms_sys/Veh_CAN/CIL_PwrEACAct_P" /begin REF_CHARACTERISTIC CIL_PwrEACAct_P /end REF_CHARACTERISTIC /end GROUP
/begin GROUP S55_CIL_PwrPtcAct_P "swc_CIL/CIL_100ms_sys/Veh_CAN/CIL_PwrPtcAct_P" /begin REF_CHARACTERISTIC CIL_PwrPtcAct_P /end REF_CHARACTERISTIC /end GROUP
/begin GROUP S55_CIL_RAcChCnctn_P "swc_CIL/CIL_100ms_sys/Veh_CAN/CIL_RAcChCnctn_P" /begin REF_CHARACTERISTIC CIL_RAcChCnctn_P /end REF_CHARACTERISTIC /end GROUP
/begin GROUP S55_CIL_StAcChCnct_P "swc_CIL/CIL_100ms_sys/Veh_CAN/CIL_StAcChCnct_P" /begin REF_CHARACTERISTIC CIL_StAcChCnct_P /end REF_CHARACTERISTIC /end GROUP
/begin GROUP S55_CIL_StBatHvReq_P "swc_CIL/CIL_100ms_sys/Veh_CAN/CIL_StBatHvReq_P" /begin REF_CHARACTERISTIC CIL_StBatHvReq_P /end REF_CHARACTERISTIC /end GROUP
/begin GROUP S55_CIL_StBatLvCutoffReq_P "swc_CIL/CIL_100ms_sys/Veh_CAN/CIL_StBatLvCutoffReq_P" /begin REF_CHARACTERISTIC CIL_StBatLvCutoffReq_P /end REF_CHARACTERISTIC /end GROUP
/begin GROUP S55_CIL_StChAllwd_P "swc_CIL/CIL_100ms_sys/Veh_CAN/CIL_StChAllwd_P" /begin REF_CHARACTERISTIC CIL_StChAllwd_P /end REF_CHARACTERISTIC /end GROUP
/begin GROUP S55_CIL_StObc_P "swc_CIL/CIL_100ms_sys/Veh_CAN/CIL_StObc_P" /begin REF_CHARACTERISTIC CIL_StObc_P /end REF_CHARACTERISTIC /end GROUP
/begin GROUP S55_CIL_StPtcW_P "swc_CIL/CIL_100ms_sys/Veh_CAN/CIL_StPtcW_P" /begin REF_CHARACTERISTIC CIL_StPtcW_P /end REF_CHARACTERISTIC /end GROUP
/begin GROUP S55_CIL_StPtIndcr_P "swc_CIL/CIL_100ms_sys/Veh_CAN/CIL_StPtIndcr_P" /begin REF_CHARACTERISTIC CIL_StPtIndcr_P /end REF_CHARACTERISTIC /end GROUP
/begin GROUP S55_CIL_TCooltPackInSnsr_P "swc_CIL/CIL_100ms_sys/Veh_CAN/CIL_TCooltPackInSnsr_P" /begin REF_CHARACTERISTIC CIL_TCooltPackInSnsr_P /end REF_CHARACTERISTIC /end GROUP
/begin GROUP S55_CIL_TCooltPackOutSnsr_P "swc_CIL/CIL_100ms_sys/Veh_CAN/CIL_TCooltPackOutSnsr_P" /begin REF_CHARACTERISTIC CIL_TCooltPackOutSnsr_P /end REF_CHARACTERISTIC /end GROUP
/begin GROUP S55_CIL_UEACAct_P "swc_CIL/CIL_100ms_sys/Veh_CAN/CIL_UEACAct_P" /begin REF_CHARACTERISTIC CIL_UEACAct_P /end REF_CHARACTERISTIC /end GROUP
/begin GROUP S55_CIL_UObcChInp_P "swc_CIL/CIL_100ms_sys/Veh_CAN/CIL_UObcChInp_P" /begin REF_CHARACTERISTIC CIL_UObcChInp_P /end REF_CHARACTERISTIC /end GROUP
/begin GROUP S55_CIL_UObcChOutp_P "swc_CIL/CIL_100ms_sys/Veh_CAN/CIL_UObcChOutp_P" /begin REF_CHARACTERISTIC CIL_UObcChOutp_P /end REF_CHARACTERISTIC /end GROUP
/begin GROUP S55_DTRC_Csw_P_1 "swc_CIL/CIL_100ms_sys/Veh_CAN/DTRC_Csw_P.1" /begin REF_CHARACTERISTIC CIL_Csw7_P /end REF_CHARACTERISTIC /end GROUP
/begin GROUP S55_DTRC_Csw_P_10 "swc_CIL/CIL_100ms_sys/Veh_CAN/DTRC_Csw_P.10" /begin REF_CHARACTERISTIC CIL_Csw7_P /end REF_CHARACTERISTIC /end GROUP
/begin GROUP S55_DTRC_Csw_P_13 "swc_CIL/CIL_100ms_sys/Veh_CAN/DTRC_Csw_P.13" /begin REF_CHARACTERISTIC CIL_Csw7_P /end REF_CHARACTERISTIC /end GROUP
/begin GROUP S55_DTRC_Csw_P_14 "swc_CIL/CIL_100ms_sys/Veh_CAN/DTRC_Csw_P.14" /begin REF_CHARACTERISTIC CIL_Csw7_P /end REF_CHARACTERISTIC /end GROUP
/begin GROUP S55_DTRC_Csw_P_2 "swc_CIL/CIL_100ms_sys/Veh_CAN/DTRC_Csw_P.2" /begin REF_CHARACTERISTIC CIL_Csw7_P /end REF_CHARACTERISTIC /end GROUP
/begin GROUP S55_DTRC_Csw_P_3 "swc_CIL/CIL_100ms_sys/Veh_CAN/DTRC_Csw_P.3" /begin REF_CHARACTERISTIC CIL_Csw7_P /end REF_CHARACTERISTIC /end GROUP
/begin GROUP S55_DTRC_Csw_P_4 "swc_CIL/CIL_100ms_sys/Veh_CAN/DTRC_Csw_P.4" /begin REF_CHARACTERISTIC CIL_Csw7_P /end REF_CHARACTERISTIC /end GROUP
/begin GROUP S55_DTRC_Csw_P_40 "swc_CIL/CIL_100ms_sys/Veh_CAN/DTRC_Csw_P.40" /begin REF_CHARACTERISTIC CIL_Csw7_P /end REF_CHARACTERISTIC /end GROUP
/begin GROUP S55_DTRC_Csw_P_41 "swc_CIL/CIL_100ms_sys/Veh_CAN/DTRC_Csw_P.41" /begin REF_CHARACTERISTIC CIL_Csw7_P /end REF_CHARACTERISTIC /end GROUP
/begin GROUP S55_DTRC_Csw_P_5 "swc_CIL/CIL_100ms_sys/Veh_CAN/DTRC_Csw_P.5" /begin REF_CHARACTERISTIC CIL_Csw7_P /end REF_CHARACTERISTIC /end GROUP
/begin GROUP S55_DTRC_Csw_P_6 "swc_CIL/CIL_100ms_sys/Veh_CAN/DTRC_Csw_P.6" /begin REF_CHARACTERISTIC CIL_Csw7_P /end REF_CHARACTERISTIC /end GROUP
/begin GROUP S55_DTRC_Csw_P_7 "swc_CIL/CIL_100ms_sys/Veh_CAN/DTRC_Csw_P.7" /begin REF_CHARACTERISTIC CIL_Csw7_P /end REF_CHARACTERISTIC /end GROUP
/begin GROUP S55_DTRC_Csw_P_71 "swc_CIL/CIL_100ms_sys/Veh_CAN/DTRC_Csw_P.71" /begin REF_CHARACTERISTIC CIL_Csw7_P /end REF_CHARACTERISTIC /end GROUP
/begin GROUP S55_DTRC_Csw_P_72 "swc_CIL/CIL_100ms_sys/Veh_CAN/DTRC_Csw_P.72" /begin REF_CHARACTERISTIC CIL_Csw7_P /end REF_CHARACTERISTIC /end GROUP
/begin GROUP S55_DTRC_Csw_P_8 "swc_CIL/CIL_100ms_sys/Veh_CAN/DTRC_Csw_P.8" /begin REF_CHARACTERISTIC CIL_Csw7_P /end REF_CHARACTERISTIC /end GROUP
/begin GROUP S55_DTRC_Csw_P_82 "swc_CIL/CIL_100ms_sys/Veh_CAN/DTRC_Csw_P.82" /begin REF_CHARACTERISTIC CIL_Csw7_P /end REF_CHARACTERISTIC /end GROUP
/begin GROUP S55_DTRC_Csw_P_83 "swc_CIL/CIL_100ms_sys/Veh_CAN/DTRC_Csw_P.83" /begin REF_CHARACTERISTIC CIL_Csw7_P /end REF_CHARACTERISTIC /end GROUP
/begin GROUP S55_DTRC_Csw_P_9 "swc_CIL/CIL_100ms_sys/Veh_CAN/DTRC_Csw_P.9" /begin REF_CHARACTERISTIC CIL_Csw7_P /end REF_CHARACTERISTIC /end GROUP
/begin GROUP S560_Evaluate_Power_Loss "swc_BatCoreFct/BCF_100ms_sys/BatCoreFct/PackStateClcn/PackSofClcn/Pack Min Max Current Calculation (PwrLoss & U)/Find Max Current within the Temperature Limitations/Calc Power Loss Buffer/Evaluate Power Loss"
 /begin SUB_GROUP S564_BCF_PwrCellLossMax_M S564_BCF_PwrChWtng_P S564_BCF_PwrChWtng_P1 S564_BCF_PwrFilFacLossAct_P S564_BCF_PwrFilFacLossPred_P /end SUB_GROUP
/end GROUP
/begin GROUP S560_Power_Loss_According_to_Current_Direction "swc_BatCoreFct/BCF_100ms_sys/BatCoreFct/PackStateClcn/PackSofClcn/Pack Min Max Current Calculation (PwrLoss & U)/Find Max Current within the Temperature Limitations/Calc Power Loss Buffer/Power Loss According to Current Direction" /begin SUB_GROUP S565_BCF_PwrChWtng_P /end SUB_GROUP /end GROUP
/begin GROUP S560_Simple_Filter "swc_BatCoreFct/BCF_100ms_sys/BatCoreFct/PackStateClcn/PackSofClcn/Pack Min Max Current Calculation (PwrLoss & U)/Find Max Current within the Temperature Limitations/Calc Power Loss Buffer/Simple Filter"
 /begin SUB_GROUP S566_BCF_PwrFilTcLoss_P S566_BCF_PwrFilTcLoss_P1 S566_BCF_Td_P S566_BCF_Td_P1 /end SUB_GROUP
/end GROUP
/begin GROUP S561_BCF_IChMax_P "swc_BatCoreFct/BCF_100ms_sys/BatCoreFct/PackStateClcn/PackSofClcn/Pack Min Max Current Calculation (PwrLoss & U)/Find Max Current within the Temperature Limitations/Current Limit Calculation/BCF_IChMax_P" /begin REF_CHARACTERISTIC BCF_IChMax_P /end REF_CHARACTERISTIC /end GROUP
/begin GROUP S561_BCF_IDchaMax_P "swc_BatCoreFct/BCF_100ms_sys/BatCoreFct/PackStateClcn/PackSofClcn/Pack Min Max Current Calculation (PwrLoss & U)/Find Max Current within the Temperature Limitations/Current Limit Calculation/BCF_IDchaMax_P" /begin REF_CHARACTERISTIC BCF_IDchaMax_P /end REF_CHARACTERISTIC /end GROUP
/begin GROUP S561_BCF_SofIChAry_P "swc_BatCoreFct/BCF_100ms_sys/BatCoreFct/PackStateClcn/PackSofClcn/Pack Min Max Current Calculation (PwrLoss & U)/Find Max Current within the Temperature Limitations/Current Limit Calculation/BCF_SofIChAry_P" /begin REF_CHARACTERISTIC BCF_SofIChAry_P /end REF_CHARACTERISTIC /end GROUP
/begin GROUP S561_BCF_SofIDchaAry_P "swc_BatCoreFct/BCF_100ms_sys/BatCoreFct/PackStateClcn/PackSofClcn/Pack Min Max Current Calculation (PwrLoss & U)/Find Max Current within the Temperature Limitations/Current Limit Calculation/BCF_SofIDchaAry_P" /begin REF_CHARACTERISTIC BCF_SofIDchaAry_P /end REF_CHARACTERISTIC /end GROUP
/begin GROUP S562_BCF_SofIChAry_P "swc_BatCoreFct/BCF_100ms_sys/BatCoreFct/PackStateClcn/PackSofClcn/Pack Min Max Current Calculation (PwrLoss & U)/Find Max Current within the Temperature Limitations/Dimensions of UPredAry/BCF_SofIChAry_P" /begin REF_CHARACTERISTIC BCF_SofIChAry_P /end REF_CHARACTERISTIC /end GROUP
/begin GROUP S562_BCF_SofIDchaAry_P "swc_BatCoreFct/BCF_100ms_sys/BatCoreFct/PackStateClcn/PackSofClcn/Pack Min Max Current Calculation (PwrLoss & U)/Find Max Current within the Temperature Limitations/Dimensions of UPredAry/BCF_SofIDchaAry_P" /begin REF_CHARACTERISTIC BCF_SofIDchaAry_P /end REF_CHARACTERISTIC /end GROUP
/begin GROUP S564_BCF_PwrCellLossMax_M "swc_BatCoreFct/BCF_100ms_sys/BatCoreFct/PackStateClcn/PackSofClcn/Pack Min Max Current Calculation (PwrLoss & U)/Find Max Current within the Temperature Limitations/Calc Power Loss Buffer/Evaluate Power Loss/BCF_PwrCellLossMax_M" /begin REF_CHARACTERISTIC BCF_PwrCellLossMax_M /end REF_CHARACTERISTIC /end GROUP
/begin GROUP S564_BCF_PwrChWtng_P "swc_BatCoreFct/BCF_100ms_sys/BatCoreFct/PackStateClcn/PackSofClcn/Pack Min Max Current Calculation (PwrLoss & U)/Find Max Current within the Temperature Limitations/Calc Power Loss Buffer/Evaluate Power Loss/BCF_PwrChWtng_P" /begin REF_CHARACTERISTIC BCF_PwrChWtng_P /end REF_CHARACTERISTIC /end GROUP
/begin GROUP S564_BCF_PwrChWtng_P1 "swc_BatCoreFct/BCF_100ms_sys/BatCoreFct/PackStateClcn/PackSofClcn/Pack Min Max Current Calculation (PwrLoss & U)/Find Max Current within the Temperature Limitations/Calc Power Loss Buffer/Evaluate Power Loss/BCF_PwrChWtng_P1" /begin REF_CHARACTERISTIC BCF_PwrChWtng_P /end REF_CHARACTERISTIC /end GROUP
/begin GROUP S564_BCF_PwrFilFacLossAct_P "swc_BatCoreFct/BCF_100ms_sys/BatCoreFct/PackStateClcn/PackSofClcn/Pack Min Max Current Calculation (PwrLoss & U)/Find Max Current within the Temperature Limitations/Calc Power Loss Buffer/Evaluate Power Loss/BCF_PwrFilFacLossAct_P" /begin REF_CHARACTERISTIC BCF_PwrFilFacLossAct_P /end REF_CHARACTERISTIC /end GROUP
/begin GROUP S564_BCF_PwrFilFacLossPred_P "swc_BatCoreFct/BCF_100ms_sys/BatCoreFct/PackStateClcn/PackSofClcn/Pack Min Max Current Calculation (PwrLoss & U)/Find Max Current within the Temperature Limitations/Calc Power Loss Buffer/Evaluate Power Loss/BCF_PwrFilFacLossPred_P" /begin REF_CHARACTERISTIC BCF_PwrFilFacLossPred_P /end REF_CHARACTERISTIC /end GROUP
/begin GROUP S565_BCF_PwrChWtng_P "swc_BatCoreFct/BCF_100ms_sys/BatCoreFct/PackStateClcn/PackSofClcn/Pack Min Max Current Calculation (PwrLoss & U)/Find Max Current within the Temperature Limitations/Calc Power Loss Buffer/Power Loss According to Current Direction/BCF_PwrChWtng_P" /begin REF_CHARACTERISTIC BCF_PwrChWtng_P /end REF_CHARACTERISTIC /end GROUP
/begin GROUP S566_BCF_PwrFilTcLoss_P "swc_BatCoreFct/BCF_100ms_sys/BatCoreFct/PackStateClcn/PackSofClcn/Pack Min Max Current Calculation (PwrLoss & U)/Find Max Current within the Temperature Limitations/Calc Power Loss Buffer/Simple Filter/BCF_PwrFilTcLoss_P" /begin REF_CHARACTERISTIC BCF_PwrFilTcLoss_P /end REF_CHARACTERISTIC /end GROUP
/begin GROUP S566_BCF_PwrFilTcLoss_P1 "swc_BatCoreFct/BCF_100ms_sys/BatCoreFct/PackStateClcn/PackSofClcn/Pack Min Max Current Calculation (PwrLoss & U)/Find Max Current within the Temperature Limitations/Calc Power Loss Buffer/Simple Filter/BCF_PwrFilTcLoss_P1" /begin REF_CHARACTERISTIC BCF_PwrFilTcLoss_P /end REF_CHARACTERISTIC /end GROUP
/begin GROUP S593_BCF_SofIChAry_P "swc_BatCoreFct/BCF_100ms_sys/BatCoreFct/PackStateClcn/PackSofClcn/Pack Min Max Current Calculation (PwrLoss & U)/Pred Worst Cell Voltages and Power Losses/Dimensions of UPredAry/BCF_SofIChAry_P" /begin REF_CHARACTERISTIC BCF_SofIChAry_P /end REF_CHARACTERISTIC /end GROUP
/begin GROUP S593_BCF_SofIDchaAry_P "swc_BatCoreFct/BCF_100ms_sys/BatCoreFct/PackStateClcn/PackSofClcn/Pack Min Max Current Calculation (PwrLoss & U)/Pred Worst Cell Voltages and Power Losses/Dimensions of UPredAry/BCF_SofIDchaAry_P" /begin REF_CHARACTERISTIC BCF_SofIDchaAry_P /end REF_CHARACTERISTIC /end GROUP
/begin GROUP S594_BCF_bAcvSofVeri_P "swc_BatCoreFct/BCF_100ms_sys/BatCoreFct/PackStateClcn/PackSofClcn/Pack Min Max Current Calculation (PwrLoss & U)/Pred Worst Cell Voltages and Power Losses/FindWorstCellForVoltageLimitation_AdjustOvervoltages/BCF_bAcvSofVeri_P" /begin REF_CHARACTERISTIC BCF_bAcvSofVeri_P /end REF_CHARACTERISTIC /end GROUP
/begin GROUP S594_BCF_ILimnFacAct_P "swc_BatCoreFct/BCF_100ms_sys/BatCoreFct/PackStateClcn/PackSofClcn/Pack Min Max Current Calculation (PwrLoss & U)/Pred Worst Cell Voltages and Power Losses/FindWorstCellForVoltageLimitation_AdjustOvervoltages/BCF_ILimnFacAct_P" /begin REF_CHARACTERISTIC BCF_ILimnFacAct_P /end REF_CHARACTERISTIC /end GROUP
/begin GROUP S594_BCF_ILimnFacPred_P "swc_BatCoreFct/BCF_100ms_sys/BatCoreFct/PackStateClcn/PackSofClcn/Pack Min Max Current Calculation (PwrLoss & U)/Pred Worst Cell Voltages and Power Losses/FindWorstCellForVoltageLimitation_AdjustOvervoltages/BCF_ILimnFacPred_P" /begin REF_CHARACTERISTIC BCF_ILimnFacPred_P /end REF_CHARACTERISTIC /end GROUP
/begin GROUP S594_BCF_UChLim_M "swc_BatCoreFct/BCF_100ms_sys/BatCoreFct/PackStateClcn/PackSofClcn/Pack Min Max Current Calculation (PwrLoss & U)/Pred Worst Cell Voltages and Power Losses/FindWorstCellForVoltageLimitation_AdjustOvervoltages/BCF_UChLim_M" /begin REF_CHARACTERISTIC BCF_UChLim_M /end REF_CHARACTERISTIC /end GROUP
/begin GROUP S594_BCF_UDchaLim_M "swc_BatCoreFct/BCF_100ms_sys/BatCoreFct/PackStateClcn/PackSofClcn/Pack Min Max Current Calculation (PwrLoss & U)/Pred Worst Cell Voltages and Power Losses/FindWorstCellForVoltageLimitation_AdjustOvervoltages/BCF_UDchaLim_M" /begin REF_CHARACTERISTIC BCF_UDchaLim_M /end REF_CHARACTERISTIC /end GROUP
/begin GROUP S594_BCF_UDchaLimForSofVeri_M "swc_BatCoreFct/BCF_100ms_sys/BatCoreFct/PackStateClcn/PackSofClcn/Pack Min Max Current Calculation (PwrLoss & U)/Pred Worst Cell Voltages and Power Losses/FindWorstCellForVoltageLimitation_AdjustOvervoltages/BCF_UDchaLimForSofVeri_M" /begin REF_CHARACTERISTIC BCF_UDchaLimForSofVeri_M /end REF_CHARACTERISTIC /end GROUP
/begin GROUP S595_BCF_SofIChAry_P "swc_BatCoreFct/BCF_100ms_sys/BatCoreFct/PackStateClcn/PackSofClcn/Pack Min Max Current Calculation (PwrLoss & U)/Pred Worst Cell Voltages and Power Losses/Pred Losses/BCF_SofIChAry_P" /begin REF_CHARACTERISTIC BCF_SofIChAry_P /end REF_CHARACTERISTIC /end GROUP
/begin GROUP S595_BCF_SofIDchaAry_P "swc_BatCoreFct/BCF_100ms_sys/BatCoreFct/PackStateClcn/PackSofClcn/Pack Min Max Current Calculation (PwrLoss & U)/Pred Worst Cell Voltages and Power Losses/Pred Losses/BCF_SofIDchaAry_P" /begin REF_CHARACTERISTIC BCF_SofIDchaAry_P /end REF_CHARACTERISTIC /end GROUP
/begin GROUP S596_Current_Vector_Generation "swc_BatCoreFct/BCF_100ms_sys/BatCoreFct/PackStateClcn/PackSofClcn/Pack Min Max Current Calculation (PwrLoss & U)/Pred Worst Cell Voltages and Power Losses/Predict average cell voltages/Current Vector Generation" /begin SUB_GROUP S610_BCF_SofIChAry_P S610_BCF_SofIDchaAry_P /end SUB_GROUP /end GROUP
/begin GROUP S596_Filter_Factors "swc_BatCoreFct/BCF_100ms_sys/BatCoreFct/PackStateClcn/PackSofClcn/Pack Min Max Current Calculation (PwrLoss & U)/Pred Worst Cell Voltages and Power Losses/Predict average cell voltages/Filter Factors"
 /begin SUB_GROUP S611_BCF_BvFilFacAct_M S611_BCF_BvFilFacPred_M S611_BCF_SofTcAct_P S611_BCF_SofTcPred_P S611_BCF_WbzFilFacAct_M S611_BCF_WbzFilFacPred_M /end SUB_GROUP
/end GROUP
/begin GROUP S596_Predict_Average_Cell_Voltages "swc_BatCoreFct/BCF_100ms_sys/BatCoreFct/PackStateClcn/PackSofClcn/Pack Min Max Current Calculation (PwrLoss & U)/Pred Worst Cell Voltages and Power Losses/Predict average cell voltages/Predict Average Cell Voltages"
 /begin SUB_GROUP S612__Process_Equation__ffun S612_Measurement_Equation_hfun /end SUB_GROUP
/end GROUP
/begin GROUP S597_BCF_ErrSohSocCellDelta_M "swc_BatCoreFct/BCF_100ms_sys/BatCoreFct/PackStateClcn/PackSofClcn/Pack Min Max Current Calculation (PwrLoss & U)/Pred Worst Cell Voltages and Power Losses/Safety Margins/BCF_ErrSohSocCellDelta_M" /begin REF_CHARACTERISTIC BCF_ErrSohSocCellDelta_M /end REF_CHARACTERISTIC /end GROUP
/begin GROUP S597_BCF_InvldMdlFacForRDelta_P "swc_BatCoreFct/BCF_100ms_sys/BatCoreFct/PackStateClcn/PackSofClcn/Pack Min Max Current Calculation (PwrLoss & U)/Pred Worst Cell Voltages and Power Losses/Safety Margins/BCF_InvldMdlFacForRDelta_P" /begin REF_CHARACTERISTIC BCF_InvldMdlFacForRDelta_P /end REF_CHARACTERISTIC /end GROUP
/begin GROUP S597_BCF_InvldMdlFacForSocDelta_P "swc_BatCoreFct/BCF_100ms_sys/BatCoreFct/PackStateClcn/PackSofClcn/Pack Min Max Current Calculation (PwrLoss & U)/Pred Worst Cell Voltages and Power Losses/Safety Margins/BCF_InvldMdlFacForSocDelta_P" /begin REF_CHARACTERISTIC BCF_InvldMdlFacForSocDelta_P /end REF_CHARACTERISTIC /end GROUP
/begin GROUP S597_BCF_RDeltaSafe_P "swc_BatCoreFct/BCF_100ms_sys/BatCoreFct/PackStateClcn/PackSofClcn/Pack Min Max Current Calculation (PwrLoss & U)/Pred Worst Cell Voltages and Power Losses/Safety Margins/BCF_RDeltaSafe_P" /begin REF_CHARACTERISTIC BCF_RDeltaSafe_P /end REF_CHARACTERISTIC /end GROUP
/begin GROUP S597_BCF_SocCellDeltaSafe_P "swc_BatCoreFct/BCF_100ms_sys/BatCoreFct/PackStateClcn/PackSofClcn/Pack Min Max Current Calculation (PwrLoss & U)/Pred Worst Cell Voltages and Power Losses/Safety Margins/BCF_SocCellDeltaSafe_P" /begin REF_CHARACTERISTIC BCF_SocCellDeltaSafe_P /end REF_CHARACTERISTIC /end GROUP
/begin GROUP S597_BCF_SohErrLimForRDelta_M "swc_BatCoreFct/BCF_100ms_sys/BatCoreFct/PackStateClcn/PackSofClcn/Pack Min Max Current Calculation (PwrLoss & U)/Pred Worst Cell Voltages and Power Losses/Safety Margins/BCF_SohErrLimForRDelta_M" /begin REF_CHARACTERISTIC BCF_SohErrLimForRDelta_M /end REF_CHARACTERISTIC /end GROUP
/begin GROUP S597_BCF_SohRCellCorrnFac_M "swc_BatCoreFct/BCF_100ms_sys/BatCoreFct/PackStateClcn/PackSofClcn/Pack Min Max Current Calculation (PwrLoss & U)/Pred Worst Cell Voltages and Power Losses/Safety Margins/BCF_SohRCellCorrnFac_M" /begin REF_CHARACTERISTIC BCF_SohRCellCorrnFac_M /end REF_CHARACTERISTIC /end GROUP
/begin GROUP S597_BCF_SohSocCellCorrnFac_M "swc_BatCoreFct/BCF_100ms_sys/BatCoreFct/PackStateClcn/PackSofClcn/Pack Min Max Current Calculation (PwrLoss & U)/Pred Worst Cell Voltages and Power Losses/Safety Margins/BCF_SohSocCellCorrnFac_M" /begin REF_CHARACTERISTIC BCF_SohSocCellCorrnFac_M /end REF_CHARACTERISTIC /end GROUP
/begin GROUP S5_MCC_NrCellByMdul_P "swc_CIL/CIL_100ms_sys/BMS customer config/MCC_NrCellByMdul_P" /begin REF_CHARACTERISTIC MCC_NrCellByMdul_P /end REF_CHARACTERISTIC /end GROUP
/begin GROUP S5_MCC_NrCellTot_P "swc_CIL/CIL_100ms_sys/BMS customer config/MCC_NrCellTot_P" /begin REF_CHARACTERISTIC MCC_NrCellTot_P /end REF_CHARACTERISTIC /end GROUP
/begin GROUP S5_MCC_NrCtlrSnsrTByMdul_P "swc_CIL/CIL_100ms_sys/BMS customer config/MCC_NrCtlrSnsrTByMdul_P" /begin REF_CHARACTERISTIC MCC_NrCtlrSnsrTByMdul_P /end REF_CHARACTERISTIC /end GROUP
/begin GROUP S5_MCC_NrMdulCtlrSnsrTTot_P "swc_CIL/CIL_100ms_sys/BMS customer config/MCC_NrMdulCtlrSnsrTTot_P" /begin REF_CHARACTERISTIC MCC_NrMdulCtlrSnsrTTot_P /end REF_CHARACTERISTIC /end GROUP
/begin GROUP S5_MCC_NrMdulTot_P "swc_CIL/CIL_100ms_sys/BMS customer config/MCC_NrMdulTot_P" /begin REF_CHARACTERISTIC MCC_NrMdulTot_P /end REF_CHARACTERISTIC /end GROUP
/begin GROUP S5_MCC_NrSnsrTByMdul_P "swc_CIL/CIL_100ms_sys/BMS customer config/MCC_NrSnsrTByMdul_P" /begin REF_CHARACTERISTIC MCC_NrSnsrTByMdul_P /end REF_CHARACTERISTIC /end GROUP
/begin GROUP S5_MCC_NrSnsrTTot_P "swc_CIL/CIL_100ms_sys/BMS customer config/MCC_NrSnsrTTot_P" /begin REF_CHARACTERISTIC MCC_NrSnsrTTot_P /end REF_CHARACTERISTIC /end GROUP
/begin GROUP S5_NVM_Write "swc_DiagcEveHndlg/NVM_Write_100ms_sys/NVM Write" /begin SUB_GROUP S1122_NVM_store_contions /end SUB_GROUP /end GROUP
/begin GROUP S60_InitializationDecision "swc_BatCoreFct/BCF_100ms_sys/BatCoreFct/BatCoreInit/InitializationDecision"
 /begin SUB_GROUP S69_BCF_IDCMDFORININOC_P S69_BCF_IDCMDFORSOCMAN_P S69_BCF_ReqSrv_P1 /end SUB_GROUP
/end GROUP
/begin GROUP S60_ManualSOCInitializationServiceMode "swc_BatCoreFct/BCF_100ms_sys/BatCoreFct/BatCoreInit/ManualSOCInitializationServiceMode" /begin SUB_GROUP S70_BCF_SocIniMan_P /end SUB_GROUP /end GROUP
/begin GROUP S60_MemoryAndSignalInitializationInServiceMode "swc_BatCoreFct/BCF_100ms_sys/BatCoreFct/BatCoreInit/MemoryAndSignalInitializationInServiceMode"
 /begin SUB_GROUP S71_BCF_CMdulAgiFacTest_P S71_BCF_CMdulAgiFacTripTest_P S71_BCF_RMdulAgiFacTest_P S71_BCF_RMdulAgiFacTripTest_P S71_BCF_SohPackMinFlsForTest_P S71_BCF_SohRDeltaFlsForTest_P S71_BCF_SohSocDeltaFlsForTest_P S71_BCF_TiBatOffForMdulCTest_P S71_BCF_TiBatOffForMdulRTest_P /end SUB_GROUP
/end GROUP
/begin GROUP S60_OCVInitializationServiceMode "swc_BatCoreFct/BCF_100ms_sys/BatCoreFct/BatCoreInit/OCVInitializationServiceMode" /begin SUB_GROUP S73_BCF_SocInin_M /end SUB_GROUP /end GROUP
/begin GROUP S60_StateInitialization "swc_BatCoreFct/BCF_100ms_sys/BatCoreFct/BatCoreInit/StateInitialization" /begin SUB_GROUP S74_SocMdulInit /end SUB_GROUP /end GROUP
/begin GROUP S610_BCF_SofIChAry_P "swc_BatCoreFct/BCF_100ms_sys/BatCoreFct/PackStateClcn/PackSofClcn/Pack Min Max Current Calculation (PwrLoss & U)/Pred Worst Cell Voltages and Power Losses/Predict average cell voltages/Current Vector Generation/BCF_SofIChAry_P" /begin REF_CHARACTERISTIC BCF_SofIChAry_P /end REF_CHARACTERISTIC /end GROUP
/begin GROUP S610_BCF_SofIDchaAry_P "swc_BatCoreFct/BCF_100ms_sys/BatCoreFct/PackStateClcn/PackSofClcn/Pack Min Max Current Calculation (PwrLoss & U)/Pred Worst Cell Voltages and Power Losses/Predict average cell voltages/Current Vector Generation/BCF_SofIDchaAry_P" /begin REF_CHARACTERISTIC BCF_SofIDchaAry_P /end REF_CHARACTERISTIC /end GROUP
/begin GROUP S611_BCF_BvFilFacAct_M "swc_BatCoreFct/BCF_100ms_sys/BatCoreFct/PackStateClcn/PackSofClcn/Pack Min Max Current Calculation (PwrLoss & U)/Pred Worst Cell Voltages and Power Losses/Predict average cell voltages/Filter Factors/BCF_BvFilFacAct_M" /begin REF_CHARACTERISTIC BCF_BvFilFacAct_M /end REF_CHARACTERISTIC /end GROUP
/begin GROUP S611_BCF_BvFilFacPred_M "swc_BatCoreFct/BCF_100ms_sys/BatCoreFct/PackStateClcn/PackSofClcn/Pack Min Max Current Calculation (PwrLoss & U)/Pred Worst Cell Voltages and Power Losses/Predict average cell voltages/Filter Factors/BCF_BvFilFacPred_M" /begin REF_CHARACTERISTIC BCF_BvFilFacPred_M /end REF_CHARACTERISTIC /end GROUP
/begin GROUP S611_BCF_SofTcAct_P "swc_BatCoreFct/BCF_100ms_sys/BatCoreFct/PackStateClcn/PackSofClcn/Pack Min Max Current Calculation (PwrLoss & U)/Pred Worst Cell Voltages and Power Losses/Predict average cell voltages/Filter Factors/BCF_SofTcAct_P" /begin REF_CHARACTERISTIC BCF_SofTcAct_P /end REF_CHARACTERISTIC /end GROUP
/begin GROUP S611_BCF_SofTcPred_P "swc_BatCoreFct/BCF_100ms_sys/BatCoreFct/PackStateClcn/PackSofClcn/Pack Min Max Current Calculation (PwrLoss & U)/Pred Worst Cell Voltages and Power Losses/Predict average cell voltages/Filter Factors/BCF_SofTcPred_P" /begin REF_CHARACTERISTIC BCF_SofTcPred_P /end REF_CHARACTERISTIC /end GROUP
/begin GROUP S611_BCF_WbzFilFacAct_M "swc_BatCoreFct/BCF_100ms_sys/BatCoreFct/PackStateClcn/PackSofClcn/Pack Min Max Current Calculation (PwrLoss & U)/Pred Worst Cell Voltages and Power Losses/Predict average cell voltages/Filter Factors/BCF_WbzFilFacAct_M" /begin REF_CHARACTERISTIC BCF_WbzFilFacAct_M /end REF_CHARACTERISTIC /end GROUP
/begin GROUP S611_BCF_WbzFilFacPred_M "swc_BatCoreFct/BCF_100ms_sys/BatCoreFct/PackStateClcn/PackSofClcn/Pack Min Max Current Calculation (PwrLoss & U)/Pred Worst Cell Voltages and Power Losses/Predict average cell voltages/Filter Factors/BCF_WbzFilFacPred_M" /begin REF_CHARACTERISTIC BCF_WbzFilFacPred_M /end REF_CHARACTERISTIC /end GROUP
/begin GROUP S612__Process_Equation__ffun "swc_BatCoreFct/BCF_100ms_sys/BatCoreFct/PackStateClcn/PackSofClcn/Pack Min Max Current Calculation (PwrLoss & U)/Pred Worst Cell Voltages and Power Losses/Predict average cell voltages/Predict Average Cell Voltages/ Process Equation, ffun" /begin SUB_GROUP S621_BCF_CCellNom_M S621_BCF_WbzTc_M /end SUB_GROUP /end GROUP
/begin GROUP S612_Measurement_Equation_hfun "swc_BatCoreFct/BCF_100ms_sys/BatCoreFct/PackStateClcn/PackSofClcn/Pack Min Max Current Calculation (PwrLoss & U)/Pred Worst Cell Voltages and Power Losses/Predict average cell voltages/Predict Average Cell Voltages/Measurement Equation hfun"
 /begin SUB_GROUP S622_BCF_RBv_M S622_BCF_RMdulCnct_P S622_BCF_SocLnrznDelta_P S622_BCF_SofIChAry_P S622_BCF_SofIDchaAry_P S622_BCF_UChOc_M S622_BCF_UChOc_M1 S622_BCF_UChOc_M2 S622_BCF_UChOc_M3 S622_BCF_UDchaOc_M S622_BCF_UDchaOc_M1 S622_BCF_UDchaOc_M2 S622_BCF_UDchaOc_M3 S622_BCF_Wbz_M S622_BCF_WbzFac_P /end SUB_GROUP
/end GROUP
/begin GROUP S622_BCF_SofIChAry_P "swc_BatCoreFct/BCF_100ms_sys/BatCoreFct/PackStateClcn/PackSofClcn/Pack Min Max Current Calculation (PwrLoss & U)/Pred Worst Cell Voltages and Power Losses/Predict average cell voltages/Predict Average Cell Voltages/Measurement Equation hfun/BCF_SofIChAry_" /begin REF_CHARACTERISTIC BCF_SofIChAry_P /end REF_CHARACTERISTIC /end GROUP
/begin GROUP S622_BCF_SofIDchaAry_P "swc_BatCoreFct/BCF_100ms_sys/BatCoreFct/PackStateClcn/PackSofClcn/Pack Min Max Current Calculation (PwrLoss & U)/Pred Worst Cell Voltages and Power Losses/Predict average cell voltages/Predict Average Cell Voltages/Measurement Equation hfun/BCF_SofIDchaAr" /begin REF_CHARACTERISTIC BCF_SofIDchaAry_P /end REF_CHARACTERISTIC /end GROUP
/begin GROUP S622_BCF_Wbz_M "swc_BatCoreFct/BCF_100ms_sys/BatCoreFct/PackStateClcn/PackSofClcn/Pack Min Max Current Calculation (PwrLoss & U)/Pred Worst Cell Voltages and Power Losses/Predict average cell voltages/Predict Average Cell Voltages/Measurement Equation hfun/BCF_Wbz_M" /begin REF_CHARACTERISTIC BCF_Wbz_M /end REF_CHARACTERISTIC /end GROUP
/begin GROUP S622_BCF_WbzFac_P "swc_BatCoreFct/BCF_100ms_sys/BatCoreFct/PackStateClcn/PackSofClcn/Pack Min Max Current Calculation (PwrLoss & U)/Pred Worst Cell Voltages and Power Losses/Predict average cell voltages/Predict Average Cell Voltages/Measurement Equation hfun/BCF_WbzFac_P" /begin REF_CHARACTERISTIC BCF_WbzFac_P /end REF_CHARACTERISTIC /end GROUP
/begin GROUP S62_BCF_NrMdulMax_P "swc_BatCoreFct/BCF_100ms_sys/BatCoreFct/NrMdulMax/BCF_NrMdulMax_P" /begin REF_CHARACTERISTIC BCF_NrMdulMax_P /end REF_CHARACTERISTIC /end GROUP
/begin GROUP S62_ConditionCalculation "swc_CtctrTranCtl/CtcrtTranCtl_sys/CtcrtTranCtl/ContactorAgingObserver/ConditionCalculation"
 /begin SUB_GROUP S93_CTC_CtrCtctrChDtrtLim_P S93_CTC_CtrCtctrDtrtLimNeg_P S93_CTC_CtrCtctrDtrtLimPos_P S93_CTC_CtrCtctrDtrtLimPrech_P S93_CTC_PctgCtctrChErrCdnLim_P S93_CTC_PctgCtctrChWarnCdnLim_P S93_CTC_PctgCtctrErrCdnLimNeg_P S93_CTC_PctgCtctrErrCdnLimPos_P S93_CTC_PctgCtctrErrCdnLimPrech_P S93_CTC_PctgCtctrWarnCdnLimNeg_P S93_CTC_PctgCtctrWarnCdnLimPos_P S93_CTC_PctgCtctrWarnCdnLimPrech_P /end SUB_GROUP
/end GROUP
/begin GROUP S62_CTC_CtrCtctrAgiCh_M "swc_CtctrTranCtl/CtcrtTranCtl_sys/CtcrtTranCtl/ContactorAgingObserver/CTC_CtrCtctrAgiCh_M" /begin REF_CHARACTERISTIC CTC_CtrCtctrAgiCh_M /end REF_CHARACTERISTIC /end GROUP
/begin GROUP S62_CTC_CtrCtctrAgiNeg_M "swc_CtctrTranCtl/CtcrtTranCtl_sys/CtcrtTranCtl/ContactorAgingObserver/CTC_CtrCtctrAgiNeg_M" /begin REF_CHARACTERISTIC CTC_CtrCtctrAgiNeg_M /end REF_CHARACTERISTIC /end GROUP
/begin GROUP S62_CTC_CtrCtctrAgiPos_M "swc_CtctrTranCtl/CtcrtTranCtl_sys/CtcrtTranCtl/ContactorAgingObserver/CTC_CtrCtctrAgiPos_M" /begin REF_CHARACTERISTIC CTC_CtrCtctrAgiPos_M /end REF_CHARACTERISTIC /end GROUP
/begin GROUP S62_CTC_CtrCtctrAgiPrech_M "swc_CtctrTranCtl/CtcrtTranCtl_sys/CtcrtTranCtl/ContactorAgingObserver/CTC_CtrCtctrAgiPrech_M" /begin REF_CHARACTERISTIC CTC_CtrCtctrAgiPrech_M /end REF_CHARACTERISTIC /end GROUP
/begin GROUP S62_TimerCh "swc_CtctrTranCtl/CtcrtTranCtl_sys/CtcrtTranCtl/ContactorAgingObserver/TimerCh" /begin SUB_GROUP S106_CTC_TiCtctrAgiDetmnRngCh_P /end SUB_GROUP /end GROUP
/begin GROUP S62_TimerNeg "swc_CtctrTranCtl/CtcrtTranCtl_sys/CtcrtTranCtl/ContactorAgingObserver/TimerNeg" /begin SUB_GROUP S107_CTC_TiCtctrAgiDetmnRngNeg_P /end SUB_GROUP /end GROUP
/begin GROUP S62_TimerPos "swc_CtctrTranCtl/CtcrtTranCtl_sys/CtcrtTranCtl/ContactorAgingObserver/TimerPos" /begin SUB_GROUP S108_CTC_TiCtctrAgiDetmnRngPos_P /end SUB_GROUP /end GROUP
/begin GROUP S62_TimerPrec "swc_CtctrTranCtl/CtcrtTranCtl_sys/CtcrtTranCtl/ContactorAgingObserver/TimerPrec" /begin SUB_GROUP S109_CTC_TiCtctrAgiDetmnRngPrech_P /end SUB_GROUP /end GROUP
/begin GROUP S62_WriteCtctrChDtrt "swc_CtctrTranCtl/CtcrtTranCtl_sys/CtcrtTranCtl/ContactorAgingObserver/WriteCtctrChDtrt" /begin SUB_GROUP S110_ResetCtctrChDtrt /end SUB_GROUP /end GROUP
/begin GROUP S62_WriteCtctrNegDtrt "swc_CtctrTranCtl/CtcrtTranCtl_sys/CtcrtTranCtl/ContactorAgingObserver/WriteCtctrNegDtrt" /begin SUB_GROUP S111_ResetCtctrNegDtrt /end SUB_GROUP /end GROUP
/begin GROUP S62_WriteCtctrPosDtrt "swc_CtctrTranCtl/CtcrtTranCtl_sys/CtcrtTranCtl/ContactorAgingObserver/WriteCtctrPosDtrt" /begin SUB_GROUP S112_ResetCtctrPosDtrt /end SUB_GROUP /end GROUP
/begin GROUP S62_WriteCtctrPrecDtrt "swc_CtctrTranCtl/CtcrtTranCtl_sys/CtcrtTranCtl/ContactorAgingObserver/WriteCtctrPrecDtrt" /begin SUB_GROUP S113_ResetCtctrPrechDtrt /end SUB_GROUP /end GROUP
/begin GROUP S631_BMS_CoolNegRelayCtrl_P "swc_COL/COL_10ms_sys/COL_10ms_sys/BMS_CoolNegRelayCtrl_P" /begin REF_CHARACTERISTIC BMS_CoolNegRelayCtrl_P /end REF_CHARACTERISTIC /end GROUP
/begin GROUP S631_BMS_CoolPosRelayCtrl_P "swc_COL/COL_10ms_sys/COL_10ms_sys/BMS_CoolPosRelayCtrl_P" /begin REF_CHARACTERISTIC BMS_CoolPosRelayCtrl_P /end REF_CHARACTERISTIC /end GROUP
/begin GROUP S631_BMS_HeatNegRelayCtrl_Reserved_P "swc_COL/COL_10ms_sys/COL_10ms_sys/BMS_HeatNegRelayCtrl_Reserved_P" /begin REF_CHARACTERISTIC BMS_HeatNegRelayCtrl_Reserved_P /end REF_CHARACTERISTIC /end GROUP
/begin GROUP S631_BMS_HeatPosRelayCtrl_Reserved_P "swc_COL/COL_10ms_sys/COL_10ms_sys/BMS_HeatPosRelayCtrl_Reserved_P" /begin REF_CHARACTERISTIC BMS_HeatPosRelayCtrl_Reserved_P /end REF_CHARACTERISTIC /end GROUP
/begin GROUP S631_BMS_InsideFltCode_P "swc_COL/COL_10ms_sys/COL_10ms_sys/BMS_InsideFltCode_P" /begin REF_CHARACTERISTIC BMS_InsideFltCode_P /end REF_CHARACTERISTIC /end GROUP
/begin GROUP S631_BMS_TestFrame_P "swc_COL/COL_10ms_sys/COL_10ms_sys/BMS_TestFrame_P" /begin REF_CHARACTERISTIC BMS_TestFrame_P /end REF_CHARACTERISTIC /end GROUP
/begin GROUP S631_BMS_TestInfo1_BMS_MainNegRelay1Ctrl_P "swc_COL/COL_10ms_sys/COL_10ms_sys/BMS_TestInfo1_BMS_MainNegRelay1Ctrl_P" /begin REF_CHARACTERISTIC BMS_MainNegRelay1Ctrl_P /end REF_CHARACTERISTIC /end GROUP
/begin GROUP S631_BMS_TestInfo1_BMS_MainNegRelay2Ctrl_P "swc_COL/COL_10ms_sys/COL_10ms_sys/BMS_TestInfo1_BMS_MainNegRelay2Ctrl_P" /begin REF_CHARACTERISTIC BMS_MainNegRelay2Ctrl_P /end REF_CHARACTERISTIC /end GROUP
/begin GROUP S631_BmsSuspCause_ActiveSuspend_P "swc_COL/COL_10ms_sys/COL_10ms_sys/BmsSuspCause_ActiveSuspend_P" /begin REF_CHARACTERISTIC BmsSuspCause_ActiveSuspend_P /end REF_CHARACTERISTIC /end GROUP
/begin GROUP S631_BmsSuspCause_SingleVoltage_P "swc_COL/COL_10ms_sys/COL_10ms_sys/BmsSuspCause_SingleVoltage_P" /begin REF_CHARACTERISTIC BmsSuspCause_SingleVoltage_P /end REF_CHARACTERISTIC /end GROUP
/begin GROUP S631_BmsSuspCause_SOC_P "swc_COL/COL_10ms_sys/COL_10ms_sys/BmsSuspCause_SOC_P" /begin REF_CHARACTERISTIC BmsSuspCause_SOC_P /end REF_CHARACTERISTIC /end GROUP
/begin GROUP S631_BmsSuspCause_TotalVoltage_P "swc_COL/COL_10ms_sys/COL_10ms_sys/BmsSuspCause_TotalVoltage_P" /begin REF_CHARACTERISTIC BmsSuspCause_TotalVoltage_P /end REF_CHARACTERISTIC /end GROUP
/begin GROUP S631_BmsSuspError_AbnormalVoltage_P "swc_COL/COL_10ms_sys/COL_10ms_sys/BmsSuspError_AbnormalVoltage_P" /begin REF_CHARACTERISTIC BmsSuspError_AbnormalVoltage_P /end REF_CHARACTERISTIC /end GROUP
/begin GROUP S631_BmsSuspError_ExcessiveCurrent_P "swc_COL/COL_10ms_sys/COL_10ms_sys/BmsSuspError_ExcessiveCurrent_P" /begin REF_CHARACTERISTIC BmsSuspError_ExcessiveCurrent_P /end REF_CHARACTERISTIC /end GROUP
/begin GROUP S631_BmsSuspFault_BatteryTemp_P "swc_COL/COL_10ms_sys/COL_10ms_sys/BmsSuspFault_BatteryTemp_P" /begin REF_CHARACTERISTIC BmsSuspFault_BatteryTemp_P /end REF_CHARACTERISTIC /end GROUP
/begin GROUP S631_BmsSuspFault_BmsTemp_P "swc_COL/COL_10ms_sys/COL_10ms_sys/BmsSuspFault_BmsTemp_P" /begin REF_CHARACTERISTIC BmsSuspFault_BmsTemp_P /end REF_CHARACTERISTIC /end GROUP
/begin GROUP S631_BmsSuspFault_ChargeConn_P "swc_COL/COL_10ms_sys/COL_10ms_sys/BmsSuspFault_ChargeConn_P" /begin REF_CHARACTERISTIC BmsSuspFault_ChargeConn_P /end REF_CHARACTERISTIC /end GROUP
/begin GROUP S631_BmsSuspFault_Insulation_P "swc_COL/COL_10ms_sys/COL_10ms_sys/BmsSuspFault_Insulation_P" /begin REF_CHARACTERISTIC BmsSuspFault_Insulation_P /end REF_CHARACTERISTIC /end GROUP
/begin GROUP S631_BmsSuspFault_OtherFaults_P "swc_COL/COL_10ms_sys/COL_10ms_sys/BmsSuspFault_OtherFaults_P" /begin REF_CHARACTERISTIC BmsSuspFault_OtherFaults_P /end REF_CHARACTERISTIC /end GROUP
/begin GROUP S631_BmsSuspFault_OutputConnTemp_P "swc_COL/COL_10ms_sys/COL_10ms_sys/BmsSuspFault_OutputConnTemp_P" /begin REF_CHARACTERISTIC BmsSuspFault_OutputConnTemp_P /end REF_CHARACTERISTIC /end GROUP
/begin GROUP S631_BmsSuspFault_VoltageDetection_P "swc_COL/COL_10ms_sys/COL_10ms_sys/BmsSuspFault_VoltageDetection_P" /begin REF_CHARACTERISTIC BmsSuspFault_VoltageDetection_P /end REF_CHARACTERISTIC /end GROUP
/begin GROUP S631_BmsSuspFault_VoltageRelay_P "swc_COL/COL_10ms_sys/COL_10ms_sys/BmsSuspFault_VoltageRelay_P" /begin REF_CHARACTERISTIC BmsSuspFault_VoltageRelay_P /end REF_CHARACTERISTIC /end GROUP
/begin GROUP S631_BmuControl_BalanceControl_P "swc_COL/COL_10ms_sys/COL_10ms_sys/BmuControl_BalanceControl_P" /begin REF_CHARACTERISTIC BmuControl_BalanceControl_P /end REF_CHARACTERISTIC /end GROUP
/begin GROUP S631_BSWIOSP_Mode_Request_shutdown_P "swc_COL/COL_10ms_sys/COL_10ms_sys/BSWIOSP_Mode_Request_shutdown_P" /begin REF_CHARACTERISTIC BSWIOSP_Mode_Request_shutdown_P /end REF_CHARACTERISTIC /end GROUP
/begin GROUP S631_BSWIOSP_Request_BCL_P "swc_COL/COL_10ms_sys/COL_10ms_sys/BSWIOSP_Request_BCL_P" /begin REF_CHARACTERISTIC BSWIOSP_Request_BCL_P /end REF_CHARACTERISTIC /end GROUP
/begin GROUP S631_BSWIOSP_Request_BCP_P "swc_COL/COL_10ms_sys/COL_10ms_sys/BSWIOSP_Request_BCP_P" /begin REF_CHARACTERISTIC BSWIOSP_Request_BCP_P /end REF_CHARACTERISTIC /end GROUP
/begin GROUP S631_BSWIOSP_Request_BCPP_P "swc_COL/COL_10ms_sys/COL_10ms_sys/BSWIOSP_Request_BCPP_P" /begin REF_CHARACTERISTIC BSWIOSP_Request_BCPP_P /end REF_CHARACTERISTIC /end GROUP
/begin GROUP S631_BSWIOSP_Request_BCS_P "swc_COL/COL_10ms_sys/COL_10ms_sys/BSWIOSP_Request_BCS_P" /begin REF_CHARACTERISTIC BSWIOSP_Request_BCS_P /end REF_CHARACTERISTIC /end GROUP
/begin GROUP S631_BSWIOSP_Request_BCSP_P "swc_COL/COL_10ms_sys/COL_10ms_sys/BSWIOSP_Request_BCSP_P" /begin REF_CHARACTERISTIC BSWIOSP_Request_BCSP_P /end REF_CHARACTERISTIC /end GROUP
/begin GROUP S631_BSWIOSP_Request_BDC_P "swc_COL/COL_10ms_sys/COL_10ms_sys/BSWIOSP_Request_BDC_P" /begin REF_CHARACTERISTIC BSWIOSP_Request_BDC_P /end REF_CHARACTERISTIC /end GROUP
/begin GROUP S631_BSWIOSP_Request_BEM_P "swc_COL/COL_10ms_sys/COL_10ms_sys/BSWIOSP_Request_BEM_P" /begin REF_CHARACTERISTIC BSWIOSP_Request_BEM_P /end REF_CHARACTERISTIC /end GROUP
/begin GROUP S631_BSWIOSP_Request_BHM_P "swc_COL/COL_10ms_sys/COL_10ms_sys/BSWIOSP_Request_BHM_P" /begin REF_CHARACTERISTIC BSWIOSP_Request_BHM_P /end REF_CHARACTERISTIC /end GROUP
/begin GROUP S631_BSWIOSP_Request_BMS_FastChgStopInfo_P "swc_COL/COL_10ms_sys/COL_10ms_sys/BSWIOSP_Request_BMS_FastChgStopInfo_P" /begin REF_CHARACTERISTIC BSWIOSP_Request_BMS_FastChgStopInfo_P /end REF_CHARACTERISTIC /end GROUP
/begin GROUP S631_BSWIOSP_Request_BMT_P "swc_COL/COL_10ms_sys/COL_10ms_sys/BSWIOSP_Request_BMT_P" /begin REF_CHARACTERISTIC BSWIOSP_Request_BMT_P /end REF_CHARACTERISTIC /end GROUP
/begin GROUP S631_BSWIOSP_Request_BMV_P "swc_COL/COL_10ms_sys/COL_10ms_sys/BSWIOSP_Request_BMV_P" /begin REF_CHARACTERISTIC BSWIOSP_Request_BMV_P /end REF_CHARACTERISTIC /end GROUP
/begin GROUP S631_BSWIOSP_Request_BRM_P "swc_COL/COL_10ms_sys/COL_10ms_sys/BSWIOSP_Request_BRM_P" /begin REF_CHARACTERISTIC BSWIOSP_Request_BRM_P /end REF_CHARACTERISTIC /end GROUP
/begin GROUP S631_BSWIOSP_Request_BRO_P "swc_COL/COL_10ms_sys/COL_10ms_sys/BSWIOSP_Request_BRO_P" /begin REF_CHARACTERISTIC BSWIOSP_Request_BRO_P /end REF_CHARACTERISTIC /end GROUP
/begin GROUP S631_BSWIOSP_Request_BSD_P "swc_COL/COL_10ms_sys/COL_10ms_sys/BSWIOSP_Request_BSD_P" /begin REF_CHARACTERISTIC BSWIOSP_Request_BSD_P /end REF_CHARACTERISTIC /end GROUP
/begin GROUP S631_BSWIOSP_Request_BSM_P "swc_COL/COL_10ms_sys/COL_10ms_sys/BSWIOSP_Request_BSM_P" /begin REF_CHARACTERISTIC BSWIOSP_Request_BSM_P /end REF_CHARACTERISTIC /end GROUP
/begin GROUP S631_BSWIOSP_Request_BSP_P "swc_COL/COL_10ms_sys/COL_10ms_sys/BSWIOSP_Request_BSP_P" /begin REF_CHARACTERISTIC BSWIOSP_Request_BSP_P /end REF_CHARACTERISTIC /end GROUP
/begin GROUP S631_BSWIOSP_Request_BST_P "swc_COL/COL_10ms_sys/COL_10ms_sys/BSWIOSP_Request_BST_P" /begin REF_CHARACTERISTIC BSWIOSP_Request_BST_P /end REF_CHARACTERISTIC /end GROUP
/begin GROUP S631_ChargingMode_P "swc_COL/COL_10ms_sys/COL_10ms_sys/ChargingMode_P" /begin REF_CHARACTERISTIC ChargingMode_P /end REF_CHARACTERISTIC /end GROUP
/begin GROUP S631_CurrentDemand_P "swc_COL/COL_10ms_sys/COL_10ms_sys/CurrentDemand_P" /begin REF_CHARACTERISTIC CurrentDemand_P /end REF_CHARACTERISTIC /end GROUP
/begin GROUP S631_DTRC_Csw_P_100 "swc_COL/COL_10ms_sys/COL_10ms_sys/DTRC_Csw_P.100" /begin REF_CHARACTERISTIC COL_Csw1_P /end REF_CHARACTERISTIC /end GROUP
/begin GROUP S631_DTRC_Csw_P_101 "swc_COL/COL_10ms_sys/COL_10ms_sys/DTRC_Csw_P.101" /begin REF_CHARACTERISTIC COL_Csw1_P /end REF_CHARACTERISTIC /end GROUP
/begin GROUP S631_DTRC_Csw_P_109 "swc_COL/COL_10ms_sys/COL_10ms_sys/DTRC_Csw_P.109" /begin REF_CHARACTERISTIC COL_Csw1_P /end REF_CHARACTERISTIC /end GROUP
/begin GROUP S631_DTRC_Csw_P_119 "swc_COL/COL_10ms_sys/COL_10ms_sys/DTRC_Csw_P.119" /begin REF_CHARACTERISTIC COL_Csw1_P /end REF_CHARACTERISTIC /end GROUP
/begin GROUP S631_DTRC_Csw_P_120 "swc_COL/COL_10ms_sys/COL_10ms_sys/DTRC_Csw_P.120" /begin REF_CHARACTERISTIC COL_Csw1_P /end REF_CHARACTERISTIC /end GROUP
/begin GROUP S631_DTRC_Csw_P_121 "swc_COL/COL_10ms_sys/COL_10ms_sys/DTRC_Csw_P.121" /begin REF_CHARACTERISTIC COL_Csw1_P /end REF_CHARACTERISTIC /end GROUP
/begin GROUP S631_DTRC_Csw_P_122 "swc_COL/COL_10ms_sys/COL_10ms_sys/DTRC_Csw_P.122" /begin REF_CHARACTERISTIC COL_Csw1_P /end REF_CHARACTERISTIC /end GROUP
/begin GROUP S631_DTRC_Csw_P_123 "swc_COL/COL_10ms_sys/COL_10ms_sys/DTRC_Csw_P.123" /begin REF_CHARACTERISTIC COL_Csw1_P /end REF_CHARACTERISTIC /end GROUP
/begin GROUP S631_DTRC_Csw_P_124 "swc_COL/COL_10ms_sys/COL_10ms_sys/DTRC_Csw_P.124" /begin REF_CHARACTERISTIC COL_Csw1_P /end REF_CHARACTERISTIC /end GROUP
/begin GROUP S631_DTRC_Csw_P_125 "swc_COL/COL_10ms_sys/COL_10ms_sys/DTRC_Csw_P.125" /begin REF_CHARACTERISTIC COL_Csw1_P /end REF_CHARACTERISTIC /end GROUP
/begin GROUP S631_DTRC_Csw_P_126 "swc_COL/COL_10ms_sys/COL_10ms_sys/DTRC_Csw_P.126" /begin REF_CHARACTERISTIC COL_Csw1_P /end REF_CHARACTERISTIC /end GROUP
/begin GROUP S631_DTRC_Csw_P_127 "swc_COL/COL_10ms_sys/COL_10ms_sys/DTRC_Csw_P.127" /begin REF_CHARACTERISTIC COL_Csw1_P /end REF_CHARACTERISTIC /end GROUP
/begin GROUP S631_DTRC_Csw_P_128 "swc_COL/COL_10ms_sys/COL_10ms_sys/DTRC_Csw_P.128" /begin REF_CHARACTERISTIC COL_Csw1_P /end REF_CHARACTERISTIC /end GROUP
/begin GROUP S631_DTRC_Csw_P_129 "swc_COL/COL_10ms_sys/COL_10ms_sys/DTRC_Csw_P.129" /begin REF_CHARACTERISTIC COL_Csw1_P /end REF_CHARACTERISTIC /end GROUP
/begin GROUP S631_DTRC_Csw_P_130 "swc_COL/COL_10ms_sys/COL_10ms_sys/DTRC_Csw_P.130" /begin REF_CHARACTERISTIC COL_Csw1_P /end REF_CHARACTERISTIC /end GROUP
/begin GROUP S631_DTRC_Csw_P_131 "swc_COL/COL_10ms_sys/COL_10ms_sys/DTRC_Csw_P.131" /begin REF_CHARACTERISTIC COL_Csw1_P /end REF_CHARACTERISTIC /end GROUP
/begin GROUP S631_DTRC_Csw_P_132 "swc_COL/COL_10ms_sys/COL_10ms_sys/DTRC_Csw_P.132" /begin REF_CHARACTERISTIC COL_Csw1_P /end REF_CHARACTERISTIC /end GROUP
/begin GROUP S631_DTRC_Csw_P_133 "swc_COL/COL_10ms_sys/COL_10ms_sys/DTRC_Csw_P.133" /begin REF_CHARACTERISTIC COL_Csw1_P /end REF_CHARACTERISTIC /end GROUP
/begin GROUP S631_DTRC_Csw_P_134 "swc_COL/COL_10ms_sys/COL_10ms_sys/DTRC_Csw_P.134" /begin REF_CHARACTERISTIC COL_Csw1_P /end REF_CHARACTERISTIC /end GROUP
/begin GROUP S631_DTRC_Csw_P_135 "swc_COL/COL_10ms_sys/COL_10ms_sys/DTRC_Csw_P.135" /begin REF_CHARACTERISTIC COL_Csw1_P /end REF_CHARACTERISTIC /end GROUP
/begin GROUP S631_DTRC_Csw_P_164 "swc_COL/COL_10ms_sys/COL_10ms_sys/DTRC_Csw_P.164" /begin REF_CHARACTERISTIC COL_Csw1_P /end REF_CHARACTERISTIC /end GROUP
/begin GROUP S631_DTRC_Csw_P_40 "swc_COL/COL_10ms_sys/COL_10ms_sys/DTRC_Csw_P.40" /begin REF_CHARACTERISTIC COL_Csw1_P /end REF_CHARACTERISTIC /end GROUP
/begin GROUP S631_DTRC_Csw_P_43 "swc_COL/COL_10ms_sys/COL_10ms_sys/DTRC_Csw_P.43" /begin REF_CHARACTERISTIC COL_Csw1_P /end REF_CHARACTERISTIC /end GROUP
/begin GROUP S631_DTRC_Csw_P_54 "swc_COL/COL_10ms_sys/COL_10ms_sys/DTRC_Csw_P.54" /begin REF_CHARACTERISTIC COL_Csw1_P /end REF_CHARACTERISTIC /end GROUP
/begin GROUP S631_DTRC_Csw_P_8 "swc_COL/COL_10ms_sys/COL_10ms_sys/DTRC_Csw_P.8" /begin REF_CHARACTERISTIC COL_Csw1_P /end REF_CHARACTERISTIC /end GROUP
/begin GROUP S631_DTRC_Csw_P_89 "swc_COL/COL_10ms_sys/COL_10ms_sys/DTRC_Csw_P.89" /begin REF_CHARACTERISTIC COL_Csw1_P /end REF_CHARACTERISTIC /end GROUP
/begin GROUP S631_DTRC_Csw_P_9 "swc_COL/COL_10ms_sys/COL_10ms_sys/DTRC_Csw_P.9" /begin REF_CHARACTERISTIC COL_Csw1_P /end REF_CHARACTERISTIC /end GROUP
/begin GROUP S631_DTRC_Csw_P_90 "swc_COL/COL_10ms_sys/COL_10ms_sys/DTRC_Csw_P.90" /begin REF_CHARACTERISTIC COL_Csw1_P /end REF_CHARACTERISTIC /end GROUP
/begin GROUP S631_DTRC_Csw_P_92 "swc_COL/COL_10ms_sys/COL_10ms_sys/DTRC_Csw_P.92" /begin REF_CHARACTERISTIC COL_Csw1_P /end REF_CHARACTERISTIC /end GROUP
/begin GROUP S631_DTRC_Csw_P_96 "swc_COL/COL_10ms_sys/COL_10ms_sys/DTRC_Csw_P.96" /begin REF_CHARACTERISTIC COL_Csw1_P /end REF_CHARACTERISTIC /end GROUP
/begin GROUP S631_HvSysSample_DisableIso_P "swc_COL/COL_10ms_sys/COL_10ms_sys/HvSysSample_DisableIso_P" /begin REF_CHARACTERISTIC HvSysSample_DisableIso_P /end REF_CHARACTERISTIC /end GROUP
/begin GROUP S631_VoltageDemand_P "swc_COL/COL_10ms_sys/COL_10ms_sys/VoltageDemand_P" /begin REF_CHARACTERISTIC VoltageDemand_P /end REF_CHARACTERISTIC /end GROUP
/begin GROUP S63_BitSelect4 "swc_BatProtnPack/PackSocAndSohDiag/1000ms/PackSocDiagnosisAndLimit/Subsystem/BitSelect4" /end GROUP
/begin GROUP S63_BPP_SocCellDifMax_P "swc_BatProtnPack/PackSocAndSohDiag/1000ms/PackSocDiagnosisAndLimit/Subsystem/BPP_SocCellDifMax_P" /end GROUP
/begin GROUP S63_BPP_SocCellDifMin_P "swc_BatProtnPack/PackSocAndSohDiag/1000ms/PackSocDiagnosisAndLimit/Subsystem/BPP_SocCellDifMin_P" /end GROUP
/begin GROUP S63_BPP_TiOffDig196_P "swc_BatProtnPack/PackSocAndSohDiag/1000ms/PackSocDiagnosisAndLimit/Subsystem/BPP_TiOffDig196_P" /end GROUP
/begin GROUP S63_BPP_TiOnDig196_P "swc_BatProtnPack/PackSocAndSohDiag/1000ms/PackSocDiagnosisAndLimit/Subsystem/BPP_TiOnDig196_P" /end GROUP
/begin GROUP S63_BPP_TiSample2_P "swc_BatProtnPack/PackSocAndSohDiag/1000ms/PackSocDiagnosisAndLimit/Subsystem/BPP_TiSample2_P" /end GROUP
/begin GROUP S64_BitSelect1 "swc_BatProtnPack/PackSocAndSohDiag/1000ms/PackSocDiagnosisAndLimit/Subsystem1/BitSelect1" /end GROUP
/begin GROUP S64_BitSelect2 "swc_BatProtnPack/PackSocAndSohDiag/1000ms/PackSocDiagnosisAndLimit/Subsystem1/BitSelect2" /end GROUP
/begin GROUP S64_BitSelect3 "swc_BatProtnPack/PackSocAndSohDiag/1000ms/PackSocDiagnosisAndLimit/Subsystem1/BitSelect3" /end GROUP
/begin GROUP S64_BitSelect4 "swc_BatProtnPack/PackSocAndSohDiag/1000ms/PackSocDiagnosisAndLimit/Subsystem1/BitSelect4" /end GROUP
/begin GROUP S64_BPIU_SocPackMinLim1_P "swc_BatProtnPack/PackSocAndSohDiag/1000ms/PackSocDiagnosisAndLimit/Subsystem1/BPIU_SocPackMinLim1_P" /end GROUP
/begin GROUP S64_BPIU_SocPackMinLim2_P "swc_BatProtnPack/PackSocAndSohDiag/1000ms/PackSocDiagnosisAndLimit/Subsystem1/BPIU_SocPackMinLim2_P" /end GROUP
/begin GROUP S64_BPIU_SocPackMinOff1_P "swc_BatProtnPack/PackSocAndSohDiag/1000ms/PackSocDiagnosisAndLimit/Subsystem1/BPIU_SocPackMinOff1_P" /end GROUP
/begin GROUP S64_BPIU_SocPackMinOff2_P "swc_BatProtnPack/PackSocAndSohDiag/1000ms/PackSocDiagnosisAndLimit/Subsystem1/BPIU_SocPackMinOff2_P" /end GROUP
/begin GROUP S64_BPP_SocPackJmpLim_P "swc_BatProtnPack/PackSocAndSohDiag/1000ms/PackSocDiagnosisAndLimit/Subsystem1/BPP_SocPackJmpLim_P" /end GROUP
/begin GROUP S64_BPP_TiOffDig182_P "swc_BatProtnPack/PackSocAndSohDiag/1000ms/PackSocDiagnosisAndLimit/Subsystem1/BPP_TiOffDig182_P" /end GROUP
/begin GROUP S64_BPP_TiOffDig184_P "swc_BatProtnPack/PackSocAndSohDiag/1000ms/PackSocDiagnosisAndLimit/Subsystem1/BPP_TiOffDig184_P" /end GROUP
/begin GROUP S64_BPP_TiOffDig185_P "swc_BatProtnPack/PackSocAndSohDiag/1000ms/PackSocDiagnosisAndLimit/Subsystem1/BPP_TiOffDig185_P" /end GROUP
/begin GROUP S64_BPP_TiOffDig97_P "swc_BatProtnPack/PackSocAndSohDiag/1000ms/PackSocDiagnosisAndLimit/Subsystem1/BPP_TiOffDig97_P" /end GROUP
/begin GROUP S64_BPP_TiOnDig182_P "swc_BatProtnPack/PackSocAndSohDiag/1000ms/PackSocDiagnosisAndLimit/Subsystem1/BPP_TiOnDig182_P" /end GROUP
/begin GROUP S64_BPP_TiOnDig184_P "swc_BatProtnPack/PackSocAndSohDiag/1000ms/PackSocDiagnosisAndLimit/Subsystem1/BPP_TiOnDig184_P" /end GROUP
/begin GROUP S64_BPP_TiOnDig185_P "swc_BatProtnPack/PackSocAndSohDiag/1000ms/PackSocDiagnosisAndLimit/Subsystem1/BPP_TiOnDig185_P" /end GROUP
/begin GROUP S64_BPP_TiOnDig97_P "swc_BatProtnPack/PackSocAndSohDiag/1000ms/PackSocDiagnosisAndLimit/Subsystem1/BPP_TiOnDig97_P" /end GROUP
/begin GROUP S64_BPP_TiSample2_P "swc_BatProtnPack/PackSocAndSohDiag/1000ms/PackSocDiagnosisAndLimit/Subsystem1/BPP_TiSample2_P" /end GROUP
/begin GROUP S64_BPP_TiSample2_P1 "swc_BatProtnPack/PackSocAndSohDiag/1000ms/PackSocDiagnosisAndLimit/Subsystem1/BPP_TiSample2_P1" /end GROUP
/begin GROUP S64_BPP_TiSample2_P2 "swc_BatProtnPack/PackSocAndSohDiag/1000ms/PackSocDiagnosisAndLimit/Subsystem1/BPP_TiSample2_P2" /end GROUP
/begin GROUP S64_BPP_TiSample2_P3 "swc_BatProtnPack/PackSocAndSohDiag/1000ms/PackSocDiagnosisAndLimit/Subsystem1/BPP_TiSample2_P3" /end GROUP
/begin GROUP S64_PackObsLoop "swc_BatCoreFct/BCF_100ms_sys/BatCoreFct/PackObs/PackObsLoop" /begin SUB_GROUP S128_Extract_Mdul_Data S128_MdulObs /end SUB_GROUP /end GROUP
/begin GROUP S64_TriggerMdulCObsr "swc_BatCoreFct/BCF_100ms_sys/BatCoreFct/PackObs/TriggerMdulCObsr" /begin SUB_GROUP S130_BCF_TsCtrCMdulObsr_P /end SUB_GROUP /end GROUP
/begin GROUP S65_ELHPN_TiDebIniOffHvIntlc_P "swc_EltlLnkHzrdProtnNet/ELHPN_10ms_sys/ELHPN_10ms_sys/HighVoltageInterlock /InitialCheck/ELHPN_TiDebIniOffHvIntlc_P" /begin REF_CHARACTERISTIC ELHPN_TiDebIniOffHvIntlc_P /end REF_CHARACTERISTIC /end GROUP
/begin GROUP S65_ELHPN_TiDebIniOnHvIntlc_P1 "swc_EltlLnkHzrdProtnNet/ELHPN_10ms_sys/ELHPN_10ms_sys/HighVoltageInterlock /InitialCheck/ELHPN_TiDebIniOnHvIntlc_P1" /begin REF_CHARACTERISTIC ELHPN_TiDebIniOnHvIntlc_P /end REF_CHARACTERISTIC /end GROUP
/begin GROUP S65_PackSocClcn "swc_BatCoreFct/BCF_100ms_sys/BatCoreFct/PackStateClcn/PackSocClcn"
 /begin SUB_GROUP S525_BCF_bAcvSocMin_P S525_BCF_CswPackSoc_P S525_BCF_SocPackLimnMax_P S525_BCF_SocPackLimnMin_P S525_BCF_SocPackMan_P S525_BCF_SocPackMpg_M /end SUB_GROUP
/end GROUP
/begin GROUP S65_PackSofClcn "swc_BatCoreFct/BCF_100ms_sys/BatCoreFct/PackStateClcn/PackSofClcn"
 /begin SUB_GROUP S526_Pack_Current_Limits_Calculation_and_Indication S526_Pack_Min_Max_Current_Calculation__PwrLoss___U_ S526_Pack_Min_Max_Current_Calculation__SOC_T___SOH_ S526_Pack_Min_Max_Voltage_Prediction S526_RPack_Calculation S526_Static_Limits_for_Soc_and_Current /end SUB_GROUP
/end GROUP
/begin GROUP S65_PackSohClcn "swc_BatCoreFct/BCF_100ms_sys/BatCoreFct/PackStateClcn/PackSohClcn"
 /begin SUB_GROUP S527_SohPack_Evaluation S527_SohRDelta_Calculation S527_SohSocDelta_Calculation /end SUB_GROUP
/end GROUP
/begin GROUP S667_BCF_bAcvTEstimnForSof_P "swc_BatCoreFct/BCF_100ms_sys/BatCoreFct/PackStateClcn/PackSofClcn/Pack Min Max Current Calculation (SOC,T & SOH)/SocTCellLim/BCF_bAcvTEstimnForSof_P" /begin REF_CHARACTERISTIC BCF_bAcvTEstimnForSof_P /end REF_CHARACTERISTIC /end GROUP
/begin GROUP S667_BCF_IChActLimBySocT_M "swc_BatCoreFct/BCF_100ms_sys/BatCoreFct/PackStateClcn/PackSofClcn/Pack Min Max Current Calculation (SOC,T & SOH)/SocTCellLim/BCF_IChActLimBySocT_M" /begin REF_CHARACTERISTIC BCF_IChActLimBySocT_M /end REF_CHARACTERISTIC /end GROUP
/begin GROUP S667_BCF_IChPredLimBySocT_M "swc_BatCoreFct/BCF_100ms_sys/BatCoreFct/PackStateClcn/PackSofClcn/Pack Min Max Current Calculation (SOC,T & SOH)/SocTCellLim/BCF_IChPredLimBySocT_M" /begin REF_CHARACTERISTIC BCF_IChPredLimBySocT_M /end REF_CHARACTERISTIC /end GROUP
/begin GROUP S667_BCF_IDchaActLimBySocT_M "swc_BatCoreFct/BCF_100ms_sys/BatCoreFct/PackStateClcn/PackSofClcn/Pack Min Max Current Calculation (SOC,T & SOH)/SocTCellLim/BCF_IDchaActLimBySocT_M" /begin REF_CHARACTERISTIC BCF_IDchaActLimBySocT_M /end REF_CHARACTERISTIC /end GROUP
/begin GROUP S667_BCF_IDchaPredLimBySocT_M "swc_BatCoreFct/BCF_100ms_sys/BatCoreFct/PackStateClcn/PackSofClcn/Pack Min Max Current Calculation (SOC,T & SOH)/SocTCellLim/BCF_IDchaPredLimBySocT_M" /begin REF_CHARACTERISTIC BCF_IDchaPredLimBySocT_M /end REF_CHARACTERISTIC /end GROUP
/begin GROUP S669_BCF_CoeffSohChLim_M "swc_BatCoreFct/BCF_100ms_sys/BatCoreFct/PackStateClcn/PackSofClcn/Pack Min Max Current Calculation (SOC,T & SOH)/SohLim/BCF_CoeffSohChLim_M" /begin REF_CHARACTERISTIC BCF_CoeffSohChLim_M /end REF_CHARACTERISTIC /end GROUP
/begin GROUP S669_BCF_CoeffSohDchaLim_M "swc_BatCoreFct/BCF_100ms_sys/BatCoreFct/PackStateClcn/PackSofClcn/Pack Min Max Current Calculation (SOC,T & SOH)/SohLim/BCF_CoeffSohDchaLim_M" /begin REF_CHARACTERISTIC BCF_CoeffSohDchaLim_M /end REF_CHARACTERISTIC /end GROUP
/begin GROUP S66_Battery_is_AC_Charging "swc_BatBalnCtl/BBC_100ms_sys/BBC_100ms_sys/BatBalnCtl/Battery Balancing Decision/BatBalnCtl/Determine Balancing Thresholds/Battery is AC Charging" /begin SUB_GROUP S69_BBC_SocChBalnModeOffThd_M S69_BBC_SocChBalnModeOnThd_M /end SUB_GROUP /end GROUP
/begin GROUP S66_Battery_is_DC_Charging "swc_BatBalnCtl/BBC_100ms_sys/BBC_100ms_sys/BatBalnCtl/Battery Balancing Decision/BatBalnCtl/Determine Balancing Thresholds/Battery is DC Charging" /begin SUB_GROUP S70_BBC_SocChBalnModeOffThd_M S70_BBC_SocChBalnModeOnThd_M /end SUB_GROUP /end GROUP
/begin GROUP S66_Battery_is_Offline____Relais_open "swc_BatBalnCtl/BBC_100ms_sys/BBC_100ms_sys/BatBalnCtl/Battery Balancing Decision/BatBalnCtl/Determine Balancing Thresholds/Battery is Offline // Relais open"
 /begin SUB_GROUP S71_BBC_SocDcnctBalnModeOffThd_M S71_BBC_SocDcnctBalnModeOnThd_M /end SUB_GROUP
/end GROUP
/begin GROUP S66_Battery_is_Online "swc_BatBalnCtl/BBC_100ms_sys/BBC_100ms_sys/BatBalnCtl/Battery Balancing Decision/BatBalnCtl/Determine Balancing Thresholds/Battery is Online"
 /begin SUB_GROUP S72_BBC_SocDrvgBalnModeOffThd_M S72_BBC_SocDrvgBalnModeOnThd_M /end SUB_GROUP
/end GROUP
/begin GROUP S681_BCF_RPack_P "swc_BatCoreFct/BCF_100ms_sys/BatCoreFct/PackStateClcn/PackSofClcn/Pack Min Max Voltage Prediction/Add Wiring Resistance/BCF_RPack_P" /begin REF_CHARACTERISTIC BCF_RPack_P /end REF_CHARACTERISTIC /end GROUP
/begin GROUP S681_BCF_RPack_P1 "swc_BatCoreFct/BCF_100ms_sys/BatCoreFct/PackStateClcn/PackSofClcn/Pack Min Max Voltage Prediction/Add Wiring Resistance/BCF_RPack_P1" /begin REF_CHARACTERISTIC BCF_RPack_P /end REF_CHARACTERISTIC /end GROUP
/begin GROUP S683_Calculate_forecast_filter_coefficients_actual "swc_BatCoreFct/BCF_100ms_sys/BatCoreFct/PackStateClcn/PackSofClcn/Pack Min Max Voltage Prediction/Module Min Max Voltage Prediction/Calculate forecast filter coefficients actual" /begin SUB_GROUP S688_BCF_BvFilFacAct_M S688_BCF_WbzFilFacAct_M /end SUB_GROUP /end GROUP
/begin GROUP S683_Calculate_forecast_filter_coefficients_predicted "swc_BatCoreFct/BCF_100ms_sys/BatCoreFct/PackStateClcn/PackSofClcn/Pack Min Max Voltage Prediction/Module Min Max Voltage Prediction/Calculate forecast filter coefficients predicted" /begin SUB_GROUP S689_BCF_BvFilFacPred_M S689_BCF_WbzFilFacPred_M /end SUB_GROUP /end GROUP
/begin GROUP S683_SOF_Actual "swc_BatCoreFct/BCF_100ms_sys/BatCoreFct/PackStateClcn/PackSofClcn/Pack Min Max Voltage Prediction/Module Min Max Voltage Prediction/SOF Actual"
 /begin SUB_GROUP S692__Process_Equation__ffun S692_Measurement_Equation_hfun /end SUB_GROUP
/end GROUP
/begin GROUP S683_SOF_Pred "swc_BatCoreFct/BCF_100ms_sys/BatCoreFct/PackStateClcn/PackSofClcn/Pack Min Max Voltage Prediction/Module Min Max Voltage Prediction/SOF Pred"
 /begin SUB_GROUP S693__Process_Equation__ffun S693_Measurement_Equation_hfun /end SUB_GROUP
/end GROUP
/begin GROUP S683_Voltage_Limit_Actual_Assignment "swc_BatCoreFct/BCF_100ms_sys/BatCoreFct/PackStateClcn/PackSofClcn/Pack Min Max Voltage Prediction/Module Min Max Voltage Prediction/Voltage Limit Actual Assignment" /begin SUB_GROUP S694_BCF_UChLim_M S694_BCF_UDchaLim_M /end SUB_GROUP /end GROUP
/begin GROUP S683_Voltage_Limit_Predicted_Assignment "swc_BatCoreFct/BCF_100ms_sys/BatCoreFct/PackStateClcn/PackSofClcn/Pack Min Max Voltage Prediction/Module Min Max Voltage Prediction/Voltage Limit Predicted Assignment" /begin SUB_GROUP S695_BCF_UChLim_M S695_BCF_UDchaLim_M /end SUB_GROUP /end GROUP
/begin GROUP S688_BCF_BvFilFacAct_M "swc_BatCoreFct/BCF_100ms_sys/BatCoreFct/PackStateClcn/PackSofClcn/Pack Min Max Voltage Prediction/Module Min Max Voltage Prediction/Calculate forecast filter coefficients actual/BCF_BvFilFacAct_M" /begin REF_CHARACTERISTIC BCF_BvFilFacAct_M /end REF_CHARACTERISTIC /end GROUP
/begin GROUP S688_BCF_WbzFilFacAct_M "swc_BatCoreFct/BCF_100ms_sys/BatCoreFct/PackStateClcn/PackSofClcn/Pack Min Max Voltage Prediction/Module Min Max Voltage Prediction/Calculate forecast filter coefficients actual/BCF_WbzFilFacAct_M" /begin REF_CHARACTERISTIC BCF_WbzFilFacAct_M /end REF_CHARACTERISTIC /end GROUP
/begin GROUP S689_BCF_BvFilFacPred_M "swc_BatCoreFct/BCF_100ms_sys/BatCoreFct/PackStateClcn/PackSofClcn/Pack Min Max Voltage Prediction/Module Min Max Voltage Prediction/Calculate forecast filter coefficients predicted/BCF_BvFilFacPred_M" /begin REF_CHARACTERISTIC BCF_BvFilFacPred_M /end REF_CHARACTERISTIC /end GROUP
/begin GROUP S689_BCF_WbzFilFacPred_M "swc_BatCoreFct/BCF_100ms_sys/BatCoreFct/PackStateClcn/PackSofClcn/Pack Min Max Voltage Prediction/Module Min Max Voltage Prediction/Calculate forecast filter coefficients predicted/BCF_WbzFilFacPred_M" /begin REF_CHARACTERISTIC BCF_WbzFilFacPred_M /end REF_CHARACTERISTIC /end GROUP
/begin GROUP S68_BCF_UCellChnCfg_P "swc_BatCoreFct/BCF_100ms_sys/BatCoreFct/Signal Mapping/BCF_UCellChnCfg_P" /begin REF_CHARACTERISTIC BCF_UCellChnCfg_P /end REF_CHARACTERISTIC /end GROUP
/begin GROUP S692__Process_Equation__ffun "swc_BatCoreFct/BCF_100ms_sys/BatCoreFct/PackStateClcn/PackSofClcn/Pack Min Max Voltage Prediction/Module Min Max Voltage Prediction/SOF Actual/ Process Equation, ffun" /begin SUB_GROUP S700_BCF_CCellNom_M S700_BCF_SofTcPred_P S700_BCF_WbzTc_M /end SUB_GROUP /end GROUP
/begin GROUP S694_BCF_UChLim_M "swc_BatCoreFct/BCF_100ms_sys/BatCoreFct/PackStateClcn/PackSofClcn/Pack Min Max Voltage Prediction/Module Min Max Voltage Prediction/Voltage Limit Actual Assignment/BCF_UChLim_M" /begin REF_CHARACTERISTIC BCF_UChLim_M /end REF_CHARACTERISTIC /end GROUP
/begin GROUP S694_BCF_UDchaLim_M "swc_BatCoreFct/BCF_100ms_sys/BatCoreFct/PackStateClcn/PackSofClcn/Pack Min Max Voltage Prediction/Module Min Max Voltage Prediction/Voltage Limit Actual Assignment/BCF_UDchaLim_M" /begin REF_CHARACTERISTIC BCF_UDchaLim_M /end REF_CHARACTERISTIC /end GROUP
/begin GROUP S695_BCF_UChLim_M "swc_BatCoreFct/BCF_100ms_sys/BatCoreFct/PackStateClcn/PackSofClcn/Pack Min Max Voltage Prediction/Module Min Max Voltage Prediction/Voltage Limit Predicted Assignment/BCF_UChLim_M" /begin REF_CHARACTERISTIC BCF_UChLim_M /end REF_CHARACTERISTIC /end GROUP
/begin GROUP S695_BCF_UDchaLim_M "swc_BatCoreFct/BCF_100ms_sys/BatCoreFct/PackStateClcn/PackSofClcn/Pack Min Max Voltage Prediction/Module Min Max Voltage Prediction/Voltage Limit Predicted Assignment/BCF_UDchaLim_M" /begin REF_CHARACTERISTIC BCF_UDchaLim_M /end REF_CHARACTERISTIC /end GROUP
/begin GROUP S700_BCF_SofTcPred_P "swc_BatCoreFct/BCF_100ms_sys/BatCoreFct/PackStateClcn/PackSofClcn/Pack Min Max Voltage Prediction/Module Min Max Voltage Prediction/SOF Actual/ Process Equation, ffun/BCF_SofTcPred_P" /begin REF_CHARACTERISTIC BCF_SofTcPred_P /end REF_CHARACTERISTIC /end GROUP
/begin GROUP S701_BCF_Wbz_M "swc_BatCoreFct/BCF_100ms_sys/BatCoreFct/PackStateClcn/PackSofClcn/Pack Min Max Voltage Prediction/Module Min Max Voltage Prediction/SOF Actual/Measurement Equation hfun/BCF_Wbz_M" /begin REF_CHARACTERISTIC BCF_Wbz_M /end REF_CHARACTERISTIC /end GROUP
/begin GROUP S701_BCF_WbzFac_P "swc_BatCoreFct/BCF_100ms_sys/BatCoreFct/PackStateClcn/PackSofClcn/Pack Min Max Voltage Prediction/Module Min Max Voltage Prediction/SOF Actual/Measurement Equation hfun/BCF_WbzFac_P" /begin REF_CHARACTERISTIC BCF_WbzFac_P /end REF_CHARACTERISTIC /end GROUP
/begin GROUP S717_BCF_SofTcPred_P "swc_BatCoreFct/BCF_100ms_sys/BatCoreFct/PackStateClcn/PackSofClcn/Pack Min Max Voltage Prediction/Module Min Max Voltage Prediction/SOF Pred/ Process Equation, ffun/BCF_SofTcPred_P" /begin REF_CHARACTERISTIC BCF_SofTcPred_P /end REF_CHARACTERISTIC /end GROUP
/begin GROUP S718_BCF_Wbz_M "swc_BatCoreFct/BCF_100ms_sys/BatCoreFct/PackStateClcn/PackSofClcn/Pack Min Max Voltage Prediction/Module Min Max Voltage Prediction/SOF Pred/Measurement Equation hfun/BCF_Wbz_M" /begin REF_CHARACTERISTIC BCF_Wbz_M /end REF_CHARACTERISTIC /end GROUP
/begin GROUP S718_BCF_WbzFac_P "swc_BatCoreFct/BCF_100ms_sys/BatCoreFct/PackStateClcn/PackSofClcn/Pack Min Max Voltage Prediction/Module Min Max Voltage Prediction/SOF Pred/Measurement Equation hfun/BCF_WbzFac_P" /begin REF_CHARACTERISTIC BCF_WbzFac_P /end REF_CHARACTERISTIC /end GROUP
/begin GROUP S761_BCF_InvldMdlFacForRDelta_P "swc_BatCoreFct/BCF_100ms_sys/BatCoreFct/PackStateClcn/PackSohClcn/SohRDelta Calculation/Error//Heal Detection/ErrorHealEvaluation/BCF_InvldMdlFacForRDelta_P" /begin REF_CHARACTERISTIC BCF_InvldMdlFacForRDelta_P /end REF_CHARACTERISTIC /end GROUP
/begin GROUP S761_BCF_SohErrLimForRDelta_M "swc_BatCoreFct/BCF_100ms_sys/BatCoreFct/PackStateClcn/PackSohClcn/SohRDelta Calculation/Error//Heal Detection/ErrorHealEvaluation/BCF_SohErrLimForRDelta_M" /begin REF_CHARACTERISTIC BCF_SohErrLimForRDelta_M /end REF_CHARACTERISTIC /end GROUP
/begin GROUP S761_BCF_SohRCellCorrnFac_M "swc_BatCoreFct/BCF_100ms_sys/BatCoreFct/PackStateClcn/PackSohClcn/SohRDelta Calculation/Error//Heal Detection/ErrorHealEvaluation/BCF_SohRCellCorrnFac_M" /begin REF_CHARACTERISTIC BCF_SohRCellCorrnFac_M /end REF_CHARACTERISTIC /end GROUP
/begin GROUP S777_BCF_ErrSohSocCellDelta_M "swc_BatCoreFct/BCF_100ms_sys/BatCoreFct/PackStateClcn/PackSohClcn/SohSocDelta Calculation/Error//Heal Detection/ErrorHealEvaluation/BCF_ErrSohSocCellDelta_M" /begin REF_CHARACTERISTIC BCF_ErrSohSocCellDelta_M /end REF_CHARACTERISTIC /end GROUP
/begin GROUP S777_BCF_InvldMdlFacForSocDelta_P "swc_BatCoreFct/BCF_100ms_sys/BatCoreFct/PackStateClcn/PackSohClcn/SohSocDelta Calculation/Error//Heal Detection/ErrorHealEvaluation/BCF_InvldMdlFacForSocDelta_P" /begin REF_CHARACTERISTIC BCF_InvldMdlFacForSocDelta_P /end REF_CHARACTERISTIC /end GROUP
/begin GROUP S777_BCF_SohSocCellCorrnFac_M "swc_BatCoreFct/BCF_100ms_sys/BatCoreFct/PackStateClcn/PackSohClcn/SohSocDelta Calculation/Error//Heal Detection/ErrorHealEvaluation/BCF_SohSocCellCorrnFac_M" /begin REF_CHARACTERISTIC BCF_SohSocCellCorrnFac_M /end REF_CHARACTERISTIC /end GROUP
/begin GROUP S82_BitSelect1 "swc_CtctrTranCtl/CtcrtTranCtl_sys/CtcrtTranCtl/Subsystem/BitSelect1" /begin REF_CHARACTERISTIC CTC_Csw1_P /end REF_CHARACTERISTIC /end GROUP
/begin GROUP S82_BitSelect11 "swc_CtctrTranCtl/CtcrtTranCtl_sys/CtcrtTranCtl/Subsystem/BitSelect11" /begin REF_CHARACTERISTIC CTC_Csw1_P /end REF_CHARACTERISTIC /end GROUP
/begin GROUP S82_BitSelect12 "swc_CtctrTranCtl/CtcrtTranCtl_sys/CtcrtTranCtl/Subsystem/BitSelect12" /begin REF_CHARACTERISTIC CTC_Csw1_P /end REF_CHARACTERISTIC /end GROUP
/begin GROUP S82_BitSelect13 "swc_CtctrTranCtl/CtcrtTranCtl_sys/CtcrtTranCtl/Subsystem/BitSelect13" /begin REF_CHARACTERISTIC CTC_Csw1_P /end REF_CHARACTERISTIC /end GROUP
/begin GROUP S82_BitSelect14 "swc_CtctrTranCtl/CtcrtTranCtl_sys/CtcrtTranCtl/Subsystem/BitSelect14" /begin REF_CHARACTERISTIC CTC_Csw1_P /end REF_CHARACTERISTIC /end GROUP
/begin GROUP S82_BitSelect15 "swc_CtctrTranCtl/CtcrtTranCtl_sys/CtcrtTranCtl/Subsystem/BitSelect15" /begin REF_CHARACTERISTIC CTC_Csw1_P /end REF_CHARACTERISTIC /end GROUP
/begin GROUP S82_BitSelect16 "swc_CtctrTranCtl/CtcrtTranCtl_sys/CtcrtTranCtl/Subsystem/BitSelect16" /begin REF_CHARACTERISTIC CTC_Csw1_P /end REF_CHARACTERISTIC /end GROUP
/begin GROUP S82_BitSelect17 "swc_CtctrTranCtl/CtcrtTranCtl_sys/CtcrtTranCtl/Subsystem/BitSelect17" /begin REF_CHARACTERISTIC CTC_Csw1_P /end REF_CHARACTERISTIC /end GROUP
/begin GROUP S82_BitSelect2 "swc_CtctrTranCtl/CtcrtTranCtl_sys/CtcrtTranCtl/Subsystem/BitSelect2" /begin REF_CHARACTERISTIC CTC_Csw1_P /end REF_CHARACTERISTIC /end GROUP
/begin GROUP S82_BitSelect21 "swc_CtctrTranCtl/CtcrtTranCtl_sys/CtcrtTranCtl/Subsystem/BitSelect21" /begin REF_CHARACTERISTIC CTC_Csw1_P /end REF_CHARACTERISTIC /end GROUP
/begin GROUP S82_BitSelect3 "swc_CtctrTranCtl/CtcrtTranCtl_sys/CtcrtTranCtl/Subsystem/BitSelect3" /begin REF_CHARACTERISTIC CTC_Csw1_P /end REF_CHARACTERISTIC /end GROUP
/begin GROUP S82_BitSelect4 "swc_CtctrTranCtl/CtcrtTranCtl_sys/CtcrtTranCtl/Subsystem/BitSelect4" /begin REF_CHARACTERISTIC CTC_Csw1_P /end REF_CHARACTERISTIC /end GROUP
/begin GROUP S82_BitSelect5 "swc_CtctrTranCtl/CtcrtTranCtl_sys/CtcrtTranCtl/Subsystem/BitSelect5" /begin REF_CHARACTERISTIC CTC_Csw1_P /end REF_CHARACTERISTIC /end GROUP
/begin GROUP S82_BitSelect6 "swc_CtctrTranCtl/CtcrtTranCtl_sys/CtcrtTranCtl/Subsystem/BitSelect6" /begin REF_CHARACTERISTIC CTC_Csw1_P /end REF_CHARACTERISTIC /end GROUP
/begin GROUP S82_BitSelect7 "swc_CtctrTranCtl/CtcrtTranCtl_sys/CtcrtTranCtl/Subsystem/BitSelect7" /begin REF_CHARACTERISTIC CTC_Csw1_P /end REF_CHARACTERISTIC /end GROUP
/begin GROUP S82_BitSelect8 "swc_CtctrTranCtl/CtcrtTranCtl_sys/CtcrtTranCtl/Subsystem/BitSelect8" /begin REF_CHARACTERISTIC CTC_Csw1_P /end REF_CHARACTERISTIC /end GROUP
/begin GROUP S82_BitSelect9 "swc_CtctrTranCtl/CtcrtTranCtl_sys/CtcrtTranCtl/Subsystem/BitSelect9" /begin REF_CHARACTERISTIC CTC_Csw1_P /end REF_CHARACTERISTIC /end GROUP
/begin RECORD_LAYOUT Lookup1D_FLOAT32_IEEE FNC_VALUES 1 FLOAT32_IEEE COLUMN_DIR DIRECT /end RECORD_LAYOUT
/begin RECORD_LAYOUT Lookup1D_X_FLOAT32_IEEE AXIS_PTS_X 1 FLOAT32_IEEE INDEX_INCR DIRECT /end RECORD_LAYOUT
/begin RECORD_LAYOUT Lookup2D_FLOAT32_IEEE FNC_VALUES 1 FLOAT32_IEEE COLUMN_DIR DIRECT /end RECORD_LAYOUT
/begin RECORD_LAYOUT Lookup2D_X_FLOAT32_IEEE AXIS_PTS_X 1 FLOAT32_IEEE INDEX_INCR DIRECT /end RECORD_LAYOUT
/begin RECORD_LAYOUT Scalar_BOOLEAN FNC_VALUES 1 UBYTE COLUMN_DIR DIRECT /end RECORD_LAYOUT
/begin RECORD_LAYOUT Scalar_BYTE FNC_VALUES 1 SBYTE COLUMN_DIR DIRECT /end RECORD_LAYOUT
/begin RECORD_LAYOUT Scalar_FLOAT32_IEEE FNC_VALUES 1 FLOAT32_IEEE COLUMN_DIR DIRECT /end RECORD_LAYOUT
/begin RECORD_LAYOUT Scalar_SWORD FNC_VALUES 1 SWORD COLUMN_DIR DIRECT /end RECORD_LAYOUT
/begin RECORD_LAYOUT Scalar_UBYTE FNC_VALUES 1 UBYTE COLUMN_DIR DIRECT /end RECORD_LAYOUT
/begin RECORD_LAYOUT Scalar_ULONG FNC_VALUES 1 ULONG COLUMN_DIR DIRECT /end RECORD_LAYOUT
/begin RECORD_LAYOUT Scalar_UWORD FNC_VALUES 1 UWORD COLUMN_DIR DIRECT /end RECORD_LAYOUT
/begin RECORD_LAYOUT __FLOAT32_IEEE_Z FNC_VALUES 1 FLOAT32_IEEE ROW_DIR DIRECT /end RECORD_LAYOUT
/begin RECORD_LAYOUT __FLOAT64_IEEE_Z FNC_VALUES 1 FLOAT64_IEEE ROW_DIR DIRECT /end RECORD_LAYOUT
/begin RECORD_LAYOUT __UBYTE_S FNC_VALUES 1 UBYTE COLUMN_DIR DIRECT /end RECORD_LAYOUT
/begin RECORD_LAYOUT __UWORD_S FNC_VALUES 1 UWORD COLUMN_DIR DIRECT /end RECORD_LAYOUT
/begin RECORD_LAYOUT __ULONG_S FNC_VALUES 1 ULONG COLUMN_DIR DIRECT /end RECORD_LAYOUT
/begin RECORD_LAYOUT __SBYTE_S FNC_VALUES 1 SBYTE COLUMN_DIR DIRECT /end RECORD_LAYOUT
/begin RECORD_LAYOUT __SWORD_S FNC_VALUES 1 SWORD COLUMN_DIR DIRECT /end RECORD_LAYOUT
/begin RECORD_LAYOUT __SLONG_S FNC_VALUES 1 SLONG COLUMN_DIR DIRECT /end RECORD_LAYOUT
/begin RECORD_LAYOUT __FLOAT32_IEEE_S FNC_VALUES 1 FLOAT32_IEEE COLUMN_DIR DIRECT /end RECORD_LAYOUT
/begin RECORD_LAYOUT __FLOAT64_IEEE_S FNC_VALUES 1 FLOAT64_IEEE COLUMN_DIR DIRECT /end RECORD_LAYOUT
/end MODULE
/end PROJECT
