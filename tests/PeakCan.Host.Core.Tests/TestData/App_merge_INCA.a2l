ASAP2_VERSION 1 40
/begin PROJECT ProjectName "Project Comment Goes Here"
/begin HEADER "Header Comments go here" /end HEADER
/begin MODULE ModuleName "Module Comment Goes Here"
/begin MOD_COMMON "Mod Common Comment Here" BYTE_ORDER MSB_LAST ALIGNMENT_BYTE 1 ALIGNMENT_WORD 1 ALIGNMENT_LONG 1 ALIGNMENT_FLOAT32_IEEE 1 ALIGNMENT_FLOAT64_IEEE 1 /end MOD_COMMON
/begin COMPU_METHOD swc_BatBalnCtl_CM_boolean_dash_ "Q = V" RAT_FUNC "%1.0" "-" COEFFS 0 1 0 0 0 1 /end COMPU_METHOD
/begin COMPU_METHOD swc_BatBalnCtl_CM_single_A "Q = V" RAT_FUNC "%8.6" "A" COEFFS 0 1 0 0 0 1 /end COMPU_METHOD
/begin COMPU_METHOD swc_BatBalnCtl_CM_single_dash_ "Q = V" RAT_FUNC "%8.6" "-" COEFFS 0 1 0 0 0 1 /end COMPU_METHOD
/begin COMPU_METHOD swc_BatBalnCtl_CM_uint16_dash_ "Q = V" RAT_FUNC "%5.0" "-" COEFFS 0 1 0 0 0 1 /end COMPU_METHOD
/begin COMPU_METHOD swc_BatBalnCtl_CM_uint32_dash_ "Q = V" RAT_FUNC "%10.0" "-" COEFFS 0 1 0 0 0 1 /end COMPU_METHOD
/begin COMPU_METHOD swc_BatBalnCtl_CM_uint8_dash_ "Q = V" RAT_FUNC "%3.0" "-" COEFFS 0 1 0 0 0 1 /end COMPU_METHOD
/begin COMPU_METHOD swc_BatChCtl_CM_boolean_dash_ "Q = V" RAT_FUNC "%1.0" "-" COEFFS 0 1 0 0 0 1 /end COMPU_METHOD
/begin COMPU_METHOD swc_BatChCtl_CM_single_A "Q = V" RAT_FUNC "%8.6" "A" COEFFS 0 1 0 0 0 1 /end COMPU_METHOD
/begin COMPU_METHOD swc_BatChCtl_CM_single_h "Q = V" RAT_FUNC "%8.6" "h" COEFFS 0 1 0 0 0 1 /end COMPU_METHOD
/begin COMPU_METHOD swc_BatChCtl_CM_single_min "Q = V" RAT_FUNC "%8.6" "min" COEFFS 0 1 0 0 0 1 /end COMPU_METHOD
/begin COMPU_METHOD swc_BatChCtl_CM_single_V "Q = V" RAT_FUNC "%8.6" "V" COEFFS 0 1 0 0 0 1 /end COMPU_METHOD
/begin COMPU_METHOD swc_BatChCtl_CM_uint16_dash_ "Q = V" RAT_FUNC "%5.0" "-" COEFFS 0 1 0 0 0 1 /end COMPU_METHOD
/begin COMPU_METHOD swc_BatChCtl_CM_uint32_dash_ "Q = V" RAT_FUNC "%10.0" "-" COEFFS 0 1 0 0 0 1 /end COMPU_METHOD
/begin COMPU_METHOD swc_BatChCtl_CM_uint8_dash_ "Q = V" RAT_FUNC "%3.0" "-" COEFFS 0 1 0 0 0 1 /end COMPU_METHOD
/begin COMPU_METHOD swc_BatCoreFct_CM_boolean_dash_ "Q = V" RAT_FUNC "%1.0" "-" COEFFS 0 1 0 0 0 1 /end COMPU_METHOD
/begin COMPU_METHOD swc_BatCoreFct_CM_int16_dash_ "Q = V" RAT_FUNC "%5.0" "-" COEFFS 0 1 0 0 0 1 /end COMPU_METHOD
/begin COMPU_METHOD swc_BatCoreFct_CM_single__ "Q = V" RAT_FUNC "%8.6" "癈" COEFFS 0 1 0 0 0 1 /end COMPU_METHOD
/begin COMPU_METHOD swc_BatCoreFct_CM_single_A "Q = V" RAT_FUNC "%8.6" "A" COEFFS 0 1 0 0 0 1 /end COMPU_METHOD
/begin COMPU_METHOD swc_BatCoreFct_CM_single_Ah "Q = V" RAT_FUNC "%8.6" "Ah" COEFFS 0 1 0 0 0 1 /end COMPU_METHOD
/begin COMPU_METHOD swc_BatCoreFct_CM_single_dash_ "Q = V" RAT_FUNC "%8.6" "-" COEFFS 0 1 0 0 0 1 /end COMPU_METHOD
/begin COMPU_METHOD swc_BatCoreFct_CM_single_kW "Q = V" RAT_FUNC "%8.6" "kW" COEFFS 0 1 0 0 0 1 /end COMPU_METHOD
/begin COMPU_METHOD swc_BatCoreFct_CM_single_Ohm "Q = V" RAT_FUNC "%8.6" "Ohm" COEFFS 0 1 0 0 0 1 /end COMPU_METHOD
/begin COMPU_METHOD swc_BatCoreFct_CM_single_s "Q = V" RAT_FUNC "%8.6" "s" COEFFS 0 1 0 0 0 1 /end COMPU_METHOD
/begin COMPU_METHOD swc_BatCoreFct_CM_single_seconds "Q = V" RAT_FUNC "%8.6" "seconds" COEFFS 0 1 0 0 0 1 /end COMPU_METHOD
/begin COMPU_METHOD swc_BatCoreFct_CM_single_V "Q = V" RAT_FUNC "%8.6" "V" COEFFS 0 1 0 0 0 1 /end COMPU_METHOD
/begin COMPU_METHOD swc_BatCoreFct_CM_single_V_per_s "Q = V" RAT_FUNC "%8.6" "V/s" COEFFS 0 1 0 0 0 1 /end COMPU_METHOD
/begin COMPU_METHOD swc_BatCoreFct_CM_single_W "Q = V" RAT_FUNC "%8.6" "W" COEFFS 0 1 0 0 0 1 /end COMPU_METHOD
/begin COMPU_METHOD swc_BatCoreFct_CM_uint32_dash_ "Q = V" RAT_FUNC "%10.0" "-" COEFFS 0 1 0 0 0 1 /end COMPU_METHOD
/begin COMPU_METHOD swc_BatCoreFct_CM_uint32_s "Q = V" RAT_FUNC "%10.0" "s" COEFFS 0 1 0 0 0 1 /end COMPU_METHOD
/begin COMPU_METHOD swc_BatCoreFct_CM_uint8_dash_ "Q = V" RAT_FUNC "%3.0" "-" COEFFS 0 1 0 0 0 1 /end COMPU_METHOD
/begin COMPU_METHOD swc_BatProtnIU_CM_single_dash_ "Q = V" RAT_FUNC "%8.6" "-" COEFFS 0 1 0 0 0 1 /end COMPU_METHOD
/begin COMPU_METHOD swc_BatThermHndlgMngt_CM_single_dash_ "Q = V" RAT_FUNC "%8.6" "-" COEFFS 0 1 0 0 0 1 /end COMPU_METHOD
/begin COMPU_METHOD swc_BatWntyLogtcData_CM_boolean_dash_ "Q = V" RAT_FUNC "%1.0" "-" COEFFS 0 1 0 0 0 1 /end COMPU_METHOD
/begin COMPU_METHOD swc_BatWntyLogtcData_CM_single_A "Q = V" RAT_FUNC "%8.6" "A" COEFFS 0 1 0 0 0 1 /end COMPU_METHOD
/begin COMPU_METHOD swc_BatWntyLogtcData_CM_single_kWh "Q = V" RAT_FUNC "%8.6" "kWh" COEFFS 0 1 0 0 0 1 /end COMPU_METHOD
/begin COMPU_METHOD swc_BcuStTranCtl_CM_single_s "Q = V" RAT_FUNC "%8.6" "s" COEFFS 0 1 0 0 0 1 /end COMPU_METHOD
/begin COMPU_METHOD swc_BcuStTranCtl_CM_uint8_dash_ "Q = V" RAT_FUNC "%3.0" "-" COEFFS 0 1 0 0 0 1 /end COMPU_METHOD
/begin COMPU_METHOD swc_CtctrTranCtl_CM_boolean_dash_ "Q = V" RAT_FUNC "%1.0" "-" COEFFS 0 1 0 0 0 1 /end COMPU_METHOD
/begin COMPU_METHOD swc_CtctrTranCtl_CM_single_dash_ "Q = V" RAT_FUNC "%8.6" "-" COEFFS 0 1 0 0 0 1 /end COMPU_METHOD
/begin COMPU_METHOD swc_CtctrTranCtl_CM_single_percent_ "Q = V" RAT_FUNC "%8.6" "%" COEFFS 0 1 0 0 0 1 /end COMPU_METHOD
/begin COMPU_METHOD swc_CtctrTranCtl_CM_single_s "Q = V" RAT_FUNC "%8.6" "s" COEFFS 0 1 0 0 0 1 /end COMPU_METHOD
/begin COMPU_METHOD swc_CtctrTranCtl_CM_single_V "Q = V" RAT_FUNC "%8.6" "V" COEFFS 0 1 0 0 0 1 /end COMPU_METHOD
/begin COMPU_METHOD swc_CtctrTranCtl_CM_uint32_dash_ "Q = V" RAT_FUNC "%10.0" "-" COEFFS 0 1 0 0 0 1 /end COMPU_METHOD
/begin COMPU_METHOD swc_CtctrTranCtl_CM_uint8_A "Q = V" RAT_FUNC "%3.0" "A" COEFFS 0 1 0 0 0 1 /end COMPU_METHOD
/begin COMPU_METHOD swc_CtctrTranCtl_CM_uint8_dash_ "Q = V" RAT_FUNC "%3.0" "-" COEFFS 0 1 0 0 0 1 /end COMPU_METHOD
/begin COMPU_METHOD swc_EltlLnkHzrdProtnNet_CM_single_s "Q = V" RAT_FUNC "%8.6" "s" COEFFS 0 1 0 0 0 1 /end COMPU_METHOD
/begin COMPU_METHOD swc_EltlLnkHzrdProtnNet_CM_uint16_Ohm_per_V "Q = V" RAT_FUNC "%5.0" "Ohm/V" COEFFS 0 1 0 0 0 1 /end COMPU_METHOD
/begin COMPU_METHOD swc_EltlLnkHzrdProtnNet_CM_uint32_kOhm "Q = V" RAT_FUNC "%10.0" "kOhm" COEFFS 0 1 0 0 0 1 /end COMPU_METHOD
/begin COMPU_METHOD swc_EltlLnkHzrdProtnNet_CM_uint8_dash_ "Q = V" RAT_FUNC "%3.0" "-" COEFFS 0 1 0 0 0 1 /end COMPU_METHOD
/begin MEASUREMENT BBC_AcvCellReqSrc "Logical Array for active source cells requested" UWORD swc_BatBalnCtl_CM_uint16_dash_ 0 0 0 65535 ECU_ADDRESS 0x1FFE3700 MATRIX_DIM 24 1 1 /end MEASUREMENT
/begin MEASUREMENT BBC_AcvCellReqTgt "Logical Array for active target cells" UWORD swc_BatBalnCtl_CM_uint16_dash_ 0 0 0 65535 ECU_ADDRESS 0x1FFE3730 MATRIX_DIM 24 1 1 /end MEASUREMENT
/begin MEASUREMENT BBC_AcvCellSrcReqdOutp "Logical Array for active source cells requested - value." ULONG swc_BatBalnCtl_CM_uint32_dash_ 0 0 0 4294967295 ECU_ADDRESS 0x1FFE37C0 MATRIX_DIM 24 1 1 /end MEASUREMENT
/begin MEASUREMENT BBC_AcvCellTgtReqdOutp "Logical Array for active target cells - value." UWORD swc_BatBalnCtl_CM_uint16_dash_ 0 0 0 65535 ECU_ADDRESS 0x1FFE3760 MATRIX_DIM 24 1 1 /end MEASUREMENT
/begin MEASUREMENT BBC_CtrBalnReqdOutp "Requested Balancing Count Events - value." UWORD swc_BatBalnCtl_CM_uint16_dash_ 0 0 0 65535 ECU_ADDRESS 0x1FFE3790 MATRIX_DIM 24 1 1 /end MEASUREMENT
/begin MEASUREMENT BBC_ICellBaln "Balancing current on each cell" FLOAT32_IEEE swc_BatBalnCtl_CM_single_A 0 0 -3.40282346639e+038 3.40282346639e+038 ECU_ADDRESS 0x1FFE3824 MATRIX_DIM 255 1 1 /end MEASUREMENT
/begin CHARACTERISTIC BBC_NrBalnCtMax_P "Number of maximum possible counts of balancing pulses (used for scaling the voltage compensation and balancing current maps)" VALUE 0x200186D0 Scalar_FLOAT32_IEEE 0 swc_BatBalnCtl_CM_single_dash_ -10000 10000 /end CHARACTERISTIC
/begin MEASUREMENT BBC_NrMdulReqSrc "Balancing Energy Source Module Number requested" UBYTE swc_BatBalnCtl_CM_uint8_dash_ 0 0 0 255 ECU_ADDRESS 0x1FFE4084 MATRIX_DIM 24 1 1 /end MEASUREMENT
/begin MEASUREMENT BBC_NrMdulReqTgt "Balancing Energy Target Module Number requested" UBYTE swc_BatBalnCtl_CM_uint8_dash_ 0 0 0 255 ECU_ADDRESS 0x1FFE409C MATRIX_DIM 24 1 1 /end MEASUREMENT
/begin MEASUREMENT BBC_NrMdulSrcReqdOutp "Balancing Energy Source Module Number requested - value." UBYTE swc_BatBalnCtl_CM_uint8_dash_ 0 0 0 255 ECU_ADDRESS 0x1FFE40B4 MATRIX_DIM 24 1 1 /end MEASUREMENT
/begin MEASUREMENT BBC_NrMdulTgtReqdOutp "Balancing Energy Target Module Number requested - value." UBYTE swc_BatBalnCtl_CM_uint8_dash_ 0 0 0 255 ECU_ADDRESS 0x1FFE40CC MATRIX_DIM 24 1 1 /end MEASUREMENT
/begin CHARACTERISTIC BBC_SocChBalnModeOffThd_M "Charging mode Balancing OFF threshold that depends on pack SOC" CURVE 0x20018704 Lookup1D_FLOAT32_IEEE 0 swc_BatBalnCtl_CM_single_dash_ -10000 10000
 /begin AXIS_DESCR COM_AXIS NO_INPUT_QUANTITY swc_BatBalnCtl_CM_single_dash_ 11 -10000 10000 DEPOSIT ABSOLUTE AXIS_PTS_REF BBC_SocPack_A /end AXIS_DESCR
/end CHARACTERISTIC
/begin CHARACTERISTIC BBC_SocChBalnModeOnThd_M "Charging mode Balancing ON threshold that depends on pack SOC" CURVE 0x20018730 Lookup1D_FLOAT32_IEEE 0 swc_BatBalnCtl_CM_single_dash_ -10000 10000
 /begin AXIS_DESCR COM_AXIS NO_INPUT_QUANTITY swc_BatBalnCtl_CM_single_dash_ 11 -10000 10000 DEPOSIT ABSOLUTE AXIS_PTS_REF BBC_SocPack_A /end AXIS_DESCR
/end CHARACTERISTIC
/begin CHARACTERISTIC BBC_SocDcnctBalnModeOffThd_M "offline mode Balancing OFF threshold that depends on pack SOC" CURVE 0x2001875C Lookup1D_FLOAT32_IEEE 0 swc_BatBalnCtl_CM_single_dash_ -10000 10000
 /begin AXIS_DESCR COM_AXIS NO_INPUT_QUANTITY swc_BatBalnCtl_CM_single_dash_ 11 -10000 10000 DEPOSIT ABSOLUTE AXIS_PTS_REF BBC_SocPack_A /end AXIS_DESCR
/end CHARACTERISTIC
/begin CHARACTERISTIC BBC_SocDcnctBalnModeOnThd_M "Offline mode Balancing ON threshold that depends on pack SOC" CURVE 0x20018788 Lookup1D_FLOAT32_IEEE 0 swc_BatBalnCtl_CM_single_dash_ -10000 10000
 /begin AXIS_DESCR COM_AXIS NO_INPUT_QUANTITY swc_BatBalnCtl_CM_single_dash_ 11 -10000 10000 DEPOSIT ABSOLUTE AXIS_PTS_REF BBC_SocPack_A /end AXIS_DESCR
/end CHARACTERISTIC
/begin CHARACTERISTIC BBC_SocDrvgBalnModeOffThd_M "Driving mode Balancing OFF threshold that depends on pack SOC" CURVE 0x200187B4 Lookup1D_FLOAT32_IEEE 0 swc_BatBalnCtl_CM_single_dash_ -10000 10000
 /begin AXIS_DESCR COM_AXIS NO_INPUT_QUANTITY swc_BatBalnCtl_CM_single_dash_ 11 -10000 10000 DEPOSIT ABSOLUTE AXIS_PTS_REF BBC_SocPack_A /end AXIS_DESCR
/end CHARACTERISTIC
/begin CHARACTERISTIC BBC_SocDrvgBalnModeOnThd_M "Driving mode Balancing ON threshold that depends on pack SOC" CURVE 0x200187E0 Lookup1D_FLOAT32_IEEE 0 swc_BatBalnCtl_CM_single_dash_ -10000 10000
 /begin AXIS_DESCR COM_AXIS NO_INPUT_QUANTITY swc_BatBalnCtl_CM_single_dash_ 11 -10000 10000 DEPOSIT ABSOLUTE AXIS_PTS_REF BBC_SocPack_A /end AXIS_DESCR
/end CHARACTERISTIC
/begin AXIS_PTS BBC_SocPack_A "Pack SOC" 0x2001880C NO_INPUT_QUANTITY Lookup1D_X_FLOAT32_IEEE 0 swc_BatBalnCtl_CM_single_dash_ 11 -10000 10000 DEPOSIT ABSOLUTE /end AXIS_PTS
/begin MEASUREMENT BBC_bAcvBaln "Indicates whether balancing is active or not." UBYTE swc_BatBalnCtl_CM_boolean_dash_ 0 0 0 1 ECU_ADDRESS 0x1FFE7551 /end MEASUREMENT
/begin MEASUREMENT BBC_bAcvMdulBaln "Balancing active flag per module" UBYTE swc_BatBalnCtl_CM_boolean_dash_ 0 0 0 1 ECU_ADDRESS 0x1FFE40FC MATRIX_DIM 24 1 1 /end MEASUREMENT
/begin MEASUREMENT BCC_AcvCellURchd "BMS charging suspension reason: Cell voltage reached" UBYTE swc_BatChCtl_CM_uint8_dash_ 0 0 0 255 ECU_ADDRESS 0x1FFE751C /end MEASUREMENT
/begin MEASUREMENT BCC_AcvSocRchd "BMS charging suspension reason: SOC target reached" UBYTE swc_BatChCtl_CM_uint8_dash_ 0 0 0 255 ECU_ADDRESS 0x1FFE751D /end MEASUREMENT
/begin MEASUREMENT BCC_AcvUTotRchd "BMS charging suspension reason: Total voltage reached" UBYTE swc_BatChCtl_CM_uint8_dash_ 0 0 0 255 ECU_ADDRESS 0x1FFE751E /end MEASUREMENT
/begin MEASUREMENT BCC_ErrInfo "diagnosis for charge" ULONG swc_BatChCtl_CM_uint32_dash_ 0 0 0 4294967295 ECU_ADDRESS 0x1FFE36C0 /end MEASUREMENT
/begin MEASUREMENT BCC_IChReq "Charging Current Request" FLOAT32_IEEE swc_BatChCtl_CM_single_A 0 0 -3.40282346639e+038 3.40282346639e+038 ECU_ADDRESS 0x1FFE36C4 /end MEASUREMENT
/begin MEASUREMENT BCC_IChReqIRV "charge current request" FLOAT32_IEEE swc_BatChCtl_CM_single_A 0 0 -3.40282346639e+038 3.40282346639e+038 ECU_ADDRESS 0x1FFE36C8 /end MEASUREMENT
/begin MEASUREMENT BCC_IDchaReq "discharge current request" FLOAT32_IEEE swc_BatChCtl_CM_single_A 0 0 -3.40282346639e+038 3.40282346639e+038 ECU_ADDRESS 0x1FFE36CC /end MEASUREMENT
/begin MEASUREMENT BCC_IDchaReqIRV "discharge current request" FLOAT32_IEEE swc_BatChCtl_CM_single_A 0 0 -3.40282346639e+038 3.40282346639e+038 ECU_ADDRESS 0x1FFE36D0 /end MEASUREMENT
/begin MEASUREMENT BCC_IObcLimn "AC charge current limitation to obc" FLOAT32_IEEE swc_BatChCtl_CM_single_A 0 0 -3.40282346639e+038 3.40282346639e+038 ECU_ADDRESS 0x1FFE36D4 /end MEASUREMENT
/begin MEASUREMENT BCC_ModeCh "Charge Mode: 0x1: AC charge 0x2:DC Charge 0x3: Other Charge" UBYTE swc_BatChCtl_CM_uint8_dash_ 0 0 0 255 ECU_ADDRESS 0x1FFE751F /end MEASUREMENT
/begin MEASUREMENT BCC_StAcChReq "AC charge request to obc" UBYTE swc_BatChCtl_CM_uint8_dash_ 0 0 0 255 ECU_ADDRESS 0x1FFE7520 /end MEASUREMENT
/begin MEASUREMENT BCC_StAcSys "AC charge system state" UBYTE swc_BatChCtl_CM_uint8_dash_ 0 0 0 255 ECU_ADDRESS 0x1FFE7521 /end MEASUREMENT
/begin MEASUREMENT BCC_StAcSysIRV "AC charge system state" UBYTE swc_BatChCtl_CM_uint8_dash_ 0 0 0 255 ECU_ADDRESS 0x1FFE7522 /end MEASUREMENT
/begin MEASUREMENT BCC_StCh "0x0: Default\n      0x1: Charging\n      0x2: Charge end\n      0x3: Error Charge Stop\n      0x4: Heating\n      0x5: Cooling\n      0x6: Charge Pause\n      0x7: Other Charge Stop\n      0x8-0xF: Reserved;" UBYTE swc_BatChCtl_CM_uint8_dash_ 0 0 0 255 ECU_ADDRESS 0x1FFE7523 /end MEASUREMENT
/begin MEASUREMENT BCC_StChAllwdDigIRV "Flag fo charge allowed dignosis " UBYTE swc_BatChCtl_CM_boolean_dash_ 0 0 0 1 ECU_ADDRESS 0x1FFE7532 /end MEASUREMENT
/begin MEASUREMENT BCC_StChCnctDigIRV "Flag for charger connect dignosis " UBYTE swc_BatChCtl_CM_boolean_dash_ 0 0 0 1 ECU_ADDRESS 0x1FFE7533 /end MEASUREMENT
/begin MEASUREMENT BCC_StDig10IRV "state for diagnosis 10" UBYTE swc_BatChCtl_CM_boolean_dash_ 0 0 0 1 ECU_ADDRESS 0x1FFE7534 /end MEASUREMENT
/begin MEASUREMENT BCC_StDig53IRV "Flag for 53 dignosis " UBYTE swc_BatChCtl_CM_boolean_dash_ 0 0 0 1 ECU_ADDRESS 0x1FFE7535 /end MEASUREMENT
/begin MEASUREMENT BCC_StDig71IRV "Flag for 71 dignosis " UBYTE swc_BatChCtl_CM_boolean_dash_ 0 0 0 1 ECU_ADDRESS 0x1FFE7536 /end MEASUREMENT
/begin MEASUREMENT BCC_StDig73IRV "Flag for 73 dignosis " UBYTE swc_BatChCtl_CM_boolean_dash_ 0 0 0 1 ECU_ADDRESS 0x1FFE7537 /end MEASUREMENT
/begin MEASUREMENT BCC_StPwrUpDigIRV "Flag for powerup dignosis " UBYTE swc_BatChCtl_CM_boolean_dash_ 0 0 0 1 ECU_ADDRESS 0x1FFE7538 /end MEASUREMENT
/begin MEASUREMENT BCC_UChReq "Charging Voltage Request" FLOAT32_IEEE swc_BatChCtl_CM_single_V 0 0 0 2000 ECU_ADDRESS 0x1FFE36D8 /end MEASUREMENT
/begin MEASUREMENT BCC_UChReqIRV "Charging Voltage Request to other runable" FLOAT32_IEEE swc_BatChCtl_CM_single_V 0 0 0 2000 ECU_ADDRESS 0x1FFE36DC /end MEASUREMENT
/begin MEASUREMENT BCC_UObcLimn "AC charge voltage limitation to obc" FLOAT32_IEEE swc_BatChCtl_CM_single_A 0 0 -3.40282346639e+038 3.40282346639e+038 ECU_ADDRESS 0x1FFE36E0 /end MEASUREMENT
/begin MEASUREMENT BCC_bAcvHvbatFull "Flag to indicate if HV battery is determined to be fully charged" UBYTE swc_BatChCtl_CM_boolean_dash_ 0 0 0 1 ECU_ADDRESS 0x1FFE7539 /end MEASUREMENT
/begin MEASUREMENT BCC_bAcvHvbatFullIRV "Flag to indicate if HV battery is determined to be fully charged to other runables" UBYTE swc_BatChCtl_CM_boolean_dash_ 0 0 0 1 ECU_ADDRESS 0x1FFE753A /end MEASUREMENT
/begin MEASUREMENT BCF_CMdulAbsv "Array of absolute module capacitance values" FLOAT32_IEEE swc_BatCoreFct_CM_single_Ah 0 0 -3.40282346639e+038 3.40282346639e+038 ECU_ADDRESS 0x200011C4 MATRIX_DIM 24 1 1 /end MEASUREMENT
/begin MEASUREMENT BCF_CMdulAgiFacFlsNv "Modules capacity ageing factor stored" FLOAT32_IEEE swc_BatCoreFct_CM_single_dash_ 0 0 -3.40282346639e+038 3.40282346639e+038 ECU_ADDRESS 0x20001284 MATRIX_DIM 24 1 1 /end MEASUREMENT
/begin CHARACTERISTIC BCF_CMdulAgiFacTest_P "CMdulDelta Ageing Factor parameter for bench testing" VAL_BLK 0x20000A0C Scalar_FLOAT32_IEEE 0 swc_BatCoreFct_CM_single_dash_ -3.40282346639e+038 3.40282346639e+038 MATRIX_DIM 24 1 1 /end CHARACTERISTIC
/begin CHARACTERISTIC BCF_CMdulAgiFacTripTest_P " Module C Trip Ageing Factor Test Parameter" VAL_BLK 0x20000A6C Scalar_FLOAT32_IEEE 0 swc_BatCoreFct_CM_single_dash_ -3.40282346639e+038 3.40282346639e+038 MATRIX_DIM 24 1 1 /end CHARACTERISTIC
/begin MEASUREMENT BCF_CMdulDeltaOfTrip "Array of module delta capacity values" FLOAT32_IEEE swc_BatCoreFct_CM_single_dash_ 0 0 -3.40282346639e+038 3.40282346639e+038 ECU_ADDRESS 0x20001344 MATRIX_DIM 24 1 1 /end MEASUREMENT
/begin AXIS_PTS BCF_CMdulDeltaOfTrip_A "Module C Delta axis of SOH based on Module C Delta Curve" 0x1FFE7F98 NO_INPUT_QUANTITY Lookup1D_X_FLOAT32_IEEE 0 swc_BatCoreFct_CM_single_dash_ 11 -3.40282346639e+038 3.40282346639e+038 DEPOSIT ABSOLUTE /end AXIS_PTS
/begin MEASUREMENT BCF_ChMdulIntglInCTest "Integrated charge to be used in Soh calculation in capacity test mode." FLOAT32_IEEE swc_BatCoreFct_CM_single_Ah 0 0 -3.40282346639e+038 3.40282346639e+038 ECU_ADDRESS 0x20001404 MATRIX_DIM 24 1 1 /end MEASUREMENT
/begin CHARACTERISTIC BCF_CoeffIChLim0_P "Battery Core Function Coefficient Current Charge Limit  Parameter" VALUE 0x20000ACC Scalar_FLOAT32_IEEE 0 swc_BatCoreFct_CM_single_dash_ -3.40282346639e+038 3.40282346639e+038 /end CHARACTERISTIC
/begin CHARACTERISTIC BCF_CoeffIChLim1_P "Battery Core Function Coefficient Current Charge Limit1 Parameter" VALUE 0x1FFE7FE4 Scalar_FLOAT32_IEEE 0 swc_BatCoreFct_CM_single_dash_ -3.40282346639e+038 3.40282346639e+038 /end CHARACTERISTIC
/begin CHARACTERISTIC BCF_CoeffIChLim2_P "Battery Core Function Coefficient Current Charge Limit2 Parameter" VALUE 0x1FFE7FE8 Scalar_FLOAT32_IEEE 0 swc_BatCoreFct_CM_single_dash_ -3.40282346639e+038 3.40282346639e+038 /end CHARACTERISTIC
/begin CHARACTERISTIC BCF_CoeffIDchaLim0_P "Battery Core Function Coefficient Current Discharge Limit Parameter" VALUE 0x20000AD0 Scalar_FLOAT32_IEEE 0 swc_BatCoreFct_CM_single_dash_ -3.40282346639e+038 3.40282346639e+038 /end CHARACTERISTIC
/begin CHARACTERISTIC BCF_CoeffIDchaLim1_P "Battery Core Function Coefficient Current Discharge Limit1 Parameter" VALUE 0x1FFE7FEC Scalar_FLOAT32_IEEE 0 swc_BatCoreFct_CM_single_dash_ -3.40282346639e+038 3.40282346639e+038 /end CHARACTERISTIC
/begin CHARACTERISTIC BCF_CoeffIDchaLim2_P "Battery Core Function Coefficient Current Discharge Limit2 Parameter" VALUE 0x1FFE7FF0 Scalar_FLOAT32_IEEE 0 swc_BatCoreFct_CM_single_dash_ -3.40282346639e+038 3.40282346639e+038 /end CHARACTERISTIC
/begin MEASUREMENT BCF_ErrInfo "Battery Core Function Enable Flag ThermalRunaway Flag" ULONG swc_BatCoreFct_CM_uint32_dash_ 0 0 0 4294967295 ECU_ADDRESS 0x20001464 /end MEASUREMENT
/begin MEASUREMENT BCF_ErrInfo1 "The difference between cell SOC and module average SOC is too large" ULONG swc_BatCoreFct_CM_uint32_dash_ 0 0 0 4294967295 ECU_ADDRESS 0x20001468 /end MEASUREMENT
/begin MEASUREMENT BCF_ErrInfo2 "Excessive difference between cell R and module average R" ULONG swc_BatCoreFct_CM_uint32_dash_ 0 0 0 4294967295 ECU_ADDRESS 0x2000146C /end MEASUREMENT
/begin MEASUREMENT BCF_ErrInfo3 "The difference between the predicted R of the module and the measured R of the module is too large" ULONG swc_BatCoreFct_CM_uint32_dash_ 0 0 0 4294967295 ECU_ADDRESS 0x20001470 /end MEASUREMENT
/begin MEASUREMENT BCF_ErrInfo4 "The difference between the measured module capacity and the predicted module capacity is too large" ULONG swc_BatCoreFct_CM_uint32_dash_ 0 0 0 4294967295 ECU_ADDRESS 0x20001474 /end MEASUREMENT
/begin MEASUREMENT BCF_ErrInfo5 "There is a large deviation between the predicted voltage of the module and the measured voltage" ULONG swc_BatCoreFct_CM_uint32_dash_ 0 0 0 4294967295 ECU_ADDRESS 0x20001478 /end MEASUREMENT
/begin MEASUREMENT BCF_ErrInfo6 "Module SOC initialization error" ULONG swc_BatCoreFct_CM_uint32_dash_ 0 0 0 4294967295 ECU_ADDRESS 0x2000147C /end MEASUREMENT
/begin CHARACTERISTIC BCF_FacSohSocCellDelta_P "Factor to scale Cell Delta SOC limits based on SOH" VALUE 0x1FFE806C Scalar_FLOAT32_IEEE 0 swc_BatCoreFct_CM_single_dash_ 0 100000000 /end CHARACTERISTIC
/begin MEASUREMENT BCF_IChActLim1 "SOF - Pack Charge Dynamic Current Limit Actual" FLOAT32_IEEE swc_BatCoreFct_CM_single_A 0 0 -3.40282346639e+038 3.40282346639e+038 ECU_ADDRESS 0x20001480 /end MEASUREMENT
/begin MEASUREMENT BCF_IChLim "SOF - Pack Charge Current Actual" FLOAT32_IEEE swc_BatCoreFct_CM_single_A 0 0 -3.40282346639e+038 3.40282346639e+038 ECU_ADDRESS 0x20001484 /end MEASUREMENT
/begin MEASUREMENT BCF_IChLimInt "SOF - Pack Charge Current Actual internal value (100ms task)." FLOAT32_IEEE swc_BatCoreFct_CM_single_A 0 0 -3.40282346639e+038 3.40282346639e+038 ECU_ADDRESS 0x20001488 /end MEASUREMENT
/begin MEASUREMENT BCF_IChLimIntIRV "SOF - Pack Charge Current Actual internal value (100ms task)." FLOAT32_IEEE swc_BatCoreFct_CM_single_dash_ 0 0 -3.40282346639e+038 3.40282346639e+038 ECU_ADDRESS 0x2000148C /end MEASUREMENT
/begin MEASUREMENT BCF_IChMax "Charge Current Absolute Maximum Value" FLOAT32_IEEE swc_BatCoreFct_CM_single_A 0 0 -3.40282346639e+038 3.40282346639e+038 ECU_ADDRESS 0x20001490 /end MEASUREMENT
/begin MEASUREMENT BCF_IChPredLim "SOF - Pack Charge Current Prediction " FLOAT32_IEEE swc_BatCoreFct_CM_single_A 0 0 -3.40282346639e+038 3.40282346639e+038 ECU_ADDRESS 0x20001494 /end MEASUREMENT
/begin MEASUREMENT BCF_IChPredLim1 "SOF - Pack Charge Dynamic Current Limit Prediction " FLOAT32_IEEE swc_BatCoreFct_CM_single_A 0 0 -3.40282346639e+038 3.40282346639e+038 ECU_ADDRESS 0x20001498 /end MEASUREMENT
/begin MEASUREMENT BCF_IChPredLimInt "SOF - Pack Charge Current Prediction internal value (100ms task)." FLOAT32_IEEE swc_BatCoreFct_CM_single_A 0 0 -3.40282346639e+038 3.40282346639e+038 ECU_ADDRESS 0x2000149C /end MEASUREMENT
/begin MEASUREMENT BCF_IChPredLimIntIRV "SOF - Pack Charge Current Prediction internal value (100ms task)." FLOAT32_IEEE swc_BatCoreFct_CM_single_dash_ 0 0 -3.40282346639e+038 3.40282346639e+038 ECU_ADDRESS 0x200014A0 /end MEASUREMENT
/begin CHARACTERISTIC BCF_IDCMDFORININOC_P "OCV initialization service mode" VALUE 0x20008A7A Scalar_UBYTE 0 swc_BatCoreFct_CM_uint8_dash_ 0 255 /end CHARACTERISTIC
/begin CHARACTERISTIC BCF_IDCMDFORSOCMAN_P "Manual SOC initialization service mode" VALUE 0x20008A7B Scalar_UBYTE 0 swc_BatCoreFct_CM_uint8_dash_ 0 255 /end CHARACTERISTIC
/begin MEASUREMENT BCF_IDchaActLim1 "SOF - Pack Discharge Dynamic Current Limit Actual" FLOAT32_IEEE swc_BatCoreFct_CM_single_A 0 0 -3.40282346639e+038 3.40282346639e+038 ECU_ADDRESS 0x200014A4 /end MEASUREMENT
/begin MEASUREMENT BCF_IDchaLim "SOF - Pack Discharge Current Actual" FLOAT32_IEEE swc_BatCoreFct_CM_single_A 0 0 -3.40282346639e+038 3.40282346639e+038 ECU_ADDRESS 0x200014A8 /end MEASUREMENT
/begin MEASUREMENT BCF_IDchaLimInt "SOF - Pack Discharge Current Actual internal value (100ms task)." FLOAT32_IEEE swc_BatCoreFct_CM_single_A 0 0 -3.40282346639e+038 3.40282346639e+038 ECU_ADDRESS 0x200014AC /end MEASUREMENT
/begin MEASUREMENT BCF_IDchaLimIntIRV "SOF - Pack Discharge Current Actual internal value (100ms task)." FLOAT32_IEEE swc_BatCoreFct_CM_single_dash_ 0 0 -3.40282346639e+038 3.40282346639e+038 ECU_ADDRESS 0x200014B0 /end MEASUREMENT
/begin MEASUREMENT BCF_IDchaMax "Discharge Current Absolute Maximum" FLOAT32_IEEE swc_BatCoreFct_CM_single_A 0 0 -3.40282346639e+038 3.40282346639e+038 ECU_ADDRESS 0x200014B4 /end MEASUREMENT
/begin MEASUREMENT BCF_IDchaPredLim "SOF - Pack Discharge Current Prediction " FLOAT32_IEEE swc_BatCoreFct_CM_single_A 0 0 -3.40282346639e+038 3.40282346639e+038 ECU_ADDRESS 0x200014B8 /end MEASUREMENT
/begin MEASUREMENT BCF_IDchaPredLim1 "SOF - Pack Discharge Dynamic Current Limit Prediction" FLOAT32_IEEE swc_BatCoreFct_CM_single_A 0 0 -3.40282346639e+038 3.40282346639e+038 ECU_ADDRESS 0x200014BC /end MEASUREMENT
/begin MEASUREMENT BCF_IDchaPredLimInt "SOF - Pack Charge Current Prediction internal value (100ms task)." FLOAT32_IEEE swc_BatCoreFct_CM_single_A 0 0 -3.40282346639e+038 3.40282346639e+038 ECU_ADDRESS 0x200014C0 /end MEASUREMENT
/begin MEASUREMENT BCF_IDchaPredLimIntIRV "SOF - Pack Charge Current Prediction internal value (100ms task)." FLOAT32_IEEE swc_BatCoreFct_CM_single_dash_ 0 0 -3.40282346639e+038 3.40282346639e+038 ECU_ADDRESS 0x200014C4 /end MEASUREMENT
/begin AXIS_PTS BCF_LvlErr_A "Battery error level axis of the SOF derating curves  (for both U and I limits)" 0x1FFEB400 NO_INPUT_QUANTITY Lookup1D_X_UBYTE 0 swc_BatCoreFct_CM_uint8_dash_ 8 0 255 DEPOSIT ABSOLUTE /end AXIS_PTS
/begin MEASUREMENT BCF_NrMdulMax "Maximum number of modules" UBYTE swc_BatCoreFct_CM_uint8_dash_ 0 0 0 255 ECU_ADDRESS 0x20008A84 /end MEASUREMENT
/begin CHARACTERISTIC BCF_PctgIChActLimByBatErr_M "Curve for derating SOF Actual Charge Current Limit by Battery Error Level" CURVE 0x1FFE8828 Lookup1D_FLOAT32_IEEE 0 swc_BatCoreFct_CM_single_dash_ -3.40282346639e+038 3.40282346639e+038
 /begin AXIS_DESCR COM_AXIS NO_INPUT_QUANTITY swc_BatCoreFct_CM_uint8_dash_ 8 0 255 DEPOSIT ABSOLUTE AXIS_PTS_REF BCF_LvlErr_A /end AXIS_DESCR
/end CHARACTERISTIC
/begin CHARACTERISTIC BCF_PctgIChActLimByBatSt_M "Curve for derating SOF Actual Charge Current Limit by Battery Operating State" CURVE 0x1FFE8848 Lookup1D_FLOAT32_IEEE 0 swc_BatCoreFct_CM_single_dash_ -3.40282346639e+038 3.40282346639e+038
 /begin AXIS_DESCR COM_AXIS NO_INPUT_QUANTITY swc_BatCoreFct_CM_uint8_dash_ 10 0 255 DEPOSIT ABSOLUTE AXIS_PTS_REF BCF_StBat_A /end AXIS_DESCR
/end CHARACTERISTIC
/begin CHARACTERISTIC BCF_PctgIChPredLimByBatErr_M "Curve for derating SOF Predicted Charge Current Limit by Battery Error Level" CURVE 0x1FFE8870 Lookup1D_FLOAT32_IEEE 0 swc_BatCoreFct_CM_single_dash_ -3.40282346639e+038 3.40282346639e+038
 /begin AXIS_DESCR COM_AXIS NO_INPUT_QUANTITY swc_BatCoreFct_CM_uint8_dash_ 8 0 255 DEPOSIT ABSOLUTE AXIS_PTS_REF BCF_LvlErr_A /end AXIS_DESCR
/end CHARACTERISTIC
/begin CHARACTERISTIC BCF_PctgIChPredLimByBatSt_M "Curve for derating SOF Predicted Charge Current Limit by Battery Operating State" CURVE 0x1FFE8890 Lookup1D_FLOAT32_IEEE 0 swc_BatCoreFct_CM_single_dash_ -3.40282346639e+038 3.40282346639e+038
 /begin AXIS_DESCR COM_AXIS NO_INPUT_QUANTITY swc_BatCoreFct_CM_uint8_dash_ 10 0 255 DEPOSIT ABSOLUTE AXIS_PTS_REF BCF_StBat_A /end AXIS_DESCR
/end CHARACTERISTIC
/begin CHARACTERISTIC BCF_PctgIDchaActLimByBatErr_M "Curve for derating SOF Actual Discharge Current Limit by Battery Error Level" CURVE 0x1FFE88B8 Lookup1D_FLOAT32_IEEE 0 swc_BatCoreFct_CM_single_dash_ -3.40282346639e+038 3.40282346639e+038
 /begin AXIS_DESCR COM_AXIS NO_INPUT_QUANTITY swc_BatCoreFct_CM_uint8_dash_ 8 0 255 DEPOSIT ABSOLUTE AXIS_PTS_REF BCF_LvlErr_A /end AXIS_DESCR
/end CHARACTERISTIC
/begin CHARACTERISTIC BCF_PctgIDchaActLimByBatSt_M "Curve for derating SOF Actual Discharge Current Limit by Battery Operating State" CURVE 0x1FFE88D8 Lookup1D_FLOAT32_IEEE 0 swc_BatCoreFct_CM_single_dash_ -3.40282346639e+038 3.40282346639e+038
 /begin AXIS_DESCR COM_AXIS NO_INPUT_QUANTITY swc_BatCoreFct_CM_uint8_dash_ 10 0 255 DEPOSIT ABSOLUTE AXIS_PTS_REF BCF_StBat_A /end AXIS_DESCR
/end CHARACTERISTIC
/begin CHARACTERISTIC BCF_PctgIDchaPredLimByBatErr_M "Curve for derating SOF Predicted Discharge Current Limit by Battery Error Level" CURVE 0x1FFE8900 Lookup1D_FLOAT32_IEEE 0 swc_BatCoreFct_CM_single_dash_ -3.40282346639e+038 3.40282346639e+038
 /begin AXIS_DESCR COM_AXIS NO_INPUT_QUANTITY swc_BatCoreFct_CM_uint8_dash_ 8 0 255 DEPOSIT ABSOLUTE AXIS_PTS_REF BCF_LvlErr_A /end AXIS_DESCR
/end CHARACTERISTIC
/begin CHARACTERISTIC BCF_PctgIDchaPredLimByBatSt_M "Curve for derating SOF Predicted Discharge Current Limit by Battery Operating State" CURVE 0x1FFE8920 Lookup1D_FLOAT32_IEEE 0 swc_BatCoreFct_CM_single_dash_ -3.40282346639e+038 3.40282346639e+038
 /begin AXIS_DESCR COM_AXIS NO_INPUT_QUANTITY swc_BatCoreFct_CM_uint8_dash_ 10 0 255 DEPOSIT ABSOLUTE AXIS_PTS_REF BCF_StBat_A /end AXIS_DESCR
/end CHARACTERISTIC
/begin CHARACTERISTIC BCF_PctgUChActLimByBatErr_M "Curve for derating SOF Actual Charge Voltage Limit by Battery Error Level" CURVE 0x1FFE8948 Lookup1D_FLOAT32_IEEE 0 swc_BatCoreFct_CM_single_dash_ -3.40282346639e+038 3.40282346639e+038
 /begin AXIS_DESCR COM_AXIS NO_INPUT_QUANTITY swc_BatCoreFct_CM_uint8_dash_ 8 0 255 DEPOSIT ABSOLUTE AXIS_PTS_REF BCF_LvlErr_A /end AXIS_DESCR
/end CHARACTERISTIC
/begin CHARACTERISTIC BCF_PctgUChPredLimByBatErr_M "Curve for derating SOF Predicted Charge Voltage Limit by Battery Error Level" CURVE 0x1FFE8968 Lookup1D_FLOAT32_IEEE 0 swc_BatCoreFct_CM_single_dash_ -3.40282346639e+038 3.40282346639e+038
 /begin AXIS_DESCR COM_AXIS NO_INPUT_QUANTITY swc_BatCoreFct_CM_uint8_dash_ 8 0 255 DEPOSIT ABSOLUTE AXIS_PTS_REF BCF_LvlErr_A /end AXIS_DESCR
/end CHARACTERISTIC
/begin CHARACTERISTIC BCF_PctgUDchaActLimByBatErr_M "Curve for derating SOF Actual Discharge Voltage Limit by Battery Error Level" CURVE 0x1FFE8988 Lookup1D_FLOAT32_IEEE 0 swc_BatCoreFct_CM_single_dash_ -3.40282346639e+038 3.40282346639e+038
 /begin AXIS_DESCR COM_AXIS NO_INPUT_QUANTITY swc_BatCoreFct_CM_uint8_dash_ 8 0 255 DEPOSIT ABSOLUTE AXIS_PTS_REF BCF_LvlErr_A /end AXIS_DESCR
/end CHARACTERISTIC
/begin CHARACTERISTIC BCF_PctgUDchaPredLimByBatErr_M "Curve for derating SOF Predicted Discharge Voltage Limit by Battery Error Level" CURVE 0x1FFE89A8 Lookup1D_FLOAT32_IEEE 0 swc_BatCoreFct_CM_single_dash_ -3.40282346639e+038 3.40282346639e+038
 /begin AXIS_DESCR COM_AXIS NO_INPUT_QUANTITY swc_BatCoreFct_CM_uint8_dash_ 8 0 255 DEPOSIT ABSOLUTE AXIS_PTS_REF BCF_LvlErr_A /end AXIS_DESCR
/end CHARACTERISTIC
/begin MEASUREMENT BCF_PwrChLim "SOF - Pack Charge Power Actual" FLOAT32_IEEE swc_BatCoreFct_CM_single_kW 0 0 -3.40282346639e+038 3.40282346639e+038 ECU_ADDRESS 0x200014C8 /end MEASUREMENT
/begin MEASUREMENT BCF_PwrChPredLim "SOF - Pack Charge Power Predicted" FLOAT32_IEEE swc_BatCoreFct_CM_single_kW 0 0 -3.40282346639e+038 3.40282346639e+038 ECU_ADDRESS 0x200014CC /end MEASUREMENT
/begin MEASUREMENT BCF_PwrDchaLim "SOF - Pack Discharge Power Actual" FLOAT32_IEEE swc_BatCoreFct_CM_single_kW 0 0 -3.40282346639e+038 3.40282346639e+038 ECU_ADDRESS 0x200014D0 /end MEASUREMENT
/begin CHARACTERISTIC BCF_PwrDchaLim_P "Battery Core Function Power Discharge Limit _Parameter" VALUE 0x1FFE89F0 Scalar_FLOAT32_IEEE 0 swc_BatCoreFct_CM_single_W -3.40282346639e+038 3.40282346639e+038 /end CHARACTERISTIC
/begin MEASUREMENT BCF_PwrDchaPredLim "SOF - Pack Discharge Power Predicted" FLOAT32_IEEE swc_BatCoreFct_CM_single_kW 0 0 -3.40282346639e+038 3.40282346639e+038 ECU_ADDRESS 0x200014D4 /end MEASUREMENT
/begin MEASUREMENT BCF_PwrMdulLoss "Module Power Loss" FLOAT32_IEEE swc_BatCoreFct_CM_single_W 0 0 0 10000 ECU_ADDRESS 0x200014D8 MATRIX_DIM 24 1 1 /end MEASUREMENT
/begin MEASUREMENT BCF_RCellDelta "Array of Cell internal resistance differences to modules" FLOAT32_IEEE swc_BatCoreFct_CM_single_dash_ 0 0 -3.40282346639e+038 3.40282346639e+038 ECU_ADDRESS 0x20001538 MATRIX_DIM 255 1 1 /end MEASUREMENT
/begin MEASUREMENT BCF_RMdulAgiFacFlsNv "Module resistance ageing factors stored" FLOAT32_IEEE swc_BatCoreFct_CM_single_dash_ 0 0 -3.40282346639e+038 3.40282346639e+038 ECU_ADDRESS 0x20001994 MATRIX_DIM 24 1 1 /end MEASUREMENT
/begin CHARACTERISTIC BCF_RMdulAgiFacTest_P "RMdulDelta Ageing Factor parameter used for a reset by a service command" VAL_BLK 0x1FFE9E8C Scalar_FLOAT32_IEEE 0 swc_BatCoreFct_CM_single_dash_ -3.40282346639e+038 3.40282346639e+038 MATRIX_DIM 24 1 1 /end CHARACTERISTIC
/begin CHARACTERISTIC BCF_RMdulAgiFacTripTest_P " Module R Trip Ageing Factor used for a reset by a service command" VAL_BLK 0x20000ED4 Scalar_FLOAT32_IEEE 0 swc_BatCoreFct_CM_single_dash_ -3.40282346639e+038 3.40282346639e+038 MATRIX_DIM 24 1 1 /end CHARACTERISTIC
/begin MEASUREMENT BCF_RMdulDeltaOfTrip "Array of module internal resistances" FLOAT32_IEEE swc_BatCoreFct_CM_single_dash_ 0 0 -3.40282346639e+038 3.40282346639e+038 ECU_ADDRESS 0x20001A54 MATRIX_DIM 24 1 1 /end MEASUREMENT
/begin AXIS_PTS BCF_RMdulDeltaOfTrip_A "Module R Delta axis of SOH based on Module R Delta Curve" 0x1FFE9F1C NO_INPUT_QUANTITY Lookup1D_X_FLOAT32_IEEE 0 swc_BatCoreFct_CM_single_dash_ 11 -3.40282346639e+038 3.40282346639e+038 DEPOSIT ABSOLUTE /end AXIS_PTS
/begin MEASUREMENT BCF_RMdulDeltaSho "Array of short term  module internal resistance deltas" FLOAT32_IEEE swc_BatCoreFct_CM_single_dash_ 0 0 -3.40282346639e+038 3.40282346639e+038 ECU_ADDRESS 0x20001AB4 MATRIX_DIM 24 1 1 /end MEASUREMENT
/begin MEASUREMENT BCF_RPackInt "Internal resistance of pack" FLOAT32_IEEE swc_BatCoreFct_CM_single_Ohm 0 0 -3.40282346639e+038 3.40282346639e+038 ECU_ADDRESS 0x20001B14 /end MEASUREMENT
/begin CHARACTERISTIC BCF_RateFallLimForPwrDchaPred_M "Curve for derating SOP Predicted Discharge power Limit fall rate limitation by Battery Error Level " CURVE 0x1FFE9F70 Lookup1D_FLOAT32_IEEE 0 swc_BatCoreFct_CM_single_dash_ -3.40282346639e+038 3.40282346639e+038
 /begin AXIS_DESCR COM_AXIS NO_INPUT_QUANTITY swc_BatCoreFct_CM_uint8_dash_ 8 0 255 DEPOSIT ABSOLUTE AXIS_PTS_REF BCF_LvlErr_A /end AXIS_DESCR
/end CHARACTERISTIC
/begin CHARACTERISTIC BCF_RateFallLimnForIChActLim_M "Curve for derating SOF Actual Charge Current Limit fall rate limitation by Battery Error Level " CURVE 0x1FFE9F90 Lookup1D_FLOAT32_IEEE 0 swc_BatCoreFct_CM_single_dash_ -3.40282346639e+038 3.40282346639e+038
 /begin AXIS_DESCR COM_AXIS NO_INPUT_QUANTITY swc_BatCoreFct_CM_uint8_dash_ 8 0 255 DEPOSIT ABSOLUTE AXIS_PTS_REF BCF_LvlErr_A /end AXIS_DESCR
/end CHARACTERISTIC
/begin CHARACTERISTIC BCF_RateFallLimnForIChPredLim_M "Curve for derating SOF Predicted Charge Current Limit fall rate limitation by Battery Error Level " CURVE 0x1FFE9FB0 Lookup1D_FLOAT32_IEEE 0 swc_BatCoreFct_CM_single_dash_ -3.40282346639e+038 3.40282346639e+038
 /begin AXIS_DESCR COM_AXIS NO_INPUT_QUANTITY swc_BatCoreFct_CM_uint8_dash_ 8 0 255 DEPOSIT ABSOLUTE AXIS_PTS_REF BCF_LvlErr_A /end AXIS_DESCR
/end CHARACTERISTIC
/begin CHARACTERISTIC BCF_RateFallLimnForIDchaActLim_M "Curve for derating SOF Actual Discharge Current Limit fall rate limitation by Battery Error Level " CURVE 0x1FFE9FD0 Lookup1D_FLOAT32_IEEE 0 swc_BatCoreFct_CM_single_dash_ -3.40282346639e+038 3.40282346639e+038
 /begin AXIS_DESCR COM_AXIS NO_INPUT_QUANTITY swc_BatCoreFct_CM_uint8_dash_ 8 0 255 DEPOSIT ABSOLUTE AXIS_PTS_REF BCF_LvlErr_A /end AXIS_DESCR
/end CHARACTERISTIC
/begin CHARACTERISTIC BCF_RateFallLimnForPwrChAct_M "Curve for derating SOP Charge power Limit fall rate limitation by Battery Error Level " CURVE 0x1FFE9FF0 Lookup1D_FLOAT32_IEEE 0 swc_BatCoreFct_CM_single_dash_ -3.40282346639e+038 3.40282346639e+038
 /begin AXIS_DESCR COM_AXIS NO_INPUT_QUANTITY swc_BatCoreFct_CM_uint8_dash_ 8 0 255 DEPOSIT ABSOLUTE AXIS_PTS_REF BCF_LvlErr_A /end AXIS_DESCR
/end CHARACTERISTIC
/begin CHARACTERISTIC BCF_RateFallLimnForPwrChPred_M "Curve for derating SOP Predicted Charge power Limit fall rate limitation by Battery Error Level " CURVE 0x1FFEA010 Lookup1D_FLOAT32_IEEE 0 swc_BatCoreFct_CM_single_dash_ -3.40282346639e+038 3.40282346639e+038
 /begin AXIS_DESCR COM_AXIS NO_INPUT_QUANTITY swc_BatCoreFct_CM_uint8_dash_ 8 0 255 DEPOSIT ABSOLUTE AXIS_PTS_REF BCF_LvlErr_A /end AXIS_DESCR
/end CHARACTERISTIC
/begin CHARACTERISTIC BCF_RateFallLimnForPwrDchaAct_M "Curve for derating SOP Discharge power Limit fall rate limitation by Battery Error Level " CURVE 0x1FFEA030 Lookup1D_FLOAT32_IEEE 0 swc_BatCoreFct_CM_single_dash_ -3.40282346639e+038 3.40282346639e+038
 /begin AXIS_DESCR COM_AXIS NO_INPUT_QUANTITY swc_BatCoreFct_CM_uint8_dash_ 8 0 255 DEPOSIT ABSOLUTE AXIS_PTS_REF BCF_LvlErr_A /end AXIS_DESCR
/end CHARACTERISTIC
/begin CHARACTERISTIC BCF_RateFallLimnForUChActLim_P "Actual Charge Voltage Limit fall rate limitation" VALUE 0x1FFEA050 Scalar_FLOAT32_IEEE 0 swc_BatCoreFct_CM_single_V_per_s -3.40282346639e+038 3.40282346639e+038 /end CHARACTERISTIC
/begin CHARACTERISTIC BCF_RateFallLimnForUChPredLim_P "Predicted Charge Voltage Limit fall rate limitation" VALUE 0x1FFEA054 Scalar_FLOAT32_IEEE 0 swc_BatCoreFct_CM_single_V_per_s -3.40282346639e+038 3.40282346639e+038 /end CHARACTERISTIC
/begin CHARACTERISTIC BCF_RateFallLimnForUDchaActLim_P "Actual Discharge Voltage Limit fall rate limitation" VALUE 0x1FFEA058 Scalar_FLOAT32_IEEE 0 swc_BatCoreFct_CM_single_V_per_s -3.40282346639e+038 3.40282346639e+038 /end CHARACTERISTIC
/begin CHARACTERISTIC BCF_RateFallLimnIDchaPredLim_M "Curve for derating SOF Predicted Discharge Current Limit fall rate limitation by Battery Error Level " CURVE 0x1FFEA05C Lookup1D_FLOAT32_IEEE 0 swc_BatCoreFct_CM_single_dash_ -3.40282346639e+038 3.40282346639e+038
 /begin AXIS_DESCR COM_AXIS NO_INPUT_QUANTITY swc_BatCoreFct_CM_uint8_dash_ 8 0 255 DEPOSIT ABSOLUTE AXIS_PTS_REF BCF_LvlErr_A /end AXIS_DESCR
/end CHARACTERISTIC
/begin CHARACTERISTIC BCF_RateFallLimnUDchaPredLim_P "Predicted Discharge Voltage Limit fall rate limitation" VALUE 0x1FFEA07C Scalar_FLOAT32_IEEE 0 swc_BatCoreFct_CM_single_V_per_s -3.40282346639e+038 3.40282346639e+038 /end CHARACTERISTIC
/begin CHARACTERISTIC BCF_RateRiseLimForPwrDchaPred_M "Curve for derating SOP Predicted Discharge power Limit rise rate limitation by Battery Error Level " CURVE 0x1FFEA080 Lookup1D_FLOAT32_IEEE 0 swc_BatCoreFct_CM_single_dash_ -3.40282346639e+038 3.40282346639e+038
 /begin AXIS_DESCR COM_AXIS NO_INPUT_QUANTITY swc_BatCoreFct_CM_uint8_dash_ 8 0 255 DEPOSIT ABSOLUTE AXIS_PTS_REF BCF_LvlErr_A /end AXIS_DESCR
/end CHARACTERISTIC
/begin CHARACTERISTIC BCF_RateRiseLimnForIChActLim_M "Curve for derating SOF Actual Charge Current Limit rise rate limitation by Battery Error Level " CURVE 0x1FFEA0A0 Lookup1D_FLOAT32_IEEE 0 swc_BatCoreFct_CM_single_dash_ -3.40282346639e+038 3.40282346639e+038
 /begin AXIS_DESCR COM_AXIS NO_INPUT_QUANTITY swc_BatCoreFct_CM_uint8_dash_ 8 0 255 DEPOSIT ABSOLUTE AXIS_PTS_REF BCF_LvlErr_A /end AXIS_DESCR
/end CHARACTERISTIC
/begin CHARACTERISTIC BCF_RateRiseLimnForIChPredLim_M "Curve for derating SOF Predicted Charge Current Limit rise rate limitation by Battery Error Level " CURVE 0x1FFEA0C0 Lookup1D_FLOAT32_IEEE 0 swc_BatCoreFct_CM_single_dash_ -3.40282346639e+038 3.40282346639e+038
 /begin AXIS_DESCR COM_AXIS NO_INPUT_QUANTITY swc_BatCoreFct_CM_uint8_dash_ 8 0 255 DEPOSIT ABSOLUTE AXIS_PTS_REF BCF_LvlErr_A /end AXIS_DESCR
/end CHARACTERISTIC
/begin CHARACTERISTIC BCF_RateRiseLimnForIDchaActLim_M "Curve for derating SOF Actual Discharge Current Limit rise rate limitation by Battery Error Level " CURVE 0x1FFEA0E0 Lookup1D_FLOAT32_IEEE 0 swc_BatCoreFct_CM_single_dash_ -3.40282346639e+038 3.40282346639e+038
 /begin AXIS_DESCR COM_AXIS NO_INPUT_QUANTITY swc_BatCoreFct_CM_uint8_dash_ 8 0 255 DEPOSIT ABSOLUTE AXIS_PTS_REF BCF_LvlErr_A /end AXIS_DESCR
/end CHARACTERISTIC
/begin CHARACTERISTIC BCF_RateRiseLimnForPwrChAct_M "Curve for derating SOP Charge power Limit rise rate limitation by Battery Error Level " CURVE 0x1FFEA100 Lookup1D_FLOAT32_IEEE 0 swc_BatCoreFct_CM_single_dash_ -3.40282346639e+038 3.40282346639e+038
 /begin AXIS_DESCR COM_AXIS NO_INPUT_QUANTITY swc_BatCoreFct_CM_uint8_dash_ 8 0 255 DEPOSIT ABSOLUTE AXIS_PTS_REF BCF_LvlErr_A /end AXIS_DESCR
/end CHARACTERISTIC
/begin CHARACTERISTIC BCF_RateRiseLimnForPwrChPred_M "Curve for derating SOP Predicted Charge power Limit rise rate limitation by Battery Error Level " CURVE 0x1FFEA120 Lookup1D_FLOAT32_IEEE 0 swc_BatCoreFct_CM_single_dash_ -3.40282346639e+038 3.40282346639e+038
 /begin AXIS_DESCR COM_AXIS NO_INPUT_QUANTITY swc_BatCoreFct_CM_uint8_dash_ 8 0 255 DEPOSIT ABSOLUTE AXIS_PTS_REF BCF_LvlErr_A /end AXIS_DESCR
/end CHARACTERISTIC
/begin CHARACTERISTIC BCF_RateRiseLimnForPwrDchaAct_M "Curve for derating SOP Discharge power Limit rise rate limitation by Battery Error Level " CURVE 0x1FFEA140 Lookup1D_FLOAT32_IEEE 0 swc_BatCoreFct_CM_single_dash_ -3.40282346639e+038 3.40282346639e+038
 /begin AXIS_DESCR COM_AXIS NO_INPUT_QUANTITY swc_BatCoreFct_CM_uint8_dash_ 8 0 255 DEPOSIT ABSOLUTE AXIS_PTS_REF BCF_LvlErr_A /end AXIS_DESCR
/end CHARACTERISTIC
/begin CHARACTERISTIC BCF_RateRiseLimnForUChActLim_P "Actual Charge Voltage Limit rise rate limitation" VALUE 0x1FFEA160 Scalar_FLOAT32_IEEE 0 swc_BatCoreFct_CM_single_V_per_s -3.40282346639e+038 3.40282346639e+038 /end CHARACTERISTIC
/begin CHARACTERISTIC BCF_RateRiseLimnForUChPredLim_P "Predicted Charge Voltage Limit rise rate limitation" VALUE 0x1FFEA164 Scalar_FLOAT32_IEEE 0 swc_BatCoreFct_CM_single_V_per_s -3.40282346639e+038 3.40282346639e+038 /end CHARACTERISTIC
/begin CHARACTERISTIC BCF_RateRiseLimnForUDchaActLim_P "Actual Discharge Voltage Limit rise rate limitation" VALUE 0x1FFEA168 Scalar_FLOAT32_IEEE 0 swc_BatCoreFct_CM_single_V_per_s -3.40282346639e+038 3.40282346639e+038 /end CHARACTERISTIC
/begin CHARACTERISTIC BCF_RateRiseLimnIDchaPredLim_M "Curve for derating SOF Predicted Discharge Current Limit rise rate limitation by Battery Error Level " CURVE 0x1FFEA16C Lookup1D_FLOAT32_IEEE 0 swc_BatCoreFct_CM_single_dash_ -3.40282346639e+038 3.40282346639e+038
 /begin AXIS_DESCR COM_AXIS NO_INPUT_QUANTITY swc_BatCoreFct_CM_uint8_dash_ 8 0 255 DEPOSIT ABSOLUTE AXIS_PTS_REF BCF_LvlErr_A /end AXIS_DESCR
/end CHARACTERISTIC
/begin CHARACTERISTIC BCF_RateRiseLimnUDchaPredLim_P "Predicted Discharge Voltage Limit rise rate limitation" VALUE 0x1FFEA18C Scalar_FLOAT32_IEEE 0 swc_BatCoreFct_CM_single_V_per_s -3.40282346639e+038 3.40282346639e+038 /end CHARACTERISTIC
/begin CHARACTERISTIC BCF_ReqSrv_P "Service Command for BCF to initialize flash memory" VALUE 0x1FFEB52D Scalar_UBYTE 0 swc_BatCoreFct_CM_uint8_dash_ 0 255 /end CHARACTERISTIC
/begin MEASUREMENT BCF_SocCell "Array of cell SOCs" FLOAT32_IEEE swc_BatCoreFct_CM_single_dash_ 0 0 -3.40282346639e+038 3.40282346639e+038 ECU_ADDRESS 0x20001B18 MATRIX_DIM 255 1 1 /end MEASUREMENT
/begin MEASUREMENT BCF_SocCellDelta "Array of cell SOC differences to the module SOCs" FLOAT32_IEEE swc_BatCoreFct_CM_single_dash_ 0 0 -3.40282346639e+038 3.40282346639e+038 ECU_ADDRESS 0x20001F14 MATRIX_DIM 255 1 1 /end MEASUREMENT
/begin MEASUREMENT BCF_SocCellMax "Maximum Cell SOC in pack" FLOAT32_IEEE swc_BatCoreFct_CM_single_dash_ 0 0 -3.40282346639e+038 3.40282346639e+038 ECU_ADDRESS 0x20002310 /end MEASUREMENT
/begin MEASUREMENT BCF_SocCellMin "Minimum Cell SOC in pack" FLOAT32_IEEE swc_BatCoreFct_CM_single_dash_ 0 0 -3.40282346639e+038 3.40282346639e+038 ECU_ADDRESS 0x20002314 /end MEASUREMENT
/begin CHARACTERISTIC BCF_SocIniMan_P "In service mode, for manual SOC initialization" VALUE 0x1FFEA1CC Scalar_FLOAT32_IEEE 0 swc_BatCoreFct_CM_single_dash_ 0 255 /end CHARACTERISTIC
/begin MEASUREMENT BCF_SocLimMax "SOC operating window higher limit" FLOAT32_IEEE swc_BatCoreFct_CM_single_dash_ 0 0 -3.40282346639e+038 3.40282346639e+038 ECU_ADDRESS 0x20002318 /end MEASUREMENT
/begin MEASUREMENT BCF_SocLimMin "SOC operating window lower limit" FLOAT32_IEEE swc_BatCoreFct_CM_single_dash_ 0 0 -3.40282346639e+038 3.40282346639e+038 ECU_ADDRESS 0x2000231C /end MEASUREMENT
/begin MEASUREMENT BCF_SocMdul "Array of module SOCs" FLOAT32_IEEE swc_BatCoreFct_CM_single_dash_ 0 0 -3.40282346639e+038 3.40282346639e+038 ECU_ADDRESS 0x20002320 MATRIX_DIM 24 1 1 /end MEASUREMENT
/begin MEASUREMENT BCF_SocPack "Pack  SOC" FLOAT32_IEEE swc_BatCoreFct_CM_single_dash_ 0 0 -3.40282346639e+038 3.40282346639e+038 ECU_ADDRESS 0x20002380 /end MEASUREMENT
/begin MEASUREMENT BCF_SocPackScld "Scaled SOC of the pack for communcation to HMI" FLOAT32_IEEE swc_BatCoreFct_CM_single_dash_ 0 0 0 1 ECU_ADDRESS 0x20002384 /end MEASUREMENT
/begin CHARACTERISTIC BCF_SofDeratDeac_P "State of Function Derating Deactivation" VALUE 0x20008A7E Scalar_BOOLEAN 0 swc_BatCoreFct_CM_boolean_dash_ 0 1 /end CHARACTERISTIC
/begin CHARACTERISTIC BCF_SofDeratPackStOk_P "Allowed battery state for SoF derating - 10ms task" VAL_BLK 0x1FFEA3A0 Scalar_FLOAT32_IEEE 0 swc_BatCoreFct_CM_single_dash_ -3.40282346639e+038 3.40282346639e+038 MATRIX_DIM 5 1 1 /end CHARACTERISTIC
/begin CHARACTERISTIC BCF_SofDeratTs_P "Sample time of SOF derating function" VALUE 0x1FFEA3B4 Scalar_FLOAT32_IEEE 0 swc_BatCoreFct_CM_single_seconds 0 100000 /end CHARACTERISTIC
/begin CHARACTERISTIC BCF_SohC_M "SOH based on Module C Delta Curve" CURVE 0x1FFEA3E8 Lookup1D_FLOAT32_IEEE 0 swc_BatCoreFct_CM_single_dash_ -3.40282346639e+038 3.40282346639e+038
 /begin AXIS_DESCR COM_AXIS NO_INPUT_QUANTITY swc_BatCoreFct_CM_single_dash_ 11 -3.40282346639e+038 3.40282346639e+038 DEPOSIT ABSOLUTE AXIS_PTS_REF BCF_CMdulDeltaOfTrip_A /end AXIS_DESCR
/end CHARACTERISTIC
/begin CHARACTERISTIC BCF_SohFacForRDelta_P "Factor to scale Cell Delta R limits based on SOH" VALUE 0x1FFEA458 Scalar_FLOAT32_IEEE 0 swc_BatCoreFct_CM_single_dash_ 0 100000000 /end CHARACTERISTIC
/begin MEASUREMENT BCF_SohPack "Pack  SOH" FLOAT32_IEEE swc_BatCoreFct_CM_single_dash_ 0 0 -3.40282346639e+038 3.40282346639e+038 ECU_ADDRESS 0x2000238C /end MEASUREMENT
/begin CHARACTERISTIC BCF_SohPackMinFlsForTest_P " Minimum Pack SOH in Flash (reset value used if service mode is active)" VALUE 0x20000FA8 Scalar_FLOAT32_IEEE 0 swc_BatCoreFct_CM_single_dash_ 0 100000000 /end CHARACTERISTIC
/begin CHARACTERISTIC BCF_SohPackValmin_P "Switch for reporting minimum Pack SOH from flash (= 1) or the current minimum of different SOH calculations (= 0)" VALUE 0x20008A7C Scalar_UBYTE 0 swc_BatCoreFct_CM_uint8_dash_ 0 255 /end CHARACTERISTIC
/begin CHARACTERISTIC BCF_SohRDeltaFlsForTest_P " Cell R Delta based SOH (reset value used if service mode is active)" VAL_BLK 0x20000FAC Scalar_FLOAT32_IEEE 0 swc_BatCoreFct_CM_single_dash_ -3.40282346639e+038 3.40282346639e+038 MATRIX_DIM 24 1 1 /end CHARACTERISTIC
/begin MEASUREMENT BCF_SohRDeltaFlsNv "Delta R based SOH value in flash" FLOAT32_IEEE swc_BatCoreFct_CM_single_dash_ 0 0 -3.40282346639e+038 3.40282346639e+038 ECU_ADDRESS 0x200023F4 MATRIX_DIM 24 1 1 /end MEASUREMENT
/begin CHARACTERISTIC BCF_SohRDeltaLimForUpd_P "R Cell Delta based SOH update limit" VALUE 0x1FFEA4B4 Scalar_FLOAT32_IEEE 0 swc_BatCoreFct_CM_single_dash_ 0 100000000 /end CHARACTERISTIC
/begin MEASUREMENT BCF_SohRMdul "Module R based SOH per module internal signal." FLOAT32_IEEE swc_BatCoreFct_CM_single_dash_ 0 0 -3.40282346639e+038 3.40282346639e+038 ECU_ADDRESS 0x20002514 MATRIX_DIM 24 1 1 /end MEASUREMENT
/begin CHARACTERISTIC BCF_SohR_M "SOH based on Module R Delta Curve" CURVE 0x1FFEA4B8 Lookup1D_FLOAT32_IEEE 0 swc_BatCoreFct_CM_single_dash_ -3.40282346639e+038 3.40282346639e+038
 /begin AXIS_DESCR COM_AXIS NO_INPUT_QUANTITY swc_BatCoreFct_CM_single_dash_ 11 -3.40282346639e+038 3.40282346639e+038 DEPOSIT ABSOLUTE AXIS_PTS_REF BCF_RMdulDeltaOfTrip_A /end AXIS_DESCR
/end CHARACTERISTIC
/begin CHARACTERISTIC BCF_SohSocDeltaFlsForTest_P " Cell Soc Delta based SOH (reset value used if service mode is active)" VAL_BLK 0x2000100C Scalar_FLOAT32_IEEE 0 swc_BatCoreFct_CM_single_dash_ -3.40282346639e+038 3.40282346639e+038 MATRIX_DIM 24 1 1 /end CHARACTERISTIC
/begin MEASUREMENT BCF_SohSocDeltaFlsNv "DeltaSOC based SOH value in flash" FLOAT32_IEEE swc_BatCoreFct_CM_single_dash_ 0 0 -3.40282346639e+038 3.40282346639e+038 ECU_ADDRESS 0x200025D4 MATRIX_DIM 24 1 1 /end MEASUREMENT
/begin CHARACTERISTIC BCF_SohSocDeltaLimForUpd_P "Soc Cell Delta based SOH update limit" VALUE 0x1FFEA53C Scalar_FLOAT32_IEEE 0 swc_BatCoreFct_CM_single_dash_ 0 100000000 /end CHARACTERISTIC
/begin CHARACTERISTIC BCF_SohUpdFacForRDelta_P "Factor for Cell DeltaR variance based Soh Update" VALUE 0x1FFEA540 Scalar_FLOAT32_IEEE 0 swc_BatCoreFct_CM_single_dash_ -3.40282346639e+038 3.40282346639e+038 /end CHARACTERISTIC
/begin CHARACTERISTIC BCF_SohUpdFacForSocDelta_P "Factor for Cell DeltaSOC variance based Soh Update" VALUE 0x1FFEA544 Scalar_FLOAT32_IEEE 0 swc_BatCoreFct_CM_single_dash_ -3.40282346639e+038 3.40282346639e+038 /end CHARACTERISTIC
/begin CHARACTERISTIC BCF_SohUpdSatnForRDelta_M "Cell DeltaR variance based Soh Update Saturation Curve" CURVE 0x1FFEA548 Lookup1D_FLOAT32_IEEE 0 swc_BatCoreFct_CM_single_dash_ -3.40282346639e+038 3.40282346639e+038
 /begin AXIS_DESCR COM_AXIS NO_INPUT_QUANTITY swc_BatCoreFct_CM_uint32_s 5 0 4294967295 DEPOSIT ABSOLUTE AXIS_PTS_REF BCF_TiBatOffForAgiFac_A /end AXIS_DESCR
/end CHARACTERISTIC
/begin CHARACTERISTIC BCF_SohUpdSatnForSocDelta_M "Cell DeltaSOC variance based Soh Update Saturation Curve" CURVE 0x1FFEA55C Lookup1D_FLOAT32_IEEE 0 swc_BatCoreFct_CM_single_dash_ -3.40282346639e+038 3.40282346639e+038
 /begin AXIS_DESCR COM_AXIS NO_INPUT_QUANTITY swc_BatCoreFct_CM_uint32_s 5 0 4294967295 DEPOSIT ABSOLUTE AXIS_PTS_REF BCF_TiBatOffForAgiFac_A /end AXIS_DESCR
/end CHARACTERISTIC
/begin MEASUREMENT BCF_StAryFlsNv "Module model states of electrical and thermal model" FLOAT32_IEEE swc_BatCoreFct_CM_single_dash_ 0 0 -3.40282346639e+038 3.40282346639e+038 ECU_ADDRESS 0x20002934 MATRIX_DIM 144 1 1 /end MEASUREMENT
/begin AXIS_PTS BCF_StBat_A "Battery state axis of the SOF derating curves  (for both U and I limits)" 0x1FFEB408 NO_INPUT_QUANTITY Lookup1D_X_UBYTE 0 swc_BatCoreFct_CM_uint8_dash_ 10 0 255 DEPOSIT ABSOLUTE /end AXIS_PTS
/begin MEASUREMENT BCF_StLimnId "SOF - Limitation Source Flag." UBYTE swc_BatCoreFct_CM_uint8_dash_ 0 0 0 255 ECU_ADDRESS 0x20003B7C MATRIX_DIM 4 1 1 /end MEASUREMENT
/begin MEASUREMENT BCF_TCooltMdulOut "Array of Coolant temperature downstream of modules " FLOAT32_IEEE swc_BatCoreFct_CM_single__ 0 0 -40 140 ECU_ADDRESS 0x20002B74 MATRIX_DIM 24 1 1 /end MEASUREMENT
/begin MEASUREMENT BCF_TMdulAvgInCTest "Average temperature in constant current capacity test for Soh validation." FLOAT32_IEEE swc_BatCoreFct_CM_single_dash_ 0 0 -3.40282346639e+038 3.40282346639e+038 ECU_ADDRESS 0x20002BD4 MATRIX_DIM 24 1 1 /end MEASUREMENT
/begin MEASUREMENT BCF_TMdulEstimd "Model estimated module temperature" FLOAT32_IEEE swc_BatCoreFct_CM_single__ 0 0 -3.40282346639e+038 3.40282346639e+038 ECU_ADDRESS 0x20002C34 MATRIX_DIM 24 1 1 /end MEASUREMENT
/begin MEASUREMENT BCF_TSamplgCtr "Temperature downsampling counter for internal circuit short detection" FLOAT32_IEEE swc_BatCoreFct_CM_single_s 0 0 -3.40282346639e+038 3.40282346639e+038 ECU_ADDRESS 0x20002C94 /end MEASUREMENT
/begin AXIS_PTS BCF_TiBatOffForAgiFac_A "Time axis of the for Saturation Curve of the Ageing Factor Update Steps based on stand still time" 0x1FFEA5E8 NO_INPUT_QUANTITY Lookup1D_X_ULONG 0 swc_BatCoreFct_CM_uint32_s 5 0 4294967295 DEPOSIT ABSOLUTE /end AXIS_PTS
/begin MEASUREMENT BCF_TiBatOffForMdulCFlsNv "TiBatOff stored in flash for Mdul C Observer" ULONG swc_BatCoreFct_CM_uint32_dash_ 0 0 0 4294967295 ECU_ADDRESS 0x20002CF8 MATRIX_DIM 24 1 1 /end MEASUREMENT
/begin CHARACTERISTIC BCF_TiBatOffForMdulCTest_P " Time since last battery off for Last Valid Module C Estimation Test Parameter" VAL_BLK 0x20001074 Scalar_ULONG 0 swc_BatCoreFct_CM_uint32_s 0 4294967295 MATRIX_DIM 24 1 1 /end CHARACTERISTIC
/begin MEASUREMENT BCF_TiBatOffForMdulRFlsNv "TiBatOff stored in flash for Mdul R Observer" ULONG swc_BatCoreFct_CM_uint32_dash_ 0 0 0 4294967295 ECU_ADDRESS 0x20002E18 MATRIX_DIM 24 1 1 /end MEASUREMENT
/begin CHARACTERISTIC BCF_TiBatOffForMdulRTest_P "Time since last battery off for Last Valid Module R Estimation (used for reset in service mode)" VAL_BLK 0x200010D4 Scalar_ULONG 0 swc_BatCoreFct_CM_uint32_s 0 4294967295 MATRIX_DIM 24 1 1 /end CHARACTERISTIC
/begin MEASUREMENT BCF_UBatTotInt "Total voltage of traction battery system of complete vehicle (internally calculated)" FLOAT32_IEEE swc_BatCoreFct_CM_single_V 0 0 0 65535 ECU_ADDRESS 0x20002F38 /end MEASUREMENT
/begin MEASUREMENT BCF_UBatTotIntIRV "Total voltage of traction battery system of complete vehicle (internally calculated)" FLOAT32_IEEE swc_BatCoreFct_CM_single_dash_ 0 0 -3.40282346639e+038 3.40282346639e+038 ECU_ADDRESS 0x20002F3C /end MEASUREMENT
/begin MEASUREMENT BCF_UCellAvg "Battery Core Function Voltage Cell Average" FLOAT32_IEEE swc_BatCoreFct_CM_single_dash_ 0 0 -3.40282346639e+038 3.40282346639e+038 ECU_ADDRESS 0x20002F40 /end MEASUREMENT
/begin MEASUREMENT BCF_UCellMeasdToMdlDelta "Internal signal for module voltage measurement to model voltage prediction deviation (calculated per cell)" FLOAT32_IEEE swc_BatCoreFct_CM_single_dash_ 0 0 -3.40282346639e+038 3.40282346639e+038 ECU_ADDRESS 0x20002F44 MATRIX_DIM 255 1 1 /end MEASUREMENT
/begin MEASUREMENT BCF_UChLim "SOF - Pack Charge Voltage Actual" FLOAT32_IEEE swc_BatCoreFct_CM_single_V 0 0 -3.40282346639e+038 3.40282346639e+038 ECU_ADDRESS 0x20003340 /end MEASUREMENT
/begin MEASUREMENT BCF_UChLimInt "SOF - Pack Charge Voltage Actual Limit internal value (100ms task)." FLOAT32_IEEE swc_BatCoreFct_CM_single_V 0 0 -3.40282346639e+038 3.40282346639e+038 ECU_ADDRESS 0x20003344 /end MEASUREMENT
/begin MEASUREMENT BCF_UChLimIntIRV "SOF - Pack Charge Voltage Actual Limit internal value (100ms task)." FLOAT32_IEEE swc_BatCoreFct_CM_single_dash_ 0 0 -3.40282346639e+038 3.40282346639e+038 ECU_ADDRESS 0x20003348 /end MEASUREMENT
/begin MEASUREMENT BCF_UChPredLim "SOF - Pack Charge Voltage Predicted." FLOAT32_IEEE swc_BatCoreFct_CM_single_V 0 0 -3.40282346639e+038 3.40282346639e+038 ECU_ADDRESS 0x2000334C /end MEASUREMENT
/begin MEASUREMENT BCF_UChPredLimInt "SOF - Predicted Pack Charge Voltage Limit internal value (100ms task)." FLOAT32_IEEE swc_BatCoreFct_CM_single_V 0 0 -3.40282346639e+038 3.40282346639e+038 ECU_ADDRESS 0x20003350 /end MEASUREMENT
/begin MEASUREMENT BCF_UChPredLimIntIRV "SOF - Predicted Pack Charge Voltage Limit internal value (100ms task)." FLOAT32_IEEE swc_BatCoreFct_CM_single_dash_ 0 0 -3.40282346639e+038 3.40282346639e+038 ECU_ADDRESS 0x20003354 /end MEASUREMENT
/begin MEASUREMENT BCF_UDchaLim "SOF - Pack Discharge Voltage Actual" FLOAT32_IEEE swc_BatCoreFct_CM_single_V 0 0 -3.40282346639e+038 3.40282346639e+038 ECU_ADDRESS 0x20003358 /end MEASUREMENT
/begin MEASUREMENT BCF_UDchaLimInt "SOF - Pack Discharge Voltage Actual Limit internal value (100ms task)." FLOAT32_IEEE swc_BatCoreFct_CM_single_V 0 0 -3.40282346639e+038 3.40282346639e+038 ECU_ADDRESS 0x2000335C /end MEASUREMENT
/begin MEASUREMENT BCF_UDchaLimIntIRV "SOF - Pack Discharge Voltage Actual Limit internal value (100ms task)." FLOAT32_IEEE swc_BatCoreFct_CM_single_dash_ 0 0 -3.40282346639e+038 3.40282346639e+038 ECU_ADDRESS 0x20003360 /end MEASUREMENT
/begin MEASUREMENT BCF_UDchaPredLim "SOF - Pack Discharge Voltage Predicted." FLOAT32_IEEE swc_BatCoreFct_CM_single_V 0 0 -3.40282346639e+038 3.40282346639e+038 ECU_ADDRESS 0x20003364 /end MEASUREMENT
/begin MEASUREMENT BCF_UDchaPredLimInt "SOF - Predicted Pack Discharge Voltage Limit internal value (100ms task)." FLOAT32_IEEE swc_BatCoreFct_CM_single_V 0 0 -3.40282346639e+038 3.40282346639e+038 ECU_ADDRESS 0x20003368 /end MEASUREMENT
/begin MEASUREMENT BCF_UDchaPredLimIntIRV "SOF - Predicted Pack Discharge Voltage Limit internal value (100ms task)." FLOAT32_IEEE swc_BatCoreFct_CM_single_dash_ 0 0 -3.40282346639e+038 3.40282346639e+038 ECU_ADDRESS 0x2000336C /end MEASUREMENT
/begin MEASUREMENT BCF_UMdul "Battery Core Function Voltage Module" FLOAT32_IEEE swc_BatCoreFct_CM_single_dash_ 0 0 -3.40282346639e+038 3.40282346639e+038 ECU_ADDRESS 0x20003370 MATRIX_DIM 24 1 1 /end MEASUREMENT
/begin MEASUREMENT BCF_UMdulAgiFacErrCt "U Module Ageing Factor Error Counter" SWORD swc_BatCoreFct_CM_int16_dash_ 0 0 -32768 32767 ECU_ADDRESS 0x20001194 MATRIX_DIM 24 1 1 /end MEASUREMENT
/begin MEASUREMENT BCF_UMdulOffSho "Module Voltage Short Term Offsets internal signal" FLOAT32_IEEE swc_BatCoreFct_CM_single_V 0 0 -3.40282346639e+038 3.40282346639e+038 ECU_ADDRESS 0x200033D0 MATRIX_DIM 24 1 1 /end MEASUREMENT
/begin MEASUREMENT BCF_UPackCircOpen "Pack open-circuit voltage" FLOAT32_IEEE swc_BatCoreFct_CM_single_V 0 0 -3.40282346639e+038 3.40282346639e+038 ECU_ADDRESS 0x20003490 /end MEASUREMENT
/begin MEASUREMENT BCF_UPackCircOpenIRV "Pack open-circuit voltage" FLOAT32_IEEE swc_BatCoreFct_CM_single_dash_ 0 0 -3.40282346639e+038 3.40282346639e+038 ECU_ADDRESS 0x20003494 /end MEASUREMENT
/begin MEASUREMENT BCF_VldMdlOperCdn "Flag indicating electrical model operation condition in valid range" UBYTE swc_BatCoreFct_CM_boolean_dash_ 0 0 0 1 ECU_ADDRESS 0x20003BB0 MATRIX_DIM 24 1 1 /end MEASUREMENT
/begin CHARACTERISTIC BCF_bAcvSohUpd_P "Activate Pack SOH calculation" VALUE 0x1FFEB531 Scalar_BOOLEAN 0 swc_BatCoreFct_CM_boolean_dash_ 0 1 /end CHARACTERISTIC
/begin MEASUREMENT BCF_bEnaThrwyFlg "Battery Core Function Enable Flag ThermalRunaway Flag" UBYTE swc_BatCoreFct_CM_boolean_dash_ 0 0 0 1 ECU_ADDRESS 0x20008A86 /end MEASUREMENT
/begin MEASUREMENT BCF_bErrMdulSocInvldFls "Soc Estimation Error Flag per Module" UBYTE swc_BatCoreFct_CM_uint8_dash_ 0 0 0 255 ECU_ADDRESS 0x20003B80 MATRIX_DIM 24 1 1 /end MEASUREMENT
/begin MEASUREMENT BCF_bErrMdulSocInvldFlsNv "Soc Estimation Error Flag per Module" UBYTE swc_BatCoreFct_CM_uint8_dash_ 0 0 0 255 ECU_ADDRESS 0x20003B98 MATRIX_DIM 24 1 1 /end MEASUREMENT
/begin MEASUREMENT BCF_tmp_rel_1 "temporary signal for code generation" UBYTE swc_BatCoreFct_CM_boolean_dash_ 0 0 0 1 ECU_ADDRESS 0x20008A87 /end MEASUREMENT
/begin MEASUREMENT BCF_tmp_rel_18 "temporary signal for code generation" UBYTE swc_BatCoreFct_CM_boolean_dash_ 0 0 0 1 ECU_ADDRESS 0x20008A88 /end MEASUREMENT
/begin MEASUREMENT BCF_tmp_rel_21 "temporary signal for code generation" UBYTE swc_BatCoreFct_CM_boolean_dash_ 0 0 0 1 ECU_ADDRESS 0x20008A89 /end MEASUREMENT
/begin MEASUREMENT BCF_tmp_rel_26 "temporary signal for code generation" UBYTE swc_BatCoreFct_CM_boolean_dash_ 0 0 0 1 ECU_ADDRESS 0x20008A8A /end MEASUREMENT
/begin MEASUREMENT BCF_tmp_rel_27 "temporary signal for code generation" UBYTE swc_BatCoreFct_CM_boolean_dash_ 0 0 0 1 ECU_ADDRESS 0x20008A8B /end MEASUREMENT
/begin MEASUREMENT BCF_tmp_rel_3 "temporary signal for code generation" UBYTE swc_BatCoreFct_CM_boolean_dash_ 0 0 0 1 ECU_ADDRESS 0x20008A8C /end MEASUREMENT
/begin MEASUREMENT BCF_tmp_rel_31 "temporary signal for code generation" FLOAT32_IEEE swc_BatCoreFct_CM_single_dash_ 0 0 -3.40282346639e+038 3.40282346639e+038 ECU_ADDRESS 0x20003B58 /end MEASUREMENT
/begin MEASUREMENT BCF_tmp_rel_32 "temporary signal for code generation" UBYTE swc_BatCoreFct_CM_boolean_dash_ 0 0 0 1 ECU_ADDRESS 0x20008A8D /end MEASUREMENT
/begin MEASUREMENT BCF_tmp_rel_36 "temporary signal for code generation" ULONG swc_BatCoreFct_CM_uint32_dash_ 0 0 0 4294967295 ECU_ADDRESS 0x20003B5C /end MEASUREMENT
/begin MEASUREMENT BCF_tmp_rel_37 "temporary signal for code generation" ULONG swc_BatCoreFct_CM_uint32_dash_ 0 0 0 4294967295 ECU_ADDRESS 0x20003B60 /end MEASUREMENT
/begin MEASUREMENT BCTE_TiBatChByMinuTot "Maximum charge time by minute" FLOAT32_IEEE swc_BatChCtl_CM_single_min 0 0 -3.40282346639e+038 3.40282346639e+038 ECU_ADDRESS 0x1FFE36E4 /end MEASUREMENT
/begin MEASUREMENT BCTE_TiBatChMaxByHour "Maximum charge time by hour" FLOAT32_IEEE swc_BatChCtl_CM_single_h 0 0 -3.40282346639e+038 3.40282346639e+038 ECU_ADDRESS 0x1FFE36E8 /end MEASUREMENT
/begin MEASUREMENT BCTE_TiBatChMaxByMinu "Maximum charge time by minute" FLOAT32_IEEE swc_BatChCtl_CM_single_min 0 0 -3.40282346639e+038 3.40282346639e+038 ECU_ADDRESS 0x1FFE36EC /end MEASUREMENT
/begin MEASUREMENT BCTE_TiBatDchaByMinuTot "Maximum discharge time by minute" FLOAT32_IEEE swc_BatChCtl_CM_single_min 0 0 -3.40282346639e+038 3.40282346639e+038 ECU_ADDRESS 0x1FFE36F0 /end MEASUREMENT
/begin CHARACTERISTIC BPIU_TCellUMinThd1_P "Low temperature threshold 1 for minimum voltage diagnoses" VALUE 0x200188EC Scalar_FLOAT32_IEEE 0 swc_BatProtnIU_CM_single_dash_ -3.40282346639e+038 3.40282346639e+038 /end CHARACTERISTIC
/begin CHARACTERISTIC BPIU_TCellUMinThd2_P "Low temperature threshold 2 for minimum voltage diagnoses" VALUE 0x200188F0 Scalar_FLOAT32_IEEE 0 swc_BatProtnIU_CM_single_dash_ -3.40282346639e+038 3.40282346639e+038 /end CHARACTERISTIC
/begin CHARACTERISTIC BSTC_ReqEmcyHvOffFromVcu_P "Request HV emergency shutdown from Vcu" VALUE 0x20019C4F Scalar_UBYTE 0 swc_BcuStTranCtl_CM_uint8_dash_ 0 255 /end CHARACTERISTIC
/begin CHARACTERISTIC BSTC_ReqNormHvOffFromVcu_P "Request HV normal shutdown from Vcu" VALUE 0x20019C51 Scalar_UBYTE 0 swc_BcuStTranCtl_CM_uint8_dash_ 0 255 /end CHARACTERISTIC
/begin CHARACTERISTIC BSTC_TiRxHvOffReqAftEmcy_P "Maximum waiting time for Hv off request after receiving the emergency Hv off request 1" VALUE 0x20018C40 Scalar_FLOAT32_IEEE 0 swc_BcuStTranCtl_CM_single_s -3.40282346639e+038 3.40282346639e+038 /end CHARACTERISTIC
/begin CHARACTERISTIC BSTC_TiRxHvOffReqForAcCh_P "Wait time for receiving the HV off request when BCU internal state transferfrom charge(AC) normal shutdown" VALUE 0x20018C44 Scalar_FLOAT32_IEEE 0 swc_BcuStTranCtl_CM_single_s -3.40282346639e+038 3.40282346639e+038 /end CHARACTERISTIC
/begin CHARACTERISTIC BSTC_TiRxHvOffReqForDcCh_P "Wait time for receiving the HV off request when BCU internal state transferfrom charge(DC) normal shutdown" VALUE 0x20018C48 Scalar_FLOAT32_IEEE 0 swc_BcuStTranCtl_CM_single_s -3.40282346639e+038 3.40282346639e+038 /end CHARACTERISTIC
/begin CHARACTERISTIC BSTC_TiRxHvOffReqForDcha_P "Wait time for receiving the HV off request when BCU internal state transfer from discharge normal shutdown" VALUE 0x20018C4C Scalar_FLOAT32_IEEE 0 swc_BcuStTranCtl_CM_single_s -3.40282346639e+038 3.40282346639e+038 /end CHARACTERISTIC
/begin CHARACTERISTIC BTHM_TRstDig93_P "Temperature for reset daignosis 93" VALUE 0x20018DBC Scalar_FLOAT32_IEEE 0 swc_BatThermHndlgMngt_CM_single_dash_ -3.40282346639e+038 3.40282346639e+038 /end CHARACTERISTIC
/begin CHARACTERISTIC BTHM_TSetDig93_P "Temperature for set daignosis 93" VALUE 0x20018DF8 Scalar_FLOAT32_IEEE 0 swc_BatThermHndlgMngt_CM_single_dash_ -3.40282346639e+038 3.40282346639e+038 /end CHARACTERISTIC
/begin CHARACTERISTIC BTHM_TiOffDig93_P "time delay off for diganosis 93" VALUE 0x20018E60 Scalar_FLOAT32_IEEE 0 swc_BatThermHndlgMngt_CM_single_dash_ 0 3.40282346639e+038 /end CHARACTERISTIC
/begin CHARACTERISTIC BTHM_TiOnDig93_P "time delay on for diganosis 93" VALUE 0x20018E9C Scalar_FLOAT32_IEEE 0 swc_BatThermHndlgMngt_CM_single_dash_ 0 3.40282346639e+038 /end CHARACTERISTIC
/begin CHARACTERISTIC BWLD_DirIChg_P "Parameter to change the direction of current\n      0:Current direction is negative for charging and positive for discharging\n      1:Current direction is positive for charging and negative for discharging" VALUE 0x20019C61 Scalar_BOOLEAN 0 swc_BatWntyLogtcData_CM_boolean_dash_ 0 1 /end CHARACTERISTIC
/begin CHARACTERISTIC BWLD_ESet_P "This value is used if energy set mode is activated and GUI mode is not active." VALUE 0x20018ED4 Scalar_FLOAT32_IEEE 0 swc_BatWntyLogtcData_CM_single_kWh 0 10000000 /end CHARACTERISTIC
/begin CHARACTERISTIC BWLD_IBatRst_P "Parameter to reset the maximum current values during battery life cycle" VALUE 0x20019C62 Scalar_BOOLEAN 0 swc_BatWntyLogtcData_CM_boolean_dash_ 0 1 /end CHARACTERISTIC
/begin CHARACTERISTIC BWLD_IChCtLim_P "Current limit for the charging energy counter" VALUE 0x20018ED8 Scalar_FLOAT32_IEEE 0 swc_BatWntyLogtcData_CM_single_A -2000 2000 /end CHARACTERISTIC
/begin CHARACTERISTIC BWLD_IDchaCtLim_P "Current limit for the discharging energy counter" VALUE 0x20018EDC Scalar_FLOAT32_IEEE 0 swc_BatWntyLogtcData_CM_single_A -2000 2000 /end CHARACTERISTIC
/begin CHARACTERISTIC BWLD_PBatRst_P "Parameter to reset the maximum power values during battery life cycle" VALUE 0x20019C63 Scalar_BOOLEAN 0 swc_BatWntyLogtcData_CM_boolean_dash_ 0 1 /end CHARACTERISTIC
/begin CHARACTERISTIC BWLD_UBatRst_P "Parameter to reset the maximum and mimimum voltages during battery life cycle" VALUE 0x20019C66 Scalar_BOOLEAN 0 swc_BatWntyLogtcData_CM_boolean_dash_ 0 1 /end CHARACTERISTIC
/begin CHARACTERISTIC CTC_CtrCtctrChDtrtLim_P "Maximum amount of tolerable switching cycles of charging contactor. Switching under load can consume more than one switching cycle." VALUE 0x200197FC Scalar_FLOAT32_IEEE 0 swc_CtctrTranCtl_CM_single_dash_ 0 100000000 /end CHARACTERISTIC
/begin CHARACTERISTIC CTC_CtrCtctrDtrtLimNeg_P "Maximum amount of tolerable switching cycles of a negative contactor. Switching under load can consume more than one switching cycle." VALUE 0x20019800 Scalar_FLOAT32_IEEE 0 swc_CtctrTranCtl_CM_single_dash_ 0 100000000 /end CHARACTERISTIC
/begin CHARACTERISTIC CTC_CtrCtctrDtrtLimPos_P "Maximum amount of tolerable switching cycles of a positive contactor. Switching under load can consume more than one switching cycle." VALUE 0x20019804 Scalar_FLOAT32_IEEE 0 swc_CtctrTranCtl_CM_single_dash_ 0 100000000 /end CHARACTERISTIC
/begin CHARACTERISTIC CTC_CtrCtctrDtrtLimPrech_P "Maximum amount of tolerable switching cycles of precharge contactor. Switching under load can consume more than one switching cycle." VALUE 0x20019808 Scalar_FLOAT32_IEEE 0 swc_CtctrTranCtl_CM_single_dash_ 0 100000000 /end CHARACTERISTIC
/begin CHARACTERISTIC CTC_ErrLoopHv_P "Hv loop error state\n      0x0: No error\n      0x1: Error\n      0x2: Reserved\n      0x3: Invalid" VALUE 0x20019D37 Scalar_UBYTE 0 swc_CtctrTranCtl_CM_uint8_dash_ 0 255 /end CHARACTERISTIC
/begin CHARACTERISTIC CTC_FacUMainPosPoleBefRly_P "The factor of main positive pole voltage before relay" VALUE 0x20019810 Scalar_FLOAT32_IEEE 0 swc_CtctrTranCtl_CM_single_dash_ 0 255 /end CHARACTERISTIC
/begin CHARACTERISTIC CTC_IBatHvLimHvOff_P "The current limit for determining whether the Hv power-off can be started" VALUE 0x20019D38 Scalar_UBYTE 0 swc_CtctrTranCtl_CM_uint8_A 0 255 /end CHARACTERISTIC
/begin CHARACTERISTIC CTC_IdRlyCh_P "PIN ID of charge relay control" VALUE 0x200198FC Scalar_ULONG 0 swc_CtctrTranCtl_CM_uint32_dash_ 0 4294967295 /end CHARACTERISTIC
/begin CHARACTERISTIC CTC_IdRlyHeat_P "PIN ID of heat relay control" VALUE 0x20019900 Scalar_ULONG 0 swc_CtctrTranCtl_CM_uint32_dash_ 0 4294967295 /end CHARACTERISTIC
/begin CHARACTERISTIC CTC_IdRlyNeg_P "PIN ID of negative relay control" VALUE 0x20019904 Scalar_ULONG 0 swc_CtctrTranCtl_CM_uint32_dash_ 0 4294967295 /end CHARACTERISTIC
/begin CHARACTERISTIC CTC_IdRlyPos_P "PIN ID of positive relay control" VALUE 0x20019908 Scalar_ULONG 0 swc_CtctrTranCtl_CM_uint32_dash_ 0 4294967295 /end CHARACTERISTIC
/begin CHARACTERISTIC CTC_IdRlyPrech_P "PIN ID of precharge relay control" VALUE 0x2001990C Scalar_ULONG 0 swc_CtctrTranCtl_CM_uint32_dash_ 0 4294967295 /end CHARACTERISTIC
/begin CHARACTERISTIC CTC_ModeMotDchaFnshd_P "The motor work mode is discharge finish" VALUE 0x20019D39 Scalar_UBYTE 0 swc_CtctrTranCtl_CM_uint8_dash_ 0 255 /end CHARACTERISTIC
/begin CHARACTERISTIC CTC_PctgCtctrChErrCdnLim_P "If the contactor deterioration of charging contactor is below this threshold, a corresponding error is activated." VALUE 0x20019910 Scalar_FLOAT32_IEEE 0 swc_CtctrTranCtl_CM_single_percent_ 0 100 /end CHARACTERISTIC
/begin CHARACTERISTIC CTC_PctgCtctrChWarnCdnLim_P "If the contactor deterioration of charging contactor is below this threshold, a corresponding warning is activated." VALUE 0x20019914 Scalar_FLOAT32_IEEE 0 swc_CtctrTranCtl_CM_single_percent_ 0 100 /end CHARACTERISTIC
/begin CHARACTERISTIC CTC_PctgCtctrErrCdnLimNeg_P "If the contactor deterioration of negative contactor is below this threshold, a corresponding error is activated." VALUE 0x20019918 Scalar_FLOAT32_IEEE 0 swc_CtctrTranCtl_CM_single_percent_ 0 100 /end CHARACTERISTIC
/begin CHARACTERISTIC CTC_PctgCtctrErrCdnLimPos_P "If the contactor deterioration of positive contactor is below this threshold, a corresponding error is activated." VALUE 0x2001991C Scalar_FLOAT32_IEEE 0 swc_CtctrTranCtl_CM_single_percent_ 0 100 /end CHARACTERISTIC
/begin CHARACTERISTIC CTC_PctgCtctrErrCdnLimPrech_P "If the contactor deterioration of precharge contactor is below this threshold, a corresponding error is activated." VALUE 0x20019920 Scalar_FLOAT32_IEEE 0 swc_CtctrTranCtl_CM_single_percent_ 0 100 /end CHARACTERISTIC
/begin CHARACTERISTIC CTC_PctgCtctrWarnCdnLimNeg_P "If the contactor deterioration of negative contactor is below this threshold, a corresponding warning is activated." VALUE 0x20019924 Scalar_FLOAT32_IEEE 0 swc_CtctrTranCtl_CM_single_percent_ 0 100 /end CHARACTERISTIC
/begin CHARACTERISTIC CTC_PctgCtctrWarnCdnLimPos_P "If the contactor deterioration of positive contactor is below this threshold, a corresponding warning is activated." VALUE 0x20019928 Scalar_FLOAT32_IEEE 0 swc_CtctrTranCtl_CM_single_percent_ 0 100 /end CHARACTERISTIC
/begin CHARACTERISTIC CTC_PctgCtctrWarnCdnLimPrech_P "If the contactor deterioration of precharge contactor is below this threshold, a corresponding warning is activated." VALUE 0x2001992C Scalar_FLOAT32_IEEE 0 swc_CtctrTranCtl_CM_single_percent_ 0 100 /end CHARACTERISTIC
/begin CHARACTERISTIC CTC_ReqHvOnFromVcu_P "Request HV on from Vcu" VALUE 0x20019D3A Scalar_UBYTE 0 swc_CtctrTranCtl_CM_uint8_dash_ 0 255 /end CHARACTERISTIC
/begin CHARACTERISTIC CTC_ReqRlyCh_P "Request for charge relay \n      0x0: Open\n      0x1: Close\n      0x2: Reserved\n      0x3: Invalid" VALUE 0x20019D3B Scalar_UBYTE 0 swc_CtctrTranCtl_CM_uint8_dash_ 0 255 /end CHARACTERISTIC
/begin CHARACTERISTIC CTC_ReqRlyHeat_P "Request for heat relay \n      0x0: Open\n      0x1: Close\n      0x2: Reserved\n      0x3: Invalid" VALUE 0x20019D3C Scalar_UBYTE 0 swc_CtctrTranCtl_CM_uint8_dash_ 0 255 /end CHARACTERISTIC
/begin CHARACTERISTIC CTC_ReqRlyNeg_P "Request for negative relay \n      0x0: Open\n      0x1: Close\n      0x2: Reserved\n      0x3: Invalid" VALUE 0x20019D3D Scalar_UBYTE 0 swc_CtctrTranCtl_CM_uint8_dash_ 0 255 /end CHARACTERISTIC
/begin CHARACTERISTIC CTC_ReqRlyPos_P "Request for positive relay \n      0x0: Open\n      0x1: Close\n      0x2: Reserved\n      0x3: Invalid" VALUE 0x20019D3E Scalar_UBYTE 0 swc_CtctrTranCtl_CM_uint8_dash_ 0 255 /end CHARACTERISTIC
/begin CHARACTERISTIC CTC_ReqRlyPrech_P "Request for precharge relay \n      0x0: Open\n      0x1: Close\n      0x2: Reserved\n      0x3: Invalid" VALUE 0x20019D3F Scalar_UBYTE 0 swc_CtctrTranCtl_CM_uint8_dash_ 0 255 /end CHARACTERISTIC
/begin CHARACTERISTIC CTC_StBcuStb_P "The BCU state is standby" VALUE 0x20019D40 Scalar_UBYTE 0 swc_CtctrTranCtl_CM_uint8_dash_ 0 255 /end CHARACTERISTIC
/begin CHARACTERISTIC CTC_StRlyCh_P "Charge relay state" VALUE 0x20019D43 Scalar_UBYTE 0 swc_CtctrTranCtl_CM_uint8_dash_ 0 255 /end CHARACTERISTIC
/begin CHARACTERISTIC CTC_StRlyChkCh_P "Fast charge relay self-check state\n      0:  OK\n      1:  Debouncing\n      2:  Error " VALUE 0x20019D44 Scalar_UBYTE 0 swc_CtctrTranCtl_CM_uint8_dash_ 0 255 /end CHARACTERISTIC
/begin CHARACTERISTIC CTC_StRlyChkHeat_P "Heat relay self-check state\n      0:  OK\n      1:  Debouncing\n      2:  Error " VALUE 0x20019D45 Scalar_UBYTE 0 swc_CtctrTranCtl_CM_uint8_dash_ 0 255 /end CHARACTERISTIC
/begin CHARACTERISTIC CTC_StRlyChkPos_P "Positive relay self-check state\n      0:  OK\n      1:  Debouncing\n      2:  Error " VALUE 0x20019D46 Scalar_UBYTE 0 swc_CtctrTranCtl_CM_uint8_dash_ 0 255 /end CHARACTERISTIC
/begin CHARACTERISTIC CTC_StRlyHeat_P "Heat relay state" VALUE 0x20019D47 Scalar_UBYTE 0 swc_CtctrTranCtl_CM_uint8_dash_ 0 255 /end CHARACTERISTIC
/begin CHARACTERISTIC CTC_StRlyNeg_P "Negative relay state" VALUE 0x20019D48 Scalar_UBYTE 0 swc_CtctrTranCtl_CM_uint8_dash_ 0 255 /end CHARACTERISTIC
/begin CHARACTERISTIC CTC_StRlyPos_P "Positive relay state" VALUE 0x20019D49 Scalar_UBYTE 0 swc_CtctrTranCtl_CM_uint8_dash_ 0 255 /end CHARACTERISTIC
/begin CHARACTERISTIC CTC_StRlyPrech_P "Precharge relay state" VALUE 0x20019D4A Scalar_UBYTE 0 swc_CtctrTranCtl_CM_uint8_dash_ 0 255 /end CHARACTERISTIC
/begin CHARACTERISTIC CTC_TiChkIni_P "Turn on delay for diganosis 119" VALUE 0x20019930 Scalar_FLOAT32_IEEE 0 swc_CtctrTranCtl_CM_single_s -3.40282346639e+038 3.40282346639e+038 /end CHARACTERISTIC
/begin CHARACTERISTIC CTC_TiCutoffLvReqFromVcu_P "Wait time for receiving Lv cutoff request from Vcu" VALUE 0x20019944 Scalar_FLOAT32_IEEE 0 swc_CtctrTranCtl_CM_single_s -3.40282346639e+038 3.40282346639e+038 /end CHARACTERISTIC
/begin CHARACTERISTIC CTC_TiEmcyHvOffReqFromVcu_P "Wait time for receiving Hv off request from Vcu" VALUE 0x20019948 Scalar_FLOAT32_IEEE 0 swc_CtctrTranCtl_CM_single_s -3.40282346639e+038 3.40282346639e+038 /end CHARACTERISTIC
/begin CHARACTERISTIC CTC_TiLoopDchaEmcy_P "Wait time for Hv loop discharge (emergency shutdown)" VALUE 0x2001994C Scalar_FLOAT32_IEEE 0 swc_CtctrTranCtl_CM_single_s -3.40282346639e+038 3.40282346639e+038 /end CHARACTERISTIC
/begin CHARACTERISTIC CTC_TiLoopDchaNorm_P "Wait time for Hv loop discharge (normal shutdown)" VALUE 0x20019950 Scalar_FLOAT32_IEEE 0 swc_CtctrTranCtl_CM_single_s -3.40282346639e+038 3.40282346639e+038 /end CHARACTERISTIC
/begin CHARACTERISTIC CTC_TiLoopNorm_P "Wait time for Hv loop become normal" VALUE 0x20019954 Scalar_FLOAT32_IEEE 0 swc_CtctrTranCtl_CM_single_s -3.40282346639e+038 3.40282346639e+038 /end CHARACTERISTIC
/begin CHARACTERISTIC CTC_TiLoopStTranToNorm_P "Wait time for transitioning Hv loop state from precharge finished to normal drive" VALUE 0x20019958 Scalar_FLOAT32_IEEE 0 swc_CtctrTranCtl_CM_single_s -3.40282346639e+038 3.40282346639e+038 /end CHARACTERISTIC
/begin CHARACTERISTIC CTC_TiMaxMainPosAftRlyUDecr_P "Maximum waiting time for voltage drop" VALUE 0x2001995C Scalar_FLOAT32_IEEE 0 swc_CtctrTranCtl_CM_single_s -3.40282346639e+038 3.40282346639e+038 /end CHARACTERISTIC
/begin CHARACTERISTIC CTC_TiMotDcha_P "Maximum wait time for motor discharge" VALUE 0x20019960 Scalar_FLOAT32_IEEE 0 swc_CtctrTranCtl_CM_single_s -3.40282346639e+038 3.40282346639e+038 /end CHARACTERISTIC
/begin CHARACTERISTIC CTC_TiPrechLim_P "Maximum limit precharge time" VALUE 0x20019A38 Scalar_FLOAT32_IEEE 0 swc_CtctrTranCtl_CM_single_s -3.40282346639e+038 3.40282346639e+038 /end CHARACTERISTIC
/begin CHARACTERISTIC CTC_TiRlyChChkIni_P "Waiting time for charge relay detection at initialisation" VALUE 0x20019A40 Scalar_FLOAT32_IEEE 0 swc_CtctrTranCtl_CM_single_s -3.40282346639e+038 3.40282346639e+038 /end CHARACTERISTIC
/begin CHARACTERISTIC CTC_TiRlyChkPosIni_P "Waiting time for main positive relay detection at initialisation" VALUE 0x20019A44 Scalar_FLOAT32_IEEE 0 swc_CtctrTranCtl_CM_single_s -3.40282346639e+038 3.40282346639e+038 /end CHARACTERISTIC
/begin CHARACTERISTIC CTC_TiRlyHeatChkIni_P "Waiting time for heat relay detection at initialisation\n      " VALUE 0x20019A48 Scalar_FLOAT32_IEEE 0 swc_CtctrTranCtl_CM_single_s -3.40282346639e+038 3.40282346639e+038 /end CHARACTERISTIC
/begin CHARACTERISTIC CTC_TiRlyNegOpenEmcy_P "Wait time for negative relay open (emergency shutdown)" VALUE 0x20019A4C Scalar_FLOAT32_IEEE 0 swc_CtctrTranCtl_CM_single_s -3.40282346639e+038 3.40282346639e+038 /end CHARACTERISTIC
/begin CHARACTERISTIC CTC_TiRlyNegOpenNorm_P "Wait time for negative relay open (normal shutdown)" VALUE 0x20019A50 Scalar_FLOAT32_IEEE 0 swc_CtctrTranCtl_CM_single_s -3.40282346639e+038 3.40282346639e+038 /end CHARACTERISTIC
/begin CHARACTERISTIC CTC_TiRlyNegOpen_P "Waiting time for the main negative relay to open" VALUE 0x20019A54 Scalar_FLOAT32_IEEE 0 swc_CtctrTranCtl_CM_single_s -3.40282346639e+038 3.40282346639e+038 /end CHARACTERISTIC
/begin CHARACTERISTIC CTC_TiRlyPrechOpen_P "Wait time for precharge relay open" VALUE 0x20019A58 Scalar_FLOAT32_IEEE 0 swc_CtctrTranCtl_CM_single_s -3.40282346639e+038 3.40282346639e+038 /end CHARACTERISTIC
/begin CHARACTERISTIC CTC_TiUDecr_P "Waiting time for the voltage to decrease (for skip voltage reduction detection)" VALUE 0x20019A5C Scalar_FLOAT32_IEEE 0 swc_CtctrTranCtl_CM_single_s -3.40282346639e+038 3.40282346639e+038 /end CHARACTERISTIC
/begin CHARACTERISTIC CTC_TiValmaxIDecr_P "Maximum wait time for HV battery current decrease" VALUE 0x20019A60 Scalar_FLOAT32_IEEE 0 swc_CtctrTranCtl_CM_single_s -3.40282346639e+038 3.40282346639e+038 /end CHARACTERISTIC
/begin CHARACTERISTIC CTC_TiWaitMaxForRlyChCls_P "Maximum waiting time for the charge relay to close\n      " VALUE 0x20019A64 Scalar_FLOAT32_IEEE 0 swc_CtctrTranCtl_CM_single_s -3.40282346639e+038 3.40282346639e+038 /end CHARACTERISTIC
/begin CHARACTERISTIC CTC_TiWaitMaxForRlyChOpen_P "Maximum waiting time for the charge relay to open\n      " VALUE 0x20019A68 Scalar_FLOAT32_IEEE 0 swc_CtctrTranCtl_CM_single_s -3.40282346639e+038 3.40282346639e+038 /end CHARACTERISTIC
/begin CHARACTERISTIC CTC_TiWaitMaxForRlyHeatCls_P "Maximum waiting time for the heat relay to close\n      " VALUE 0x20019A6C Scalar_FLOAT32_IEEE 0 swc_CtctrTranCtl_CM_single_s -3.40282346639e+038 3.40282346639e+038 /end CHARACTERISTIC
/begin CHARACTERISTIC CTC_TiWaitMaxForRlyHeatOpen_P "Maximum waiting time for the heat relay to open\n      " VALUE 0x20019A70 Scalar_FLOAT32_IEEE 0 swc_CtctrTranCtl_CM_single_s -3.40282346639e+038 3.40282346639e+038 /end CHARACTERISTIC
/begin CHARACTERISTIC CTC_TiWaitPrech_P "Wait time for precharging" VALUE 0x20019A74 Scalar_FLOAT32_IEEE 0 swc_CtctrTranCtl_CM_single_s -3.40282346639e+038 3.40282346639e+038 /end CHARACTERISTIC
/begin CHARACTERISTIC CTC_UChPoleHiSideDrv_P "The voltage for determining whether the high side drive voltage of charge relay is on or off" VALUE 0x20019A78 Scalar_FLOAT32_IEEE 0 swc_CtctrTranCtl_CM_single_V -3.40282346639e+038 3.40282346639e+038 /end CHARACTERISTIC
/begin CHARACTERISTIC CTC_UClsLim_P "The voltage limit for determining whether the voltage before and after the positive relay is similar" VALUE 0x20019A7C Scalar_FLOAT32_IEEE 0 swc_CtctrTranCtl_CM_single_V -3.40282346639e+038 3.40282346639e+038 /end CHARACTERISTIC
/begin CHARACTERISTIC CTC_UDecrChkLim_P "The voltage limit for determining whether the voltage has decreased" VALUE 0x20019A80 Scalar_FLOAT32_IEEE 0 swc_CtctrTranCtl_CM_single_V -3.40282346639e+038 3.40282346639e+038 /end CHARACTERISTIC
/begin CHARACTERISTIC CTC_UEquForCh_P "The voltage for determining whether the pole voltage after charge relay is equal to the pole voltage before charge relay" VALUE 0x20019A84 Scalar_FLOAT32_IEEE 0 swc_CtctrTranCtl_CM_single_V -3.40282346639e+038 3.40282346639e+038 /end CHARACTERISTIC
/begin CHARACTERISTIC CTC_UEquForHeat_P "The voltage for determining whether the pole voltage after heat relay is equal to the pole voltage before heat relay" VALUE 0x20019A88 Scalar_FLOAT32_IEEE 0 swc_CtctrTranCtl_CM_single_V -3.40282346639e+038 3.40282346639e+038 /end CHARACTERISTIC
/begin CHARACTERISTIC CTC_UEqu_P "The voltage for determining whether the pole voltage after main positive relay is equal to the pole voltage before main positive relay" VALUE 0x20019A8C Scalar_FLOAT32_IEEE 0 swc_CtctrTranCtl_CM_single_V -3.40282346639e+038 3.40282346639e+038 /end CHARACTERISTIC
/begin CHARACTERISTIC CTC_UHeatPoleHiSideDrv_P "The voltage for determining whether the high side drive voltage of heat relay is on or off" VALUE 0x20019A90 Scalar_FLOAT32_IEEE 0 swc_CtctrTranCtl_CM_single_V -3.40282346639e+038 3.40282346639e+038 /end CHARACTERISTIC
/begin CHARACTERISTIC CTC_UIncChkLim_P "The voltage limit for determining whether the voltage has increased" VALUE 0x20019A94 Scalar_FLOAT32_IEEE 0 swc_CtctrTranCtl_CM_single_V -3.40282346639e+038 3.40282346639e+038 /end CHARACTERISTIC
/begin CHARACTERISTIC CTC_UMainNegPoleHiSideDrv_P "The voltage for determining whether the high side drive voltage of negative relay is on or off" VALUE 0x20019A98 Scalar_FLOAT32_IEEE 0 swc_CtctrTranCtl_CM_single_V -3.40282346639e+038 3.40282346639e+038 /end CHARACTERISTIC
/begin CHARACTERISTIC CTC_UMainPosPoleHiSideDrv_P "The voltage for determining whether the high side drive voltage of positive relay is on or off" VALUE 0x20019A9C Scalar_FLOAT32_IEEE 0 swc_CtctrTranCtl_CM_single_V -3.40282346639e+038 3.40282346639e+038 /end CHARACTERISTIC
/begin CHARACTERISTIC CTC_UMotDchaLim_P "Maximum limit voltage after successful discharge of the motor" VALUE 0x20019AA0 Scalar_FLOAT32_IEEE 0 swc_CtctrTranCtl_CM_single_V 0 10000 /end CHARACTERISTIC
/begin CHARACTERISTIC CTC_URlyPrechHiSideDrv_P "The voltage for determining whether the high side drive voltage of precharge relay is on or off" VALUE 0x20019AA8 Scalar_FLOAT32_IEEE 0 swc_CtctrTranCtl_CM_single_V -3.40282346639e+038 3.40282346639e+038 /end CHARACTERISTIC
/begin CHARACTERISTIC CTC_bAcvCh_P "acitve flag of charging" VALUE 0x20019D4C Scalar_BOOLEAN 0 swc_CtctrTranCtl_CM_boolean_dash_ 0 1 /end CHARACTERISTIC
/begin CHARACTERISTIC CTC_bAcvTrml15Chk_P "Active flag for check KL15 state" VALUE 0x20019D4E Scalar_BOOLEAN 0 swc_CtctrTranCtl_CM_boolean_dash_ 0 1 /end CHARACTERISTIC
/begin CHARACTERISTIC CTC_bErrToutForMotDcha_P "Motor discharge time out" VALUE 0x20019D66 Scalar_BOOLEAN 0 swc_CtctrTranCtl_CM_boolean_dash_ 0 1 /end CHARACTERISTIC
/begin AXIS_PTS ELHPN_StBatHv_A "Axis for look up table of isolation measurement disable flag." 0x20019B84 NO_INPUT_QUANTITY Lookup1D_X_UBYTE 0 swc_EltlLnkHzrdProtnNet_CM_uint8_dash_ 16 0 255 DEPOSIT ABSOLUTE /end AXIS_PTS
/begin CHARACTERISTIC ELHPN_StIslnSys1Thd1_P "Threshold1 to distinguish wether State Isolation of system1 is level1. (level1: System resistance isolation lower than threshold1; System1: 400V System).\n      " VALUE 0x20019B1C Scalar_ULONG 0 swc_EltlLnkHzrdProtnNet_CM_uint32_kOhm 0 4294967295 /end CHARACTERISTIC
/begin CHARACTERISTIC ELHPN_StIslnSys1Thd2_P "Threshold2 to distinguish wether State Isolation of system1 is level2. (level2: System resistance isolation lower than threshold2; system1: 400V System)." VALUE 0x20019B20 Scalar_ULONG 0 swc_EltlLnkHzrdProtnNet_CM_uint32_kOhm 0 4294967295 /end CHARACTERISTIC
/begin CHARACTERISTIC ELHPN_StIslnSys2Thd1_P "Threshold1 to distinguish wether State Isolation of system2 is level1. (level1: System resistance isolation lower than threshold1; System2: 600V System).\n      " VALUE 0x20019B24 Scalar_ULONG 0 swc_EltlLnkHzrdProtnNet_CM_uint32_kOhm 0 4294967295 /end CHARACTERISTIC
/begin CHARACTERISTIC ELHPN_StIslnSys2Thd2_P "Threshold2 to distinguish wether State Isolation of system2 is level2. (level2: System resistance isolation lower than threshold2; System2: 600V System).\n      " VALUE 0x20019B28 Scalar_ULONG 0 swc_EltlLnkHzrdProtnNet_CM_uint32_kOhm 0 4294967295 /end CHARACTERISTIC
/begin CHARACTERISTIC ELHPN_StIslnSysCfg_P "Set this parameter either 0 or 1 according to system voltage for state isolation judgement. (0: 400V system; 1: 600V system)." VALUE 0x20019D85 Scalar_UBYTE 0 swc_EltlLnkHzrdProtnNet_CM_uint8_dash_ 0 255 /end CHARACTERISTIC
/begin CHARACTERISTIC ELHPN_ThdClrDiag101_P "Threshold to clear DTC101." VALUE 0x20019C22 Scalar_UWORD 0 swc_EltlLnkHzrdProtnNet_CM_uint16_Ohm_per_V 0 65535 /end CHARACTERISTIC
/begin CHARACTERISTIC ELHPN_ThdClrDiag102_P "Parameter to clear DTC102." VALUE 0x20019C24 Scalar_UWORD 0 swc_EltlLnkHzrdProtnNet_CM_uint16_Ohm_per_V 0 65535 /end CHARACTERISTIC
/begin CHARACTERISTIC ELHPN_ThdDiag101_P "DTC101 will be activated when isolation value per voltage on positive less than this threshold." VALUE 0x20019C26 Scalar_UWORD 0 swc_EltlLnkHzrdProtnNet_CM_uint16_Ohm_per_V 0 65535 /end CHARACTERISTIC
/begin CHARACTERISTIC ELHPN_ThdDiag102_P "DTC102 will be activated when isolation value per voltage on negative less than this threshold." VALUE 0x20019C28 Scalar_UWORD 0 swc_EltlLnkHzrdProtnNet_CM_uint16_Ohm_per_V 0 65535 /end CHARACTERISTIC
/begin CHARACTERISTIC ELHPN_ThdDiag16_P "DTC16 will be activated when isolation value per voltage on positive less than this threshold." VALUE 0x20019C2A Scalar_UWORD 0 swc_EltlLnkHzrdProtnNet_CM_uint16_Ohm_per_V 0 65535 /end CHARACTERISTIC
/begin CHARACTERISTIC ELHPN_ThdDiag17_P "DTC17 will be activated when isolation value per voltage on negative less than this threshold." VALUE 0x20019C2C Scalar_UWORD 0 swc_EltlLnkHzrdProtnNet_CM_uint16_Ohm_per_V 0 65535 /end CHARACTERISTIC
/begin CHARACTERISTIC ELHPN_TiDiagDebOff101_P "Time dalay off for debounce of DTC101." VALUE 0x20019B54 Scalar_FLOAT32_IEEE 0 swc_EltlLnkHzrdProtnNet_CM_single_s -3.40282346639e+038 3.40282346639e+038 /end CHARACTERISTIC
/begin CHARACTERISTIC ELHPN_TiDiagDebOff102_P "Time dalay off for debounce of DTC102." VALUE 0x20019B58 Scalar_FLOAT32_IEEE 0 swc_EltlLnkHzrdProtnNet_CM_single_s -3.40282346639e+038 3.40282346639e+038 /end CHARACTERISTIC
/begin CHARACTERISTIC ELHPN_TiDiagDebOff16_P "Time dalay off for debounce of DTC16." VALUE 0x20019B5C Scalar_FLOAT32_IEEE 0 swc_EltlLnkHzrdProtnNet_CM_single_s -3.40282346639e+038 3.40282346639e+038 /end CHARACTERISTIC
/begin CHARACTERISTIC ELHPN_TiDiagDebOff17_P "Time dalay off for debounce of DTC17." VALUE 0x20019B60 Scalar_FLOAT32_IEEE 0 swc_EltlLnkHzrdProtnNet_CM_single_s -3.40282346639e+038 3.40282346639e+038 /end CHARACTERISTIC
/begin CHARACTERISTIC ELHPN_TiDiagDebOff18_P "Time dalay off for debounce of DTC18." VALUE 0x20019B64 Scalar_FLOAT32_IEEE 0 swc_EltlLnkHzrdProtnNet_CM_single_s -3.40282346639e+038 3.40282346639e+038 /end CHARACTERISTIC
/begin CHARACTERISTIC ELHPN_TiDiagDebOn101_P "Time dalay on for debounce of DTC101." VALUE 0x20019B68 Scalar_FLOAT32_IEEE 0 swc_EltlLnkHzrdProtnNet_CM_single_s -3.40282346639e+038 3.40282346639e+038 /end CHARACTERISTIC
/begin CHARACTERISTIC ELHPN_TiDiagDebOn102_P "Time dalay on for debounce of DTC102." VALUE 0x20019B6C Scalar_FLOAT32_IEEE 0 swc_EltlLnkHzrdProtnNet_CM_single_s -3.40282346639e+038 3.40282346639e+038 /end CHARACTERISTIC
/begin CHARACTERISTIC ELHPN_TiDiagDebOn16_P "Time dalay on for debounce of DTC16." VALUE 0x20019B70 Scalar_FLOAT32_IEEE 0 swc_EltlLnkHzrdProtnNet_CM_single_s -3.40282346639e+038 3.40282346639e+038 /end CHARACTERISTIC
/begin CHARACTERISTIC ELHPN_TiDiagDebOn17_P "Time dalay on for debounce of DTC17." VALUE 0x20019B74 Scalar_FLOAT32_IEEE 0 swc_EltlLnkHzrdProtnNet_CM_single_s -3.40282346639e+038 3.40282346639e+038 /end CHARACTERISTIC
/begin CHARACTERISTIC ELHPN_TiDiagDebOn18_P "Time dalay on for debounce of DTC18." VALUE 0x20019B78 Scalar_FLOAT32_IEEE 0 swc_EltlLnkHzrdProtnNet_CM_single_s -3.40282346639e+038 3.40282346639e+038 /end CHARACTERISTIC
/begin CHARACTERISTIC ELHPN_bAcvLoopHv_M "Indicates the establishment of high voltage loop." CURVE 0x20019B94 Lookup1D_UBYTE 0 swc_EltlLnkHzrdProtnNet_CM_uint8_dash_ 0 255
 /begin AXIS_DESCR COM_AXIS NO_INPUT_QUANTITY swc_EltlLnkHzrdProtnNet_CM_uint8_dash_ 16 0 255 DEPOSIT ABSOLUTE AXIS_PTS_REF ELHPN_StBatHv_A /end AXIS_DESCR
/end CHARACTERISTIC
/begin MEASUREMENT EVCSH_AcvChSuspdByChrgr "BMS charging suspension reason: Suspended by charger " UBYTE swc_BatChCtl_CM_uint8_dash_ 0 0 0 255 ECU_ADDRESS 0x1FFE7524 /end MEASUREMENT
/begin MEASUREMENT EVCSH_ChEndTypIRV "DC charge status" UBYTE swc_BatChCtl_CM_uint8_dash_ 0 0 0 255 ECU_ADDRESS 0x1FFE7525 /end MEASUREMENT
/begin MEASUREMENT EVCSH_ChMode "Charging mode (0 x 01: constant voltage charging;0 x 02: constant current charging)" UBYTE swc_BatChCtl_CM_uint8_dash_ 0 0 0 255 ECU_ADDRESS 0x1FFE7526 /end MEASUREMENT
/begin MEASUREMENT EVCSH_ErrMsgChrgrChRdy "Timeout when receiving ready for charging message of the charger (<00>: = normal; <01>: = timeout; <10>: = implausible state)" UBYTE swc_BatChCtl_CM_uint8_dash_ 0 0 0 255 ECU_ADDRESS 0x1FFE7527 /end MEASUREMENT
/begin MEASUREMENT EVCSH_ErrMsgChrgrChSts "Timeout when receiving charging status message of the charger (<00>: = normal; <01>: = timeout; <10>: = implausible state)" UBYTE swc_BatChCtl_CM_uint8_dash_ 0 0 0 255 ECU_ADDRESS 0x1FFE7528 /end MEASUREMENT
/begin MEASUREMENT EVCSH_ErrMsgChrgrChStstc "Timeout when receiving charging statistic data message of the charger (<00>: = normal; <01>: = timeout; <10>: = implausible state)" UBYTE swc_BatChCtl_CM_uint8_dash_ 0 0 0 255 ECU_ADDRESS 0x1FFE7529 /end MEASUREMENT
/begin MEASUREMENT EVCSH_ErrMsgChrgrChSuspd "Timeout when receiving charging suspension message of the charger (<00>: = normal; <01>: = timeout; <10>: = implausible state)" UBYTE swc_BatChCtl_CM_uint8_dash_ 0 0 0 255 ECU_ADDRESS 0x1FFE752A /end MEASUREMENT
/begin MEASUREMENT EVCSH_ErrMsgChrgrIdfcNotRdy "Timeout when receiving charger identification message SPN2560 = 0 x 00 (<00>: = normal; <01>: = timeout; <10>: = implausible state)" UBYTE swc_BatChCtl_CM_uint8_dash_ 0 0 0 255 ECU_ADDRESS 0x1FFE752B /end MEASUREMENT
/begin MEASUREMENT EVCSH_ErrMsgChrgrIdfcRdy "Timeout when receiving charger identification message SPN2560 = 0 x AA (<00>: = normal; <01>: = timeout; <10>: = implausible state)" UBYTE swc_BatChCtl_CM_uint8_dash_ 0 0 0 255 ECU_ADDRESS 0x1FFE752C /end MEASUREMENT
/begin MEASUREMENT EVCSH_ErrMsgChrgrSync "Timeout when receiving charger time synchronization and maximum output capacity message (<00>: = normal; <01>: = timeout; <10>: = implausible state)" UBYTE swc_BatChCtl_CM_uint8_dash_ 0 0 0 255 ECU_ADDRESS 0x1FFE752D /end MEASUREMENT
/begin MEASUREMENT EVCSH_IChrgrSp "Current demand" FLOAT32_IEEE swc_BatChCtl_CM_single_A 0 0 -3.40282346639e+038 3.40282346639e+038 ECU_ADDRESS 0x1FFE36F4 /end MEASUREMENT
/begin MEASUREMENT EVCSH_IChrgrSpIRV "Current demand" FLOAT32_IEEE swc_BatChCtl_CM_single_A 0 0 -3.40282346639e+038 3.40282346639e+038 ECU_ADDRESS 0x1FFE36F8 /end MEASUREMENT
/begin MEASUREMENT EVCSH_StBatRdy "BMS is ready for charging or not (<0 x 00 >: = BMS is not ready); <0 x AA >: = BMS is ready; <0 x FF>: = invalid)" UBYTE swc_BatChCtl_CM_uint8_dash_ 0 0 0 255 ECU_ADDRESS 0x1FFE752E /end MEASUREMENT
/begin MEASUREMENT EVCSH_StDcCh "DC charging status." UBYTE swc_BatChCtl_CM_uint8_dash_ 0 0 0 255 ECU_ADDRESS 0x1FFE752F /end MEASUREMENT
/begin MEASUREMENT EVCSH_StInt "Electric Vehicle Charging State Handler State Internal" UWORD swc_BatChCtl_CM_uint16_dash_ 0 0 0 65535 ECU_ADDRESS 0x1FFE748C /end MEASUREMENT
/begin MEASUREMENT EVCSH_StIntIRV "Electric Vehicle Charging State Handler State Internal" UWORD swc_BatChCtl_CM_uint16_dash_ 0 0 0 65535 ECU_ADDRESS 0x1FFE748E /end MEASUREMENT
/begin MEASUREMENT EVCSH_StIslnMeasReq "State Isolation Measure Request" UBYTE swc_BatChCtl_CM_uint8_dash_ 0 0 0 8 ECU_ADDRESS 0x1FFE7530 /end MEASUREMENT
/begin MEASUREMENT EVCSH_UChrgrSp "Voltage demand (V)" FLOAT32_IEEE swc_BatChCtl_CM_single_V 0 0 -3.40282346639e+038 3.40282346639e+038 ECU_ADDRESS 0x1FFE36FC /end MEASUREMENT
/begin MEASUREMENT EVCSH_bAcvCfgCmpl "Parameter configuration completed flag" UBYTE swc_BatChCtl_CM_boolean_dash_ 0 0 0 1 ECU_ADDRESS 0x1FFE753B /end MEASUREMENT
/begin MEASUREMENT EVCSH_bAcvChSeqEnd "Active Flag Charge Sequence End" UBYTE swc_BatChCtl_CM_boolean_dash_ 0 0 0 1 ECU_ADDRESS 0x1FFE753C /end MEASUREMENT
/begin MEASUREMENT EVCSH_bAcvDcChReqFromVcu "Active Flag DC Charging Request From VehicleControlUnit" UBYTE swc_BatChCtl_CM_boolean_dash_ 0 0 0 1 ECU_ADDRESS 0x1FFE753D /end MEASUREMENT
/begin MEASUREMENT EVCSH_bAcvDcCnctReq "DC Charging Contactor Connect Request" UBYTE swc_BatChCtl_CM_boolean_dash_ 0 0 0 1 ECU_ADDRESS 0x1FFE753E /end MEASUREMENT
/begin MEASUREMENT EVCSH_bAcvVeh2VehDcha "V2V active flag" UBYTE swc_BatChCtl_CM_boolean_dash_ 0 0 0 1 ECU_ADDRESS 0x1FFE753F /end MEASUREMENT
/begin MEASUREMENT EVCSH_bEnaChrgn "Allow charging (<00>: = forbidden; <01>: = allowable)" UBYTE swc_BatChCtl_CM_uint8_dash_ 0 0 0 255 ECU_ADDRESS 0x1FFE7531 /end MEASUREMENT
/begin MEASUREMENT EVCSH_bEnaMsgBatCfg "Enable send BCP : 0-disable;1-enable " UBYTE swc_BatChCtl_CM_boolean_dash_ 0 0 0 1 ECU_ADDRESS 0x1FFE7540 /end MEASUREMENT
/begin MEASUREMENT EVCSH_bEnaMsgBatCfgPgtn "Enable send BCPP: 0-disable;1-enable" UBYTE swc_BatChCtl_CM_boolean_dash_ 0 0 0 1 ECU_ADDRESS 0x1FFE7541 /end MEASUREMENT
/begin MEASUREMENT EVCSH_bEnaMsgBatChDmd "Enable send BCL : 0-disable;1-enable" UBYTE swc_BatChCtl_CM_boolean_dash_ 0 0 0 1 ECU_ADDRESS 0x1FFE7542 /end MEASUREMENT
/begin MEASUREMENT EVCSH_bEnaMsgBatChSt "Enable send BCS : 0-disable;1-enable" UBYTE swc_BatChCtl_CM_boolean_dash_ 0 0 0 1 ECU_ADDRESS 0x1FFE7543 /end MEASUREMENT
/begin MEASUREMENT EVCSH_bEnaMsgBatChStPgtn "Enable send BCSP: 0-disable;1-enable" UBYTE swc_BatChCtl_CM_boolean_dash_ 0 0 0 1 ECU_ADDRESS 0x1FFE7544 /end MEASUREMENT
/begin MEASUREMENT EVCSH_bEnaMsgBatChSuspd "Enable send BST: 0-disable;1-enable" UBYTE swc_BatChCtl_CM_boolean_dash_ 0 0 0 1 ECU_ADDRESS 0x1FFE7545 /end MEASUREMENT
/begin MEASUREMENT EVCSH_bEnaMsgBatDetdCfg "Enable send BDC: 0-disable;1-enable" UBYTE swc_BatChCtl_CM_boolean_dash_ 0 0 0 1 ECU_ADDRESS 0x1FFE7546 /end MEASUREMENT
/begin MEASUREMENT EVCSH_bEnaMsgBatErr "Enable send BSD: 0-disable;1-enable" UBYTE swc_BatChCtl_CM_boolean_dash_ 0 0 0 1 ECU_ADDRESS 0x1FFE7547 /end MEASUREMENT
/begin MEASUREMENT EVCSH_bEnaMsgBatHdshk "Enable send BHM : 0-disable;1-enable" UBYTE swc_BatChCtl_CM_boolean_dash_ 0 0 0 1 ECU_ADDRESS 0x1FFE7548 /end MEASUREMENT
/begin MEASUREMENT EVCSH_bEnaMsgBatPrvt "Enable send BSP : 0-disable;1-enable" UBYTE swc_BatChCtl_CM_boolean_dash_ 0 0 0 1 ECU_ADDRESS 0x1FFE7549 /end MEASUREMENT
/begin MEASUREMENT EVCSH_bEnaMsgBatRcgtn "Enable send BRM : 0-disable;1-enable" UBYTE swc_BatChCtl_CM_boolean_dash_ 0 0 0 1 ECU_ADDRESS 0x1FFE754A /end MEASUREMENT
/begin MEASUREMENT EVCSH_bEnaMsgBatRdy "Enable send BRO : 0-disable;1-enable" UBYTE swc_BatChCtl_CM_boolean_dash_ 0 0 0 1 ECU_ADDRESS 0x1FFE754B /end MEASUREMENT
/begin MEASUREMENT EVCSH_bEnaMsgBatSt "Enable send BSM : 0-disable;1-enable" UBYTE swc_BatChCtl_CM_boolean_dash_ 0 0 0 1 ECU_ADDRESS 0x1FFE754C /end MEASUREMENT
/begin MEASUREMENT EVCSH_bEnaMsgBatStstc "Enable send BSD: 0-disable;1-enable" UBYTE swc_BatChCtl_CM_boolean_dash_ 0 0 0 1 ECU_ADDRESS 0x1FFE754D /end MEASUREMENT
/begin MEASUREMENT EVCSH_bEnaMsgBatT "Enable send BMT: 0-disable;1-enable" UBYTE swc_BatChCtl_CM_boolean_dash_ 0 0 0 1 ECU_ADDRESS 0x1FFE754E /end MEASUREMENT
/begin MEASUREMENT EVCSH_bEnaMsgCellU "Enable send BMV : 0-disable;1-enable" UBYTE swc_BatChCtl_CM_boolean_dash_ 0 0 0 1 ECU_ADDRESS 0x1FFE754F /end MEASUREMENT
/begin GROUP S692_Measurement_Equation_hfun "swc_BatCoreFct/BCF_100ms_sys/BatCoreFct/PackStateClcn/PackSofClcn/Pack Min Max Voltage Prediction/Module Min Max Voltage Prediction/SOF Actual/Measurement Equation hfun"
 /begin SUB_GROUP S701_BCF_RBv_M S701_BCF_RMdulCnct_P S701_BCF_UChOc_M S701_BCF_UDchaOc_M S701_BCF_Wbz_M S701_BCF_WbzFac_P /end SUB_GROUP
/end GROUP
/begin GROUP S693__Process_Equation__ffun "swc_BatCoreFct/BCF_100ms_sys/BatCoreFct/PackStateClcn/PackSofClcn/Pack Min Max Voltage Prediction/Module Min Max Voltage Prediction/SOF Pred/ Process Equation, ffun" /begin SUB_GROUP S717_BCF_CCellNom_M S717_BCF_SofTcPred_P S717_BCF_WbzTc_M /end SUB_GROUP /end GROUP
/begin GROUP S693_Measurement_Equation_hfun "swc_BatCoreFct/BCF_100ms_sys/BatCoreFct/PackStateClcn/PackSofClcn/Pack Min Max Voltage Prediction/Module Min Max Voltage Prediction/SOF Pred/Measurement Equation hfun"
 /begin SUB_GROUP S718_BCF_RBv_M S718_BCF_RMdulCnct_P S718_BCF_UChOc_M S718_BCF_UDchaOc_M S718_BCF_Wbz_M S718_BCF_WbzFac_P /end SUB_GROUP
/end GROUP
/begin GROUP S69_BBC_SocChBalnModeOffThd_M "swc_BatBalnCtl/BBC_100ms_sys/BBC_100ms_sys/BatBalnCtl/Battery Balancing Decision/BatBalnCtl/Determine Balancing Thresholds/Battery is AC Charging/BBC_SocChBalnModeOffThd_M" /begin REF_CHARACTERISTIC BBC_SocChBalnModeOffThd_M /end REF_CHARACTERISTIC /end GROUP
/begin GROUP S69_BBC_SocChBalnModeOnThd_M "swc_BatBalnCtl/BBC_100ms_sys/BBC_100ms_sys/BatBalnCtl/Battery Balancing Decision/BatBalnCtl/Determine Balancing Thresholds/Battery is AC Charging/BBC_SocChBalnModeOnThd_M" /begin REF_CHARACTERISTIC BBC_SocChBalnModeOnThd_M /end REF_CHARACTERISTIC /end GROUP
/begin GROUP S69_BCF_IDCMDFORININOC_P "swc_BatCoreFct/BCF_100ms_sys/BatCoreFct/BatCoreInit/InitializationDecision/BCF_IDCMDFORININOC_P" /begin REF_CHARACTERISTIC BCF_IDCMDFORININOC_P /end REF_CHARACTERISTIC /end GROUP
/begin GROUP S69_BCF_IDCMDFORSOCMAN_P "swc_BatCoreFct/BCF_100ms_sys/BatCoreFct/BatCoreInit/InitializationDecision/BCF_IDCMDFORSOCMAN_P" /begin REF_CHARACTERISTIC BCF_IDCMDFORSOCMAN_P /end REF_CHARACTERISTIC /end GROUP
/begin GROUP S69_BCF_ReqSrv_P1 "swc_BatCoreFct/BCF_100ms_sys/BatCoreFct/BatCoreInit/InitializationDecision/BCF_ReqSrv_P1" /begin REF_CHARACTERISTIC BCF_ReqSrv_P /end REF_CHARACTERISTIC /end GROUP
/begin GROUP S70_BBC_SocChBalnModeOffThd_M "swc_BatBalnCtl/BBC_100ms_sys/BBC_100ms_sys/BatBalnCtl/Battery Balancing Decision/BatBalnCtl/Determine Balancing Thresholds/Battery is DC Charging/BBC_SocChBalnModeOffThd_M" /begin REF_CHARACTERISTIC BBC_SocChBalnModeOffThd_M /end REF_CHARACTERISTIC /end GROUP
/begin GROUP S70_BBC_SocChBalnModeOnThd_M "swc_BatBalnCtl/BBC_100ms_sys/BBC_100ms_sys/BatBalnCtl/Battery Balancing Decision/BatBalnCtl/Determine Balancing Thresholds/Battery is DC Charging/BBC_SocChBalnModeOnThd_M" /begin REF_CHARACTERISTIC BBC_SocChBalnModeOnThd_M /end REF_CHARACTERISTIC /end GROUP
/begin GROUP S70_BCF_SocIniMan_P "swc_BatCoreFct/BCF_100ms_sys/BatCoreFct/BatCoreInit/ManualSOCInitializationServiceMode/BCF_SocIniMan_P" /begin REF_CHARACTERISTIC BCF_SocIniMan_P /end REF_CHARACTERISTIC /end GROUP
/begin GROUP S71_BBC_SocDcnctBalnModeOffThd_M "swc_BatBalnCtl/BBC_100ms_sys/BBC_100ms_sys/BatBalnCtl/Battery Balancing Decision/BatBalnCtl/Determine Balancing Thresholds/Battery is Offline // Relais open/BBC_SocDcnctBalnModeOffThd_M" /begin REF_CHARACTERISTIC BBC_SocDcnctBalnModeOffThd_M /end REF_CHARACTERISTIC /end GROUP
/begin GROUP S71_BBC_SocDcnctBalnModeOnThd_M "swc_BatBalnCtl/BBC_100ms_sys/BBC_100ms_sys/BatBalnCtl/Battery Balancing Decision/BatBalnCtl/Determine Balancing Thresholds/Battery is Offline // Relais open/BBC_SocDcnctBalnModeOnThd_M" /begin REF_CHARACTERISTIC BBC_SocDcnctBalnModeOnThd_M /end REF_CHARACTERISTIC /end GROUP
/begin GROUP S71_BCF_CMdulAgiFacTest_P "swc_BatCoreFct/BCF_100ms_sys/BatCoreFct/BatCoreInit/MemoryAndSignalInitializationInServiceMode/BCF_CMdulAgiFacTest_P" /begin REF_CHARACTERISTIC BCF_CMdulAgiFacTest_P /end REF_CHARACTERISTIC /end GROUP
/begin GROUP S71_BCF_CMdulAgiFacTripTest_P "swc_BatCoreFct/BCF_100ms_sys/BatCoreFct/BatCoreInit/MemoryAndSignalInitializationInServiceMode/BCF_CMdulAgiFacTripTest_P" /begin REF_CHARACTERISTIC BCF_CMdulAgiFacTripTest_P /end REF_CHARACTERISTIC /end GROUP
/begin GROUP S71_BCF_RMdulAgiFacTest_P "swc_BatCoreFct/BCF_100ms_sys/BatCoreFct/BatCoreInit/MemoryAndSignalInitializationInServiceMode/BCF_RMdulAgiFacTest_P" /begin REF_CHARACTERISTIC BCF_RMdulAgiFacTest_P /end REF_CHARACTERISTIC /end GROUP
/begin GROUP S71_BCF_RMdulAgiFacTripTest_P "swc_BatCoreFct/BCF_100ms_sys/BatCoreFct/BatCoreInit/MemoryAndSignalInitializationInServiceMode/BCF_RMdulAgiFacTripTest_P" /begin REF_CHARACTERISTIC BCF_RMdulAgiFacTripTest_P /end REF_CHARACTERISTIC /end GROUP
/begin GROUP S71_BCF_SohPackMinFlsForTest_P "swc_BatCoreFct/BCF_100ms_sys/BatCoreFct/BatCoreInit/MemoryAndSignalInitializationInServiceMode/BCF_SohPackMinFlsForTest_P" /begin REF_CHARACTERISTIC BCF_SohPackMinFlsForTest_P /end REF_CHARACTERISTIC /end GROUP
/begin GROUP S71_BCF_SohRDeltaFlsForTest_P "swc_BatCoreFct/BCF_100ms_sys/BatCoreFct/BatCoreInit/MemoryAndSignalInitializationInServiceMode/BCF_SohRDeltaFlsForTest_P" /begin REF_CHARACTERISTIC BCF_SohRDeltaFlsForTest_P /end REF_CHARACTERISTIC /end GROUP
/begin GROUP S71_BCF_SohSocDeltaFlsForTest_P "swc_BatCoreFct/BCF_100ms_sys/BatCoreFct/BatCoreInit/MemoryAndSignalInitializationInServiceMode/BCF_SohSocDeltaFlsForTest_P" /begin REF_CHARACTERISTIC BCF_SohSocDeltaFlsForTest_P /end REF_CHARACTERISTIC /end GROUP
/begin GROUP S71_BCF_TiBatOffForMdulCTest_P "swc_BatCoreFct/BCF_100ms_sys/BatCoreFct/BatCoreInit/MemoryAndSignalInitializationInServiceMode/BCF_TiBatOffForMdulCTest_P" /begin REF_CHARACTERISTIC BCF_TiBatOffForMdulCTest_P /end REF_CHARACTERISTIC /end GROUP
/begin GROUP S71_BCF_TiBatOffForMdulRTest_P "swc_BatCoreFct/BCF_100ms_sys/BatCoreFct/BatCoreInit/MemoryAndSignalInitializationInServiceMode/BCF_TiBatOffForMdulRTest_P" /begin REF_CHARACTERISTIC BCF_TiBatOffForMdulRTest_P /end REF_CHARACTERISTIC /end GROUP
/begin GROUP S72_BBC_SocDrvgBalnModeOffThd_M "swc_BatBalnCtl/BBC_100ms_sys/BBC_100ms_sys/BatBalnCtl/Battery Balancing Decision/BatBalnCtl/Determine Balancing Thresholds/Battery is Online/BBC_SocDrvgBalnModeOffThd_M" /begin REF_CHARACTERISTIC BBC_SocDrvgBalnModeOffThd_M /end REF_CHARACTERISTIC /end GROUP
/begin GROUP S72_BBC_SocDrvgBalnModeOnThd_M "swc_BatBalnCtl/BBC_100ms_sys/BBC_100ms_sys/BatBalnCtl/Battery Balancing Decision/BatBalnCtl/Determine Balancing Thresholds/Battery is Online/BBC_SocDrvgBalnModeOnThd_M" /begin REF_CHARACTERISTIC BBC_SocDrvgBalnModeOnThd_M /end REF_CHARACTERISTIC /end GROUP
/begin GROUP S73_BPIU_TCellUMinThd1_P "swc_BatProtnIU/CellUDiag/100ms/CellVoltageDiagnosis/CellVoltageLimitCore/Subsystem/BPIU_TCellUMinThd1_P" /begin REF_CHARACTERISTIC BPIU_TCellUMinThd1_P /end REF_CHARACTERISTIC /end GROUP
/begin GROUP S73_BPIU_TCellUMinThd2_P "swc_BatProtnIU/CellUDiag/100ms/CellVoltageDiagnosis/CellVoltageLimitCore/Subsystem/BPIU_TCellUMinThd2_P" /begin REF_CHARACTERISTIC BPIU_TCellUMinThd2_P /end REF_CHARACTERISTIC /end GROUP
/begin GROUP S73_BWLD_DirIChg_P "swc_BatWntyLogtcData/10ms/10ms/EBat/BWLD_DirIChg_P" /begin REF_CHARACTERISTIC BWLD_DirIChg_P /end REF_CHARACTERISTIC /end GROUP
/begin GROUP S73_BWLD_DirIChg_P1 "swc_BatWntyLogtcData/10ms/10ms/EBat/BWLD_DirIChg_P1" /begin REF_CHARACTERISTIC BWLD_DirIChg_P /end REF_CHARACTERISTIC /end GROUP
/begin GROUP S73_BWLD_IChCtLim_P "swc_BatWntyLogtcData/10ms/10ms/EBat/BWLD_IChCtLim_P" /begin REF_CHARACTERISTIC BWLD_IChCtLim_P /end REF_CHARACTERISTIC /end GROUP
/begin GROUP S73_BWLD_IDchaCtLim_P "swc_BatWntyLogtcData/10ms/10ms/EBat/BWLD_IDchaCtLim_P" /begin REF_CHARACTERISTIC BWLD_IDchaCtLim_P /end REF_CHARACTERISTIC /end GROUP
/begin GROUP S73_SetTotalCharge "swc_BatWntyLogtcData/10ms/10ms/EBat/SetTotalCharge" /begin SUB_GROUP S91_BWLD_ESet_P /end SUB_GROUP /end GROUP
/begin GROUP S73_SetTotalDischarge "swc_BatWntyLogtcData/10ms/10ms/EBat/SetTotalDischarge" /begin SUB_GROUP S92_BWLD_ESet_P /end SUB_GROUP /end GROUP
/begin GROUP S748_BCF_bAcvSohUpd_P "swc_BatCoreFct/BCF_100ms_sys/BatCoreFct/PackStateClcn/PackSohClcn/SohPack Evaluation/BCF_bAcvSohUpd_P" /begin REF_CHARACTERISTIC BCF_bAcvSohUpd_P /end REF_CHARACTERISTIC /end GROUP
/begin GROUP S748_BCF_SohC_M "swc_BatCoreFct/BCF_100ms_sys/BatCoreFct/PackStateClcn/PackSohClcn/SohPack Evaluation/BCF_SohC_M" /begin REF_CHARACTERISTIC BCF_SohC_M /end REF_CHARACTERISTIC /end GROUP
/begin GROUP S748_BCF_SohPackValmin_P "swc_BatCoreFct/BCF_100ms_sys/BatCoreFct/PackStateClcn/PackSohClcn/SohPack Evaluation/BCF_SohPackValmin_P" /begin REF_CHARACTERISTIC BCF_SohPackValmin_P /end REF_CHARACTERISTIC /end GROUP
/begin GROUP S748_BCF_SohR_M "swc_BatCoreFct/BCF_100ms_sys/BatCoreFct/PackStateClcn/PackSohClcn/SohPack Evaluation/BCF_SohR_M" /begin REF_CHARACTERISTIC BCF_SohR_M /end REF_CHARACTERISTIC /end GROUP
/begin GROUP S749_Error__Heal_Detection "swc_BatCoreFct/BCF_100ms_sys/BatCoreFct/PackStateClcn/PackSohClcn/SohRDelta Calculation/Error//Heal Detection" /begin SUB_GROUP S759_ErrorHealEvaluation /end SUB_GROUP /end GROUP
/begin GROUP S749_Update_of_SohRDelta "swc_BatCoreFct/BCF_100ms_sys/BatCoreFct/PackStateClcn/PackSohClcn/SohRDelta Calculation/Update of SohRDelta"
 /begin SUB_GROUP S760_BCF_SohRDeltaLimForUpd_P S760_BCF_SohRDeltaLimForUpd_P1 S760_BCF_SohUpdFacForRDelta_P S760_BCF_SohUpdSatnForRDelta_M /end SUB_GROUP
/end GROUP
/begin GROUP S74_BTHM_TiOffDig93_P "swc_BatThermHndlgMngt/BTHM_100ms_sys/100ms/DataPrep/DataClcn/TPackDif/BTHM_TiOffDig93_P" /begin REF_CHARACTERISTIC BTHM_TiOffDig93_P /end REF_CHARACTERISTIC /end GROUP
/begin GROUP S74_BTHM_TiOnDig93_P "swc_BatThermHndlgMngt/BTHM_100ms_sys/100ms/DataPrep/DataClcn/TPackDif/BTHM_TiOnDig93_P" /begin REF_CHARACTERISTIC BTHM_TiOnDig93_P /end REF_CHARACTERISTIC /end GROUP
/begin GROUP S74_BWLD_DirIChg_P "swc_BatWntyLogtcData/10ms/10ms/IBat/BWLD_DirIChg_P" /begin REF_CHARACTERISTIC BWLD_DirIChg_P /end REF_CHARACTERISTIC /end GROUP
/begin GROUP S74_BWLD_IBatRst_P "swc_BatWntyLogtcData/10ms/10ms/IBat/BWLD_IBatRst_P" /begin REF_CHARACTERISTIC BWLD_IBatRst_P /end REF_CHARACTERISTIC /end GROUP
/begin GROUP S74_CompareToCalibrationPara "swc_BatThermHndlgMngt/BTHM_100ms_sys/100ms/DataPrep/DataClcn/TPackDif/CompareToCalibrationPara" /begin REF_CHARACTERISTIC BTHM_TSetDig93_P /end REF_CHARACTERISTIC /end GROUP
/begin GROUP S74_CompareToCalibrationPara1 "swc_BatThermHndlgMngt/BTHM_100ms_sys/100ms/DataPrep/DataClcn/TPackDif/CompareToCalibrationPara1" /begin REF_CHARACTERISTIC BTHM_TRstDig93_P /end REF_CHARACTERISTIC /end GROUP
/begin GROUP S74_CTC_IdRlyNeg_P "swc_CtctrTranCtl/CtcrtTranCtl_sys/CtcrtTranCtl/Enabled Subsystem1/CTC_IdRlyNeg_P" /begin REF_CHARACTERISTIC CTC_IdRlyNeg_P /end REF_CHARACTERISTIC /end GROUP
/begin GROUP S74_SocMdulInit "swc_BatCoreFct/BCF_100ms_sys/BatCoreFct/BatCoreInit/StateInitialization/SocMdulInit"
 /begin SUB_GROUP S100_ModuleSocInitializationEitherFromFlashorOCV S100_SOCInitializationDiagnostics /end SUB_GROUP
/end GROUP
/begin GROUP S750_Error__Heal_Detection "swc_BatCoreFct/BCF_100ms_sys/BatCoreFct/PackStateClcn/PackSohClcn/SohSocDelta Calculation/Error//Heal Detection" /begin SUB_GROUP S775_ErrorHealEvaluation /end SUB_GROUP /end GROUP
/begin GROUP S750_SohSocDeltaEvaluation "swc_BatCoreFct/BCF_100ms_sys/BatCoreFct/PackStateClcn/PackSohClcn/SohSocDelta Calculation/SohSocDeltaEvaluation"
 /begin SUB_GROUP S776_BCF_SohSocDeltaLimForUpd_P S776_BCF_SohSocDeltaLimForUpd_P1 S776_BCF_SohUpdFacForSocDelta_P S776_BCF_SohUpdSatnForSocDelta_M /end SUB_GROUP
/end GROUP
/begin GROUP S759_ErrorHealEvaluation "swc_BatCoreFct/BCF_100ms_sys/BatCoreFct/PackStateClcn/PackSohClcn/SohRDelta Calculation/Error//Heal Detection/ErrorHealEvaluation"
 /begin SUB_GROUP S761_BCF_InvldMdlFacForRDelta_P S761_BCF_SohErrLimForRDelta_M S761_BCF_SohFacForRDelta_P S761_BCF_SohRCellCorrnFac_M /end SUB_GROUP
/end GROUP
/begin GROUP S75_BWLD_DirIChg_P "swc_BatWntyLogtcData/10ms/10ms/PBat/BWLD_DirIChg_P" /begin REF_CHARACTERISTIC BWLD_DirIChg_P /end REF_CHARACTERISTIC /end GROUP
/begin GROUP S75_BWLD_PBatRst_P "swc_BatWntyLogtcData/10ms/10ms/PBat/BWLD_PBatRst_P" /begin REF_CHARACTERISTIC BWLD_PBatRst_P /end REF_CHARACTERISTIC /end GROUP
/begin GROUP S75_CTC_IdRlyPos_P "swc_CtctrTranCtl/CtcrtTranCtl_sys/CtcrtTranCtl/Enabled Subsystem2/CTC_IdRlyPos_P" /begin REF_CHARACTERISTIC CTC_IdRlyPos_P /end REF_CHARACTERISTIC /end GROUP
/begin GROUP S760_BCF_SohRDeltaLimForUpd_P "swc_BatCoreFct/BCF_100ms_sys/BatCoreFct/PackStateClcn/PackSohClcn/SohRDelta Calculation/Update of SohRDelta/BCF_SohRDeltaLimForUpd_P" /begin REF_CHARACTERISTIC BCF_SohRDeltaLimForUpd_P /end REF_CHARACTERISTIC /end GROUP
/begin GROUP S760_BCF_SohRDeltaLimForUpd_P1 "swc_BatCoreFct/BCF_100ms_sys/BatCoreFct/PackStateClcn/PackSohClcn/SohRDelta Calculation/Update of SohRDelta/BCF_SohRDeltaLimForUpd_P1" /begin REF_CHARACTERISTIC BCF_SohRDeltaLimForUpd_P /end REF_CHARACTERISTIC /end GROUP
/begin GROUP S760_BCF_SohUpdFacForRDelta_P "swc_BatCoreFct/BCF_100ms_sys/BatCoreFct/PackStateClcn/PackSohClcn/SohRDelta Calculation/Update of SohRDelta/BCF_SohUpdFacForRDelta_P" /begin REF_CHARACTERISTIC BCF_SohUpdFacForRDelta_P /end REF_CHARACTERISTIC /end GROUP
/begin GROUP S760_BCF_SohUpdSatnForRDelta_M "swc_BatCoreFct/BCF_100ms_sys/BatCoreFct/PackStateClcn/PackSohClcn/SohRDelta Calculation/Update of SohRDelta/BCF_SohUpdSatnForRDelta_M" /begin REF_CHARACTERISTIC BCF_SohUpdSatnForRDelta_M /end REF_CHARACTERISTIC /end GROUP
/begin GROUP S761_BCF_SohFacForRDelta_P "swc_BatCoreFct/BCF_100ms_sys/BatCoreFct/PackStateClcn/PackSohClcn/SohRDelta Calculation/Error//Heal Detection/ErrorHealEvaluation/BCF_SohFacForRDelta_P" /begin REF_CHARACTERISTIC BCF_SohFacForRDelta_P /end REF_CHARACTERISTIC /end GROUP
/begin GROUP S76_BWLD_UBatRst_P "swc_BatWntyLogtcData/10ms/10ms/UBat/BWLD_UBatRst_P" /begin REF_CHARACTERISTIC BWLD_UBatRst_P /end REF_CHARACTERISTIC /end GROUP
/begin GROUP S76_CTC_IdRlyPrech_P "swc_CtctrTranCtl/CtcrtTranCtl_sys/CtcrtTranCtl/Enabled Subsystem3/CTC_IdRlyPrech_P" /begin REF_CHARACTERISTIC CTC_IdRlyPrech_P /end REF_CHARACTERISTIC /end GROUP
/begin GROUP S775_ErrorHealEvaluation "swc_BatCoreFct/BCF_100ms_sys/BatCoreFct/PackStateClcn/PackSohClcn/SohSocDelta Calculation/Error//Heal Detection/ErrorHealEvaluation"
 /begin SUB_GROUP S777_BCF_ErrSohSocCellDelta_M S777_BCF_FacSohSocCellDelta_P S777_BCF_InvldMdlFacForSocDelta_P S777_BCF_SohSocCellCorrnFac_M /end SUB_GROUP
/end GROUP
/begin GROUP S776_BCF_SohSocDeltaLimForUpd_P "swc_BatCoreFct/BCF_100ms_sys/BatCoreFct/PackStateClcn/PackSohClcn/SohSocDelta Calculation/SohSocDeltaEvaluation/BCF_SohSocDeltaLimForUpd_P" /begin REF_CHARACTERISTIC BCF_SohSocDeltaLimForUpd_P /end REF_CHARACTERISTIC /end GROUP
/begin GROUP S776_BCF_SohSocDeltaLimForUpd_P1 "swc_BatCoreFct/BCF_100ms_sys/BatCoreFct/PackStateClcn/PackSohClcn/SohSocDelta Calculation/SohSocDeltaEvaluation/BCF_SohSocDeltaLimForUpd_P1" /begin REF_CHARACTERISTIC BCF_SohSocDeltaLimForUpd_P /end REF_CHARACTERISTIC /end GROUP
/begin GROUP S776_BCF_SohUpdFacForSocDelta_P "swc_BatCoreFct/BCF_100ms_sys/BatCoreFct/PackStateClcn/PackSohClcn/SohSocDelta Calculation/SohSocDeltaEvaluation/BCF_SohUpdFacForSocDelta_P" /begin REF_CHARACTERISTIC BCF_SohUpdFacForSocDelta_P /end REF_CHARACTERISTIC /end GROUP
/begin GROUP S776_BCF_SohUpdSatnForSocDelta_M "swc_BatCoreFct/BCF_100ms_sys/BatCoreFct/PackStateClcn/PackSohClcn/SohSocDelta Calculation/SohSocDeltaEvaluation/BCF_SohUpdSatnForSocDelta_M" /begin REF_CHARACTERISTIC BCF_SohUpdSatnForSocDelta_M /end REF_CHARACTERISTIC /end GROUP
/begin GROUP S777_BCF_FacSohSocCellDelta_P "swc_BatCoreFct/BCF_100ms_sys/BatCoreFct/PackStateClcn/PackSohClcn/SohSocDelta Calculation/Error//Heal Detection/ErrorHealEvaluation/BCF_FacSohSocCellDelta_P" /begin REF_CHARACTERISTIC BCF_FacSohSocCellDelta_P /end REF_CHARACTERISTIC /end GROUP
/begin GROUP S77_CTC_IdRlyCh_P "swc_CtctrTranCtl/CtcrtTranCtl_sys/CtcrtTranCtl/Enabled Subsystem4/CTC_IdRlyCh_P" /begin REF_CHARACTERISTIC CTC_IdRlyCh_P /end REF_CHARACTERISTIC /end GROUP
/begin GROUP S78_CTC_IdRlyHeat_P "swc_CtctrTranCtl/CtcrtTranCtl_sys/CtcrtTranCtl/Enabled Subsystem5/CTC_IdRlyHeat_P" /begin REF_CHARACTERISTIC CTC_IdRlyHeat_P /end REF_CHARACTERISTIC /end GROUP
/begin GROUP S79_ChargeSignalLost "swc_CtctrTranCtl/CtcrtTranCtl_sys/CtcrtTranCtl/Error/ChargeSignalLost"
 /begin SUB_GROUP S200_BitSelect S200_BitSelect20 S200_CTC_bErrSigChWupLost_P S200_CTC_TiOffDig225_P S200_CTC_TiOnDig225_P S200_CTC_TiProc_P19 /end SUB_GROUP
/end GROUP
/begin GROUP S79_CurrentZeroDriftError "swc_CtctrTranCtl/CtcrtTranCtl_sys/CtcrtTranCtl/Error/CurrentZeroDriftError"
 /begin SUB_GROUP S201_BitSelect S201_BitSelect20 S201_CompareToCalibrationPara S201_CTC_bErrIDriftZero_P S201_CTC_TiOffDig239_P S201_CTC_TiOnDig239_P S201_CTC_TiProc_P /end SUB_GROUP
/end GROUP
/begin GROUP S79_FastChargeRelayError "swc_CtctrTranCtl/CtcrtTranCtl_sys/CtcrtTranCtl/Error/FastChargeRelayError"
 /begin SUB_GROUP S202_BitSelect S202_BitSelect1 S202_BitSelect10 S202_BitSelect11 S202_BitSelect12 S202_BitSelect13 S202_BitSelect2 S202_BitSelect6 S202_CTC_bErrRlyChHiDrvShoToGnd_P S202_CTC_bErrRlyChHiDrvShoToPwr_P S202_CTC_bErrRlyChHiSideDrv_P S202_CTC_bErrRlyChWldd_P S202_CTC_TiOffDig123_P S202_CTC_TiOffDig123ForSc_P S202_CTC_TiOffDig124AftChk_P S202_CTC_TiOffDig124AtChk_P S202_CTC_TiOffDig124ForSc_P S202_CTC_TiOnDig123_P S202_CTC_TiOnDig123ForSc_P S202_CTC_TiOnDig124AftChk_P S202_CTC_TiOnDig124AtChk_P S202_CTC_TiOnDig124ForSc_P S202_CTC_TiProc_P10 S202_CTC_TiProc_P11 S202_CTC_TiProc_P12 S202_CTC_TiProc_P13 /end SUB_GROUP
/end GROUP
/begin GROUP S79_HeatRelayError "swc_CtctrTranCtl/CtcrtTranCtl_sys/CtcrtTranCtl/Error/HeatRelayError"
 /begin SUB_GROUP S203_BitSelect S203_BitSelect1 S203_BitSelect14 S203_BitSelect15 S203_BitSelect16 S203_BitSelect18 S203_BitSelect2 S203_BitSelect6 S203_CTC_bErrRlyHeatHiDrvShoToGnd_P S203_CTC_bErrRlyHeatHiDrvShoToPwr_P S203_CTC_bErrRlyHeatHiSideDrv_P S203_CTC_bErrRlyHeatWldd_P S203_CTC_TiOffDig135_P S203_CTC_TiOffDig135ForSc_P S203_CTC_TiOffDig136AftChk_P S203_CTC_TiOffDig136AtChk_P S203_CTC_TiOffDig136ForSc_P S203_CTC_TiOnDig135_P S203_CTC_TiOnDig135ForSc_P S203_CTC_TiOnDig136AftChk_P S203_CTC_TiOnDig136AtChk_P S203_CTC_TiOnDig136ForSc_P S203_CTC_TiProc_P14 S203_CTC_TiProc_P15 S203_CTC_TiProc_P16 S203_CTC_TiProc_P17 /end SUB_GROUP
/end GROUP
/begin GROUP S79_MotorDischargeError "swc_CtctrTranCtl/CtcrtTranCtl_sys/CtcrtTranCtl/Error/MotorDischargeError"
 /begin SUB_GROUP S205_BitSelect S205_BitSelect21 S205_CTC_bErrToutForMotDchaToDiag_P S205_CTC_TiOffDig226_P S205_CTC_TiOnDig226_P S205_CTC_TiProc_P20 /end SUB_GROUP
/end GROUP
/begin GROUP S79_NegativeRelayError "swc_CtctrTranCtl/CtcrtTranCtl_sys/CtcrtTranCtl/Error/NegativeRelayError"
 /begin SUB_GROUP S206_BitSelect S206_BitSelect1 S206_BitSelect2 S206_BitSelect3 S206_BitSelect4 S206_BitSelect5 S206_BitSelect6 S206_BitSelect7 S206_CTC_bErrRlyNegHiDrvShoToGnd_P S206_CTC_bErrRlyNegHiDrvShoToPwr_P S206_CTC_bErrRlyNegHiSideDrv_P S206_CTC_bErrRlyNegWldd_P S206_CTC_TiOffDig121_P S206_CTC_TiOffDig121ForSc_P S206_CTC_TiOffDig122_P S206_CTC_TiOffDig122ForSc_P S206_CTC_TiOnDig121_P S206_CTC_TiOnDig121ForSc_P S206_CTC_TiOnDig122_P S206_CTC_TiOnDig122ForSc_P S206_CTC_TiProc_P4 S206_CTC_TiProc_P5 S206_CTC_TiProc_P6 S206_CTC_TiProc_P7 /end SUB_GROUP
/end GROUP
/begin GROUP S79_PostiveRelayError "swc_CtctrTranCtl/CtcrtTranCtl_sys/CtcrtTranCtl/Error/PostiveRelayError"
 /begin SUB_GROUP S207_BitSelect S207_BitSelect1 S207_BitSelect17 S207_BitSelect2 S207_BitSelect3 S207_BitSelect4 S207_BitSelect5 S207_BitSelect6 S207_CTC_bErrRlyPosHiDrvShoToGnd_P S207_CTC_bErrRlyPosHiDrvShoToPwr_P S207_CTC_bErrRlyPosHiSideDrv_P S207_CTC_bErrRlyPosWldd_P S207_CTC_TiOffDig119_P S207_CTC_TiOffDig119ForSc_P S207_CTC_TiOffDig120AftChk_P S207_CTC_TiOffDig120AtChk_P S207_CTC_TiOffDig120ForSc_P S207_CTC_TiOnDig119_P S207_CTC_TiOnDig119ForSc_P S207_CTC_TiOnDig120AftChk_P S207_CTC_TiOnDig120AtChk_P S207_CTC_TiOnDig120ForSc_P S207_CTC_TiProc_P S207_CTC_TiProc_P1 S207_CTC_TiProc_P2 S207_CTC_TiProc_P3 /end SUB_GROUP
/end GROUP
/begin GROUP S79_PrechargeError "swc_CtctrTranCtl/CtcrtTranCtl_sys/CtcrtTranCtl/Error/PrechargeError"
 /begin SUB_GROUP S208_BitSelect S208_BitSelect1 S208_BitSelect19 S208_CTC_bErrPrech_P S208_CTC_TiOffDig84_P S208_CTC_TiOnDig84_P S208_CTC_TiOnDig84ForErrI_P S208_CTC_TiOnDig84ForErrI_P1 S208_CTC_TiProc_P1 S208_CTC_TiProc_P18 /end SUB_GROUP
/end GROUP
/begin GROUP S79_PrechargeRelayError "swc_CtctrTranCtl/CtcrtTranCtl_sys/CtcrtTranCtl/Error/PrechargeRelayError"
 /begin SUB_GROUP S209_BitSelect S209_BitSelect1 S209_BitSelect8 S209_BitSelect9 S209_CTC_bErrRlyPrechHiDrvShoToGnd_P S209_CTC_bErrRlyPrechHiDrvShoToPwr_P S209_CTC_TiOffDig84ForScToGnd_P S209_CTC_TiOffDig84ForScToPwr_P S209_CTC_TiOnDig84ForScToGnd_P S209_CTC_TiOnDig84ForScToPwr_P S209_CTC_TiProc_P8 S209_CTC_TiProc_P9 /end SUB_GROUP
/end GROUP
/begin GROUP S79_ResistorTemperatureProtect "swc_CtctrTranCtl/CtcrtTranCtl_sys/CtcrtTranCtl/Error/ResistorTemperatureProtect"
 /begin SUB_GROUP S210_BitSelect S210_BitSelect20 S210_CTC_bAcvTProtnRPrech_P S210_CTC_DecrtUPrechAccumd_P S210_CTC_GainUPrechAccumd_P S210_CTC_StsTProtnRPrech_P S210_CTC_TiOffForStsTProtnRPrech_P S210_CTC_TiOnForStsTProtnRPrech_P S210_CTC_TiProc_P S210_CTC_TiProc_P1 S210_CTC_UPrechAccumdUpprLim_P /end SUB_GROUP
/end GROUP
/begin GROUP S7_FIM "swc_DiagcEveHndlg/DEH_10ms_sys/DEH_10ms_sys/FIM"
 /begin SUB_GROUP S36_BitSelect S36_BitSelect1 S36_BitSelect10 S36_BitSelect11 S36_BitSelect12 S36_BitSelect13 S36_BitSelect14 S36_BitSelect15 S36_BitSelect16 S36_BitSelect17 S36_BitSelect18 S36_BitSelect19 S36_BitSelect2 S36_BitSelect20 S36_BitSelect21 S36_BitSelect22 S36_BitSelect3 S36_BitSelect4 S36_BitSelect5 S36_BitSelect6 S36_BitSelect7 S36_BitSelect8 S36_BitSelect9 S36_DEH_bAcvAcChInh_P S36_DEH_bAcvChInh_P S36_DEH_bAcvDcChInh_P S36_DEH_bAcvDchaInh_P S36_DEH_bAcvEmcyHvOff1_P S36_DEH_bAcvEmcyHvOff2_P S36_DEH_bAcvHeatInh_P S36_DEH_bAcvLvlErr1_P S36_DEH_bAcvLvlErr2_P S36_DEH_bAcvLvlErr3_P S36_DEH_bAcvLvlErrSb1_P S36_DEH_bAcvLvlErrSb2_P S36_DEH_bAcvLvlErrSb3_P S36_DEH_bAcvPowupInh_P S36_DEH_bAcvPwrChLim1_P S36_DEH_bAcvPwrChLim2_P S36_DEH_bAcvPwrDchaLim1_P S36_DEH_bAcvPwrDchaLim2_P S36_DEH_bAcvPwrdNorm_P S36_DEH_bAcvPwrRecupLim1_P S36_DEH_bAcvPwrRecupLim2_P S36_DEH_bAcvRecupInh_P S36_DEH_bAcvSleepNorm_P /end SUB_GROUP
/end GROUP
/begin GROUP S7_General_Diagnosis_Signals "swc_DiagcEveHndlg/DEH_10ms_sys/DEH_10ms_sys/General Diagnosis Signals"
 /begin SUB_GROUP S37_BitSelect S37_BitSelect1 S37_BSTC_StBcu_M S37_DEH_EnaDiagGlbMan_P S37_DEH_LvlErrMan_P1 S37_DEH_LvlErrSbMan_P S37_DEH_StFltLampIndcnMan_P S37_DEH_UTrmlLowrThd_P S37_DEH_UTrmlUpprThd_P /end SUB_GROUP
/end GROUP
/begin GROUP S809_SOF_Current_Limits_Derating "swc_BatCoreFct/BCF_10ms_sys/SofPackLimn/SOF Current Limits Derating"
 /begin SUB_GROUP S810_BCF_PwrDchaLim_P S810_IChActLim_Derating_Limits S810_IChActLim_Selec S810_IChPredLim_Derating_Limits S810_IChPredLim_Selection S810_IDchaActLim_Derating_Limits S810_IDchaLim_Selection S810_IDchaPredLim_Derating_Limits S810_IDchaPredLim_Selection S810_rate_limiter1 S810_rate_limiter2 S810_rate_limiter3 S810_rate_limiter5 S810_Subsystem S810_Subsystem1 S810_Subsystem2 S810_Subsystem3 /end SUB_GROUP
/end GROUP
/begin GROUP S809_SOF_Power_Limits_Derating "swc_BatCoreFct/BCF_10ms_sys/SofPackLimn/SOF Power Limits Derating"
 /begin SUB_GROUP S811_BCF_RateFallLimForPwrDchaPred_M S811_BCF_RateFallLimnForPwrChAct_M S811_BCF_RateFallLimnForPwrChPred_M S811_BCF_RateFallLimnForPwrDchaAct_M S811_BCF_RateRiseLimForPwrDchaPred_M S811_BCF_RateRiseLimnForPwrChAct_M S811_BCF_RateRiseLimnForPwrChPred_M S811_BCF_RateRiseLimnForPwrDchaAct_M S811_BCF_SofDeratTs_P S811_BCF_SofDeratTs_P1 S811_BCF_SofDeratTs_P2 S811_BCF_SofDeratTs_P3 /end SUB_GROUP
/end GROUP
/begin GROUP S809_SOF_Voltage_Limits_Derating "swc_BatCoreFct/BCF_10ms_sys/SofPackLimn/SOF Voltage Limits Derating"
 /begin SUB_GROUP S812_Actual_Charging_Voltage_Limit_Selection S812_Actual_Discharging_Voltage_Limit_Selection S812_Battery_State_Evaluation S812_Predicted_Charging_Voltage_Limit_Selection S812_Predicted_Discharging_Voltage_Limit_Selection S812_rate_limiter1 S812_rate_limiter2 S812_rate_limiter3 S812_rate_limiter5 S812_UChAct_Derating_Limits S812_UChPred_Derating_Limits S812_UDchaAct_Derating_Limits S812_UDchaPred_Derating_Limits /end SUB_GROUP
/end GROUP
/begin GROUP S810_BCF_PwrDchaLim_P "swc_BatCoreFct/BCF_10ms_sys/SofPackLimn/SOF Current Limits Derating/BCF_PwrDchaLim_P" /begin REF_CHARACTERISTIC BCF_PwrDchaLim_P /end REF_CHARACTERISTIC /end GROUP
/begin GROUP S810_IChActLim_Derating_Limits "swc_BatCoreFct/BCF_10ms_sys/SofPackLimn/SOF Current Limits Derating/IChActLim Derating Limits"
 /begin SUB_GROUP S815_BCF_PctgIChActLimByBatErr_M S815_BCF_PctgIChActLimByBatSt_M S815_BCF_RateFallLimnForIChActLim_M S815_BCF_RateRiseLimnForIChActLim_M /end SUB_GROUP
/end GROUP
/begin GROUP S810_IChActLim_Selec "swc_BatCoreFct/BCF_10ms_sys/SofPackLimn/SOF Current Limits Derating/IChActLim Selec" /begin SUB_GROUP S816_BCF_SofDeratDeac_P /end SUB_GROUP /end GROUP
/begin GROUP S810_IChPredLim_Derating_Limits "swc_BatCoreFct/BCF_10ms_sys/SofPackLimn/SOF Current Limits Derating/IChPredLim Derating Limits"
 /begin SUB_GROUP S817_BCF_PctgIChPredLimByBatErr_M S817_BCF_PctgIChPredLimByBatSt_M S817_BCF_RateFallLimnForIChPredLim_M S817_BCF_RateRiseLimnForIChPredLim_M /end SUB_GROUP
/end GROUP
/begin GROUP S810_IChPredLim_Selection "swc_BatCoreFct/BCF_10ms_sys/SofPackLimn/SOF Current Limits Derating/IChPredLim Selection" /begin SUB_GROUP S818_BCF_SofDeratDeac_P /end SUB_GROUP /end GROUP
/begin GROUP S810_IDchaActLim_Derating_Limits "swc_BatCoreFct/BCF_10ms_sys/SofPackLimn/SOF Current Limits Derating/IDchaActLim Derating Limits"
 /begin SUB_GROUP S819_BCF_PctgIDchaActLimByBatErr_M S819_BCF_PctgIDchaActLimByBatSt_M S819_BCF_RateFallLimnForIDchaActLim_M S819_BCF_RateRiseLimnForIDchaActLim_M /end SUB_GROUP
/end GROUP
/begin GROUP S810_IDchaLim_Selection "swc_BatCoreFct/BCF_10ms_sys/SofPackLimn/SOF Current Limits Derating/IDchaLim Selection" /begin SUB_GROUP S820_BCF_SofDeratDeac_P /end SUB_GROUP /end GROUP
/begin GROUP S810_IDchaPredLim_Derating_Limits "swc_BatCoreFct/BCF_10ms_sys/SofPackLimn/SOF Current Limits Derating/IDchaPredLim Derating Limits"
 /begin SUB_GROUP S821_BCF_PctgIDchaPredLimByBatErr_M S821_BCF_PctgIDchaPredLimByBatSt_M S821_BCF_RateFallLimnIDchaPredLim_M S821_BCF_RateRiseLimnIDchaPredLim_M /end SUB_GROUP
/end GROUP
/begin GROUP S810_IDchaPredLim_Selection "swc_BatCoreFct/BCF_10ms_sys/SofPackLimn/SOF Current Limits Derating/IDchaPredLim Selection" /begin SUB_GROUP S822_BCF_SofDeratDeac_P /end SUB_GROUP /end GROUP
/begin GROUP S810_rate_limiter1 "swc_BatCoreFct/BCF_10ms_sys/SofPackLimn/SOF Current Limits Derating/rate limiter1" /begin SUB_GROUP S828_BCF_SofDeratTs_P /end SUB_GROUP /end GROUP
/begin GROUP S810_rate_limiter2 "swc_BatCoreFct/BCF_10ms_sys/SofPackLimn/SOF Current Limits Derating/rate limiter2" /begin SUB_GROUP S829_BCF_SofDeratTs_P /end SUB_GROUP /end GROUP
/begin GROUP S810_rate_limiter3 "swc_BatCoreFct/BCF_10ms_sys/SofPackLimn/SOF Current Limits Derating/rate limiter3" /begin SUB_GROUP S830_BCF_SofDeratTs_P /end SUB_GROUP /end GROUP
/begin GROUP S810_rate_limiter5 "swc_BatCoreFct/BCF_10ms_sys/SofPackLimn/SOF Current Limits Derating/rate limiter5" /begin SUB_GROUP S831_BCF_SofDeratTs_P /end SUB_GROUP /end GROUP
/begin GROUP S810_Subsystem "swc_BatCoreFct/BCF_10ms_sys/SofPackLimn/SOF Current Limits Derating/Subsystem"
 /begin SUB_GROUP S824_BCF_CoeffIChLim0_P S824_BCF_CoeffIChLim1_P S824_BCF_CoeffIChLim2_P /end SUB_GROUP
/end GROUP
/begin GROUP S810_Subsystem1 "swc_BatCoreFct/BCF_10ms_sys/SofPackLimn/SOF Current Limits Derating/Subsystem1"
 /begin SUB_GROUP S825_BCF_CoeffIDchaLim0_P S825_BCF_CoeffIDchaLim1_P S825_BCF_CoeffIDchaLim2_P /end SUB_GROUP
/end GROUP
/begin GROUP S810_Subsystem2 "swc_BatCoreFct/BCF_10ms_sys/SofPackLimn/SOF Current Limits Derating/Subsystem2"
 /begin SUB_GROUP S826_BCF_CoeffIChLim0_P S826_BCF_CoeffIChLim1_P S826_BCF_CoeffIChLim2_P /end SUB_GROUP
/end GROUP
/begin GROUP S810_Subsystem3 "swc_BatCoreFct/BCF_10ms_sys/SofPackLimn/SOF Current Limits Derating/Subsystem3"
 /begin SUB_GROUP S827_BCF_CoeffIDchaLim0_P S827_BCF_CoeffIDchaLim1_P S827_BCF_CoeffIDchaLim2_P /end SUB_GROUP
/end GROUP
/begin GROUP S811_BCF_RateFallLimForPwrDchaPred_M "swc_BatCoreFct/BCF_10ms_sys/SofPackLimn/SOF Power Limits Derating/BCF_RateFallLimForPwrDchaPred_M" /begin REF_CHARACTERISTIC BCF_RateFallLimForPwrDchaPred_M /end REF_CHARACTERISTIC /end GROUP
/begin GROUP S811_BCF_RateFallLimnForPwrChAct_M "swc_BatCoreFct/BCF_10ms_sys/SofPackLimn/SOF Power Limits Derating/BCF_RateFallLimnForPwrChAct_M" /begin REF_CHARACTERISTIC BCF_RateFallLimnForPwrChAct_M /end REF_CHARACTERISTIC /end GROUP
/begin GROUP S811_BCF_RateFallLimnForPwrChPred_M "swc_BatCoreFct/BCF_10ms_sys/SofPackLimn/SOF Power Limits Derating/BCF_RateFallLimnForPwrChPred_M" /begin REF_CHARACTERISTIC BCF_RateFallLimnForPwrChPred_M /end REF_CHARACTERISTIC /end GROUP
/begin GROUP S811_BCF_RateFallLimnForPwrDchaAct_M "swc_BatCoreFct/BCF_10ms_sys/SofPackLimn/SOF Power Limits Derating/BCF_RateFallLimnForPwrDchaAct_M" /begin REF_CHARACTERISTIC BCF_RateFallLimnForPwrDchaAct_M /end REF_CHARACTERISTIC /end GROUP
/begin GROUP S811_BCF_RateRiseLimForPwrDchaPred_M "swc_BatCoreFct/BCF_10ms_sys/SofPackLimn/SOF Power Limits Derating/BCF_RateRiseLimForPwrDchaPred_M" /begin REF_CHARACTERISTIC BCF_RateRiseLimForPwrDchaPred_M /end REF_CHARACTERISTIC /end GROUP
/begin GROUP S811_BCF_RateRiseLimnForPwrChAct_M "swc_BatCoreFct/BCF_10ms_sys/SofPackLimn/SOF Power Limits Derating/BCF_RateRiseLimnForPwrChAct_M" /begin REF_CHARACTERISTIC BCF_RateRiseLimnForPwrChAct_M /end REF_CHARACTERISTIC /end GROUP
/begin GROUP S811_BCF_RateRiseLimnForPwrChPred_M "swc_BatCoreFct/BCF_10ms_sys/SofPackLimn/SOF Power Limits Derating/BCF_RateRiseLimnForPwrChPred_M" /begin REF_CHARACTERISTIC BCF_RateRiseLimnForPwrChPred_M /end REF_CHARACTERISTIC /end GROUP
/begin GROUP S811_BCF_RateRiseLimnForPwrDchaAct_M "swc_BatCoreFct/BCF_10ms_sys/SofPackLimn/SOF Power Limits Derating/BCF_RateRiseLimnForPwrDchaAct_M" /begin REF_CHARACTERISTIC BCF_RateRiseLimnForPwrDchaAct_M /end REF_CHARACTERISTIC /end GROUP
/begin GROUP S811_BCF_SofDeratTs_P "swc_BatCoreFct/BCF_10ms_sys/SofPackLimn/SOF Power Limits Derating/BCF_SofDeratTs_P" /begin REF_CHARACTERISTIC BCF_SofDeratTs_P /end REF_CHARACTERISTIC /end GROUP
/begin GROUP S811_BCF_SofDeratTs_P1 "swc_BatCoreFct/BCF_10ms_sys/SofPackLimn/SOF Power Limits Derating/BCF_SofDeratTs_P1" /begin REF_CHARACTERISTIC BCF_SofDeratTs_P /end REF_CHARACTERISTIC /end GROUP
/begin GROUP S811_BCF_SofDeratTs_P2 "swc_BatCoreFct/BCF_10ms_sys/SofPackLimn/SOF Power Limits Derating/BCF_SofDeratTs_P2" /begin REF_CHARACTERISTIC BCF_SofDeratTs_P /end REF_CHARACTERISTIC /end GROUP
/begin GROUP S811_BCF_SofDeratTs_P3 "swc_BatCoreFct/BCF_10ms_sys/SofPackLimn/SOF Power Limits Derating/BCF_SofDeratTs_P3" /begin REF_CHARACTERISTIC BCF_SofDeratTs_P /end REF_CHARACTERISTIC /end GROUP
/begin GROUP S812_Actual_Charging_Voltage_Limit_Selection "swc_BatCoreFct/BCF_10ms_sys/SofPackLimn/SOF Voltage Limits Derating/Actual Charging Voltage Limit Selection" /begin SUB_GROUP S884_BCF_SofDeratDeac_P /end SUB_GROUP /end GROUP
/begin GROUP S812_Actual_Discharging_Voltage_Limit_Selection "swc_BatCoreFct/BCF_10ms_sys/SofPackLimn/SOF Voltage Limits Derating/Actual Discharging Voltage Limit Selection" /begin SUB_GROUP S885_BCF_SofDeratDeac_P /end SUB_GROUP /end GROUP
/begin GROUP S812_Battery_State_Evaluation "swc_BatCoreFct/BCF_10ms_sys/SofPackLimn/SOF Voltage Limits Derating/Battery State Evaluation" /begin SUB_GROUP S886_BCF_SofDeratPackStOk_P /end SUB_GROUP /end GROUP
/begin GROUP S812_Predicted_Charging_Voltage_Limit_Selection "swc_BatCoreFct/BCF_10ms_sys/SofPackLimn/SOF Voltage Limits Derating/Predicted Charging Voltage Limit Selection" /begin SUB_GROUP S887_BCF_SofDeratDeac_P /end SUB_GROUP /end GROUP
/begin GROUP S812_Predicted_Discharging_Voltage_Limit_Selection "swc_BatCoreFct/BCF_10ms_sys/SofPackLimn/SOF Voltage Limits Derating/Predicted Discharging Voltage Limit Selection" /begin SUB_GROUP S888_BCF_SofDeratDeac_P /end SUB_GROUP /end GROUP
/begin GROUP S812_rate_limiter1 "swc_BatCoreFct/BCF_10ms_sys/SofPackLimn/SOF Voltage Limits Derating/rate limiter1" /begin SUB_GROUP S893_BCF_SofDeratTs_P /end SUB_GROUP /end GROUP
/begin GROUP S812_rate_limiter2 "swc_BatCoreFct/BCF_10ms_sys/SofPackLimn/SOF Voltage Limits Derating/rate limiter2" /begin SUB_GROUP S894_BCF_SofDeratTs_P /end SUB_GROUP /end GROUP
/begin GROUP S812_rate_limiter3 "swc_BatCoreFct/BCF_10ms_sys/SofPackLimn/SOF Voltage Limits Derating/rate limiter3" /begin SUB_GROUP S895_BCF_SofDeratTs_P /end SUB_GROUP /end GROUP
/begin GROUP S812_rate_limiter5 "swc_BatCoreFct/BCF_10ms_sys/SofPackLimn/SOF Voltage Limits Derating/rate limiter5" /begin SUB_GROUP S896_BCF_SofDeratTs_P /end SUB_GROUP /end GROUP
/begin GROUP S812_UChAct_Derating_Limits "swc_BatCoreFct/BCF_10ms_sys/SofPackLimn/SOF Voltage Limits Derating/UChAct Derating Limits"
 /begin SUB_GROUP S889_BCF_PctgUChActLimByBatErr_M S889_BCF_RateFallLimnForUChActLim_P S889_BCF_RateRiseLimnForUChActLim_P /end SUB_GROUP
/end GROUP
/begin GROUP S812_UChPred_Derating_Limits "swc_BatCoreFct/BCF_10ms_sys/SofPackLimn/SOF Voltage Limits Derating/UChPred Derating Limits"
 /begin SUB_GROUP S890_BCF_PctgUChPredLimByBatErr_M S890_BCF_RateFallLimnForUChPredLim_P S890_BCF_RateRiseLimnForUChPredLim_P /end SUB_GROUP
/end GROUP
/begin GROUP S812_UDchaAct_Derating_Limits "swc_BatCoreFct/BCF_10ms_sys/SofPackLimn/SOF Voltage Limits Derating/UDchaAct Derating Limits"
 /begin SUB_GROUP S891_BCF_PctgUDchaActLimByBatErr_M S891_BCF_RateFallLimnForUDchaActLim_P S891_BCF_RateRiseLimnForUDchaActLim_P /end SUB_GROUP
/end GROUP
/begin GROUP S812_UDchaPred_Derating_Limits "swc_BatCoreFct/BCF_10ms_sys/SofPackLimn/SOF Voltage Limits Derating/UDchaPred Derating Limits"
 /begin SUB_GROUP S892_BCF_PctgUDchaPredLimByBatErr_M S892_BCF_RateFallLimnUDchaPredLim_P S892_BCF_RateRiseLimnUDchaPredLim_P /end SUB_GROUP
/end GROUP
/begin GROUP S815_BCF_PctgIChActLimByBatErr_M "swc_BatCoreFct/BCF_10ms_sys/SofPackLimn/SOF Current Limits Derating/IChActLim Derating Limits/BCF_PctgIChActLimByBatErr_M" /begin REF_CHARACTERISTIC BCF_PctgIChActLimByBatErr_M /end REF_CHARACTERISTIC /end GROUP
/begin GROUP S815_BCF_PctgIChActLimByBatSt_M "swc_BatCoreFct/BCF_10ms_sys/SofPackLimn/SOF Current Limits Derating/IChActLim Derating Limits/BCF_PctgIChActLimByBatSt_M" /begin REF_CHARACTERISTIC BCF_PctgIChActLimByBatSt_M /end REF_CHARACTERISTIC /end GROUP
/begin GROUP S815_BCF_RateFallLimnForIChActLim_M "swc_BatCoreFct/BCF_10ms_sys/SofPackLimn/SOF Current Limits Derating/IChActLim Derating Limits/BCF_RateFallLimnForIChActLim_M" /begin REF_CHARACTERISTIC BCF_RateFallLimnForIChActLim_M /end REF_CHARACTERISTIC /end GROUP
/begin GROUP S815_BCF_RateRiseLimnForIChActLim_M "swc_BatCoreFct/BCF_10ms_sys/SofPackLimn/SOF Current Limits Derating/IChActLim Derating Limits/BCF_RateRiseLimnForIChActLim_M" /begin REF_CHARACTERISTIC BCF_RateRiseLimnForIChActLim_M /end REF_CHARACTERISTIC /end GROUP
/begin GROUP S816_BCF_SofDeratDeac_P "swc_BatCoreFct/BCF_10ms_sys/SofPackLimn/SOF Current Limits Derating/IChActLim Selec/BCF_SofDeratDeac_P" /begin REF_CHARACTERISTIC BCF_SofDeratDeac_P /end REF_CHARACTERISTIC /end GROUP
/begin GROUP S817_BCF_PctgIChPredLimByBatErr_M "swc_BatCoreFct/BCF_10ms_sys/SofPackLimn/SOF Current Limits Derating/IChPredLim Derating Limits/BCF_PctgIChPredLimByBatErr_M" /begin REF_CHARACTERISTIC BCF_PctgIChPredLimByBatErr_M /end REF_CHARACTERISTIC /end GROUP
/begin GROUP S817_BCF_PctgIChPredLimByBatSt_M "swc_BatCoreFct/BCF_10ms_sys/SofPackLimn/SOF Current Limits Derating/IChPredLim Derating Limits/BCF_PctgIChPredLimByBatSt_M" /begin REF_CHARACTERISTIC BCF_PctgIChPredLimByBatSt_M /end REF_CHARACTERISTIC /end GROUP
/begin GROUP S817_BCF_RateFallLimnForIChPredLim_M "swc_BatCoreFct/BCF_10ms_sys/SofPackLimn/SOF Current Limits Derating/IChPredLim Derating Limits/BCF_RateFallLimnForIChPredLim_M" /begin REF_CHARACTERISTIC BCF_RateFallLimnForIChPredLim_M /end REF_CHARACTERISTIC /end GROUP
/begin GROUP S817_BCF_RateRiseLimnForIChPredLim_M "swc_BatCoreFct/BCF_10ms_sys/SofPackLimn/SOF Current Limits Derating/IChPredLim Derating Limits/BCF_RateRiseLimnForIChPredLim_M" /begin REF_CHARACTERISTIC BCF_RateRiseLimnForIChPredLim_M /end REF_CHARACTERISTIC /end GROUP
/begin GROUP S818_BCF_SofDeratDeac_P "swc_BatCoreFct/BCF_10ms_sys/SofPackLimn/SOF Current Limits Derating/IChPredLim Selection/BCF_SofDeratDeac_P" /begin REF_CHARACTERISTIC BCF_SofDeratDeac_P /end REF_CHARACTERISTIC /end GROUP
/begin GROUP S819_BCF_PctgIDchaActLimByBatErr_M "swc_BatCoreFct/BCF_10ms_sys/SofPackLimn/SOF Current Limits Derating/IDchaActLim Derating Limits/BCF_PctgIDchaActLimByBatErr_M" /begin REF_CHARACTERISTIC BCF_PctgIDchaActLimByBatErr_M /end REF_CHARACTERISTIC /end GROUP
/begin GROUP S819_BCF_PctgIDchaActLimByBatSt_M "swc_BatCoreFct/BCF_10ms_sys/SofPackLimn/SOF Current Limits Derating/IDchaActLim Derating Limits/BCF_PctgIDchaActLimByBatSt_M" /begin REF_CHARACTERISTIC BCF_PctgIDchaActLimByBatSt_M /end REF_CHARACTERISTIC /end GROUP
/begin GROUP S819_BCF_RateFallLimnForIDchaActLim_M "swc_BatCoreFct/BCF_10ms_sys/SofPackLimn/SOF Current Limits Derating/IDchaActLim Derating Limits/BCF_RateFallLimnForIDchaActLim_M" /begin REF_CHARACTERISTIC BCF_RateFallLimnForIDchaActLim_M /end REF_CHARACTERISTIC /end GROUP
/begin GROUP S819_BCF_RateRiseLimnForIDchaActLim_M "swc_BatCoreFct/BCF_10ms_sys/SofPackLimn/SOF Current Limits Derating/IDchaActLim Derating Limits/BCF_RateRiseLimnForIDchaActLim_M" /begin REF_CHARACTERISTIC BCF_RateRiseLimnForIDchaActLim_M /end REF_CHARACTERISTIC /end GROUP
/begin GROUP S81_ElectrodesErrorLevel "swc_EltlLnkHzrdProtnNet/ELHPN_10ms_sys/ELHPN_10ms_sys/StateIsolation/StIsln/ElectrodesErrorLevel"
 /begin SUB_GROUP S84_Debounce1 S84_Debounce2 S84_ELHPN_ThdClrDiag101_P S84_ELHPN_ThdClrDiag102_P S84_ELHPN_ThdDiag101_P S84_ELHPN_ThdDiag102_P S84_ELHPN_ThdDiag16_P S84_ELHPN_ThdDiag17_P /end SUB_GROUP
/end GROUP
/begin GROUP S81_ELHPN_bAcvLoopHv_M "swc_EltlLnkHzrdProtnNet/ELHPN_10ms_sys/ELHPN_10ms_sys/StateIsolation/StIsln/ELHPN_bAcvLoopHv_M" /begin REF_CHARACTERISTIC ELHPN_bAcvLoopHv_M /end REF_CHARACTERISTIC /end GROUP
/begin GROUP S81_IsolationLevel "swc_EltlLnkHzrdProtnNet/ELHPN_10ms_sys/ELHPN_10ms_sys/StateIsolation/StIsln/IsolationLevel"
 /begin SUB_GROUP S85_Debounce S85_ELHPN_StIslnSys1Thd1_P1 S85_ELHPN_StIslnSys1Thd2_P S85_ELHPN_StIslnSys2Thd1_P1 S85_ELHPN_StIslnSys2Thd2_P1 S85_ELHPN_StIslnSysCfg_P1 /end SUB_GROUP
/end GROUP
/begin GROUP S81_VehicleIsolationError "swc_EltlLnkHzrdProtnNet/ELHPN_10ms_sys/ELHPN_10ms_sys/StateIsolation/StIsln/VehicleIsolationError"
 /begin SUB_GROUP S86_BitSelect S86_ELHPN_TiDiagDebOff18_P S86_ELHPN_TiDiagDebOn18_P1 S86_ELHPN_TiSample1 S86_InitialCheck /end SUB_GROUP
/end GROUP
/begin GROUP S81_VehicleIsolationState "swc_EltlLnkHzrdProtnNet/ELHPN_10ms_sys/ELHPN_10ms_sys/StateIsolation/StIsln/VehicleIsolationState"
 /begin SUB_GROUP S87_ELHPN_TiDiagDebOff101_P S87_ELHPN_TiDiagDebOff101_P1 S87_ELHPN_TiDiagDebOn101_P S87_ELHPN_TiDiagDebOn101_P1 S87_ELHPN_TiSample1 S87_ELHPN_TiSample11 /end SUB_GROUP
/end GROUP
/begin GROUP S820_BCF_SofDeratDeac_P "swc_BatCoreFct/BCF_10ms_sys/SofPackLimn/SOF Current Limits Derating/IDchaLim Selection/BCF_SofDeratDeac_P" /begin REF_CHARACTERISTIC BCF_SofDeratDeac_P /end REF_CHARACTERISTIC /end GROUP
/begin GROUP S821_BCF_PctgIDchaPredLimByBatErr_M "swc_BatCoreFct/BCF_10ms_sys/SofPackLimn/SOF Current Limits Derating/IDchaPredLim Derating Limits/BCF_PctgIDchaPredLimByBatErr_M" /begin REF_CHARACTERISTIC BCF_PctgIDchaPredLimByBatErr_M /end REF_CHARACTERISTIC /end GROUP
/begin GROUP S821_BCF_PctgIDchaPredLimByBatSt_M "swc_BatCoreFct/BCF_10ms_sys/SofPackLimn/SOF Current Limits Derating/IDchaPredLim Derating Limits/BCF_PctgIDchaPredLimByBatSt_M" /begin REF_CHARACTERISTIC BCF_PctgIDchaPredLimByBatSt_M /end REF_CHARACTERISTIC /end GROUP
/begin GROUP S821_BCF_RateFallLimnIDchaPredLim_M "swc_BatCoreFct/BCF_10ms_sys/SofPackLimn/SOF Current Limits Derating/IDchaPredLim Derating Limits/BCF_RateFallLimnIDchaPredLim_M" /begin REF_CHARACTERISTIC BCF_RateFallLimnIDchaPredLim_M /end REF_CHARACTERISTIC /end GROUP
/begin GROUP S821_BCF_RateRiseLimnIDchaPredLim_M "swc_BatCoreFct/BCF_10ms_sys/SofPackLimn/SOF Current Limits Derating/IDchaPredLim Derating Limits/BCF_RateRiseLimnIDchaPredLim_M" /begin REF_CHARACTERISTIC BCF_RateRiseLimnIDchaPredLim_M /end REF_CHARACTERISTIC /end GROUP
/begin GROUP S822_BCF_SofDeratDeac_P "swc_BatCoreFct/BCF_10ms_sys/SofPackLimn/SOF Current Limits Derating/IDchaPredLim Selection/BCF_SofDeratDeac_P" /begin REF_CHARACTERISTIC BCF_SofDeratDeac_P /end REF_CHARACTERISTIC /end GROUP
/begin GROUP S824_BCF_CoeffIChLim0_P "swc_BatCoreFct/BCF_10ms_sys/SofPackLimn/SOF Current Limits Derating/Subsystem/BCF_CoeffIChLim0_P" /begin REF_CHARACTERISTIC BCF_CoeffIChLim0_P /end REF_CHARACTERISTIC /end GROUP
/begin GROUP S824_BCF_CoeffIChLim1_P "swc_BatCoreFct/BCF_10ms_sys/SofPackLimn/SOF Current Limits Derating/Subsystem/BCF_CoeffIChLim1_P" /begin REF_CHARACTERISTIC BCF_CoeffIChLim1_P /end REF_CHARACTERISTIC /end GROUP
/begin GROUP S824_BCF_CoeffIChLim2_P "swc_BatCoreFct/BCF_10ms_sys/SofPackLimn/SOF Current Limits Derating/Subsystem/BCF_CoeffIChLim2_P" /begin REF_CHARACTERISTIC BCF_CoeffIChLim2_P /end REF_CHARACTERISTIC /end GROUP
/begin GROUP S825_BCF_CoeffIDchaLim0_P "swc_BatCoreFct/BCF_10ms_sys/SofPackLimn/SOF Current Limits Derating/Subsystem1/BCF_CoeffIDchaLim0_P" /begin REF_CHARACTERISTIC BCF_CoeffIDchaLim0_P /end REF_CHARACTERISTIC /end GROUP
/begin GROUP S825_BCF_CoeffIDchaLim1_P "swc_BatCoreFct/BCF_10ms_sys/SofPackLimn/SOF Current Limits Derating/Subsystem1/BCF_CoeffIDchaLim1_P" /begin REF_CHARACTERISTIC BCF_CoeffIDchaLim1_P /end REF_CHARACTERISTIC /end GROUP
/begin GROUP S825_BCF_CoeffIDchaLim2_P "swc_BatCoreFct/BCF_10ms_sys/SofPackLimn/SOF Current Limits Derating/Subsystem1/BCF_CoeffIDchaLim2_P" /begin REF_CHARACTERISTIC BCF_CoeffIDchaLim2_P /end REF_CHARACTERISTIC /end GROUP
/begin GROUP S826_BCF_CoeffIChLim0_P "swc_BatCoreFct/BCF_10ms_sys/SofPackLimn/SOF Current Limits Derating/Subsystem2/BCF_CoeffIChLim0_P" /begin REF_CHARACTERISTIC BCF_CoeffIChLim0_P /end REF_CHARACTERISTIC /end GROUP
/begin GROUP S826_BCF_CoeffIChLim1_P "swc_BatCoreFct/BCF_10ms_sys/SofPackLimn/SOF Current Limits Derating/Subsystem2/BCF_CoeffIChLim1_P" /begin REF_CHARACTERISTIC BCF_CoeffIChLim1_P /end REF_CHARACTERISTIC /end GROUP
/begin GROUP S826_BCF_CoeffIChLim2_P "swc_BatCoreFct/BCF_10ms_sys/SofPackLimn/SOF Current Limits Derating/Subsystem2/BCF_CoeffIChLim2_P" /begin REF_CHARACTERISTIC BCF_CoeffIChLim2_P /end REF_CHARACTERISTIC /end GROUP
/begin GROUP S827_BCF_CoeffIDchaLim0_P "swc_BatCoreFct/BCF_10ms_sys/SofPackLimn/SOF Current Limits Derating/Subsystem3/BCF_CoeffIDchaLim0_P" /begin REF_CHARACTERISTIC BCF_CoeffIDchaLim0_P /end REF_CHARACTERISTIC /end GROUP
/begin GROUP S827_BCF_CoeffIDchaLim1_P "swc_BatCoreFct/BCF_10ms_sys/SofPackLimn/SOF Current Limits Derating/Subsystem3/BCF_CoeffIDchaLim1_P" /begin REF_CHARACTERISTIC BCF_CoeffIDchaLim1_P /end REF_CHARACTERISTIC /end GROUP
/begin GROUP S827_BCF_CoeffIDchaLim2_P "swc_BatCoreFct/BCF_10ms_sys/SofPackLimn/SOF Current Limits Derating/Subsystem3/BCF_CoeffIDchaLim2_P" /begin REF_CHARACTERISTIC BCF_CoeffIDchaLim2_P /end REF_CHARACTERISTIC /end GROUP
/begin GROUP S828_BCF_SofDeratTs_P "swc_BatCoreFct/BCF_10ms_sys/SofPackLimn/SOF Current Limits Derating/rate limiter1/BCF_SofDeratTs_P" /begin REF_CHARACTERISTIC BCF_SofDeratTs_P /end REF_CHARACTERISTIC /end GROUP
/begin GROUP S829_BCF_SofDeratTs_P "swc_BatCoreFct/BCF_10ms_sys/SofPackLimn/SOF Current Limits Derating/rate limiter2/BCF_SofDeratTs_P" /begin REF_CHARACTERISTIC BCF_SofDeratTs_P /end REF_CHARACTERISTIC /end GROUP
/begin GROUP S82_CTC_bAcvCh_P "swc_CtctrTranCtl/CtcrtTranCtl_sys/CtcrtTranCtl/Subsystem/CTC_bAcvCh_P" /begin REF_CHARACTERISTIC CTC_bAcvCh_P /end REF_CHARACTERISTIC /end GROUP
/begin GROUP S82_CTC_bAcvTrml15Chk_P "swc_CtctrTranCtl/CtcrtTranCtl_sys/CtcrtTranCtl/Subsystem/CTC_bAcvTrml15Chk_P" /begin REF_CHARACTERISTIC CTC_bAcvTrml15Chk_P /end REF_CHARACTERISTIC /end GROUP
/begin GROUP S82_CTC_bErrToutForMotDcha_P "swc_CtctrTranCtl/CtcrtTranCtl_sys/CtcrtTranCtl/Subsystem/CTC_bErrToutForMotDcha_P" /begin REF_CHARACTERISTIC CTC_bErrToutForMotDcha_P /end REF_CHARACTERISTIC /end GROUP
/begin GROUP S82_CTC_ErrLoopHv_P "swc_CtctrTranCtl/CtcrtTranCtl_sys/CtcrtTranCtl/Subsystem/CTC_ErrLoopHv_P" /begin REF_CHARACTERISTIC CTC_ErrLoopHv_P /end REF_CHARACTERISTIC /end GROUP
/begin GROUP S82_CTC_ReqRlyCh_P "swc_CtctrTranCtl/CtcrtTranCtl_sys/CtcrtTranCtl/Subsystem/CTC_ReqRlyCh_P" /begin REF_CHARACTERISTIC CTC_ReqRlyCh_P /end REF_CHARACTERISTIC /end GROUP
/begin GROUP S82_CTC_ReqRlyHeat_P "swc_CtctrTranCtl/CtcrtTranCtl_sys/CtcrtTranCtl/Subsystem/CTC_ReqRlyHeat_P" /begin REF_CHARACTERISTIC CTC_ReqRlyHeat_P /end REF_CHARACTERISTIC /end GROUP
/begin GROUP S82_CTC_ReqRlyNeg_P "swc_CtctrTranCtl/CtcrtTranCtl_sys/CtcrtTranCtl/Subsystem/CTC_ReqRlyNeg_P" /begin REF_CHARACTERISTIC CTC_ReqRlyNeg_P /end REF_CHARACTERISTIC /end GROUP
/begin GROUP S82_CTC_ReqRlyPos_P "swc_CtctrTranCtl/CtcrtTranCtl_sys/CtcrtTranCtl/Subsystem/CTC_ReqRlyPos_P" /begin REF_CHARACTERISTIC CTC_ReqRlyPos_P /end REF_CHARACTERISTIC /end GROUP
/begin GROUP S82_CTC_ReqRlyPrech_P "swc_CtctrTranCtl/CtcrtTranCtl_sys/CtcrtTranCtl/Subsystem/CTC_ReqRlyPrech_P" /begin REF_CHARACTERISTIC CTC_ReqRlyPrech_P /end REF_CHARACTERISTIC /end GROUP
/begin GROUP S82_CTC_StRlyCh_P "swc_CtctrTranCtl/CtcrtTranCtl_sys/CtcrtTranCtl/Subsystem/CTC_StRlyCh_P" /begin REF_CHARACTERISTIC CTC_StRlyCh_P /end REF_CHARACTERISTIC /end GROUP
/begin GROUP S82_CTC_StRlyChkCh_P "swc_CtctrTranCtl/CtcrtTranCtl_sys/CtcrtTranCtl/Subsystem/CTC_StRlyChkCh_P" /begin REF_CHARACTERISTIC CTC_StRlyChkCh_P /end REF_CHARACTERISTIC /end GROUP
/begin GROUP S82_CTC_StRlyChkHeat_P "swc_CtctrTranCtl/CtcrtTranCtl_sys/CtcrtTranCtl/Subsystem/CTC_StRlyChkHeat_P" /begin REF_CHARACTERISTIC CTC_StRlyChkHeat_P /end REF_CHARACTERISTIC /end GROUP
/begin GROUP S82_CTC_StRlyChkPos_P "swc_CtctrTranCtl/CtcrtTranCtl_sys/CtcrtTranCtl/Subsystem/CTC_StRlyChkPos_P" /begin REF_CHARACTERISTIC CTC_StRlyChkPos_P /end REF_CHARACTERISTIC /end GROUP
/begin GROUP S82_CTC_StRlyHeat_P "swc_CtctrTranCtl/CtcrtTranCtl_sys/CtcrtTranCtl/Subsystem/CTC_StRlyHeat_P" /begin REF_CHARACTERISTIC CTC_StRlyHeat_P /end REF_CHARACTERISTIC /end GROUP
/begin GROUP S82_CTC_StRlyNeg_P "swc_CtctrTranCtl/CtcrtTranCtl_sys/CtcrtTranCtl/Subsystem/CTC_StRlyNeg_P" /begin REF_CHARACTERISTIC CTC_StRlyNeg_P /end REF_CHARACTERISTIC /end GROUP
/begin GROUP S82_CTC_StRlyPos_P "swc_CtctrTranCtl/CtcrtTranCtl_sys/CtcrtTranCtl/Subsystem/CTC_StRlyPos_P" /begin REF_CHARACTERISTIC CTC_StRlyPos_P /end REF_CHARACTERISTIC /end GROUP
/begin GROUP S82_CTC_StRlyPrech_P "swc_CtctrTranCtl/CtcrtTranCtl_sys/CtcrtTranCtl/Subsystem/CTC_StRlyPrech_P" /begin REF_CHARACTERISTIC CTC_StRlyPrech_P /end REF_CHARACTERISTIC /end GROUP
/begin GROUP S830_BCF_SofDeratTs_P "swc_BatCoreFct/BCF_10ms_sys/SofPackLimn/SOF Current Limits Derating/rate limiter3/BCF_SofDeratTs_P" /begin REF_CHARACTERISTIC BCF_SofDeratTs_P /end REF_CHARACTERISTIC /end GROUP
/begin GROUP S831_BCF_SofDeratTs_P "swc_BatCoreFct/BCF_10ms_sys/SofPackLimn/SOF Current Limits Derating/rate limiter5/BCF_SofDeratTs_P" /begin REF_CHARACTERISTIC BCF_SofDeratTs_P /end REF_CHARACTERISTIC /end GROUP
/begin GROUP S83_CTC_TiMaxMainPosAftRlyUDecr_P "swc_CtctrTranCtl/CtcrtTranCtl_sys/CtcrtTranCtl/TiLoop/CTC_TiMaxMainPosAftRlyUDecr_P" /begin REF_CHARACTERISTIC CTC_TiMaxMainPosAftRlyUDecr_P /end REF_CHARACTERISTIC /end GROUP
/begin GROUP S84_CTC_TiChkIni_P "swc_CtctrTranCtl/CtcrtTranCtl_sys/CtcrtTranCtl/Time/CTC_TiChkIni_P" /begin REF_CHARACTERISTIC CTC_TiChkIni_P /end REF_CHARACTERISTIC /end GROUP
/begin GROUP S84_CTC_TiCutoffLvReqFromVcu_P1 "swc_CtctrTranCtl/CtcrtTranCtl_sys/CtcrtTranCtl/Time/CTC_TiCutoffLvReqFromVcu_P1" /begin REF_CHARACTERISTIC CTC_TiCutoffLvReqFromVcu_P /end REF_CHARACTERISTIC /end GROUP
/begin GROUP S84_CTC_TiEmcyHvOffReqFromVcu_P1 "swc_CtctrTranCtl/CtcrtTranCtl_sys/CtcrtTranCtl/Time/CTC_TiEmcyHvOffReqFromVcu_P1" /begin REF_CHARACTERISTIC CTC_TiEmcyHvOffReqFromVcu_P /end REF_CHARACTERISTIC /end GROUP
/begin GROUP S84_CTC_TiLoopDchaEmcy_P1 "swc_CtctrTranCtl/CtcrtTranCtl_sys/CtcrtTranCtl/Time/CTC_TiLoopDchaEmcy_P1" /begin REF_CHARACTERISTIC CTC_TiLoopDchaEmcy_P /end REF_CHARACTERISTIC /end GROUP
/begin GROUP S84_CTC_TiLoopDchaNorm_P1 "swc_CtctrTranCtl/CtcrtTranCtl_sys/CtcrtTranCtl/Time/CTC_TiLoopDchaNorm_P1" /begin REF_CHARACTERISTIC CTC_TiLoopDchaNorm_P /end REF_CHARACTERISTIC /end GROUP
/begin GROUP S84_CTC_TiLoopNorm_P "swc_CtctrTranCtl/CtcrtTranCtl_sys/CtcrtTranCtl/Time/CTC_TiLoopNorm_P" /begin REF_CHARACTERISTIC CTC_TiLoopNorm_P /end REF_CHARACTERISTIC /end GROUP
/begin GROUP S84_CTC_TiLoopStTranToNorm_P "swc_CtctrTranCtl/CtcrtTranCtl_sys/CtcrtTranCtl/Time/CTC_TiLoopStTranToNorm_P" /begin REF_CHARACTERISTIC CTC_TiLoopStTranToNorm_P /end REF_CHARACTERISTIC /end GROUP
/begin GROUP S84_CTC_TiMaxMainPosAftRlyUDecr_P "swc_CtctrTranCtl/CtcrtTranCtl_sys/CtcrtTranCtl/Time/CTC_TiMaxMainPosAftRlyUDecr_P" /begin REF_CHARACTERISTIC CTC_TiMaxMainPosAftRlyUDecr_P /end REF_CHARACTERISTIC /end GROUP
/begin GROUP S84_CTC_TiMotDcha_P1 "swc_CtctrTranCtl/CtcrtTranCtl_sys/CtcrtTranCtl/Time/CTC_TiMotDcha_P1" /begin REF_CHARACTERISTIC CTC_TiMotDcha_P /end REF_CHARACTERISTIC /end GROUP
/begin GROUP S84_CTC_TiPrechLim_P "swc_CtctrTranCtl/CtcrtTranCtl_sys/CtcrtTranCtl/Time/CTC_TiPrechLim_P" /begin REF_CHARACTERISTIC CTC_TiPrechLim_P /end REF_CHARACTERISTIC /end GROUP
/begin GROUP S84_CTC_TiRlyChChkIni_P "swc_CtctrTranCtl/CtcrtTranCtl_sys/CtcrtTranCtl/Time/CTC_TiRlyChChkIni_P" /begin REF_CHARACTERISTIC CTC_TiRlyChChkIni_P /end REF_CHARACTERISTIC /end GROUP
/begin GROUP S84_CTC_TiRlyChkPosIni_P "swc_CtctrTranCtl/CtcrtTranCtl_sys/CtcrtTranCtl/Time/CTC_TiRlyChkPosIni_P" /begin REF_CHARACTERISTIC CTC_TiRlyChkPosIni_P /end REF_CHARACTERISTIC /end GROUP
/begin GROUP S84_CTC_TiRlyHeatChkIni_P "swc_CtctrTranCtl/CtcrtTranCtl_sys/CtcrtTranCtl/Time/CTC_TiRlyHeatChkIni_P" /begin REF_CHARACTERISTIC CTC_TiRlyHeatChkIni_P /end REF_CHARACTERISTIC /end GROUP
/begin GROUP S84_CTC_TiRlyNegOpen_P "swc_CtctrTranCtl/CtcrtTranCtl_sys/CtcrtTranCtl/Time/CTC_TiRlyNegOpen_P" /begin REF_CHARACTERISTIC CTC_TiRlyNegOpen_P /end REF_CHARACTERISTIC /end GROUP
/begin GROUP S84_CTC_TiRlyNegOpenEmcy_P1 "swc_CtctrTranCtl/CtcrtTranCtl_sys/CtcrtTranCtl/Time/CTC_TiRlyNegOpenEmcy_P1" /begin REF_CHARACTERISTIC CTC_TiRlyNegOpenEmcy_P /end REF_CHARACTERISTIC /end GROUP
/begin GROUP S84_CTC_TiRlyNegOpenNorm_P1 "swc_CtctrTranCtl/CtcrtTranCtl_sys/CtcrtTranCtl/Time/CTC_TiRlyNegOpenNorm_P1" /begin REF_CHARACTERISTIC CTC_TiRlyNegOpenNorm_P /end REF_CHARACTERISTIC /end GROUP
/begin GROUP S84_CTC_TiRlyPrechOpen_P "swc_CtctrTranCtl/CtcrtTranCtl_sys/CtcrtTranCtl/Time/CTC_TiRlyPrechOpen_P" /begin REF_CHARACTERISTIC CTC_TiRlyPrechOpen_P /end REF_CHARACTERISTIC /end GROUP
/begin GROUP S84_CTC_TiUDecr_P "swc_CtctrTranCtl/CtcrtTranCtl_sys/CtcrtTranCtl/Time/CTC_TiUDecr_P" /begin REF_CHARACTERISTIC CTC_TiUDecr_P /end REF_CHARACTERISTIC /end GROUP
/begin GROUP S84_CTC_TiValmaxIDecr_P1 "swc_CtctrTranCtl/CtcrtTranCtl_sys/CtcrtTranCtl/Time/CTC_TiValmaxIDecr_P1" /begin REF_CHARACTERISTIC CTC_TiValmaxIDecr_P /end REF_CHARACTERISTIC /end GROUP
/begin GROUP S84_CTC_TiWaitMaxForRlyChCls_P "swc_CtctrTranCtl/CtcrtTranCtl_sys/CtcrtTranCtl/Time/CTC_TiWaitMaxForRlyChCls_P" /begin REF_CHARACTERISTIC CTC_TiWaitMaxForRlyChCls_P /end REF_CHARACTERISTIC /end GROUP
/begin GROUP S84_CTC_TiWaitMaxForRlyChOpen_P "swc_CtctrTranCtl/CtcrtTranCtl_sys/CtcrtTranCtl/Time/CTC_TiWaitMaxForRlyChOpen_P" /begin REF_CHARACTERISTIC CTC_TiWaitMaxForRlyChOpen_P /end REF_CHARACTERISTIC /end GROUP
/begin GROUP S84_CTC_TiWaitMaxForRlyHeatCls_P "swc_CtctrTranCtl/CtcrtTranCtl_sys/CtcrtTranCtl/Time/CTC_TiWaitMaxForRlyHeatCls_P" /begin REF_CHARACTERISTIC CTC_TiWaitMaxForRlyHeatCls_P /end REF_CHARACTERISTIC /end GROUP
/begin GROUP S84_CTC_TiWaitMaxForRlyHeatOpen_P "swc_CtctrTranCtl/CtcrtTranCtl_sys/CtcrtTranCtl/Time/CTC_TiWaitMaxForRlyHeatOpen_P" /begin REF_CHARACTERISTIC CTC_TiWaitMaxForRlyHeatOpen_P /end REF_CHARACTERISTIC /end GROUP
/begin GROUP S84_CTC_TiWaitPrech_P "swc_CtctrTranCtl/CtcrtTranCtl_sys/CtcrtTranCtl/Time/CTC_TiWaitPrech_P" /begin REF_CHARACTERISTIC CTC_TiWaitPrech_P /end REF_CHARACTERISTIC /end GROUP
/begin GROUP S84_Debounce1 "swc_EltlLnkHzrdProtnNet/ELHPN_10ms_sys/ELHPN_10ms_sys/StateIsolation/StIsln/ElectrodesErrorLevel/Debounce1"
 /begin SUB_GROUP S88_BitSelect S88_BitSelect1 S88_ELHPN_TiDiagDebOff101_P S88_ELHPN_TiDiagDebOff16_P S88_ELHPN_TiDiagDebOn101_P S88_ELHPN_TiDiagDebOn16_P S88_ELHPN_TiSample1 S88_ELHPN_TiSample11 /end SUB_GROUP
/end GROUP
/begin GROUP S84_Debounce2 "swc_EltlLnkHzrdProtnNet/ELHPN_10ms_sys/ELHPN_10ms_sys/StateIsolation/StIsln/ElectrodesErrorLevel/Debounce2"
 /begin SUB_GROUP S89_BitSelect S89_BitSelect1 S89_ELHPN_TiDiagDebOff102_P S89_ELHPN_TiDiagDebOff17_P S89_ELHPN_TiDiagDebOn102_P S89_ELHPN_TiDiagDebOn17_P S89_ELHPN_TiSample1 S89_ELHPN_TiSample11 /end SUB_GROUP
/end GROUP
/begin GROUP S84_ELHPN_ThdClrDiag101_P "swc_EltlLnkHzrdProtnNet/ELHPN_10ms_sys/ELHPN_10ms_sys/StateIsolation/StIsln/ElectrodesErrorLevel/ELHPN_ThdClrDiag101_P" /begin REF_CHARACTERISTIC ELHPN_ThdClrDiag101_P /end REF_CHARACTERISTIC /end GROUP
/begin GROUP S84_ELHPN_ThdClrDiag102_P "swc_EltlLnkHzrdProtnNet/ELHPN_10ms_sys/ELHPN_10ms_sys/StateIsolation/StIsln/ElectrodesErrorLevel/ELHPN_ThdClrDiag102_P" /begin REF_CHARACTERISTIC ELHPN_ThdClrDiag102_P /end REF_CHARACTERISTIC /end GROUP
/begin GROUP S84_ELHPN_ThdDiag101_P "swc_EltlLnkHzrdProtnNet/ELHPN_10ms_sys/ELHPN_10ms_sys/StateIsolation/StIsln/ElectrodesErrorLevel/ELHPN_ThdDiag101_P" /begin REF_CHARACTERISTIC ELHPN_ThdDiag101_P /end REF_CHARACTERISTIC /end GROUP
/begin GROUP S84_ELHPN_ThdDiag102_P "swc_EltlLnkHzrdProtnNet/ELHPN_10ms_sys/ELHPN_10ms_sys/StateIsolation/StIsln/ElectrodesErrorLevel/ELHPN_ThdDiag102_P" /begin REF_CHARACTERISTIC ELHPN_ThdDiag102_P /end REF_CHARACTERISTIC /end GROUP
/begin GROUP S84_ELHPN_ThdDiag16_P "swc_EltlLnkHzrdProtnNet/ELHPN_10ms_sys/ELHPN_10ms_sys/StateIsolation/StIsln/ElectrodesErrorLevel/ELHPN_ThdDiag16_P" /begin REF_CHARACTERISTIC ELHPN_ThdDiag16_P /end REF_CHARACTERISTIC /end GROUP
/begin GROUP S84_ELHPN_ThdDiag17_P "swc_EltlLnkHzrdProtnNet/ELHPN_10ms_sys/ELHPN_10ms_sys/StateIsolation/StIsln/ElectrodesErrorLevel/ELHPN_ThdDiag17_P" /begin REF_CHARACTERISTIC ELHPN_ThdDiag17_P /end REF_CHARACTERISTIC /end GROUP
/begin GROUP S85_CTC_FacUMainPosPoleBefRly_P "swc_CtctrTranCtl/CtcrtTranCtl_sys/CtcrtTranCtl/TransitionCondition/CTC_FacUMainPosPoleBefRly_P" /begin REF_CHARACTERISTIC CTC_FacUMainPosPoleBefRly_P /end REF_CHARACTERISTIC /end GROUP
/begin GROUP S85_CTC_IBatHvLimHvOff_P "swc_CtctrTranCtl/CtcrtTranCtl_sys/CtcrtTranCtl/TransitionCondition/CTC_IBatHvLimHvOff_P" /begin REF_CHARACTERISTIC CTC_IBatHvLimHvOff_P /end REF_CHARACTERISTIC /end GROUP
/begin GROUP S85_CTC_ModeMotDchaFnshd_P "swc_CtctrTranCtl/CtcrtTranCtl_sys/CtcrtTranCtl/TransitionCondition/CTC_ModeMotDchaFnshd_P" /begin REF_CHARACTERISTIC CTC_ModeMotDchaFnshd_P /end REF_CHARACTERISTIC /end GROUP
/begin GROUP S85_CTC_ReqHvOnFromVcu_P "swc_CtctrTranCtl/CtcrtTranCtl_sys/CtcrtTranCtl/TransitionCondition/CTC_ReqHvOnFromVcu_P" /begin REF_CHARACTERISTIC CTC_ReqHvOnFromVcu_P /end REF_CHARACTERISTIC /end GROUP
/begin GROUP S85_CTC_StBcuStb_P "swc_CtctrTranCtl/CtcrtTranCtl_sys/CtcrtTranCtl/TransitionCondition/CTC_StBcuStb_P" /begin REF_CHARACTERISTIC CTC_StBcuStb_P /end REF_CHARACTERISTIC /end GROUP
/begin GROUP S85_CTC_UChPoleHiSideDrv_P "swc_CtctrTranCtl/CtcrtTranCtl_sys/CtcrtTranCtl/TransitionCondition/CTC_UChPoleHiSideDrv_P" /begin REF_CHARACTERISTIC CTC_UChPoleHiSideDrv_P /end REF_CHARACTERISTIC /end GROUP
/begin GROUP S85_CTC_UClsLim_P "swc_CtctrTranCtl/CtcrtTranCtl_sys/CtcrtTranCtl/TransitionCondition/CTC_UClsLim_P" /begin REF_CHARACTERISTIC CTC_UClsLim_P /end REF_CHARACTERISTIC /end GROUP
/begin GROUP S85_CTC_UDecrChkLim_P "swc_CtctrTranCtl/CtcrtTranCtl_sys/CtcrtTranCtl/TransitionCondition/CTC_UDecrChkLim_P" /begin REF_CHARACTERISTIC CTC_UDecrChkLim_P /end REF_CHARACTERISTIC /end GROUP
/begin GROUP S85_CTC_UEqu_P "swc_CtctrTranCtl/CtcrtTranCtl_sys/CtcrtTranCtl/TransitionCondition/CTC_UEqu_P" /begin REF_CHARACTERISTIC CTC_UEqu_P /end REF_CHARACTERISTIC /end GROUP
/begin GROUP S85_CTC_UEquForCh_P "swc_CtctrTranCtl/CtcrtTranCtl_sys/CtcrtTranCtl/TransitionCondition/CTC_UEquForCh_P" /begin REF_CHARACTERISTIC CTC_UEquForCh_P /end REF_CHARACTERISTIC /end GROUP
/begin GROUP S85_CTC_UEquForHeat_P "swc_CtctrTranCtl/CtcrtTranCtl_sys/CtcrtTranCtl/TransitionCondition/CTC_UEquForHeat_P" /begin REF_CHARACTERISTIC CTC_UEquForHeat_P /end REF_CHARACTERISTIC /end GROUP
/begin GROUP S85_CTC_UHeatPoleHiSideDrv_P "swc_CtctrTranCtl/CtcrtTranCtl_sys/CtcrtTranCtl/TransitionCondition/CTC_UHeatPoleHiSideDrv_P" /begin REF_CHARACTERISTIC CTC_UHeatPoleHiSideDrv_P /end REF_CHARACTERISTIC /end GROUP
/begin GROUP S85_CTC_UIncChkLim_P "swc_CtctrTranCtl/CtcrtTranCtl_sys/CtcrtTranCtl/TransitionCondition/CTC_UIncChkLim_P" /begin REF_CHARACTERISTIC CTC_UIncChkLim_P /end REF_CHARACTERISTIC /end GROUP
/begin GROUP S85_CTC_UMainNegPoleHiSideDrv_P "swc_CtctrTranCtl/CtcrtTranCtl_sys/CtcrtTranCtl/TransitionCondition/CTC_UMainNegPoleHiSideDrv_P" /begin REF_CHARACTERISTIC CTC_UMainNegPoleHiSideDrv_P /end REF_CHARACTERISTIC /end GROUP
/begin GROUP S85_CTC_UMainPosPoleHiSideDrv_P "swc_CtctrTranCtl/CtcrtTranCtl_sys/CtcrtTranCtl/TransitionCondition/CTC_UMainPosPoleHiSideDrv_P" /begin REF_CHARACTERISTIC CTC_UMainPosPoleHiSideDrv_P /end REF_CHARACTERISTIC /end GROUP
/begin GROUP S85_CTC_UMotDchaLim_P "swc_CtctrTranCtl/CtcrtTranCtl_sys/CtcrtTranCtl/TransitionCondition/CTC_UMotDchaLim_P" /begin REF_CHARACTERISTIC CTC_UMotDchaLim_P /end REF_CHARACTERISTIC /end GROUP
/begin GROUP S85_CTC_URlyPrechHiSideDrv_P "swc_CtctrTranCtl/CtcrtTranCtl_sys/CtcrtTranCtl/TransitionCondition/CTC_URlyPrechHiSideDrv_P" /begin REF_CHARACTERISTIC CTC_URlyPrechHiSideDrv_P /end REF_CHARACTERISTIC /end GROUP
/begin GROUP S85_Debounce "swc_EltlLnkHzrdProtnNet/ELHPN_10ms_sys/ELHPN_10ms_sys/StateIsolation/StIsln/IsolationLevel/Debounce"
 /begin SUB_GROUP S133_DebounceStepSelect S133_DebounceStepSelect1 S133_DebounceStepSelect2 S133_DebounceStepSelect3 S133_ELHPN_StIslnDebOff_P S133_ELHPN_StIslnDebOff_P1 S133_ELHPN_StIslnDebOff_P2 S133_ELHPN_StIslnDebOff_P3 S133_ELHPN_StIslnDebOn_P S133_ELHPN_StIslnDebOn_P1 S133_ELHPN_StIslnDebOn_P2 S133_ELHPN_StIslnDebOn_P3 S133_ELHPN_StIslnDebShoOff_P S133_ELHPN_StIslnDebShoOff_P1 S133_ELHPN_StIslnDebShoOff_P2 S133_ELHPN_StIslnDebShoOff_P3 S133_ELHPN_StIslnDebShoOn_P1 S133_ELHPN_StIslnDebShoOn_P2 S133_ELHPN_StIslnDebShoOn_P3 S133_ELHPN_StIslnDebShoOn_P4 S133_ELHPN_TiSample1 S133_ELHPN_TiSample11 S133_ELHPN_TiSample12 S133_ELHPN_TiSample13 /end SUB_GROUP
/end GROUP
/begin GROUP S85_ELHPN_StIslnSys1Thd1_P1 "swc_EltlLnkHzrdProtnNet/ELHPN_10ms_sys/ELHPN_10ms_sys/StateIsolation/StIsln/IsolationLevel/ELHPN_StIslnSys1Thd1_P1" /begin REF_CHARACTERISTIC ELHPN_StIslnSys1Thd1_P /end REF_CHARACTERISTIC /end GROUP
/begin GROUP S85_ELHPN_StIslnSys1Thd2_P "swc_EltlLnkHzrdProtnNet/ELHPN_10ms_sys/ELHPN_10ms_sys/StateIsolation/StIsln/IsolationLevel/ELHPN_StIslnSys1Thd2_P" /begin REF_CHARACTERISTIC ELHPN_StIslnSys1Thd2_P /end REF_CHARACTERISTIC /end GROUP
/begin GROUP S85_ELHPN_StIslnSys2Thd1_P1 "swc_EltlLnkHzrdProtnNet/ELHPN_10ms_sys/ELHPN_10ms_sys/StateIsolation/StIsln/IsolationLevel/ELHPN_StIslnSys2Thd1_P1" /begin REF_CHARACTERISTIC ELHPN_StIslnSys2Thd1_P /end REF_CHARACTERISTIC /end GROUP
/begin GROUP S85_ELHPN_StIslnSys2Thd2_P1 "swc_EltlLnkHzrdProtnNet/ELHPN_10ms_sys/ELHPN_10ms_sys/StateIsolation/StIsln/IsolationLevel/ELHPN_StIslnSys2Thd2_P1" /begin REF_CHARACTERISTIC ELHPN_StIslnSys2Thd2_P /end REF_CHARACTERISTIC /end GROUP
/begin GROUP S85_ELHPN_StIslnSysCfg_P1 "swc_EltlLnkHzrdProtnNet/ELHPN_10ms_sys/ELHPN_10ms_sys/StateIsolation/StIsln/IsolationLevel/ELHPN_StIslnSysCfg_P1" /begin REF_CHARACTERISTIC ELHPN_StIslnSysCfg_P /end REF_CHARACTERISTIC /end GROUP
/begin GROUP S86_ELHPN_TiDiagDebOff18_P "swc_EltlLnkHzrdProtnNet/ELHPN_10ms_sys/ELHPN_10ms_sys/StateIsolation/StIsln/VehicleIsolationError/ELHPN_TiDiagDebOff18_P" /begin REF_CHARACTERISTIC ELHPN_TiDiagDebOff18_P /end REF_CHARACTERISTIC /end GROUP
/begin GROUP S86_ELHPN_TiDiagDebOn18_P1 "swc_EltlLnkHzrdProtnNet/ELHPN_10ms_sys/ELHPN_10ms_sys/StateIsolation/StIsln/VehicleIsolationError/ELHPN_TiDiagDebOn18_P1" /begin REF_CHARACTERISTIC ELHPN_TiDiagDebOn18_P /end REF_CHARACTERISTIC /end GROUP
/begin GROUP S86_InitialCheck "swc_EltlLnkHzrdProtnNet/ELHPN_10ms_sys/ELHPN_10ms_sys/StateIsolation/StIsln/VehicleIsolationError/InitialCheck"
 /begin SUB_GROUP S188_BitSelect S188_ELHPN_TiDiagDebIniOff18_P S188_ELHPN_TiDiagDebIniOn18_P S188_ELHPN_TiSample1 /end SUB_GROUP
/end GROUP
/begin GROUP S87_ELHPN_TiDiagDebOff101_P "swc_EltlLnkHzrdProtnNet/ELHPN_10ms_sys/ELHPN_10ms_sys/StateIsolation/StIsln/VehicleIsolationState/ELHPN_TiDiagDebOff101_P" /begin REF_CHARACTERISTIC ELHPN_TiDiagDebOff101_P /end REF_CHARACTERISTIC /end GROUP
/begin GROUP S87_ELHPN_TiDiagDebOff101_P1 "swc_EltlLnkHzrdProtnNet/ELHPN_10ms_sys/ELHPN_10ms_sys/StateIsolation/StIsln/VehicleIsolationState/ELHPN_TiDiagDebOff101_P1" /begin REF_CHARACTERISTIC ELHPN_TiDiagDebOff101_P /end REF_CHARACTERISTIC /end GROUP
/begin GROUP S87_ELHPN_TiDiagDebOn101_P "swc_EltlLnkHzrdProtnNet/ELHPN_10ms_sys/ELHPN_10ms_sys/StateIsolation/StIsln/VehicleIsolationState/ELHPN_TiDiagDebOn101_P" /begin REF_CHARACTERISTIC ELHPN_TiDiagDebOn101_P /end REF_CHARACTERISTIC /end GROUP
/begin GROUP S87_ELHPN_TiDiagDebOn101_P1 "swc_EltlLnkHzrdProtnNet/ELHPN_10ms_sys/ELHPN_10ms_sys/StateIsolation/StIsln/VehicleIsolationState/ELHPN_TiDiagDebOn101_P1" /begin REF_CHARACTERISTIC ELHPN_TiDiagDebOn101_P /end REF_CHARACTERISTIC /end GROUP
/begin GROUP S884_BCF_SofDeratDeac_P "swc_BatCoreFct/BCF_10ms_sys/SofPackLimn/SOF Voltage Limits Derating/Actual Charging Voltage Limit Selection/BCF_SofDeratDeac_P" /begin REF_CHARACTERISTIC BCF_SofDeratDeac_P /end REF_CHARACTERISTIC /end GROUP
/begin GROUP S885_BCF_SofDeratDeac_P "swc_BatCoreFct/BCF_10ms_sys/SofPackLimn/SOF Voltage Limits Derating/Actual Discharging Voltage Limit Selection/BCF_SofDeratDeac_P" /begin REF_CHARACTERISTIC BCF_SofDeratDeac_P /end REF_CHARACTERISTIC /end GROUP
/begin GROUP S886_BCF_SofDeratPackStOk_P "swc_BatCoreFct/BCF_10ms_sys/SofPackLimn/SOF Voltage Limits Derating/Battery State Evaluation/BCF_SofDeratPackStOk_P" /begin REF_CHARACTERISTIC BCF_SofDeratPackStOk_P /end REF_CHARACTERISTIC /end GROUP
/begin GROUP S887_BCF_SofDeratDeac_P "swc_BatCoreFct/BCF_10ms_sys/SofPackLimn/SOF Voltage Limits Derating/Predicted Charging Voltage Limit Selection/BCF_SofDeratDeac_P" /begin REF_CHARACTERISTIC BCF_SofDeratDeac_P /end REF_CHARACTERISTIC /end GROUP
/begin GROUP S888_BCF_SofDeratDeac_P "swc_BatCoreFct/BCF_10ms_sys/SofPackLimn/SOF Voltage Limits Derating/Predicted Discharging Voltage Limit Selection/BCF_SofDeratDeac_P" /begin REF_CHARACTERISTIC BCF_SofDeratDeac_P /end REF_CHARACTERISTIC /end GROUP
/begin GROUP S889_BCF_PctgUChActLimByBatErr_M "swc_BatCoreFct/BCF_10ms_sys/SofPackLimn/SOF Voltage Limits Derating/UChAct Derating Limits/BCF_PctgUChActLimByBatErr_M" /begin REF_CHARACTERISTIC BCF_PctgUChActLimByBatErr_M /end REF_CHARACTERISTIC /end GROUP
/begin GROUP S889_BCF_RateFallLimnForUChActLim_P "swc_BatCoreFct/BCF_10ms_sys/SofPackLimn/SOF Voltage Limits Derating/UChAct Derating Limits/BCF_RateFallLimnForUChActLim_P" /begin REF_CHARACTERISTIC BCF_RateFallLimnForUChActLim_P /end REF_CHARACTERISTIC /end GROUP
/begin GROUP S889_BCF_RateRiseLimnForUChActLim_P "swc_BatCoreFct/BCF_10ms_sys/SofPackLimn/SOF Voltage Limits Derating/UChAct Derating Limits/BCF_RateRiseLimnForUChActLim_P" /begin REF_CHARACTERISTIC BCF_RateRiseLimnForUChActLim_P /end REF_CHARACTERISTIC /end GROUP
/begin GROUP S88_ELHPN_TiDiagDebOff101_P "swc_EltlLnkHzrdProtnNet/ELHPN_10ms_sys/ELHPN_10ms_sys/StateIsolation/StIsln/ElectrodesErrorLevel/Debounce1/ELHPN_TiDiagDebOff101_P" /begin REF_CHARACTERISTIC ELHPN_TiDiagDebOff101_P /end REF_CHARACTERISTIC /end GROUP
/begin GROUP S88_ELHPN_TiDiagDebOff16_P "swc_EltlLnkHzrdProtnNet/ELHPN_10ms_sys/ELHPN_10ms_sys/StateIsolation/StIsln/ElectrodesErrorLevel/Debounce1/ELHPN_TiDiagDebOff16_P" /begin REF_CHARACTERISTIC ELHPN_TiDiagDebOff16_P /end REF_CHARACTERISTIC /end GROUP
/begin GROUP S88_ELHPN_TiDiagDebOn101_P "swc_EltlLnkHzrdProtnNet/ELHPN_10ms_sys/ELHPN_10ms_sys/StateIsolation/StIsln/ElectrodesErrorLevel/Debounce1/ELHPN_TiDiagDebOn101_P" /begin REF_CHARACTERISTIC ELHPN_TiDiagDebOn101_P /end REF_CHARACTERISTIC /end GROUP
/begin GROUP S88_ELHPN_TiDiagDebOn16_P "swc_EltlLnkHzrdProtnNet/ELHPN_10ms_sys/ELHPN_10ms_sys/StateIsolation/StIsln/ElectrodesErrorLevel/Debounce1/ELHPN_TiDiagDebOn16_P" /begin REF_CHARACTERISTIC ELHPN_TiDiagDebOn16_P /end REF_CHARACTERISTIC /end GROUP
/begin GROUP S890_BCF_PctgUChPredLimByBatErr_M "swc_BatCoreFct/BCF_10ms_sys/SofPackLimn/SOF Voltage Limits Derating/UChPred Derating Limits/BCF_PctgUChPredLimByBatErr_M" /begin REF_CHARACTERISTIC BCF_PctgUChPredLimByBatErr_M /end REF_CHARACTERISTIC /end GROUP
/begin GROUP S890_BCF_RateFallLimnForUChPredLim_P "swc_BatCoreFct/BCF_10ms_sys/SofPackLimn/SOF Voltage Limits Derating/UChPred Derating Limits/BCF_RateFallLimnForUChPredLim_P" /begin REF_CHARACTERISTIC BCF_RateFallLimnForUChPredLim_P /end REF_CHARACTERISTIC /end GROUP
/begin GROUP S890_BCF_RateRiseLimnForUChPredLim_P "swc_BatCoreFct/BCF_10ms_sys/SofPackLimn/SOF Voltage Limits Derating/UChPred Derating Limits/BCF_RateRiseLimnForUChPredLim_P" /begin REF_CHARACTERISTIC BCF_RateRiseLimnForUChPredLim_P /end REF_CHARACTERISTIC /end GROUP
/begin GROUP S891_BCF_PctgUDchaActLimByBatErr_M "swc_BatCoreFct/BCF_10ms_sys/SofPackLimn/SOF Voltage Limits Derating/UDchaAct Derating Limits/BCF_PctgUDchaActLimByBatErr_M" /begin REF_CHARACTERISTIC BCF_PctgUDchaActLimByBatErr_M /end REF_CHARACTERISTIC /end GROUP
/begin GROUP S891_BCF_RateFallLimnForUDchaActLim_P "swc_BatCoreFct/BCF_10ms_sys/SofPackLimn/SOF Voltage Limits Derating/UDchaAct Derating Limits/BCF_RateFallLimnForUDchaActLim_P" /begin REF_CHARACTERISTIC BCF_RateFallLimnForUDchaActLim_P /end REF_CHARACTERISTIC /end GROUP
/begin GROUP S891_BCF_RateRiseLimnForUDchaActLim_P "swc_BatCoreFct/BCF_10ms_sys/SofPackLimn/SOF Voltage Limits Derating/UDchaAct Derating Limits/BCF_RateRiseLimnForUDchaActLim_P" /begin REF_CHARACTERISTIC BCF_RateRiseLimnForUDchaActLim_P /end REF_CHARACTERISTIC /end GROUP
/begin GROUP S892_BCF_PctgUDchaPredLimByBatErr_M "swc_BatCoreFct/BCF_10ms_sys/SofPackLimn/SOF Voltage Limits Derating/UDchaPred Derating Limits/BCF_PctgUDchaPredLimByBatErr_M" /begin REF_CHARACTERISTIC BCF_PctgUDchaPredLimByBatErr_M /end REF_CHARACTERISTIC /end GROUP
/begin GROUP S892_BCF_RateFallLimnUDchaPredLim_P "swc_BatCoreFct/BCF_10ms_sys/SofPackLimn/SOF Voltage Limits Derating/UDchaPred Derating Limits/BCF_RateFallLimnUDchaPredLim_P" /begin REF_CHARACTERISTIC BCF_RateFallLimnUDchaPredLim_P /end REF_CHARACTERISTIC /end GROUP
/begin GROUP S892_BCF_RateRiseLimnUDchaPredLim_P "swc_BatCoreFct/BCF_10ms_sys/SofPackLimn/SOF Voltage Limits Derating/UDchaPred Derating Limits/BCF_RateRiseLimnUDchaPredLim_P" /begin REF_CHARACTERISTIC BCF_RateRiseLimnUDchaPredLim_P /end REF_CHARACTERISTIC /end GROUP
/begin GROUP S893_BCF_SofDeratTs_P "swc_BatCoreFct/BCF_10ms_sys/SofPackLimn/SOF Voltage Limits Derating/rate limiter1/BCF_SofDeratTs_P" /begin REF_CHARACTERISTIC BCF_SofDeratTs_P /end REF_CHARACTERISTIC /end GROUP
/begin GROUP S894_BCF_SofDeratTs_P "swc_BatCoreFct/BCF_10ms_sys/SofPackLimn/SOF Voltage Limits Derating/rate limiter2/BCF_SofDeratTs_P" /begin REF_CHARACTERISTIC BCF_SofDeratTs_P /end REF_CHARACTERISTIC /end GROUP
/begin GROUP S895_BCF_SofDeratTs_P "swc_BatCoreFct/BCF_10ms_sys/SofPackLimn/SOF Voltage Limits Derating/rate limiter3/BCF_SofDeratTs_P" /begin REF_CHARACTERISTIC BCF_SofDeratTs_P /end REF_CHARACTERISTIC /end GROUP
/begin GROUP S896_BCF_SofDeratTs_P "swc_BatCoreFct/BCF_10ms_sys/SofPackLimn/SOF Voltage Limits Derating/rate limiter5/BCF_SofDeratTs_P" /begin REF_CHARACTERISTIC BCF_SofDeratTs_P /end REF_CHARACTERISTIC /end GROUP
/begin GROUP S89_ELHPN_TiDiagDebOff102_P "swc_EltlLnkHzrdProtnNet/ELHPN_10ms_sys/ELHPN_10ms_sys/StateIsolation/StIsln/ElectrodesErrorLevel/Debounce2/ELHPN_TiDiagDebOff102_P" /begin REF_CHARACTERISTIC ELHPN_TiDiagDebOff102_P /end REF_CHARACTERISTIC /end GROUP
/begin GROUP S89_ELHPN_TiDiagDebOff17_P "swc_EltlLnkHzrdProtnNet/ELHPN_10ms_sys/ELHPN_10ms_sys/StateIsolation/StIsln/ElectrodesErrorLevel/Debounce2/ELHPN_TiDiagDebOff17_P" /begin REF_CHARACTERISTIC ELHPN_TiDiagDebOff17_P /end REF_CHARACTERISTIC /end GROUP
/begin GROUP S89_ELHPN_TiDiagDebOn102_P "swc_EltlLnkHzrdProtnNet/ELHPN_10ms_sys/ELHPN_10ms_sys/StateIsolation/StIsln/ElectrodesErrorLevel/Debounce2/ELHPN_TiDiagDebOn102_P" /begin REF_CHARACTERISTIC ELHPN_TiDiagDebOn102_P /end REF_CHARACTERISTIC /end GROUP
/begin GROUP S89_ELHPN_TiDiagDebOn17_P "swc_EltlLnkHzrdProtnNet/ELHPN_10ms_sys/ELHPN_10ms_sys/StateIsolation/StIsln/ElectrodesErrorLevel/Debounce2/ELHPN_TiDiagDebOn17_P" /begin REF_CHARACTERISTIC ELHPN_TiDiagDebOn17_P /end REF_CHARACTERISTIC /end GROUP
/begin GROUP S91_BWLD_ESet_P "swc_BatWntyLogtcData/10ms/10ms/EBat/SetTotalCharge/BWLD_ESet_P" /begin REF_CHARACTERISTIC BWLD_ESet_P /end REF_CHARACTERISTIC /end GROUP
/begin GROUP S92_BSTC_ReqEmcyHvOffFromVcu_P "swc_BcuStTranCtl/BcuStTranCtl_sys/BcuStTranCtl/ConditionConfirm/ShutdownDetection/BSTC_ReqEmcyHvOffFromVcu_P" /begin REF_CHARACTERISTIC BSTC_ReqEmcyHvOffFromVcu_P /end REF_CHARACTERISTIC /end GROUP
/begin GROUP S92_BSTC_ReqNormHvOffFromVcu_P "swc_BcuStTranCtl/BcuStTranCtl_sys/BcuStTranCtl/ConditionConfirm/ShutdownDetection/BSTC_ReqNormHvOffFromVcu_P" /begin REF_CHARACTERISTIC BSTC_ReqNormHvOffFromVcu_P /end REF_CHARACTERISTIC /end GROUP
/begin GROUP S92_BSTC_TiRxHvOffReqAftEmcy_P "swc_BcuStTranCtl/BcuStTranCtl_sys/BcuStTranCtl/ConditionConfirm/ShutdownDetection/BSTC_TiRxHvOffReqAftEmcy_P" /begin REF_CHARACTERISTIC BSTC_TiRxHvOffReqAftEmcy_P /end REF_CHARACTERISTIC /end GROUP
/begin GROUP S92_BSTC_TiRxHvOffReqForAcCh_P "swc_BcuStTranCtl/BcuStTranCtl_sys/BcuStTranCtl/ConditionConfirm/ShutdownDetection/BSTC_TiRxHvOffReqForAcCh_P" /begin REF_CHARACTERISTIC BSTC_TiRxHvOffReqForAcCh_P /end REF_CHARACTERISTIC /end GROUP
/begin GROUP S92_BSTC_TiRxHvOffReqForDcCh_P "swc_BcuStTranCtl/BcuStTranCtl_sys/BcuStTranCtl/ConditionConfirm/ShutdownDetection/BSTC_TiRxHvOffReqForDcCh_P" /begin REF_CHARACTERISTIC BSTC_TiRxHvOffReqForDcCh_P /end REF_CHARACTERISTIC /end GROUP
/begin GROUP S92_BSTC_TiRxHvOffReqForDcha_P "swc_BcuStTranCtl/BcuStTranCtl_sys/BcuStTranCtl/ConditionConfirm/ShutdownDetection/BSTC_TiRxHvOffReqForDcha_P" /begin REF_CHARACTERISTIC BSTC_TiRxHvOffReqForDcha_P /end REF_CHARACTERISTIC /end GROUP
/begin GROUP S92_BWLD_ESet_P "swc_BatWntyLogtcData/10ms/10ms/EBat/SetTotalDischarge/BWLD_ESet_P" /begin REF_CHARACTERISTIC BWLD_ESet_P /end REF_CHARACTERISTIC /end GROUP
/begin GROUP S92_Subsystem "swc_BcuStTranCtl/BcuStTranCtl_sys/BcuStTranCtl/ConditionConfirm/ShutdownDetection/Subsystem" /begin SUB_GROUP S114_BSTC_TiProc_P S114_BSTC_TiRxVldMsg_P /end SUB_GROUP /end GROUP
/begin GROUP S93_Balancing_Current_Calculation_Loop "swc_BatBalnCtl/BBC_100ms_sys/BBC_100ms_sys/BatBalnCtl_BalnIClcn/Subsystem/Balancing Current Calculation Loop" /begin SUB_GROUP S94_Balancing_Current_Calculation_and_Compensation_Loop /end SUB_GROUP /end GROUP
/begin GROUP S93_CTC_CtrCtctrChDtrtLim_P "swc_CtctrTranCtl/CtcrtTranCtl_sys/CtcrtTranCtl/ContactorAgingObserver/ConditionCalculation/CTC_CtrCtctrChDtrtLim_P" /begin REF_CHARACTERISTIC CTC_CtrCtctrChDtrtLim_P /end REF_CHARACTERISTIC /end GROUP
/begin GROUP S93_CTC_CtrCtctrDtrtLimNeg_P "swc_CtctrTranCtl/CtcrtTranCtl_sys/CtcrtTranCtl/ContactorAgingObserver/ConditionCalculation/CTC_CtrCtctrDtrtLimNeg_P" /begin REF_CHARACTERISTIC CTC_CtrCtctrDtrtLimNeg_P /end REF_CHARACTERISTIC /end GROUP
/begin GROUP S93_CTC_CtrCtctrDtrtLimPos_P "swc_CtctrTranCtl/CtcrtTranCtl_sys/CtcrtTranCtl/ContactorAgingObserver/ConditionCalculation/CTC_CtrCtctrDtrtLimPos_P" /begin REF_CHARACTERISTIC CTC_CtrCtctrDtrtLimPos_P /end REF_CHARACTERISTIC /end GROUP
/begin GROUP S93_CTC_CtrCtctrDtrtLimPrech_P "swc_CtctrTranCtl/CtcrtTranCtl_sys/CtcrtTranCtl/ContactorAgingObserver/ConditionCalculation/CTC_CtrCtctrDtrtLimPrech_P" /begin REF_CHARACTERISTIC CTC_CtrCtctrDtrtLimPrech_P /end REF_CHARACTERISTIC /end GROUP
/begin GROUP S93_CTC_PctgCtctrChErrCdnLim_P "swc_CtctrTranCtl/CtcrtTranCtl_sys/CtcrtTranCtl/ContactorAgingObserver/ConditionCalculation/CTC_PctgCtctrChErrCdnLim_P" /begin REF_CHARACTERISTIC CTC_PctgCtctrChErrCdnLim_P /end REF_CHARACTERISTIC /end GROUP
/begin GROUP S93_CTC_PctgCtctrChWarnCdnLim_P "swc_CtctrTranCtl/CtcrtTranCtl_sys/CtcrtTranCtl/ContactorAgingObserver/ConditionCalculation/CTC_PctgCtctrChWarnCdnLim_P" /begin REF_CHARACTERISTIC CTC_PctgCtctrChWarnCdnLim_P /end REF_CHARACTERISTIC /end GROUP
/begin GROUP S93_CTC_PctgCtctrErrCdnLimNeg_P "swc_CtctrTranCtl/CtcrtTranCtl_sys/CtcrtTranCtl/ContactorAgingObserver/ConditionCalculation/CTC_PctgCtctrErrCdnLimNeg_P" /begin REF_CHARACTERISTIC CTC_PctgCtctrErrCdnLimNeg_P /end REF_CHARACTERISTIC /end GROUP
/begin GROUP S93_CTC_PctgCtctrErrCdnLimPos_P "swc_CtctrTranCtl/CtcrtTranCtl_sys/CtcrtTranCtl/ContactorAgingObserver/ConditionCalculation/CTC_PctgCtctrErrCdnLimPos_P" /begin REF_CHARACTERISTIC CTC_PctgCtctrErrCdnLimPos_P /end REF_CHARACTERISTIC /end GROUP
/begin GROUP S93_CTC_PctgCtctrErrCdnLimPrech_P "swc_CtctrTranCtl/CtcrtTranCtl_sys/CtcrtTranCtl/ContactorAgingObserver/ConditionCalculation/CTC_PctgCtctrErrCdnLimPrech_P" /begin REF_CHARACTERISTIC CTC_PctgCtctrErrCdnLimPrech_P /end REF_CHARACTERISTIC /end GROUP
/begin GROUP S93_CTC_PctgCtctrWarnCdnLimNeg_P "swc_CtctrTranCtl/CtcrtTranCtl_sys/CtcrtTranCtl/ContactorAgingObserver/ConditionCalculation/CTC_PctgCtctrWarnCdnLimNeg_P" /begin REF_CHARACTERISTIC CTC_PctgCtctrWarnCdnLimNeg_P /end REF_CHARACTERISTIC /end GROUP
/begin GROUP S93_CTC_PctgCtctrWarnCdnLimPos_P "swc_CtctrTranCtl/CtcrtTranCtl_sys/CtcrtTranCtl/ContactorAgingObserver/ConditionCalculation/CTC_PctgCtctrWarnCdnLimPos_P" /begin REF_CHARACTERISTIC CTC_PctgCtctrWarnCdnLimPos_P /end REF_CHARACTERISTIC /end GROUP
/begin GROUP S93_CTC_PctgCtctrWarnCdnLimPrech_P "swc_CtctrTranCtl/CtcrtTranCtl_sys/CtcrtTranCtl/ContactorAgingObserver/ConditionCalculation/CTC_PctgCtctrWarnCdnLimPrech_P" /begin REF_CHARACTERISTIC CTC_PctgCtctrWarnCdnLimPrech_P /end REF_CHARACTERISTIC /end GROUP
/begin GROUP S94_Balancing_Current_Calculation_and_Compensation_Loop "swc_BatBalnCtl/BBC_100ms_sys/BBC_100ms_sys/BatBalnCtl_BalnIClcn/Subsystem/Balancing Current Calculation Loop/Balancing Current Calculation and Compensation Loop" /begin SUB_GROUP S96_BBC_NrBalnCtMax_P S96_BBC_RCellBaln_P /end SUB_GROUP /end GROUP
/begin GROUP S96_BBC_NrBalnCtMax_P "swc_BatBalnCtl/BBC_100ms_sys/BBC_100ms_sys/BatBalnCtl_BalnIClcn/Subsystem/Balancing Current Calculation Loop/Balancing Current Calculation and Compensation Loop/BBC_NrBalnCtMax_P" /begin REF_CHARACTERISTIC BBC_NrBalnCtMax_P /end REF_CHARACTERISTIC /end GROUP
/begin GROUP swc_BatBalnCtl "swc_BatBalnCtl" ROOT /begin SUB_GROUP Root_BBC_100ms_sys /end SUB_GROUP
 /begin REF_MEASUREMENT BBC_AcvCellReqSrc BBC_AcvCellReqTgt BBC_AcvCellSrcReqdOutp BBC_AcvCellTgtReqdOutp BBC_CtrBalnReqdOutp BBC_ICellBaln BBC_NrMdulReqSrc BBC_NrMdulReqTgt BBC_NrMdulSrcReqdOutp BBC_NrMdulTgtReqdOutp BBC_bAcvBaln BBC_bAcvMdulBaln /end REF_MEASUREMENT
/end GROUP
/begin GROUP swc_BatChCtl "swc_BatChCtl" ROOT /begin SUB_GROUP Root_AC_10ms_sys Root_BCC_10ms_sys Root_DC_10ms_sys /end SUB_GROUP
 /begin REF_MEASUREMENT BCC_AcvCellURchd BCC_AcvSocRchd BCC_AcvUTotRchd BCC_ErrInfo BCC_IChReq BCC_IChReqIRV BCC_IDchaReq BCC_IDchaReqIRV BCC_IObcLimn BCC_ModeCh BCC_StAcChReq BCC_StAcSys BCC_StAcSysIRV BCC_StCh BCC_StChAllwdDigIRV BCC_StChCnctDigIRV BCC_StDig10IRV BCC_StDig53IRV BCC_StDig71IRV BCC_StDig73IRV BCC_StPwrUpDigIRV BCC_UChReq BCC_UChReqIRV BCC_UObcLimn BCC_bAcvHvbatFull BCC_bAcvHvbatFullIRV BCTE_TiBatChByMinuTot BCTE_TiBatChMaxByHour BCTE_TiBatChMaxByMinu BCTE_TiBatDchaByMinuTot EVCSH_AcvChSuspdByChrgr EVCSH_ChEndTypIRV EVCSH_ChMode EVCSH_ErrMsgChrgrChRdy EVCSH_ErrMsgChrgrChSts EVCSH_ErrMsgChrgrChStstc EVCSH_ErrMsgChrgrChSuspd EVCSH_ErrMsgChrgrIdfcNotRdy EVCSH_ErrMsgChrgrIdfcRdy EVCSH_ErrMsgChrgrSync EVCSH_IChrgrSp EVCSH_IChrgrSpIRV EVCSH_StBatRdy EVCSH_StDcCh EVCSH_StInt EVCSH_StIntIRV EVCSH_StIslnMeasReq EVCSH_UChrgrSp EVCSH_bAcvCfgCmpl EVCSH_bAcvChSeqEnd EVCSH_bAcvDcChReqFromVcu EVCSH_bAcvDcCnctReq EVCSH_bAcvVeh2VehDcha EVCSH_bEnaChrgn EVCSH_bEnaMsgBatCfg EVCSH_bEnaMsgBatCfgPgtn EVCSH_bEnaMsgBatChDmd EVCSH_bEnaMsgBatChSt EVCSH_bEnaMsgBatChStPgtn EVCSH_bEnaMsgBatChSuspd EVCSH_bEnaMsgBatDetdCfg EVCSH_bEnaMsgBatErr EVCSH_bEnaMsgBatHdshk EVCSH_bEnaMsgBatPrvt EVCSH_bEnaMsgBatRcgtn EVCSH_bEnaMsgBatRdy EVCSH_bEnaMsgBatSt EVCSH_bEnaMsgBatStstc EVCSH_bEnaMsgBatT EVCSH_bEnaMsgCellU /end REF_MEASUREMENT
/end GROUP
/begin GROUP swc_BatCoreFct "swc_BatCoreFct" ROOT /begin SUB_GROUP Root_BCF_100ms_sys Root_BCF_10ms_sys /end SUB_GROUP
 /begin REF_MEASUREMENT BCF_CMdulAbsv BCF_CMdulAgiFacFlsNv BCF_CMdulDeltaOfTrip BCF_ChMdulIntglInCTest BCF_ErrInfo BCF_ErrInfo1 BCF_ErrInfo2 BCF_ErrInfo3 BCF_ErrInfo4 BCF_ErrInfo5 BCF_ErrInfo6 BCF_IChActLim1 BCF_IChLim BCF_IChLimInt BCF_IChLimIntIRV BCF_IChMax BCF_IChPredLim BCF_IChPredLim1 BCF_IChPredLimInt BCF_IChPredLimIntIRV BCF_IDchaActLim1 BCF_IDchaLim BCF_IDchaLimInt BCF_IDchaLimIntIRV BCF_IDchaMax BCF_IDchaPredLim BCF_IDchaPredLim1 BCF_IDchaPredLimInt BCF_IDchaPredLimIntIRV BCF_NrMdulMax BCF_PwrChLim BCF_PwrChPredLim BCF_PwrDchaLim BCF_PwrDchaPredLim BCF_PwrMdulLoss BCF_RCellDelta BCF_RMdulAgiFacFlsNv BCF_RMdulDeltaOfTrip BCF_RMdulDeltaSho BCF_RPackInt BCF_SocCell BCF_SocCellDelta BCF_SocCellMax BCF_SocCellMin BCF_SocLimMax BCF_SocLimMin BCF_SocMdul BCF_SocPack BCF_SocPackScld BCF_SohPack BCF_SohRDeltaFlsNv BCF_SohRMdul BCF_SohSocDeltaFlsNv BCF_StAryFlsNv BCF_StLimnId BCF_TCooltMdulOut BCF_TMdulAvgInCTest BCF_TMdulEstimd BCF_TSamplgCtr BCF_TiBatOffForMdulCFlsNv BCF_TiBatOffForMdulRFlsNv BCF_UBatTotInt BCF_UBatTotIntIRV BCF_UCellAvg BCF_UCellMeasdToMdlDelta BCF_UChLim BCF_UChLimInt BCF_UChLimIntIRV BCF_UChPredLim BCF_UChPredLimInt BCF_UChPredLimIntIRV BCF_UDchaLim BCF_UDchaLimInt BCF_UDchaLimIntIRV BCF_UDchaPredLim BCF_UDchaPredLimInt BCF_UDchaPredLimIntIRV BCF_UMdul BCF_UMdulAgiFacErrCt BCF_UMdulOffSho BCF_UPackCircOpen BCF_UPackCircOpenIRV BCF_VldMdlOperCdn BCF_bEnaThrwyFlg BCF_bErrMdulSocInvldFls BCF_bErrMdulSocInvldFlsNv BCF_tmp_rel_1 BCF_tmp_rel_18 BCF_tmp_rel_21 BCF_tmp_rel_26 BCF_tmp_rel_27 BCF_tmp_rel_3 BCF_tmp_rel_31 BCF_tmp_rel_32 BCF_tmp_rel_36 BCF_tmp_rel_37 /end REF_MEASUREMENT
/end GROUP
/begin RECORD_LAYOUT Lookup1D_FLOAT32_IEEE FNC_VALUES 1 FLOAT32_IEEE COLUMN_DIR DIRECT /end RECORD_LAYOUT
/begin RECORD_LAYOUT Lookup1D_UBYTE FNC_VALUES 1 UBYTE COLUMN_DIR DIRECT /end RECORD_LAYOUT
/begin RECORD_LAYOUT Lookup1D_X_FLOAT32_IEEE AXIS_PTS_X 1 FLOAT32_IEEE INDEX_INCR DIRECT /end RECORD_LAYOUT
/begin RECORD_LAYOUT Lookup1D_X_UBYTE AXIS_PTS_X 1 UBYTE INDEX_INCR DIRECT /end RECORD_LAYOUT
/begin RECORD_LAYOUT Lookup1D_X_ULONG AXIS_PTS_X 1 ULONG INDEX_INCR DIRECT /end RECORD_LAYOUT
/begin RECORD_LAYOUT Scalar_BOOLEAN FNC_VALUES 1 UBYTE COLUMN_DIR DIRECT /end RECORD_LAYOUT
/begin RECORD_LAYOUT Scalar_FLOAT32_IEEE FNC_VALUES 1 FLOAT32_IEEE COLUMN_DIR DIRECT /end RECORD_LAYOUT
/begin RECORD_LAYOUT Scalar_UBYTE FNC_VALUES 1 UBYTE COLUMN_DIR DIRECT /end RECORD_LAYOUT
/begin RECORD_LAYOUT Scalar_ULONG FNC_VALUES 1 ULONG COLUMN_DIR DIRECT /end RECORD_LAYOUT
/begin RECORD_LAYOUT Scalar_UWORD FNC_VALUES 1 UWORD COLUMN_DIR DIRECT /end RECORD_LAYOUT
/begin RECORD_LAYOUT SSV__UBYTE_S AXIS_PTS_X 1 UBYTE INDEX_INCR DIRECT /end RECORD_LAYOUT
/begin RECORD_LAYOUT SSV__UWORD_S AXIS_PTS_X 1 UWORD INDEX_INCR DIRECT /end RECORD_LAYOUT
/begin RECORD_LAYOUT SSV__ULONG_S AXIS_PTS_X 1 ULONG INDEX_INCR DIRECT /end RECORD_LAYOUT
/begin RECORD_LAYOUT SSV__SBYTE_S AXIS_PTS_X 1 SBYTE INDEX_INCR DIRECT /end RECORD_LAYOUT
/begin RECORD_LAYOUT SSV__SWORD_S AXIS_PTS_X 1 SWORD INDEX_INCR DIRECT /end RECORD_LAYOUT
/begin RECORD_LAYOUT SSV__SLONG_S AXIS_PTS_X 1 SLONG INDEX_INCR DIRECT /end RECORD_LAYOUT
/begin RECORD_LAYOUT SSV__FLOAT32_IEEE_S AXIS_PTS_X 1 FLOAT32_IEEE INDEX_INCR DIRECT /end RECORD_LAYOUT
/end MODULE
/end PROJECT
